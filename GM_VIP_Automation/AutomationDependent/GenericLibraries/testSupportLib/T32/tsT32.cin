/*@!Encoding:1252*/
//  ====================================================
//   VEONEER - Functions for T32
//  ====================================================
//
//  File name: tsT32.cin
//
//  Created(DD.MM.YYYY): 04.05.2022
//
//  Description: Functions for T32 library
//          
//  --------------------------------------------------------------------
includes
{

  #include "..\..\controlLib\T32\cT32.cin"
}

variables
{
  char msgInfo[1024];
  // Updated by A_DBGR_BreakpointSet() after each call.
  // Test cases can inspect this to detect symbol-not-found failures and
  // use A_DBGR_BreakpointSet_AbortOnFail() (which calls testCaseFail()) before
  // wasting time on GO/waitForNotRunning that can never succeed.
  byte sv_T32_LastBreakpointSetOk;
}

/// <GENERIC>
/*! void  A_DBGR_Go()
*  \brief Function that sends GO command.
* 
*  \return no return
*
* Change History: 
* Date(DD.MM.YY)        Author          Change info                                                          
*   
* 31.08.20              CrJu         Refactoring the code.
* 16.02.22              IuSo         Refactoring the variable chT32Cmd.
*/
export testfunction A_DBGR_Go()
{
  long lApiExitCode[1];
  char chApiMessage[512];
  char chT32Cmd[128];
  byte bResultAction;
  byte bDebugFlag;
  char chPassText[250];
  char chFailText[250];
  char chAction[250];
  
  bDebugFlag = NotOk;
  bResultAction = NotOk;


  writeDbgLevel (DebugFuncCalls , "Function A_DBGR_Go() checking if already running.");
  if (isRunning())
  {
    snprintf(chPassText, elcount(chPassText), "ECU is already running.");
    if((byte)DebugFuncInternal & bDebugFlag)
      writeDbgLevel (DebugFuncInternal, "PASS: %s.", chPassText);
    vFctn_REPORTActionEvaluation(chPassText, PASS);
    return;
  }


  writeDbgLevel (DebugFuncCalls , "Function A_DBGR_Go() entered.");
  snprintf(chT32Cmd, elcount(chT32Cmd),"\"GO\"");
  lFctn_CallT32API(chT32Cmd, chApiMessage, lApiExitCode);
  
  //Print the action text to the raport
  snprintf(chAction, elcount(chAction), "Set the ECU in running mode.");
  bResultAction = bFctn_REPORTAction(chAction);
  
  if(bResultAction)
  {
    if (lApiExitCode[0] == 0)
    {
      snprintf(chPassText, elcount(chPassText), "ECU is running.");
      if((byte)DebugFuncInternal & bDebugFlag)
        writeDbgLevel (DebugFuncInternal, "PASS: %s.", chPassText);
      vFctn_REPORTActionEvaluation(chPassText, PASS);
    }
    else // API Command Fail
    {
      snprintf(chFailText, elcount(chFailText), "ECU is NOT running!.\nAPI error message: %s", chApiMessage);
      if((byte)DebugFuncInternal & bDebugFlag)
        writeDbgLevel (DebugFuncInternal, "FAIL: %s.", chFailText);
      vFctn_REPORTActionEvaluation(chFailText, FAIL);
    }
  }
  else//The reporting function has failed
  {
    snprintf(chFailText, elcount(chFailText), "ERROR: The action text could not be added in the Report. bFctn_REPORTAction() return: %d.", bResultAction);
    if((byte)DebugFuncInternal & bDebugFlag)
      writeDbgLevel (DebugFuncInternal, "ERROR: The action text could not be added in the Report. bFctn_REPORTAction() return: %d.", bResultAction);
    vFctn_REPORTActionEvaluation(chFailText, FAIL);
  }

  // Brief wait to ensure ECU has actually started executing before the caller proceeds.
  // For example, a downstream call to E_DBGR_BreakpointCheckForHalt (which calls
  // waitForNotRunning) could observe a not-running state prematurely if the ECU
  // has not yet transitioned into Running state after GO was issued.
  waitForRunning(250);
}

export testfunction A_DBGR_GoUp()
{
  // same implementation as go, but used go.up
  long lApiExitCode[1];
  char chApiMessage[512];

  lFctn_CallT32API("\"Go.Up\"", chApiMessage, lApiExitCode);
  // cc_dwT32_MaxTimeout (3 s) is sufficient; the original 10 s was excessive.
  waitForNotRunning(cc_dwT32_MaxTimeout);
}

export testfunction  A_DBGR_StepOver()
{
    long lApiExitCode[1];
    char chApiMessage[512];

    lFctn_CallT32API("\"STEP.OVER\"", chApiMessage, lApiExitCode);
    // cc_dwT32_MaxTimeout (3 s) is sufficient; the original 10 s was excessive.
    waitForNotRunning(cc_dwT32_MaxTimeout);
}


/// <GENERIC>
/*! void  A_DBGR_Go_Safe()
*  \brief Function that sends GO command with reset detection and retry logic.
*         If the ECU stops at the reset vector (PP register = 0A0000000), it will
*         automatically retry the GO command up to 25 times.
*
*  \return no return
*
* Change History:
* Date(DD.MM.YY)        Author          Change info
*
* 31.01.26              Copilot         Created function with soft-reset detection and retry logic.
*/
export testfunction A_DBGR_Go_Safe()
{
  long lApiExitCode[1];
  char chApiMessage[512];
  char chT32Cmd[128];
  char chPPValue[128];
  byte bResultAction;
  byte bDebugFlag;
  char chPassText[250];
  char chFailText[250];
  char chAction[250];
  int maxRetries;
  int retryCount;

  bDebugFlag = NotOk;
  bResultAction = NotOk;
  maxRetries = 25;
  retryCount = 0;

  writeDbgLevel(DebugFuncCalls, "Function A_DBGR_Go_Safe() checking if already running.");
  if (isRunning())
  {
    snprintf(chPassText, elcount(chPassText), "ECU is already running.");
    if((byte)DebugFuncInternal & bDebugFlag)
      writeDbgLevel(DebugFuncInternal, "PASS: %s.", chPassText);
    vFctn_REPORTActionEvaluation(chPassText, PASS);
    return;
  }

  writeDbgLevel(DebugFuncCalls, "Function A_DBGR_Go_Safe() entered.");

  //Print the action text to the raport
  snprintf(chAction, elcount(chAction), "Set the ECU in running mode (safe mode with reset detection).");
  bResultAction = bFctn_REPORTAction(chAction);

    while (retryCount < maxRetries)
    {
      snprintf(chT32Cmd, elcount(chT32Cmd), "\"GO\"");
      lFctn_CallT32API(chT32Cmd, chApiMessage, lApiExitCode);

      testWaitForTimeoutSilent(200);  // Allow ECU to hit the soft-reset.  It may not be instant, so giving a small buffer.
      if (isRunning())
      {
        if (retryCount > 0)
        {
          snprintf(chPassText, elcount(chPassText), "ECU is running. Soft-Reset Recovered after %d retries.", retryCount);
        }
        else
        {
          snprintf(chPassText, elcount(chPassText), "ECU is running.");
        }
        if((byte)DebugFuncInternal & bDebugFlag)
          writeDbgLevel(DebugFuncInternal, "PASS: %s.", chPassText);
        vFctn_REPORTActionEvaluation(chPassText, PASS);
        return;
      }

      // ECU is not running, check if stopped at reset vector
      readPPRegister(chPPValue);

      if (strncmp(chPPValue, "0A0000000", 9) == 0)
      {
        if((byte)DebugFuncInternal & bDebugFlag)
          writeDbgLevel(DebugFuncInternal, "WARNING: Soft-Reset Detected!");
        retryCount++;
      }
      else
      {
        // Stopped for another reason (breakpoint, etc.) - exit normally
        snprintf(chPassText, elcount(chPassText), "ECU stopped (breakpoint or other reason).");
        if((byte)DebugFuncInternal & bDebugFlag)
          writeDbgLevel(DebugFuncInternal, "PASS: %s.", chPassText);
        vFctn_REPORTActionEvaluation(chPassText, PASS);
        return;
      }
    }

    // Max retries exhausted
    snprintf(chFailText, elcount(chFailText), "ECU is NOT running! Indefinite Soft-Resets Detected after %d retries.", maxRetries);
    if((byte)DebugFuncInternal & bDebugFlag)
      writeDbgLevel(DebugFuncInternal, "FAIL: %s.", chFailText);
    vFctn_REPORTActionEvaluation(chFailText, FAIL);
}


/// <GENERIC>
/*! void  A_DBGR_Break()
*  \brief Function that STOP the ECU from running.
* 
*  \return no return
*
* Change History: 
* Date(DD.MM.YY)        Author          Change info                                                          
*   
* 31.08.20              CrJu         Refactoring the code.
* 16.02.22              IuSo         Refactoring the variable chT32Cmd.
*/
void A_DBGR_Break()
{
  long lApiExitCode[1];
  char chApiMessage[512];
  char chT32Cmd[128];
  byte bResultAction;
  byte bDebugFlag;
  char chPassText[250];
  char chFailText[250];
  char chAction[250];

  bDebugFlag = NotOk;
  bResultAction = NotOk;

  writeDbgLevel (DebugFuncCalls , "Function A_DBGR_Break() entered.");

  snprintf(chT32Cmd, elcount(chT32Cmd),"\"BREAK\"");
  lFctn_CallT32API(chT32Cmd, chApiMessage, lApiExitCode);

  //Print the action text to the raport
  snprintf(chAction, elcount(chAction), "Stop the ECU from running mode.");
  bResultAction = bFctn_REPORTAction(chAction);

  if(bResultAction)
  {
    if (lApiExitCode[0] == 0)
    {
      snprintf(chPassText, elcount(chPassText), "ECU is stopped.");
      if((byte)DebugFuncInternal & bDebugFlag)
        writeDbgLevel (DebugFuncInternal, "PASS: %s.", chPassText);
      vFctn_REPORTActionEvaluation(chPassText, PASS);
    }
    else // API Command Fail
    {
      snprintf(chFailText, elcount(chFailText), "API error message: %s", chApiMessage);
      if((byte)DebugFuncInternal & bDebugFlag)
        writeDbgLevel (DebugFuncInternal, "FAIL: %s.", chFailText);
      vFctn_REPORTActionEvaluation(chFailText, FAIL);
    }
  }
  else//The reporting function has failed
  {
    snprintf(chFailText, elcount(chFailText), "ERROR: The action text could not be added in the Report. bFctn_REPORTAction() return: %d.", bResultAction);
    if((byte)DebugFuncInternal & bDebugFlag)
      writeDbgLevel (DebugFuncInternal, "ERROR: The action text could not be added in the Report. bFctn_REPORTAction() return: %d.", bResultAction);
    vFctn_REPORTActionEvaluation(chFailText, FAIL);
  }
}

/// <GENERIC>
/*! void A_DBGR_R()
*  \brief Function that reset the ECU without reloading symbols
*
*  \return no return
*
* Change History: 
* Date(DD.MM.YY)        Author          Change info                                                          
*   
* 16.09.20              CrJu         Refactoring the code.
*/
void A_DBGR_R()
{
  long lResult;
  char chCommand[1024];
  char chAction[250];
  char chPassText[250];
  char chFailText[250];
  long lEvaluationResult;
  char chApiMessage[512];
  char chT32Cmd[128] = "";
  long lApiExitCode[1];
  byte bResultAction;
  byte bDebugFlag;
  
  // initial values
  lResult = Error;
  bResultAction = NotOk;
  bDebugFlag = NotOk;
  lEvaluationResult = Error;
  
  writeDbgLevel (DebugFuncCalls , "Function A_DBGR_R() entered.");
  
  snprintf(chT32Cmd, elcount(chT32Cmd),"\"SYStem.RESetTarget\"");
  lResult = lFctn_CallT32API(chT32Cmd, chApiMessage, lApiExitCode);
  // Brief wait to allow SYStem.RESetTarget to complete the target reset transition.
  // After reset the ECU briefly passes through Down state (0) before reaching Halted/Stopped.
  // isRunning() checks STATE.RUN()==TRUE(), so both Down and Halted satisfy "not running".
  // This wait ensures the state machine has advanced past any transient Running phase.
  testWaitForTimeoutSilent(250);

  //Print the action text to the raport
  snprintf(chAction, elcount(chAction), "Send the 'R' command to T32.");
  bResultAction = bFctn_REPORTAction(chAction);
  
  if(bResultAction)
  { 
    if ((lResult==Ok)||(lResult==NotOk))
    {

      if ((waitForNotRunning(cc_dwT32_MaxTimeout)) && (NotOk != lFctn_G_T32_GET_STATE())) // condition evaluation has returned: True
      {
        snprintf(chPassText, elcount(chPassText), "The ECU has been reseted.");
        if((byte)DebugFuncInternal & bDebugFlag)
          writeDbgLevel (DebugFuncInternal, "PASS: %s.", chPassText);
        vFctn_REPORTActionEvaluation(chPassText, PASS);
      }
      else
      {
        snprintf(chFailText, elcount(chFailText), "API is missing or couldn't be executed for command R !!!");
        if((byte)DebugFuncInternal & bDebugFlag)
          writeDbgLevel (DebugFuncInternal, "FAIL: %s.", chFailText);
        vFctn_REPORTActionEvaluation(chFailText, FAIL);
      }
    }
    else
    {
      snprintf(chFailText, elcount(chFailText), "API is missing or couldn't be executed for command R !!!");
      if((byte)DebugFuncInternal & bDebugFlag)
        writeDbgLevel (DebugFuncInternal, "Error: %s.", chFailText);
      vFctn_REPORTActionEvaluation(chFailText, FAIL);
    }
  }
  else//The reporting function has failed
  {
    snprintf(chFailText, elcount(chFailText), "ERROR: The action text could not be added in the Report. bFctn_REPORTAction() return: %d.", bResultAction);
    if((byte)DebugFuncInternal & bDebugFlag)
      writeDbgLevel (DebugFuncInternal, "ERROR: The action text could not be added in the Report. bFctn_REPORTAction() return: %d.", bResultAction);
    vFctn_REPORTActionEvaluation(chFailText, FAIL);
  }
}

/// <GENERIC>
/*! void A_DBGR_RnGo()
*  \brief Function that reset the ECU without reloading symbols, deletes all the BPs & put the ECU in running mode.
*
*  \return no return
*
* Change History: 
* Date(DD.MM.YY)        Author          Change info                                                          
*   
* 16.09.20              CrJu         Refactoring the code.
*/
void A_DBGR_RnGo()
{
  long lResult;
  char chCommand[1024];
  char chAction[250];
  char chPassText[250];
  char chFailText[250];
  long lEvaluationResult;
  char chApiMessage[512];
  char chT32Cmd[128] = "";
  long lApiExitCode[1];
  byte bResultAction;
  byte bDebugFlag;
  
  // initial values
  lResult = Error;
  bResultAction = NotOk;
  bDebugFlag = NotOk;
  lEvaluationResult = Error;
  
  writeDbgLevel (DebugFuncCalls , "Function A_DBGR_RnGo() entered.");


  A_DBGR_R();
  A_DBGR_Go();

  //Print the action text to the raport
  snprintf(chAction, elcount(chAction), "Send the 'RnGO' command to T32.");
  bResultAction = bFctn_REPORTAction(chAction);
  
  if(bResultAction)
  { 
    if ((lResult==Ok)||(lResult==NotOk))
    {
      lEvaluationResult = isRunning();

      if (lEvaluationResult) // condition evaluation has returned: True 
      {
        snprintf(chPassText, elcount(chPassText), "The ECU has been reseted and now is in Running.");
        if((byte)DebugFuncInternal & bDebugFlag)
          writeDbgLevel (DebugFuncInternal, "PASS: %s.", chPassText);
        vFctn_REPORTActionEvaluation(chPassText, PASS);
      }
      else
      {
        snprintf(chFailText, elcount(chFailText), "API is missing or couldn't be executed for command RnGO !!!");
        if((byte)DebugFuncInternal & bDebugFlag)
          writeDbgLevel (DebugFuncInternal, "FAIL: %s.", chFailText);
        vFctn_REPORTActionEvaluation(chFailText, FAIL);
      }
    }
    else
    {
      snprintf(chFailText, elcount(chFailText), "API is missing or couldn't be executed for command RnGO !!!");
      if((byte)DebugFuncInternal & bDebugFlag)
        writeDbgLevel (DebugFuncInternal, "Error: %s.", chFailText);
      vFctn_REPORTActionEvaluation(chFailText, FAIL);
    }
  }
  else//The reporting function has failed
  {
    snprintf(chFailText, elcount(chFailText), "ERROR: The action text could not be added in the Report. bFctn_REPORTAction() return: %d.", bResultAction);
    if((byte)DebugFuncInternal & bDebugFlag)
      writeDbgLevel (DebugFuncInternal, "ERROR: The action text could not be added in the Report. bFctn_REPORTAction() return: %d.", bResultAction);
    vFctn_REPORTActionEvaluation(chFailText, FAIL);
  }
}

/// <GENERIC>
/*! void  A_DBGR_RunCommand(char aCommand[])
*  \brief Function that RUN practice command line.
* 
*  \param[in] aCommand - the command to run
*
*  \return no return
*
* Change History: 
* Date(DD.MM.YY)        Author          Change info                                                          
*   
* 10.09.20              CrJu         Refactoring the code.
*/
void A_DBGR_RunCommand(char aCommand[])
{
  long lApiExitCode[1];
  char chApiMessage[512];
  byte bResultAction;
  byte bDebugFlag;
  char chPassText[250];
  char chFailText[250];
  char chAction[250];
  char chT32Cmd[128] = "";
 
  bDebugFlag = NotOk;
  bResultAction = NotOk;
  snprintf(chT32Cmd, elcount(chT32Cmd), "\"%s\"", aCommand);
 
  writeDbgLevel (DebugFuncCalls , "Function A_DBGR_RunCommand() entered.");
  
  //Print the action text to the raport
  snprintf(chAction, elcount(chAction), "Run practice cmm line: '%s'.", aCommand);
  bResultAction = bFctn_REPORTAction(chAction);
  
  if(bResultAction)
  {
    lFctn_CallT32API(chT32Cmd, chApiMessage, lApiExitCode);
  
    if (lApiExitCode[0] == 0)
    {
      snprintf(chPassText, elcount(chPassText), "Command '%s' was succesfully executed.", aCommand);
      if((byte)DebugFuncInternal & bDebugFlag)
        writeDbgLevel (DebugFuncInternal, "PASS: %s.", chPassText);
      vFctn_REPORTActionEvaluation(chPassText, PASS);
    }
    else // API Command Fail
    {
      snprintf(chFailText, elcount(chFailText), "API error message: %s", chApiMessage);
      if((byte)DebugFuncInternal & bDebugFlag)
        writeDbgLevel (DebugFuncInternal, "FAIL: %s.", chFailText);
      vFctn_REPORTActionEvaluation(chFailText, FAIL);
    }
  }
  else//The reporting function has failed
  {
    snprintf(chFailText, elcount(chFailText), "ERROR: The action text could not be added in the Report. bFctn_REPORTAction() return: %d.", bResultAction);
    if((byte)DebugFuncInternal & bDebugFlag)
      writeDbgLevel (DebugFuncInternal, "ERROR: The action text could not be added in the Report. bFctn_REPORTAction() return: %d.", bResultAction);
    vFctn_REPORTActionEvaluation(chFailText, FAIL);
  }
}

/// <GENERIC>
/*! void E_DBGR_CheckState(char aAddress[])
*  \brief Function to verify current T32 state
*  \param[in]   aT32State      - Expected T32 State (Values : T32_State_Down, ..., T32_State_Running --> See eT32State)
*  \return None
*
* Change History: 
* Date(DD.MM.YY)        Author          Change info                                                          
* 03.11.21              AnPu            Created and implemented
* 24.11.21				      AnPu			      Implement remarks after review
*/
void E_DBGR_CheckState(enum eT32State aT32State)
{
  long lState;
  char chPassText[250];
  char chFailText[250];
  byte bDebugFlag;
  
  bDebugFlag = NotOk;
  lState = Error;
  
  writeDbgLevel (DebugFuncCalls , "Function E_DBGR_CheckState() called.");
  lState = lFctn_G_T32_GET_STATE(msgInfo);
  if (lState == aT32State)
    {
      snprintf(chPassText, elcount(chPassText),  msgInfo);
      if((byte)DebugFuncInternal & bDebugFlag)
        writeDbgLevel (DebugFuncInternal, "PASS: %s.", chPassText);
      vFctn_REPORTStepEvaluation(chPassText, PASS);
    }
    else{
      snprintf(chFailText, elcount(chFailText),  msgInfo);
      if((byte)DebugFuncInternal & bDebugFlag)
        writeDbgLevel (DebugFuncInternal, "FAIL: %s.", chFailText);
      vFctn_REPORTStepEvaluation(chFailText, FAIL);
    }

  
  if((byte)DebugFuncInternal & bDebugFlag)
    writeDbgLevel (DebugFuncInternal, msgInfo);
}

/// <GENERIC>
/*! void E_DBGR_CheckConnection()
*  \brief Verifies that the Lauterbach Trace32 debugger is connected to the ECU.
*         T32 is considered connected when its state is Halted (1), Stopped (2),
*         or Running (3). A Down (0) or Error (-1) state indicates the debugger is
*         not attached. Use at bench startup to confirm hardware is ready before
*         running tests.
*
*  \return no return
*
* Change History:
* Date(DD.MM.YY)        Author          Change info
*
* 04.03.26              Copilot         Created for bench pre-deployment consistency check.
*/
void E_DBGR_CheckConnection()
{
  long lState;
  char chPassText[250];
  char chFailText[250];
  byte bDebugFlag;

  bDebugFlag = NotOk;
  writeDbgLevel(DebugFuncCalls, "Function E_DBGR_CheckConnection() entered.");

  lState = lFctn_G_T32_GET_STATE(msgInfo);

  if (lState == T32_State_Halted || lState == T32_State_Stopped || lState == T32_State_Running)
  {
    snprintf(chPassText, elcount(chPassText), "Lauterbach debugger connected. %s", msgInfo);
    if ((byte)DebugFuncInternal & bDebugFlag)
      writeDbgLevel(DebugFuncInternal, "PASS: %s.", chPassText);
    vFctn_REPORTStepEvaluation(chPassText, PASS);
  }
  else
  {
    snprintf(chFailText, elcount(chFailText), "Lauterbach debugger NOT connected (T32 state: %ld). %s Check hardware connection and T32 startup.", lState, msgInfo);
    if ((byte)DebugFuncInternal & bDebugFlag)
      writeDbgLevel(DebugFuncInternal, "FAIL: %s.", chFailText);
    vFctn_REPORTStepEvaluation(chFailText, FAIL);
  }
}

/// <GENERIC>
/*! void A_DBGR_EnsureT32Running_AutoDetect()
*  \brief Zero-argument variant of A_DBGR_EnsureT32Running() that automatically
*         discovers the Trace32 installation without requiring the caller to
*         hard-code any paths.
*
*         Algorithm:
*           1. Searches standard installation directories for a config.t32 and
*              a matching T32 executable via lFctn_T32_AutoDetect().  Directories
*              searched (in order): C:\T32\bin, C:\T32, C:\t32\bin, C:\t32.
*           2. Parses the NETASSIST PORT= value from the found config.t32 using
*              lFctn_T32_ParseConfigPort() and rewrites t32.ini with the correct
*              port via vFctn_T32_SyncT32ini() so that every T32_API.exe call
*              connects to the right socket without any API errors.
*           3. Delegates to A_DBGR_EnsureT32Running(exePath, configPath) which
*              checks the T32 state and launches Trace32 if it is not yet running.
*
*         Call this function at the start of a testcase or in a testcase setup
*         block when the T32 installation path is unknown or may vary between
*         test benches.
*
*  \return no return
*
* Change History:
* Date(DD.MM.YY)        Author          Change info
*
* 15.03.26              Copilot         Created – zero-arg wrapper using lFctn_T32_AutoDetect().
*/
export testfunction A_DBGR_EnsureT32Running_AutoDetect()
{
  char chFoundExePath[256];
  char chFoundConfigPath[256];
  char chAction[250];
  char chPassText[250];
  char chFailText[250];
  long lDetectResult;
  long lPort;
  byte bResultAction;
  byte bDebugFlag;

  bDebugFlag = NotOk;
  writeDbgLevel(DebugFuncCalls, "Function A_DBGR_EnsureT32Running_AutoDetect() entered.");

  // Step 1: report the auto-detect action.
  snprintf(chAction, elcount(chAction), "Auto-detect Trace32 installation and synchronize t32.ini.");
  bResultAction = bFctn_REPORTAction(chAction);

  if (!bResultAction)
  {
    snprintf(chFailText, elcount(chFailText), "ERROR: The action text could not be added in the Report. bFctn_REPORTAction() return: %d.", bResultAction);
    if ((byte)DebugFuncInternal & bDebugFlag)
      writeDbgLevel(DebugFuncInternal, "ERROR: %s.", chFailText);
    vFctn_REPORTActionEvaluation(chFailText, FAIL);
    return;
  }

  // Step 2: search for a T32 installation.
  lDetectResult = lFctn_T32_AutoDetect(chFoundExePath, chFoundConfigPath);

  if (lDetectResult != Ok)
  {
    snprintf(chFailText, elcount(chFailText),
             "Trace32 installation not found. "
             "Checked: C:\\T32\\bin, C:\\T32, C:\\t32\\bin, C:\\t32. "
             "Verify that Trace32 is installed and config.t32 is present.");
    if ((byte)DebugFuncInternal & bDebugFlag)
      writeDbgLevel(DebugFuncInternal, "FAIL: %s.", chFailText);
    vFctn_REPORTActionEvaluation(chFailText, FAIL);
    return;
  }

  write("A_DBGR_EnsureT32Running_AutoDetect: found exe='%s', config='%s'.",
        chFoundExePath, chFoundConfigPath);

  // Step 3: parse PORT= from config.t32 and sync t32.ini so T32_API.exe
  // uses the correct NETASSIST port (prevents API connection errors).
  lPort = lFctn_T32_ParseConfigPort(chFoundConfigPath);
  if (lPort > 0)
  {
    write("A_DBGR_EnsureT32Running_AutoDetect: config.t32 PORT=%d. Updating t32.ini.", lPort);
    vFctn_T32_SyncT32ini(lPort);
    snprintf(chPassText, elcount(chPassText),
             "Trace32 installation detected at '%s'. t32.ini synchronized with PORT=%d.",
             chFoundConfigPath, lPort);
  }
  else
  {
    write("A_DBGR_EnsureT32Running_AutoDetect: PORT not found in config.t32 – t32.ini not updated.");
    snprintf(chPassText, elcount(chPassText),
             "Trace32 installation detected at '%s'. PORT not in config.t32; t32.ini unchanged.",
             chFoundConfigPath);
  }

  vFctn_REPORTActionEvaluation(chPassText, PASS);

  // Step 4: delegate to A_DBGR_EnsureT32Running which checks the T32 state
  // and launches Trace32 if it is not yet running.
  A_DBGR_EnsureT32Running(chFoundExePath, chFoundConfigPath);
}


/// <GENERIC>
/*! void A_DBGR_EnsureT32Running(char aT32ExePath[], char aT32ConfigFile[])
*  \brief Ensures that Trace32 is connected before running test cases.
*         Checks the current T32 state.  If the state is Down (0) or Error (-1)
*         (i.e. T32 is not running / not connected), it automatically launches T32
*         using lFctn_T32_Launch() and reports the result as a test step.
*         If T32 is already connected the step is reported as PASS immediately.
*
*         Call this function at the start of a testcase or in a testcase setup
*         block to guarantee that T32 is available before issuing any debugger
*         commands.
*
*  \param[in] aT32ExePath    - Full path to the Trace32 executable
*                              (e.g. "C:\\T32\\t32marm.exe").
*  \param[in] aT32ConfigFile - Full path to the T32 configuration file
*                              (e.g. "C:\\T32\\config.t32").
*
*  \return no return
*
* Change History:
* Date(DD.MM.YY)        Author          Change info
*
* 10.03.26              Copilot         Created – auto-starts T32 when not connected.
*/
export testfunction A_DBGR_EnsureT32Running(char aT32ExePath[], char aT32ConfigFile[])
{
  long lState;
  long lLaunchResult;
  char chAction[250];
  char chPassText[250];
  char chFailText[250];
  byte bResultAction;
  byte bDebugFlag;

  bDebugFlag = NotOk;
  writeDbgLevel(DebugFuncCalls, "Function A_DBGR_EnsureT32Running() entered.");

  // Add the action to the report before any evaluation call.
  snprintf(chAction, elcount(chAction), "Ensure Trace32 is connected and running.");
  bResultAction = bFctn_REPORTAction(chAction);

  if (!bResultAction)
  {
    snprintf(chFailText, elcount(chFailText), "ERROR: The action text could not be added in the Report. bFctn_REPORTAction() return: %d.", bResultAction);
    if ((byte)DebugFuncInternal & bDebugFlag)
      writeDbgLevel(DebugFuncInternal, "ERROR: %s.", chFailText);
    vFctn_REPORTActionEvaluation(chFailText, FAIL);
    return;
  }

  lState = lFctn_G_T32_GET_STATE(msgInfo);

  if (lState == T32_State_Halted || lState == T32_State_Stopped || lState == T32_State_Running)
  {
    snprintf(chPassText, elcount(chPassText), "Trace32 already connected (state=%ld). %s", lState, msgInfo);
    if ((byte)DebugFuncInternal & bDebugFlag)
      writeDbgLevel(DebugFuncInternal, "PASS: %s.", chPassText);
    vFctn_REPORTActionEvaluation(chPassText, PASS);
    return;
  }

  // T32 is down or unreachable – try to launch it.
  write("A_DBGR_EnsureT32Running: T32 state=%ld. Attempting to launch '%s'...", lState, aT32ExePath);
  lLaunchResult = lFctn_T32_Launch(aT32ExePath, aT32ConfigFile);

  if (lLaunchResult == Ok)
  {
    snprintf(chPassText, elcount(chPassText), "Trace32 launched and connected successfully.");
    if ((byte)DebugFuncInternal & bDebugFlag)
      writeDbgLevel(DebugFuncInternal, "PASS: %s.", chPassText);
    vFctn_REPORTActionEvaluation(chPassText, PASS);
  }
  else
  {
    snprintf(chFailText, elcount(chFailText),
             "Trace32 could not be launched or did not connect within %d ms. "
             "Verify the exe path ('%s') and config file ('%s').",
             cc_dwT32_LaunchTimeout, aT32ExePath, aT32ConfigFile);
    if ((byte)DebugFuncInternal & bDebugFlag)
      writeDbgLevel(DebugFuncInternal, "FAIL: %s.", chFailText);
    vFctn_REPORTActionEvaluation(chFailText, FAIL);
  }
}


/// <BREAKPOINTS>
/*! void  A_DBGR_BreakpointSet(char aAddress[])
*  \brief Function that SET a specific BP.
*         Retries up to cc_nT32_BPSetMaxRetries times with cc_dwT32_BPSetRetryInterval ms
*         delay to handle the case where Trace32 symbol tables are still being resolved
*         after a load.  The module variable sv_T32_LastBreakpointSetOk is set to Ok on
*         success and NotOk on failure so callers can react without changing the return type.
*
*         If all retries up to cc_nT32_BPSetSymbolReloadAt fail, the function issues a
*         SYMBOL.RELOAD command (equivalent to the manual "Reload Symbols" action in the
*         T32 IDE) and waits cc_dwT32_SymbolReloadWait ms before continuing to retry.
*         This eliminates false "symbol not found" failures caused by transient delays
*         in ELF symbol table resolution that occur during unattended automation runs.
* 
*  \param[in] aAddress - name of the BP ("Symbol")
*
*  \return no return
*
* Change History: 
* Date(DD.MM.YY)        Author          Change info                                                          
*   
* 31.08.20              CrJu         Refactoring the code.
* 10.03.26              Copilot      Added retry loop and sv_T32_LastBreakpointSetOk status.
* 10.03.26              Copilot      Added SYMBOL.RELOAD on mid-retry to recover from slow symbol loading.
*/
export testfunction A_DBGR_BreakpointSet(char aAddress[])
{
  long lApiExitCode[1];
  char chApiMessage[512];
  byte bResultAction;
  byte bDebugFlag;
  char chPassText[250];
  char chFailText[250];
  char chAction[250];
  char chT32Cmd[128] = "";
  // Outer double-quotes are required by T32_API.exe to pass the command as a
  // single argument (consistent with all other chT32Cmd strings in this module).
  char chReloadCmd[32] = "\"SYMBOL.RELOAD\"";
  int  nAttempt;
  int  bSymbolReloadDone;
  // Runtime-clamped reload threshold: guards against misconfiguration where
  // cc_nT32_BPSetSymbolReloadAt >= cc_nT32_BPSetMaxRetries (which would silently
  // disable the reload path).  The effective value is always strictly less than
  // cc_nT32_BPSetMaxRetries so at least one retry occurs after SYMBOL.RELOAD.
  int  nEffectiveReloadAt;

  bDebugFlag = NotOk;
  bResultAction = NotOk;
  bSymbolReloadDone = 0;
  sv_T32_LastBreakpointSetOk = NotOk; // pessimistic default

  // Clamp the reload threshold to ensure the invariant: nEffectiveReloadAt < cc_nT32_BPSetMaxRetries.
  if (cc_nT32_BPSetSymbolReloadAt < cc_nT32_BPSetMaxRetries)
    nEffectiveReloadAt = cc_nT32_BPSetSymbolReloadAt;
  else
  {
    nEffectiveReloadAt = cc_nT32_BPSetMaxRetries - 1;
    write("A_DBGR_BreakpointSet: WARNING – cc_nT32_BPSetSymbolReloadAt (%d) >= cc_nT32_BPSetMaxRetries (%d). "
          "Clamping reload threshold to %d.",
          cc_nT32_BPSetSymbolReloadAt, cc_nT32_BPSetMaxRetries, nEffectiveReloadAt);
  }

  writeDbgLevel(DebugFuncCalls, "Function A_DBGR_BreakpointSet() entered.");

  //Print the action text to the report once, before the retry loop.
  snprintf(chAction, elcount(chAction), "Set a specific BreakPoint: %s.", aAddress);
  bResultAction = bFctn_REPORTAction(chAction);

  if (!bResultAction)
  {
    snprintf(chFailText, elcount(chFailText), "ERROR: The action text could not be added in the Report. bFctn_REPORTAction() return: %d.", bResultAction);
    if ((byte)DebugFuncInternal & bDebugFlag)
      writeDbgLevel(DebugFuncInternal, "ERROR: %s.", chFailText);
    vFctn_REPORTActionEvaluation(chFailText, FAIL);
    return;
  }

  snprintf(chT32Cmd, elcount(chT32Cmd), "\"BREAK.SET %s\"", aAddress);

  // Retry loop: T32 symbol tables may still be loading right after a DO/load script.
  // After cc_nT32_BPSetSymbolReloadAt failures a SYMBOL.RELOAD is issued to trigger
  // T32 to re-process the ELF symbol database (the same action as the manual
  // "Reload Symbols" in the T32 IDE).  Retries continue for the remaining attempts.
  for (nAttempt = 1; nAttempt <= cc_nT32_BPSetMaxRetries; nAttempt++)
  {
    // Trigger SYMBOL.RELOAD once, after nEffectiveReloadAt failed attempts,
    // to recover from slow ELF symbol table loading.
    if (!bSymbolReloadDone && nAttempt > nEffectiveReloadAt)
    {
      write("A_DBGR_BreakpointSet: BREAK.SET still failing after %d attempts for '%s' (last error: %s). Issuing SYMBOL.RELOAD and waiting %d ms...",
            nEffectiveReloadAt, aAddress, chApiMessage, cc_dwT32_SymbolReloadWait);
      lFctn_CallT32API(chReloadCmd, chApiMessage, lApiExitCode);
      if (lApiExitCode[0] != 0)
      {
        write("A_DBGR_BreakpointSet: SYMBOL.RELOAD failed for '%s' (exit=%ld, msg='%s').",
              aAddress, lApiExitCode[0], chApiMessage);
      }
      testWaitForTimeoutSilent(cc_dwT32_SymbolReloadWait);
      bSymbolReloadDone = 1;
    }

    lFctn_CallT32API(chT32Cmd, chApiMessage, lApiExitCode);

    if (lApiExitCode[0] == 0)
    {
      snprintf(chPassText, elcount(chPassText), "Breakpoint '%s' set (attempt %d/%d).", aAddress, nAttempt, cc_nT32_BPSetMaxRetries);
      if ((byte)DebugFuncInternal & bDebugFlag)
        writeDbgLevel(DebugFuncInternal, "PASS: %s.", chPassText);
      vFctn_REPORTActionEvaluation(chPassText, PASS);
      sv_T32_LastBreakpointSetOk = Ok;
      return; // success – no further retries needed
    }

    // Failed on this attempt
    if (nAttempt < cc_nT32_BPSetMaxRetries)
    {
      write("A_DBGR_BreakpointSet: attempt %d/%d failed for '%s' (%s). Retrying in %d ms...",
            nAttempt, cc_nT32_BPSetMaxRetries, aAddress, chApiMessage, cc_dwT32_BPSetRetryInterval);
      testWaitForTimeoutSilent(cc_dwT32_BPSetRetryInterval);
    }
  }

  // All retries exhausted
  snprintf(chFailText, elcount(chFailText), "BREAK.SET '%s' failed after %d attempt(s). Last error: %s",
           aAddress, cc_nT32_BPSetMaxRetries, chApiMessage);
  if ((byte)DebugFuncInternal & bDebugFlag)
    writeDbgLevel(DebugFuncInternal, "FAIL: %s.", chFailText);
  vFctn_REPORTActionEvaluation(chFailText, FAIL);
  sv_T32_LastBreakpointSetOk = NotOk;
  // No wait needed: BREAK.SET does not change ECU run state.
}

/// <BREAKPOINTS>
/*! void A_DBGR_BreakpointSet_AbortOnFail(char aAddress[])
*  \brief Convenience wrapper around A_DBGR_BreakpointSet() that aborts the current
*         test case immediately when the symbol cannot be found after all retries.
*         Use this instead of A_DBGR_BreakpointSet() in test cases where there is
*         no point continuing execution (GO / waitForNotRunning / CheckForHalt) if
*         the breakpoint was never placed.
*
*  \param[in] aAddress - name of the BP ("Symbol")
*
*  \return no return (test case is aborted on failure)
*
* Change History:
* Date(DD.MM.YY)        Author          Change info
*
* 10.03.26              Copilot         Created.
*/
export testfunction A_DBGR_BreakpointSet_AbortOnFail(char aAddress[])
{
  char chAbortMsg[512];

  A_DBGR_BreakpointSet(aAddress);

  if (sv_T32_LastBreakpointSetOk != Ok)
  {
    snprintf(chAbortMsg, elcount(chAbortMsg),
             "Symbol '%s' not found in T32 after %d attempt(s) – aborting test case to avoid 20-second GO timeout.",
             aAddress, cc_nT32_BPSetMaxRetries);
    write("ABORT: %s", chAbortMsg);
    testCaseFail();
  }
}

/// <BREAKPOINTS>
/*! void  A_DBGR_BreakpointWrite(char aAddress[])
*  \brief Function that SET a specific BP to write.
* 
*  \param[in] aAddress - name of the BP ("Symbol")
*
*  \return no return
*
* Change History: 
* Date(DD.MM.YY)        Author          Change info                                                          
*   
* 10.09.20              CrJu         Refactoring the code.
*/
void A_DBGR_BreakpointWrite(char aAddress[])
{
  long lApiExitCode[1];
  char chApiMessage[512];
  byte bResultAction;
  byte bDebugFlag;
  char chPassText[250];
  char chFailText[250];
  char chAction[250];
  char chT32Cmd[128] = "";
 
  bDebugFlag = NotOk;
  bResultAction = NotOk;
  snprintf(chT32Cmd, elcount(chT32Cmd),  "\"VAR.BREAK.SET %s /W\"", aAddress);
 
  writeDbgLevel (DebugFuncCalls , "Function A_DBGR_BreakpointWrite() entered.");
  
  lFctn_CallT32API(chT32Cmd, chApiMessage, lApiExitCode);
  
  //Print the action text to the raport
  snprintf(chAction, elcount(chAction), "Set a specific BreakPoint: %s to write.", aAddress);
  bResultAction = bFctn_REPORTAction(chAction);
  
  if(bResultAction)
  {
    if (lApiExitCode[0] == 0)
    {
      snprintf(chPassText, elcount(chPassText), "Breakpoint write access at adress: %s is set.", aAddress);
      if((byte)DebugFuncInternal & bDebugFlag)
        writeDbgLevel (DebugFuncInternal, "PASS: %s.", chPassText);
      vFctn_REPORTActionEvaluation(chPassText, PASS);
    }
    else // API Command Fail
    {
      snprintf(chFailText, elcount(chFailText), "API error message: %s", chApiMessage);
      if((byte)DebugFuncInternal & bDebugFlag)
        writeDbgLevel (DebugFuncInternal, "FAIL: %s.", chFailText);
      vFctn_REPORTActionEvaluation(chFailText, FAIL);
    }
  }
  else//The reporting function has failed
  {
    snprintf(chFailText, elcount(chFailText), "ERROR: The action text could not be added in the Report. bFctn_REPORTAction() return: %d.", bResultAction);
    if((byte)DebugFuncInternal & bDebugFlag)
      writeDbgLevel (DebugFuncInternal, "ERROR: The action text could not be added in the Report. bFctn_REPORTAction() return: %d.", bResultAction);
    vFctn_REPORTActionEvaluation(chFailText, FAIL);
  }
  // No wait needed: VAR.BREAK.SET does not change ECU run state.
}

/// <BREAKPOINTS>
/*! void  A_DBGR_BreakpointRead(char aAddress[])
*  \brief Function that SET a specific BP to read.
* 
*  \param[in] aAddress - name of the BP ("Symbol")
*
*  \return no return
*
* Change History: 
* Date(DD.MM.YY)        Author          Change info                                                          
*   
* 10.09.20              CrJu         Refactoring the code.
*/
void A_DBGR_BreakpointRead(char aAddress[])
{
  long lApiExitCode[1];
  char chApiMessage[512];
  byte bResultAction;
  byte bDebugFlag;
  char chPassText[250];
  char chFailText[250];
  char chAction[250];
  char chT32Cmd[128] = "";
 
  bDebugFlag = NotOk;
  bResultAction = NotOk;
  snprintf(chT32Cmd, elcount(chT32Cmd), "\"VAR.BREAK.SET %s /R\"", aAddress);

  // Hardware read-access BPs require ECU to be halted on some targets; wait at most cc_dwT32_MaxTimeout.
  waitForNotRunning(cc_dwT32_MaxTimeout);

  writeDbgLevel (DebugFuncCalls , "Function A_DBGR_BreakpointRead() entered.");
  
  lFctn_CallT32API(chT32Cmd, chApiMessage, lApiExitCode);
  
  //Print the action text to the raport
  snprintf(chAction, elcount(chAction), "Set a specific BreakPoint: %s to read.", aAddress);
  bResultAction = bFctn_REPORTAction(chAction);
  
  if(bResultAction)
  {
    if (lApiExitCode[0] == 0)
    {
      snprintf(chPassText, elcount(chPassText), "Breakpoint read access at adress: %s is set.", aAddress);
      if((byte)DebugFuncInternal & bDebugFlag)
        writeDbgLevel (DebugFuncInternal, "PASS: %s.", chPassText);
      vFctn_REPORTActionEvaluation(chPassText, PASS);
    }
    else // API Command Fail
    {
      snprintf(chFailText, elcount(chFailText), "API error message: %s", chApiMessage);
      if((byte)DebugFuncInternal & bDebugFlag)
        writeDbgLevel (DebugFuncInternal, "FAIL: %s.", chFailText);
      vFctn_REPORTActionEvaluation(chFailText, FAIL);
    }
  }
  else//The reporting function has failed
  {
    snprintf(chFailText, elcount(chFailText), "ERROR: The action text could not be added in the Report. bFctn_REPORTAction() return: %d.", bResultAction);
    if((byte)DebugFuncInternal & bDebugFlag)
      writeDbgLevel (DebugFuncInternal, "ERROR: The action text could not be added in the Report. bFctn_REPORTAction() return: %d.", bResultAction);
    vFctn_REPORTActionEvaluation(chFailText, FAIL);
  }
}

/// <BREAKPOINTS>
/*! void  A_DBGR_BreakpointDeleteAll()
*  \brief Function that delete all the BP from TRACE32.
*
*  \return no return
*
* Change History: 
* Date(DD.MM.YY)        Author          Change info                                                          
*   
* 31.08.20              CrJu         Refactoring the code.
* 16.02.22              IuSo         Refactoring the variable chT32Cmd.
*/
void A_DBGR_BreakpointDeleteAll()
{
  long lApiExitCode[1];
  char chApiMessage[512];
  byte bResultAction;
  byte bDebugFlag;
  char chPassText[250];
  char chFailText[250];
  char chAction[250];
  char chT32Cmd[128];
 
  bDebugFlag = NotOk;
  bResultAction = NotOk;
 
  writeDbgLevel (DebugFuncCalls , "Function A_DBGR_BreakpointDeleteAll() entered.");
  snprintf(chT32Cmd, elcount(chT32Cmd),"\"BREAK.DELETE\"");
  lFctn_CallT32API(chT32Cmd, chApiMessage, lApiExitCode);
  
  //Print the action text to the raport
  snprintf(chAction, elcount(chAction), "Delete all the BP from TRACE32");
  bResultAction = bFctn_REPORTAction(chAction);
  
  if(bResultAction)
  {
    if (lApiExitCode[0] == 0)
    {
      snprintf(chPassText, elcount(chPassText), "Breakpoint/s deleted.");
      if((byte)DebugFuncInternal & bDebugFlag)
        writeDbgLevel (DebugFuncInternal, "PASS: %s.", chPassText);
      vFctn_REPORTActionEvaluation(chPassText, PASS);
    }
    else // API Command Fail
    {
      snprintf(chFailText, elcount(chFailText), "API error message: %s", chApiMessage);
      if((byte)DebugFuncInternal & bDebugFlag)
        writeDbgLevel (DebugFuncInternal, "FAIL: %s.", chFailText);
      vFctn_REPORTActionEvaluation(chFailText, FAIL);
    }
  }
  else//The reporting function has failed
  {
    snprintf(chFailText, elcount(chFailText), "ERROR: The action text could not be added in the Report. bFctn_REPORTAction() return: %d.", bResultAction);
    if((byte)DebugFuncInternal & bDebugFlag)
      writeDbgLevel (DebugFuncInternal, "ERROR: The action text could not be added in the Report. bFctn_REPORTAction() return: %d.", bResultAction);
    vFctn_REPORTActionEvaluation(chFailText, FAIL);
  }
}

/// <BREAKPOINTS>
/*! void A_DBGR_BreakpointDelete(char aAddress[])
*  \brief Function that delete a specific BP from TRACE32.
*
*  \param[in] aAddress - name of the BP ("Symbol")
*
*  \return no return
*
* Change History: 
* Date(DD.MM.YY)        Author          Change info                                                          
*   
* 31.08.20              CrJu         Refactoring the code.
*/
void A_DBGR_BreakpointDelete(char aAddress[])
{
  long lApiExitCode[1];
  char chApiMessage[512];
  byte bResultAction;
  byte bDebugFlag;
  char chPassText[250];
  char chFailText[250];
  char chAction[250];
  char chT32Cmd[128] = "";
 
  bDebugFlag = NotOk;
  bResultAction = NotOk;
  snprintf(chT32Cmd, elcount(chT32Cmd),  "\"BREAK.DELETE %s\"", aAddress);
  
  writeDbgLevel (DebugFuncCalls , "Function A_DBGR_BreakpointDelete() entered.");
  
  lFctn_CallT32API(chT32Cmd, chApiMessage, lApiExitCode);
  
  //Print the action text to the raport
  snprintf(chAction, elcount(chAction), "Delete BP: %s from TRACE32", aAddress);
  bResultAction = bFctn_REPORTAction(chAction);
  
  if(bResultAction)
  {
    if (lApiExitCode[0] == 0)
    {
      snprintf(chPassText, elcount(chPassText), "Breakpoint '%s' was successfully deleted", aAddress);
      if((byte)DebugFuncInternal & bDebugFlag)
        writeDbgLevel (DebugFuncInternal, "PASS: %s.", chPassText);
      vFctn_REPORTActionEvaluation(chPassText, PASS);
    }
    else // API Command Fail
    {
      snprintf(chFailText, elcount(chFailText), "API error message: %s", chApiMessage);
      if((byte)DebugFuncInternal & bDebugFlag)
        writeDbgLevel (DebugFuncInternal, "FAIL: %s.", chFailText);
      vFctn_REPORTActionEvaluation(chFailText, FAIL);
    }
  }
  else//The reporting function has failed
  {
    snprintf(chFailText, elcount(chFailText), "ERROR: The action text could not be added in the Report. bFctn_REPORTAction() return: %d.", bResultAction);
    if((byte)DebugFuncInternal & bDebugFlag)
      writeDbgLevel (DebugFuncInternal, "ERROR: The action text could not be added in the Report. bFctn_REPORTAction() return: %d.", bResultAction);
    vFctn_REPORTActionEvaluation(chFailText, FAIL);
  }
}







/// <BREAKPOINTS>
/*! void E_DBGR_BreakpointCheckForHalt(char aAddress[])
*  \brief Function that verify if a specific BP is halted.
*
*  \param[in] aAddress - name of the BP ("Symbol")
*
*  \return no return
*
* Change History: 
* Date(DD.MM.YY)        Author          Change info                                                          
*   
* 09.09.20              CrJu         Refactoring the code.
*/
void E_DBGR_BreakpointCheckForHalt(char aAddress[])
{
  byte bDebugFlag;
  long lEvaluationResult;
  long lApiExitCode[1];
  char chApiMessage[512];
  char chT32Cmd[500] = "";
  char chPassText[500];
  char chFailText[500];

  bDebugFlag = NotOk;
  writeDbgLevel(DebugFuncCalls , "Function E_DBGR_BreakpointCheckForHalt() entered.");

  // Poll for not running with timeout
  if ( waitForNotRunning(cc_dwT32_BP_HaltTimeout))
  {
    snprintf(chT32Cmd, elcount(chT32Cmd),"\"EVAL (P:R(PC)==%s)\"", aAddress);
    lFctn_CallT32API(chT32Cmd, chApiMessage, lApiExitCode);
    
    if (lApiExitCode[0] == 0)
    {
      snprintf(chT32Cmd, elcount(chT32Cmd),  "\"PRINT EVAL()\"");
      lFctn_CallT32API(chT32Cmd, chApiMessage, lApiExitCode);
  
      lEvaluationResult = atol(chApiMessage);
      if(lEvaluationResult)
      {
        snprintf(chPassText, elcount(chPassText), "Breakpoint at: %s was reached.", aAddress);
        if((byte)DebugFuncInternal & bDebugFlag)
          writeDbgLevel (DebugFuncInternal, "PASS: %s.", chPassText);
        vFctn_REPORTStepEvaluation(chPassText, PASS);
      }
      else 
      {
        snprintf(chFailText, elcount(chFailText), "Breakpoint at: %s was NOT reached. API error message: %s", aAddress, chApiMessage);
        if((byte)DebugFuncInternal & bDebugFlag)
          writeDbgLevel (DebugFuncInternal, "FAIL: %s.", chFailText);
        vFctn_REPORTStepEvaluation(chFailText, FAIL);
      }
    }
    else // API Command Fail
    {
      snprintf(chFailText, elcount(chFailText), "API error message: %s", chApiMessage);
      if((byte)DebugFuncInternal & bDebugFlag)
        writeDbgLevel (DebugFuncInternal, "FAIL: %s.", chFailText);
      vFctn_REPORTStepEvaluation(chFailText, FAIL);
    }
  }
  else 
  {
    snprintf(chFailText, elcount(chFailText), "Timeout: ECU did not halt (STATE.RUN()!=FALSE) within %d ms.", cc_dwT32_BP_HaltTimeout);
    if((byte)DebugFuncInternal & bDebugFlag)
      writeDbgLevel (DebugFuncInternal, "FAIL: %s.", chFailText);
    vFctn_REPORTStepEvaluation(chFailText, FAIL);
  }
}

/// <BREAKPOINTS>
/*! void E_DBGR_BreakpointCheckForHaltCore(char aAddress[], char aCore[])
*  \brief Function that verify if a specific BP is halted on a specific core.
*
*  \param[in] aAddress - name of the BP ("Symbol")
*  \param[in] aCore - the core where BP should be
*
*  \return no return
*
* Change History: 
* Date(DD.MM.YY)        Author          Change info                                                          
*   
* 09.09.20              CrJu         Refactoring the code.
*/
void E_DBGR_BreakpointCheckForHaltCore(char aAddress[], char aCore[])
{
  byte bDebugFlag;
  long lEvaluationResult;
  long lApiExitCode[1];
  char chApiMessage[512];
  char chT32Cmd[128] = "";
  char chPassText[250];
  char chFailText[250];

  bDebugFlag = NotOk;
  if( waitForNotRunning(cc_dwT32_BP_HaltTimeout))
  {
    snprintf(chT32Cmd, elcount(chT32Cmd),"\"EVAL P:R(PC)==%s&&CORE()==%s\"", aAddress, aCore);
    lFctn_CallT32API(chT32Cmd, chApiMessage, lApiExitCode);
    
    if (lApiExitCode[0] == 0)
    {
      snprintf(chT32Cmd, elcount(chT32Cmd),  "\"PRINT EVAL()\"");
      lFctn_CallT32API(chT32Cmd, chApiMessage, lApiExitCode);
  
      lEvaluationResult = atol(chApiMessage);
      if(lEvaluationResult)
      {
        snprintf(chPassText, elcount(chPassText), "Breakpoint at: %s was reached.", aAddress);
        if((byte)DebugFuncInternal & bDebugFlag)
          writeDbgLevel (DebugFuncInternal, "PASS: %s.", chPassText);
        vFctn_REPORTStepEvaluation(chPassText, PASS);
      }
      else 
      {
        snprintf(chFailText, elcount(chFailText), "Breakpoint at: %s was NOT reached. API error message: %s", aAddress, chApiMessage);
        if((byte)DebugFuncInternal & bDebugFlag)
          writeDbgLevel (DebugFuncInternal, "FAIL: %s.", chFailText);
        vFctn_REPORTStepEvaluation(chFailText, FAIL);
      }
    }
    else // API Command Fail
    {
      snprintf(chFailText, elcount(chFailText), "API error message: %s", chApiMessage);
      if((byte)DebugFuncInternal & bDebugFlag)
        writeDbgLevel (DebugFuncInternal, "FAIL: %s.", chFailText);
      vFctn_REPORTStepEvaluation(chFailText, FAIL);
    }
  }
  else 
  {
    snprintf(chFailText, elcount(chFailText), "Timeout: ECU did not halt (STATE.RUN()!=FALSE) within %d ms.", cc_dwT32_BP_HaltTimeout);
    if((byte)DebugFuncInternal & bDebugFlag)
      writeDbgLevel (DebugFuncInternal, "FAIL: %s.", chFailText);
    vFctn_REPORTStepEvaluation(chFailText, FAIL);
  }
}

/// <VARIABLE>
/*! void A_DBGR_VariableSet(char aAddress[], char aValue[])
*  \brief Function that set a value of a variable in TRACE32.
*
*  \param[in] aAddress - name of the variable
*  \param[in] aValue - the value to set
*
*  \return no return
*
* Change History: 
* Date(DD.MM.YY)        Author          Change info                                                          
*   
* 07.09.20              CrJu         Refactoring the code.
*/
void A_DBGR_VariableSet(char aAddress[], char aValue[])
{
  long lApiExitCode[1];
  char chApiMessage[512];
  byte bResultAction;
  byte bDebugFlag;
  char chPassText[250];
  char chFailText[250];
  char chAction[500];
  char chT32Cmd[500] = "";

  // ECU must be halted for VAR.SET; wait up to cc_dwT32_MaxTimeout.
  waitForNotRunning(cc_dwT32_MaxTimeout);

  bDebugFlag = NotOk;
  bResultAction = NotOk;
  snprintf(chT32Cmd, elcount(chT32Cmd), "\"VAR.SET %s=%s\"", aAddress, aValue);

  writeDbgLevel (DebugFuncCalls , "Function A_DBGR_VariableSet() entered.");

  lFctn_CallT32API(chT32Cmd, chApiMessage, lApiExitCode);

  //Print the action text to the raport
  snprintf(chAction, elcount(chAction), "Set value: %s to register: %s.", aValue, aAddress);
  bResultAction = bFctn_REPORTAction(chAction);

  if(bResultAction)
  {
    if (lApiExitCode[0] == 0)
    {
      snprintf(chPassText, elcount(chPassText), "Variable '%s' was successfully set with value: '%s'", aAddress, aValue);
      if((byte)DebugFuncInternal & bDebugFlag)
        writeDbgLevel (DebugFuncInternal, "PASS: %s.", chPassText);
      vFctn_REPORTActionEvaluation(chPassText, PASS);
    }
    else // API Command Fail
    {
      snprintf(chFailText, elcount(chFailText), "API error message: %s", chApiMessage);
      if((byte)DebugFuncInternal & bDebugFlag)
        writeDbgLevel (DebugFuncInternal, "FAIL: %s.", chFailText);
      vFctn_REPORTActionEvaluation(chFailText, FAIL);
    }
  }
  else//The reporting function has failed
  {
    snprintf(chFailText, elcount(chFailText), "ERROR: The action text could not be added in the Report. bFctn_REPORTAction() return: %d.", bResultAction);
    if((byte)DebugFuncInternal & bDebugFlag)
      writeDbgLevel (DebugFuncInternal, "ERROR: The action text could not be added in the Report. bFctn_REPORTAction() return: %d.", bResultAction);
    vFctn_REPORTActionEvaluation(chFailText, FAIL);
  }
  // No post-write wait: ECU remains halted after VAR.SET.
}

/// <VARIABLE>
/*! void  A_DBGR_VariableRead( char aAddress[], long& aVarValue)
*  \brief Function that read the value of a variable.
*
*  \param[in] aAddress - name of the variable
*  \param[out] aVarValue - value of the variable
*
*  \return no return
*
* Change History:
* Date(DD.MM.YY)        Author          Change info
* 09.09.20              CrJu         Refactoring the code.
* 15.11.21              AnPu         Update function
*/
void  A_DBGR_VariableRead( char aAddress[], long& aVarValue)
{
  long lApiExitCode[1];
  char chApiMessage[512];
  char chT32Cmd[128];
  byte bResultAction;
  byte bDebugFlag;
  char chPassText[250];
  char chFailText[250];
  char chAction[250];

  bDebugFlag = NotOk;
  bResultAction = NotOk;

  // ECU must be halted for var.PRINT; wait up to cc_dwT32_MaxTimeout.
  waitForNotRunning(cc_dwT32_MaxTimeout);

  snprintf(chT32Cmd, elcount(chT32Cmd),"\"var.PRINT %s\"", aAddress);
  writeDbgLevel (DebugFuncCalls , "Function A_DBGR_VariableRead() entered.");
  lFctn_CallT32API(chT32Cmd, chApiMessage, lApiExitCode);
  
  //Print the action text to the raport
  snprintf(chAction, elcount(chAction), "Read the value of variable: %s.", aAddress);
  bResultAction = bFctn_REPORTAction(chAction);
  
  if(bResultAction)
  {
    if (lApiExitCode[0] == 0)
    {
      snprintf(chPassText, elcount(chPassText), "Variable value is: %s", chApiMessage);
      if((byte)DebugFuncInternal & bDebugFlag)
        writeDbgLevel (DebugFuncInternal, "PASS: %s.", chPassText);
      aVarValue=atol(chApiMessage);
      vFctn_REPORTActionEvaluation(chPassText, PASS);
    }
    else // API Command Fail
    {
      snprintf(chFailText, elcount(chFailText), "ECU is NOT running!.\nAPI error message: %s", chApiMessage);
      if((byte)DebugFuncInternal & bDebugFlag)
        writeDbgLevel (DebugFuncInternal, "FAIL: %s.", chFailText);
      aVarValue = -9999;
      vFctn_REPORTActionEvaluation(chFailText, FAIL);
    }
  }
  else//The reporting function has failed
  {
    snprintf(chFailText, elcount(chFailText), "ERROR: The action text could not be added in the Report. bFctn_REPORTAction() return: %d.", bResultAction);
    if((byte)DebugFuncInternal & bDebugFlag)
      writeDbgLevel (DebugFuncInternal, "ERROR: The action text could not be added in the Report. bFctn_REPORTAction() return: %d.", bResultAction);
    aVarValue = -9999;
    vFctn_REPORTActionEvaluation(chFailText, FAIL);
  }
}

/// <VARIABLE>
/*! void E_DBGR_VariableReadCheck(char aAddress[], long aValueToCompare, enum eCompareType aCompareType)
*  \brief Function that read the value at address & compares it with expected value.
*
*  \param[in] aAddress - name of the BP ("Symbol")
*  \param[in] aValueToCompare - the expected value of the register
*  \param[in] aCompareType - compare type (e.q. equal, not equal, greatter, smaller)
*  \return no return
*
* Change History: 
* Date(DD.MM.YY)        Author          Change info                                                          
*   
* 08.09.20              CrJu         Refactoring the code.
* 17.11.21              AnPu         Update function
* 27.02.25              SeSu         Update function
*/
void E_DBGR_VariableCheck(char aAddress[], long aValueToCompare, enum eCompareType aCompareType)
{
  byte bDebugFlag;
  long lReadValue;
  long lApiExitCode[1];
  char chApiMessage[512];
  char chT32Cmd[500] = "";
  char chPassText[500];
  char chFailText[500];

  bDebugFlag = cc_bT32_GlobalDebugFlag;

  // ECU must be halted for var.value read; wait up to cc_dwT32_MaxTimeout.
  waitForNotRunning(cc_dwT32_MaxTimeout);

  writeDbgLevel(DebugFuncCalls , "Function E_DBGR_VariableCheck() entered.");
  
  snprintf(chT32Cmd, elcount(chT32Cmd),  "\"print var.value(%s)*1.\"", aAddress);
  writeDbgLevel (DebugFuncInternal, "Calling function lFctn_CallT32API.");
  lFctn_CallT32API(chT32Cmd, chApiMessage, lApiExitCode);

  if (lApiExitCode[0] == 0)
  {
    if ( (byte)DebugFuncParam & bDebugFlag )
        writeDbgLevel (DebugFuncParam, "Parameters: char aAddress[]: -- %s --, long aValueToCompare: -- %d --,  enum eCompareType aCompareType: -- %d -- (Equal = 0, NotEqual = 1, Greater = 2, Smaller = 3).", aAddress, aValueToCompare, aCompareType);
    
    lReadValue = atol(chApiMessage); 
    switch(aCompareType){
      case Equal:
        if((byte)DebugFuncInternal & bDebugFlag)
            writeDbgLevel (DebugFuncInternal, "Case Equal: Variable aAddress -- %s -- has value lReadValue: -- %d --, compare value: aValueToCompare: -- %d --.", aAddress, lReadValue, aValueToCompare);
        
        if(lReadValue == aValueToCompare)
        {
          snprintf(chPassText, elcount(chPassText), "Variable %s has the expected value: %d", aAddress, lReadValue);
          if((byte)DebugFuncInternal & bDebugFlag)
            writeDbgLevel (DebugFuncInternal, "Test Expected passed. Calling function vFctn_REPORTStepEvaluation.");
          vFctn_REPORTStepEvaluation(chPassText, PASS);
        }
        else 
        {
          snprintf(chFailText, elcount(chFailText), "Variable %s has the value: %d, DIFFERENT than expected: %d.", aAddress, lReadValue, aValueToCompare);
          if((byte)DebugFuncInternal & bDebugFlag)
            writeDbgLevel (DebugFuncInternal, "Test Expected failed. Calling function vFctn_REPORTStepEvaluation.");
          vFctn_REPORTStepEvaluation(chFailText, FAIL);
        }
        break;
      case NotEqual:
        if((byte)DebugFuncInternal & bDebugFlag)
            writeDbgLevel (DebugFuncInternal, "Case NotEqual: Variable aAddress -- %s -- has value lReadValue: -- %d --, compare value: aValueToCompare: -- %d --.", aAddress, lReadValue, aValueToCompare);
        
        if(lReadValue != aValueToCompare)
        {
          snprintf(chPassText, elcount(chPassText), "Variable %s is different than expected value: %d", aAddress, lReadValue);
          if((byte)DebugFuncInternal & bDebugFlag)
            writeDbgLevel (DebugFuncInternal, "Test Expected passed. Calling function vFctn_REPORTStepEvaluation.");
          vFctn_REPORTStepEvaluation(chPassText, PASS);
        }
        else 
        {
          snprintf(chFailText, elcount(chFailText), "Variable %s has the value: %d, EQUAL to: %d.", aAddress, lReadValue, aValueToCompare);
          if((byte)DebugFuncInternal & bDebugFlag)
            writeDbgLevel (DebugFuncInternal, "Test Expected failed. Calling function vFctn_REPORTStepEvaluation.");
          vFctn_REPORTStepEvaluation(chFailText, FAIL);
        }
        break;
       case Greater:
        if((byte)DebugFuncInternal & bDebugFlag)
            writeDbgLevel (DebugFuncInternal, "Case Greater: Variable aAddress -- %s -- has value lReadValue: -- %d --, compare value: aValueToCompare: -- %d --.", aAddress, lReadValue, aValueToCompare);
        
        if(lReadValue > aValueToCompare)
        {
          snprintf(chPassText, elcount(chPassText), "Variable %s is Greater then expected value: %d", aAddress, lReadValue);
          if((byte)DebugFuncInternal & bDebugFlag)
            writeDbgLevel (DebugFuncInternal, "Test Expected passed. Calling function vFctn_REPORTStepEvaluation.");
          vFctn_REPORTStepEvaluation(chPassText, PASS);
        }
        else 
        {
          snprintf(chFailText, elcount(chFailText), "Variable %s has the value: %d, smaller or equal with: %d.", aAddress, lReadValue, aValueToCompare);
          if((byte)DebugFuncInternal & bDebugFlag)
            writeDbgLevel (DebugFuncInternal, "Test Expected failed. Calling function vFctn_REPORTStepEvaluation.");
          vFctn_REPORTStepEvaluation(chFailText, FAIL);
        }
        break;
       case Smaller:
        if((byte)DebugFuncInternal & bDebugFlag)
            writeDbgLevel (DebugFuncInternal, "Case Smaller: Variable aAddress -- %s -- has value lReadValue: -- %d --, compare value: aValueToCompare: -- %d --.", aAddress, lReadValue, aValueToCompare);
        
        if(lReadValue < aValueToCompare)
        {
          snprintf(chPassText, elcount(chPassText), "Variable %s is smaller then expected value: %d", aAddress, lReadValue);
          if((byte)DebugFuncInternal & bDebugFlag)
            writeDbgLevel (DebugFuncInternal, "Test Expected passed. Calling function vFctn_REPORTStepEvaluation.");
          vFctn_REPORTStepEvaluation(chPassText, PASS);
        }
        else 
        {
          snprintf(chFailText, elcount(chFailText), "Variable %s has the value: %d, greater or equal with: %d.", aAddress, lReadValue, aValueToCompare);
          if((byte)DebugFuncInternal & bDebugFlag)
            writeDbgLevel (DebugFuncInternal, "Test Expected failed. Calling function vFctn_REPORTStepEvaluation.");
          vFctn_REPORTStepEvaluation(chFailText, FAIL);
        }
        break;
    }
  }
  else // API Command Fail
  {
    snprintf(chFailText, elcount(chFailText), "API error message: %s", chApiMessage);
    if((byte)DebugFuncInternal & bDebugFlag)
      writeDbgLevel (DebugFuncInternal, "Test Expected failed. API error message: %s. Calling function vFctn_REPORTStepEvaluation.", chApiMessage);
    vFctn_REPORTStepEvaluation(chFailText, FAIL);
  }
}

/// <VARIABLE>
/*! void E_DBGR_VariableCheck_until(char aAddress[], long aValueToCompare, enum eCompareType aCompareType)
*  \brief Function that repeatedly checks the value at address until the expected condition is met.
*         Useful when hitting a breakpoint multiple times waiting for a specific value (e.g., channelId == 1).
*         Waits for ECU to halt, checks condition, if not met issues GO and retries up to max attempts.
*
*  \param[in] aAddress - name of the variable ("Symbol")
*  \param[in] aValueToCompare - the expected value of the variable
*  \param[in] aCompareType - compare type (e.q. equal, not equal, greater, smaller)
*  \return no return
*
* Change History:
* Date(DD.MM.YY)        Author          Change info
*
* 01.02.26              Copilot        Initial creation based on E_DBGR_VariableCheck
*/
void E_DBGR_VariableCheck_until(char aAddress[], long aValueToCompare, enum eCompareType aCompareType)
{
  byte bDebugFlag;
  long lReadValue;
  long lApiExitCode[1];
  char chApiMessage[512];
  char chT32Cmd[500] = "";
  char chPassText[500];
  char chFailText[500];
  int nMaxRetries = 25;
  int nRetryCount;
  byte bConditionMet;

  bDebugFlag = cc_bT32_GlobalDebugFlag;
  bConditionMet = 0;

  writeDbgLevel(DebugFuncCalls , "Function E_DBGR_VariableCheck_until() entered.");

  for (nRetryCount = 0; nRetryCount < nMaxRetries; nRetryCount++)
  {
    // Wait for ECU to stop at breakpoint
    if (!waitForNotRunning(cc_dwT32_BP_HaltTimeout))
    {
      write("Retry %d/%d: ECU did not halt within timeout, issuing GO.", nRetryCount + 1, nMaxRetries);
      snprintf(chT32Cmd, elcount(chT32Cmd), "\"GO\"");
      lFctn_CallT32API(chT32Cmd, chApiMessage, lApiExitCode);
      continue;
    }

    // Read the variable value
    snprintf(chT32Cmd, elcount(chT32Cmd), "\"print var.value(%s)*1.\"", aAddress);
    writeDbgLevel(DebugFuncInternal, "Calling function lFctn_CallT32API.");
    lFctn_CallT32API(chT32Cmd, chApiMessage, lApiExitCode);

    if (lApiExitCode[0] != 0)
    {
      write("Retry %d/%d: API error reading variable, issuing GO. Error: %s", nRetryCount + 1, nMaxRetries, chApiMessage);
      snprintf(chT32Cmd, elcount(chT32Cmd), "\"GO\"");
      lFctn_CallT32API(chT32Cmd, chApiMessage, lApiExitCode);
      continue;
    }

    lReadValue = atol(chApiMessage);

    if ((byte)DebugFuncParam & bDebugFlag)
      writeDbgLevel(DebugFuncParam, "Retry %d/%d: Variable %s has value %d, comparing to %d with type %d.", nRetryCount + 1, nMaxRetries, aAddress, lReadValue, aValueToCompare, aCompareType);

    // Check condition based on compare type
    switch(aCompareType)
    {
      case Equal:
        if (lReadValue == aValueToCompare)
          bConditionMet = 1;
        break;
      case NotEqual:
        if (lReadValue != aValueToCompare)
          bConditionMet = 1;
        break;
      case Greater:
        if (lReadValue > aValueToCompare)
          bConditionMet = 1;
        break;
      case Smaller:
        if (lReadValue < aValueToCompare)
          bConditionMet = 1;
        break;
    }

    if (bConditionMet)
    {
      // Condition met - report success and return
      switch(aCompareType)
      {
        case Equal:
          snprintf(chPassText, elcount(chPassText), "Variable %s has the expected value: %d (after %d attempt(s))", aAddress, lReadValue, nRetryCount + 1);
          break;
        case NotEqual:
          snprintf(chPassText, elcount(chPassText), "Variable %s is different than expected value: %d (after %d attempt(s))", aAddress, lReadValue, nRetryCount + 1);
          break;
        case Greater:
          snprintf(chPassText, elcount(chPassText), "Variable %s is greater than expected value: %d (after %d attempt(s))", aAddress, lReadValue, nRetryCount + 1);
          break;
        case Smaller:
          snprintf(chPassText, elcount(chPassText), "Variable %s is smaller than expected value: %d (after %d attempt(s))", aAddress, lReadValue, nRetryCount + 1);
          break;
      }
      if ((byte)DebugFuncInternal & bDebugFlag)
        writeDbgLevel(DebugFuncInternal, "Condition met. Calling function vFctn_REPORTStepEvaluation.");
      vFctn_REPORTStepEvaluation(chPassText, PASS);
      return;
    }

    // Condition not met - log retry message and issue GO
    writeDbgLevel(DebugFuncInternal, "Retry %d/%d: Variable %s has value %d, expected condition not met. Retrying...", nRetryCount + 1, nMaxRetries, aAddress, lReadValue);
    write("E_DBGR_VariableCheck_until: Retry %d/%d - Variable %s = %d, condition not met. Retrying...", nRetryCount + 1, nMaxRetries, aAddress, lReadValue);

    snprintf(chT32Cmd, elcount(chT32Cmd), "\"GO\"");
    lFctn_CallT32API(chT32Cmd, chApiMessage, lApiExitCode);
  }

  // Max retries exceeded - report failure
  snprintf(chFailText, elcount(chFailText), "Variable %s did not meet expected condition after %d attempts. Last value: %d, expected: %d.", aAddress, nMaxRetries, lReadValue, aValueToCompare);
  if ((byte)DebugFuncInternal & bDebugFlag)
    writeDbgLevel(DebugFuncInternal, "Max retries exceeded. Calling function vFctn_REPORTStepEvaluation.");
  vFctn_REPORTStepEvaluation(chFailText, FAIL);
}

/// <VARIABLE>
/*! void E_DBGR_VariableCheckArrayElement(char aAddress[], long aIndex, long aValueToCompare)
*  \brief Function that reads the value at address[index] & compares it with expected value
*
*  \param[in] aAddress - name of the BP ("Symbol")
*  \param[in] aIndex - index in the array
*  \param[in] aValueToCompare - the expected value of the register
*
*  \return no return
*
* Change History: 
* Date(DD.MM.YY)        Author          Change info                                                          
*   
* 09.09.20              CrJu         Refactoring the code.
*/
void E_DBGR_VariableCheckArrayElement(char aAddress[], long aIndex, long aValueToCompare)
{
  byte bDebugFlag;
  long lReadValue;
  long lApiExitCode[1];
  char chApiMessage[512];
  char chT32Cmd[128] = "";
  char chPassText[250];
  char chFailText[250];

  bDebugFlag = NotOk;

  // ECU must be halted for var.PRINT; wait up to cc_dwT32_MaxTimeout.
  waitForNotRunning(cc_dwT32_MaxTimeout);

  snprintf(chT32Cmd, elcount(chT32Cmd),  "\"var.PRINT %s[%d]\"", aAddress, aIndex);
 
  writeDbgLevel(DebugFuncCalls , "Function E_DBGR_VariableCheckArrayElement() entered.");
  
  lFctn_CallT32API(chT32Cmd, chApiMessage, lApiExitCode);

  if (lApiExitCode[0] == 0)
  {
    lReadValue = atol(chApiMessage); 
    
    if(lReadValue == aValueToCompare)
    {
      snprintf(chPassText, elcount(chPassText), "Variable %s has the expected value: %d", aAddress, lReadValue);
      if((byte)DebugFuncInternal & bDebugFlag)
        writeDbgLevel (DebugFuncInternal, "PASS: %s.", chPassText);
      vFctn_REPORTStepEvaluation(chPassText, PASS);
    }
    else 
    {
      snprintf(chFailText, elcount(chFailText), "Variable %s has the value: %d, DIFFERENT than expected: %d.", aAddress, lReadValue, aValueToCompare);
      if((byte)DebugFuncInternal & bDebugFlag)
        writeDbgLevel (DebugFuncInternal, "FAIL: %s.", chFailText);
      vFctn_REPORTStepEvaluation(chFailText, FAIL);
    }
  }
  else // API Command Fail
  {
    snprintf(chFailText, elcount(chFailText), "API error message: %s", chApiMessage);
    if((byte)DebugFuncInternal & bDebugFlag)
      writeDbgLevel (DebugFuncInternal, "FAIL: %s.", chFailText);
    vFctn_REPORTStepEvaluation(chFailText, FAIL);
  }
}

/// <REGISTER>
/*! void A_DBGR_RegisterSet(char aAddress[], char aValue[])
*  \brief Function that set a value of a register by address in TRACE32.
*
*  \param[in] aAddress - name of the BP ("Symbol")
*  \param[in] aValue - the value to set
*
*  \return no return
*
* Change History: 
* Date(DD.MM.YY)        Author          Change info                                                          
*   
* 07.09.20              CrJu         Refactoring the code.
*/
void A_DBGR_RegisterSet(char aAddress[], char aValue[])
{
  long lApiExitCode[1];
  char chApiMessage[512];
  byte bResultAction;
  byte bDebugFlag;
  char chPassText[250];
  char chFailText[250];
  char chAction[250];
  char chT32Cmd[128] = "";
 
  bDebugFlag = NotOk;
  bResultAction = NotOk;

  // ECU must be halted for PER.Set.simple; wait up to cc_dwT32_MaxTimeout.
  waitForNotRunning(cc_dwT32_MaxTimeout);

  snprintf(chT32Cmd, elcount(chT32Cmd),  "\"PER.Set.simple %s %% Long %s\"", aAddress, aValue);
  
  writeDbgLevel (DebugFuncCalls , "Function A_DBGR_RegisterSet() entered.");
  
  lFctn_CallT32API(chT32Cmd, chApiMessage, lApiExitCode);
  
  //Print the action text to the raport
  snprintf(chAction, elcount(chAction), "Set value: %s to register: %s.", aValue, aAddress);
  bResultAction = bFctn_REPORTAction(chAction);
  
  if(bResultAction)
  {
    if (lApiExitCode[0] == 0)
    {
      snprintf(chPassText, elcount(chPassText), "Register with address: %s was set to value: 0x%s.", aAddress, aValue);
      if((byte)DebugFuncInternal & bDebugFlag)
        writeDbgLevel (DebugFuncInternal, "PASS: %s.", chPassText);
      vFctn_REPORTActionEvaluation(chPassText, PASS);
    }
    else // API Command Fail
    {
      snprintf(chFailText, elcount(chFailText), "API error message: %s", chApiMessage);
      if((byte)DebugFuncInternal & bDebugFlag)
        writeDbgLevel (DebugFuncInternal, "FAIL: %s.", chFailText);
      vFctn_REPORTActionEvaluation(chFailText, FAIL);
    }
  }
  else//The reporting function has failed
  {
    snprintf(chFailText, elcount(chFailText), "ERROR: The action text could not be added in the Report. bFctn_REPORTAction() return: %d.", bResultAction);
    if((byte)DebugFuncInternal & bDebugFlag)
      writeDbgLevel (DebugFuncInternal, "ERROR: The action text could not be added in the Report. bFctn_REPORTAction() return: %d.", bResultAction);
    vFctn_REPORTActionEvaluation(chFailText, FAIL);
  }
  // No post-write wait: ECU remains halted after PER.Set.simple.
}

/// <REGISTER>
/*! void A_DBGR_RegisterSetByMask(char aAddress[], char aMask[])
*  \brief Function that SET a value of a specific mask from register by address in TRACE32.
* 
*  \param[in] aAddress - name of the BP ("Symbol")
*  \param[in] aMask - the mask
*
*  \return no return
*
* Change History: 
* Date(DD.MM.YY)        Author          Change info                                                          
*   
* 15.09.20              CrJu         Refactoring the code.
*/
void A_DBGR_RegisterSetByMask(char aAddress[], char aMask[])
{
  long lApiExitCode[1];
  char chApiMessage[512];
  byte bResultAction;
  byte bDebugFlag;
  char chPassText[250];
  char chFailText[250];
  char chAction[250];
  char chT32Cmd[128] = "";
  char chT32Cmd1[128]= "";
  char chT32Cmd2[128]= "";
  char chT32Cmd3[128]= "";
  char chT32Cmd4[128]= "";
  
  bDebugFlag = NotOk;
  bResultAction = NotOk;
  snprintf(chT32Cmd1, elcount(chT32Cmd1), "\"PER.Set.simple %s %%", aAddress);
  snprintf(chT32Cmd2, elcount(chT32Cmd2), "Long (d.l(%s)", aAddress);
  snprintf(chT32Cmd3, elcount(chT32Cmd3), "&~%s)", aMask);
  snprintf(chT32Cmd4, elcount(chT32Cmd4), "|%s\"", aMask);
  strncat(chT32Cmd1, chT32Cmd2, elcount(chT32Cmd));
  strncat(chT32Cmd1, chT32Cmd3, elcount(chT32Cmd));
  strncat(chT32Cmd1, chT32Cmd4, elcount(chT32Cmd));
  strncpy(chT32Cmd, chT32Cmd1, elcount(chT32Cmd));
  
  writeDbgLevel (DebugFuncCalls , "Function A_DBGR_RegisterSetByMask() entered.");
  
  lFctn_CallT32API(chT32Cmd, chApiMessage, lApiExitCode);
  
  //Print the action text to the raport
  snprintf(chAction, elcount(chAction), "Set a value of a specific mask: '%s' from register by address: '%s'.", aMask, aAddress);
  bResultAction = bFctn_REPORTAction(chAction);
  
  if(bResultAction)
  {
    if (lApiExitCode[0] == 0)
    {
      snprintf(chPassText, elcount(chPassText), "Register with address: %s was set to value: 0x%s.", aAddress, aMask);
      if((byte)DebugFuncInternal & bDebugFlag)
        writeDbgLevel (DebugFuncInternal, "PASS: %s.", chPassText);
      vFctn_REPORTActionEvaluation(chPassText, PASS);
    }
    else // API Command Fail
    {
      snprintf(chFailText, elcount(chFailText), "API error message: %s", chApiMessage);
      if((byte)DebugFuncInternal & bDebugFlag)
        writeDbgLevel (DebugFuncInternal, "FAIL: %s.", chFailText);
      vFctn_REPORTActionEvaluation(chFailText, FAIL);
    }
  }
  else//The reporting function has failed
  {
    snprintf(chFailText, elcount(chFailText), "ERROR: The action text could not be added in the Report. bFctn_REPORTAction() return: %d.", bResultAction);
    if((byte)DebugFuncInternal & bDebugFlag)
      writeDbgLevel (DebugFuncInternal, "ERROR: The action text could not be added in the Report. bFctn_REPORTAction() return: %d.", bResultAction);
    vFctn_REPORTActionEvaluation(chFailText, FAIL);
  }
  // No post-write wait: ECU remains halted after PER.Set.simple mask operation.
}

/// <REGISTER>
/*! void A_DBGR_RegisterRead(char aAddress[], int64 &aRegisterValue)
*  \brief Function that read the value of a register by address in TRACE32.
*
*  \param[in] aAddress - name of the BP ("Symbol")
*  \param[out] aRegisterValue - the value of the register
*
*  \return no return
*
* Change History: 
* Date(DD.MM.YY)        Author          Change info                                                          
*   
* 08.09.20              CrJu         Refactoring the code.
* 28.04.22              GaMo         Updated the strncat part to save the entire value of the register.
* 20.05.22              AnPa         Updated to use low level function
*/
void A_DBGR_RegisterRead(char aAddress[], int64 &aRegisterValue)
{
  long lApiExitCode[1];
  byte bResultAction;
  char chFailText[250];
  char chAction[250];
  char chMappedResponse[256];
 
  bResultAction = NotOk;

  writeDbgLevel (DebugFuncCalls , "Function A_DBGR_RegisterRead() entered.");
  
  //Print the action text to the report
  snprintf(chAction, elcount(chAction), "Read register value from address: %s.", aAddress);
  bResultAction = bFctn_REPORTAction(chAction);
  
  if(bResultAction)
  {
    if (lFctn_T32_ReadRegister_AddressValue(aAddress, aRegisterValue, chMappedResponse) == 0)
      vFctn_REPORTActionEvaluation(chMappedResponse, PASS);
    else // API Command Fail
      vFctn_REPORTActionEvaluation(chMappedResponse, FAIL);
  }
  else//The reporting function has failed
  {
    snprintf(chFailText, elcount(chFailText), "ERROR: The action text could not be added in the Report. bFctn_REPORTAction() return: %d.", bResultAction);
    vFctn_REPORTActionEvaluation(chFailText, FAIL);
  }
}

/// <REGISTER>
/*! void E_DBGR_RegisterReadCheck(char aAddress[], char aValueToCompare[])
*  \brief Function that read & check the value of a register by address.
*
*  \param[in] aAddress - name of the BP ("Symbol")
*  \param[in] aValueToCompare - the expected value of the register
*
*  \return no return
*
* Change History: 
* Date(DD.MM.YY)        Author          Change info                                                          
*   
* 07.09.20              CrJu         Refactoring the code.
*/
void E_DBGR_RegisterCheck(char aAddress[], char aValueToCompare[])
{
  byte bDebugFlag;
  long lCompareValue;
  long lApiExitCode[1];
  char chApiMessage[512];
  char chT32Cmd[128] = "";
  char chPassText[250];
  char chFailText[250];

  bDebugFlag = NotOk;
  snprintf(chT32Cmd, elcount(chT32Cmd),  "\"EVAL data.long(%s)==%s\"", aAddress, aValueToCompare);
 
  writeDbgLevel(DebugFuncCalls , "Function E_DBGR_RegisterCheck() entered.");
  
  lFctn_CallT32API(chT32Cmd, chApiMessage, lApiExitCode);

  if (lApiExitCode[0] == 0)
  {
    lCompareValue = atol(chApiMessage); 
    
    if(lCompareValue)
    {
      snprintf(chPassText, elcount(chPassText), "Register with address: %s has the expected value: %s", aAddress, aValueToCompare);
      if((byte)DebugFuncInternal & bDebugFlag)
        writeDbgLevel (DebugFuncInternal, "PASS: %s.", chPassText);
      vFctn_REPORTStepEvaluation(chPassText, PASS);
    }
    else 
    {
      snprintf(chFailText, elcount(chFailText), "Register with address: %s was read his value is DIFFERENT from expected value: %s", aAddress, aValueToCompare);
      if((byte)DebugFuncInternal & bDebugFlag)
        writeDbgLevel (DebugFuncInternal, "FAIL: %s.", chFailText);
      vFctn_REPORTStepEvaluation(chFailText, FAIL);
    }
  }
  else // API Command Fail
  {
    snprintf(chFailText, elcount(chFailText), "API error message: %s", chApiMessage);
    if((byte)DebugFuncInternal & bDebugFlag)
      writeDbgLevel (DebugFuncInternal, "FAIL: %s.", chFailText);
    vFctn_REPORTStepEvaluation(chFailText, FAIL);
  }
}

/// <REGISTER>
/*! \fn void E_DBGR_RegisterCheckBitStatus(char aAddress[], int aBit_Number, enum eBitStatus aBitStatus)
*  \brief Function that will check the status of a specific bit number of a specific address
*  \param[in]  char aAddress[]            - address from where the register value is read
*  \param[in]  byte aBit_Number            - the bit number to be verified. (bit numbers start from 0, e.g. to verify the Port2 Pin7 the aBit_Number param should be 8 )
*                                                                                                    (e.g. to verify bit 0 of an address the aBit_Number param should be 1)
*  \param[in]  enum eBitStatus aBitStatus -   BitStatus_NotSet = 0 
*                                             BitStatus_Set = 1
* Change History: 
* Date(DD.MM.YY)        Author              Change info                                                          
* 20.05.22               AnPa            Created and implemented
*/
void E_DBGR_RegisterCheckBitStatus(char aAddress[], byte aBit_Number, enum eBitStatus aBitStatus)
{
  int iRet_val;
  char chMappedResponseInfo[256];
  
  writeDbgLevel (DebugFuncCalls , "Function E_DBGR_RegisterCheckBitStatus() called.");
  
  iRet_val = lFctn_T32_Register_Check_Bit_Status( aAddress, aBit_Number, aBitStatus,chMappedResponseInfo);

  if(iRet_val == Ok)    
    vFctn_REPORTStepEvaluation(chMappedResponseInfo, PASS); 
  else
    vFctn_REPORTStepEvaluation(chMappedResponseInfo, FAIL);  
}


/**
 * Helper function to poll for STATE.RUN()==FALSE() with timeout
 * Returns 1 if not running, 0 if still running after timeout
 * Poll interval is 250 ms (reduced from 500 ms) to detect halt state faster.
 * Each failed iteration advances elapsed by pollInterval only (avoids double-counting
 * apiWait on top of pollInterval, which previously caused premature timeout expiry).
 */
long waitForNotRunning(long timeoutMs)
{
  long elapsed;
  long pollInterval;
  int apiWait = 60;

  pollInterval = 250;
  elapsed = 0;

  while (elapsed < timeoutMs)
  {
    if (!isRunning())
      return 1; // Not running

    testWaitForTimeoutSilent(pollInterval - apiWait);
    elapsed += pollInterval; // one full poll interval per iteration
  }
  return 0; // Timed out, still running
}

long waitForRunning(long timeoutMs)
{
  long elapsed;
  long pollInterval;
  int apiWait = 60;

  pollInterval = 100;
  elapsed = 0;

  while (elapsed < timeoutMs)
  {
    if (isRunning())
      return 1; // Running

    testWaitForTimeoutSilent(pollInterval - apiWait);
    elapsed += pollInterval; // one full poll interval per iteration
  }
  return 0; // Timed out, still not running
}

long isRunning()
{
  long lApiExitCode[1];
  char chApiMessage[128];
  char chT32Cmd[32] =  "\"EVAL STATE.RUN()==TRUE()\"";
  long result;

  lFctn_CallT32API(chT32Cmd, chApiMessage, lApiExitCode);
  return atol(chApiMessage);
}

/// <GENERIC>
/*! void readPPRegister(char aResult[])
*  \brief Function that reads the PP (Program Pointer) register value.
*
*  \param[out] aResult - the PP register value as a string
*
*  \return no return
*
* Change History:
* Date(DD.MM.YY)        Author          Change info
*
* 31.01.26              Copilot         Created function to support A_DBGR_Go_Safe reset detection.
*/
void readPPRegister(char aResult[])
{
  long lApiExitCode[1];
  char chApiMessage[128];
  char chT32Cmd[32] = "\"PRINT Register(PP)\"";

  lFctn_CallT32API(chT32Cmd, chApiMessage, lApiExitCode);
  strncpy(aResult, chApiMessage, elcount(aResult));
}

/// <GENERIC>
/*! void E_DBGR_CheckCmmScriptResult(char aScript[], char aCore[], long aTimeOut, char aParams[])
*  \brief Runs a CMM script via lFctn_G_T32_RUN_CMM_CORE() and records the result as a
*         PASS or FAIL step in the CANoe test report. This guarantees that every CMM
*         script invocation is consistently captured in the report, making it straightforward
*         to verify reporting accuracy across all 20 benches.
*
*  \param[in] aScript   - CMM script filename (relative to the Cmm_Commands folder)
*  \param[in] aCore     - Target core identifier (e.g., "0", "1")
*  \param[in] aTimeOut  - Maximum wait time in ms for the CMM script to complete
*  \param[in] aParams   - Parameters to pass to the CMM script (use "" for none)
*
*  \return no return
*
* Change History:
* Date(DD.MM.YY)        Author          Change info
*
* 04.03.26              Copilot         Created for CMM script reporting consistency check.
*/
void E_DBGR_CheckCmmScriptResult(char aScript[], char aCore[], long aTimeOut, char aParams[])
{
  long lResult;
  char chPassText[250];
  char chFailText[250];
  byte bDebugFlag;

  bDebugFlag = NotOk;
  writeDbgLevel(DebugFuncCalls, "Function E_DBGR_CheckCmmScriptResult() entered.");

  lResult = lFctn_G_T32_RUN_CMM_CORE(aScript, aCore, aTimeOut, aParams);

  if (lResult == Ok)
  {
    snprintf(chPassText, elcount(chPassText), "CMM script '%s' completed successfully.", aScript);
    if ((byte)DebugFuncInternal & bDebugFlag)
      writeDbgLevel(DebugFuncInternal, "PASS: %s.", chPassText);
    vFctn_REPORTStepEvaluation(chPassText, PASS);
  }
  else if (lResult == NotOk)
  {
    snprintf(chFailText, elcount(chFailText), "CMM script '%s' did not complete within timeout (%ld ms).", aScript, aTimeOut);
    if ((byte)DebugFuncInternal & bDebugFlag)
      writeDbgLevel(DebugFuncInternal, "FAIL: %s.", chFailText);
    vFctn_REPORTStepEvaluation(chFailText, FAIL);
  }
  else if (lResult == Error)
  {
    snprintf(chFailText, elcount(chFailText), "CMM script '%s' could not be started. Check path and T32 connection.", aScript);
    if ((byte)DebugFuncInternal & bDebugFlag)
      writeDbgLevel(DebugFuncInternal, "FAIL: %s.", chFailText);
    vFctn_REPORTStepEvaluation(chFailText, FAIL);
  }
  else if (lResult == -2)
  {
    snprintf(chFailText, elcount(chFailText), "CMM script '%s' exited with an unexpected exit code.", aScript);
    if ((byte)DebugFuncInternal & bDebugFlag)
      writeDbgLevel(DebugFuncInternal, "FAIL: %s.", chFailText);
    vFctn_REPORTStepEvaluation(chFailText, FAIL);
  }
  else if (lResult == -999)
  {
    snprintf(chFailText, elcount(chFailText), "CMM script '%s' aborted: measurement ended before script completed.", aScript);
    if ((byte)DebugFuncInternal & bDebugFlag)
      writeDbgLevel(DebugFuncInternal, "FAIL: %s.", chFailText);
    vFctn_REPORTStepEvaluation(chFailText, FAIL);
  }
  else
  {
    snprintf(chFailText, elcount(chFailText), "CMM script '%s' returned unexpected result: %ld.", aScript, lResult);
    if ((byte)DebugFuncInternal & bDebugFlag)
      writeDbgLevel(DebugFuncInternal, "FAIL: %s.", chFailText);
    vFctn_REPORTStepEvaluation(chFailText, FAIL);
  }
}

