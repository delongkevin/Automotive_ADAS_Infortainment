// ============================================================================
// TRACE32 Connection Script
// Automatically generated by command CONNECTION.Wizard
// ============================================================================
// Connection method:
// Connect to the TRACE32 debug module with device name "E23010045844" via USB.
// ============================================================================

LOCAL &device_index
&device_index=0

LOCAL &device_identifier
&device_identifier="E23010045844"

// The script can only run if the connection is not yet established
IF !CONNECTION.STATE.Interactive()
(
  GOSUB ErrorAndExit "ERROR: Connection is already established. Restart PowerView into interactive mode before using this script."
)

// Reset CONNECTION settings and disable saving to user preferences
CONNECTION.Config.RESet

// Select Interface
CONNECTION.USB.scan ON

// Find debug module(s)
CONNECTION.FindDEVices

// Abort if no debug modules were found
IF CONNECTION.DEVice.Number()==0
  GOSUB ErrorAndExit "ERROR: No debug module connected to USB."

&device_index=CONNECTION.DEVice.IndexByName("&device_identifier")

IF &device_index<0
  GOSUB ErrorAndExit "ERROR: Could not find debug module with device name &device_identifier"

// Check if the debug module is free for use.
IF CONNECTION.DEVice.InUse(&device_index)
(
  DIALOG.YESNO "The debug module with device name &device_identifier is already occupied by another PowerView instance. Reset device?"
  PRIVATE &reset_device
  ENTRY &reset_device
  IF &reset_device
  (
    CONNECTION.ResetDevice &device_index
    WAIT 3s
  )
  ELSE
  (
    PRINT "Aborted."
    ENDDO
  )
)

// Select Device
CONNECTION.Select.DEVice &device_index

// Establish connection
PRINT "Establishing connection..."
CONNECTION.ESTABLISH /NOERROR

// Error check and handling
IF CONNECTION.STATE.ERROR()
(
  PRIVATE &error_message
  GOSUB GetErrorMessage
  RETURNVALUES &error_message
  GOSUB ErrorAndExit "&error_message"
)

PRINT "Connection to debug module "+CONNECTION.DEVice.NAME(&device_index)+" was successful."

// Finalize connection process
CONNECTION.ESTABLISH /FINALIZE

ENDDO

// ============================================================================
// SUBROUTINES
// ============================================================================

SUBROUTINE ErrorAndExit
(
  PRIVATE &error_message
  PARAMETERS &error_message
  IF CONFIG.SCREEN()
  (
    PRINT %ERROR "&error_message"
    DIALOG.OK "&error_message"
    CONNECTION.ESTABLISH /FINALIZE
    ENDDO
  )
  ELSE
  (
    PRINT %ERROR "&error_message"
    QUIT -1
  )
)

SUBROUTINE GetErrorMessage
(
  PRIVATE &driver_message &error_message
  &driver_message=CONNECTION.GetDriverError(1,-1)
  &error_message="ERROR: Failed to connect to device "+CONNECTION.DEVice.NAME(&device_index)
  &error_message="&error_message, serial number "+CONNECTION.DEVice.SerialNumber(&device_index)
  &error_message="&error_message via port "+CONNECTION.DEVice.PORT(&device_index)+"."
  IF "&driver_message"!=""
    &error_message="&error_message"+CONVert.CHAR(0x0A)+CONVert.CHAR(0x0A)+"&driver_message"
  RETURN "&error_message"
)

