/*@!Encoding:1252*/

//  ====================================================
//   MAGNA - T32 Symbols 
//  ====================================================
//
//  File name: T32_Symbols.cin
//
//  Created(DD.MM.YYYY): 19.04.2022
//
//  Description: All Trace32 symbols used in L2L3_CCU project
//          
//  References: This file should be included in test modules
//
//  Naming Convention:
//
//  pc_T32_Fctn_NameOfTheFunction        
//  pc_T32_Var_VariableName                         
//  pc_T32_Reg_RegName  
//  pc_T32_CMD_CommandName
//  pv_T32_Fctn_NameOfTheFunction_OffSetName  
//
//  --------------------------------------------------------------------

variables
{ 
  
}
