/*@!Encoding:1252*/
//  ====================================================
//   MAGNA - DCU_EQ6 Bench Init
//  ====================================================
//
//  File name: DCU_EQ6_CallBack.cin
//
//  Created(DD.MM.YYYY): 27.01.2025
//
//  Description: Call back function whichi will prepare the test execution
//          
//  References: -
//  --------------------------------------------------------------------   
//  --------------------------------------------------------------------
//  GENERAL NOTES
//  -------------------------------------------------------------------- 
includes
{ 
  #include "..\..\ProjectSpecific\GenLib_Includes.cin"
  
}

variables
{
}

/*! \fn DCU_BenchInit()
*   \brief Function to set the init state of the ecu
*
*   \return no return
*
*  Change History: 
*  Date(DD.MM.YY)        Author          Change info                                                          
*   
*  29.01.2025            CiCo            Created
*/
testfunction BenchInit()
{
/***************************************************************************************************************/    
                                          // Variable Definition
/***************************************************************************************************************/
/***************************************************************************************************************/    
                                              // Description
/***************************************************************************************************************/
  setWriteDbgLevel(DebugOff);
  
/***************************************************************************************************************/    
                                              // Add info to report
/***************************************************************************************************************/
  bFctn_REPORTInit();// Add DUT info and Tester info in report
  
 
}