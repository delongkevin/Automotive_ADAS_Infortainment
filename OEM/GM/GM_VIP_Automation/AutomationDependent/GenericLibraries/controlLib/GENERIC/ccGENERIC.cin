/*@!Encoding:1252*/
/*!
* @defgroup ccGENERIC ccGENERIC
* @defgroup GENERIC GENERIC
* @ingroup controlLib
* @{
* @addtogroup ccGENERIC
* @{
*/ 
variables
{ 
  enum cc_eTimeFormat { nS = 0, uS = 3, mS = 6, S = 9};
  enum cc_eTimeCmp {TimeLessEq, TimeMoreEq};
}


/*! @}*/
/*! @}*/
/*!
*   \file
*   \ingroup controlLib
*   \brief GENERIC control library constants.
*/