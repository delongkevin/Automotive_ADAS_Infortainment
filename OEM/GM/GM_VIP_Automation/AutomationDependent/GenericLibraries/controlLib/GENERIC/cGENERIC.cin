/*@!Encoding:1252*/
/*!
* @defgroup cGENERIC cGENERIC
* @defgroup GENERIC GENERIC
* @ingroup controlLib
* @{
* @addtogroup cGENERIC
* @{
*/ 

includes
{
  #include "ccGENERIC.cin"
}

/*! \fn float fFctn_Generic_GetLastWaitTime( enum cc_eTimeFormat aTimeFormat, char aMappedResponse[] )
*  \brief Function that will get the last function wait elapsed time in requested format
*  \param[in]  aTimeFormat           - How the time will be returned [nS, uS, mS, S], see definition of enum cc_eTimeFormat.
*  \param[out] aMappedResponse       - Value in string format or message error.
* 
*  \return 	>0     - Elasped time for the last wait instruction
*  \return 	-1  	 - Invalid time format or no wait time for the last instruction
*
*  \note Use this function when is needed to see if the event is occured after a certain time.
*
* Change History: 
* Date(DD.MM.YY)        Author          Change info                                                          
*  
*  26.02.20             CiCo        	  Created and implemented
*/
float fFctn_Generic_GetLastWaitTime( enum cc_eTimeFormat aTimeFormat, char aMappedResponse[] )
{
  char chTimeFormat[5];
  float fWaitTimeLastInstruction;
  byte bDebugFlag;
  
  bDebugFlag = tsc_bBUS_GlobalDebugFlag;// debug only 
  
  writeDbgLevel(DebugFuncCalls, "Function fFctn_Generic_GetLastWaitTime() called.");
  
  switch ( aTimeFormat ) // nS = 0, uS = 3, mS = 6, S = 9
  {
    case ( nS ):// nano seconds
      snprintf(chTimeFormat,elcount(chTimeFormat),"nS");
      break;
    case ( uS ):// micro seconds
      snprintf(chTimeFormat,elcount(chTimeFormat),"uS");
      break;
    case ( mS ):// mili seconds
      snprintf( chTimeFormat, elcount(chTimeFormat), "mS" );
      break;
    case ( S ):// seconds
      snprintf( chTimeFormat, elcount(chTimeFormat), "S" );
      break;
    default:// time format not defined in enum eTimeFormat
      snprintf( aMappedResponse, elcount(aMappedResponse), "Time format %d not defined in enum eTimeFormat.", aTimeFormat);
      return Error;
  }
  
  fWaitTimeLastInstruction = TestGetLastWaitElapsedTimeNS() / _pow(10, aTimeFormat);
  if ( (byte)DebugFuncInternal & bDebugFlag)
	  writeDbgLevel( DebugFuncInternal, "fWaitTimeLastInstruction -> %f [%s]", fWaitTimeLastInstruction, chTimeFormat );
      
  if( Error != fWaitTimeLastInstruction )
  {
    snprintf( aMappedResponse, elcount(aMappedResponse), "%f [%s]", fWaitTimeLastInstruction, chTimeFormat );
    return fWaitTimeLastInstruction;
  }
  else
  {
    snprintf( aMappedResponse, elcount(aMappedResponse), "No wait time for the last wait instruction." );
    return Error;
  }
}

/*! @}*/
/*! @}*/
/*!
*   \file
*   \ingroup controlLib
*   \brief Library for generic functions.
*/