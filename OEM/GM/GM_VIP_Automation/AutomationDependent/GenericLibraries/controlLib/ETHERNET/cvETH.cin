/*@!Encoding:1252*/
/*!
* @defgroup cvETH cvETH
* @defgroup ETH ETH
* @ingroup controlLib
* @{
* @addtogroup cvETH
* @{
*/ 
variables
{
struct cv_stETHPacket {
    #if TOOL_MAJOR_VERSION > 15
      char ch_sMAC[50];
      char ch_dMAC[50];
      word  w_vlanID;
      word  w_ethType;
      dword dw_protocol;
      char ch_sIP[50];
      char ch_dIP[50];
      dword dw_sPort;
      dword dw_dPort;
      dword dw_flags;
    #else
      char cv_chPacketName[50];// name of ETH packet
      char cv_chSrcIP[50];// source IP address
      char cv_chDestIP[50];// destination IP address
      dword cv_dwSrcPort;// source port
      dword cv_dwDestPort;// destination port
    #endif
  };
}
/*! @}*/
/*! @}*/
/*!
*   \file
*   \ingroup controlLib
*   \brief Ethernet control library variables.
*/