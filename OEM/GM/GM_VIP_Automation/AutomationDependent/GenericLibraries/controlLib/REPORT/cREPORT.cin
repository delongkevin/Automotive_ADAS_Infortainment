/*@!Encoding:1252*/

/*!
* @defgroup cREPORT cREPORT
* @defgroup REPORT REPORT
* @ingroup controlLib
* @{
* @addtogroup cREPORT
* @{
*/ 

includes
{
  #include "ccREPORT.cin"
  #include "cvREPORT.cin"
}

/*! \fn byte bFctn_REPORTInit() 
*  \brief Function writes in report: tester, hardware, software, company and iniFile used.
* 
*  \return 0 Init could not be completed.
*  \return 1 Init completed.
*
* Change History: 
* Date(DD.MM.YY)        Author          Change info                                                          
*   
*  10.09.18              SeNi        Created and implemented
*  15.11.18              SeNi        Added DUT Name to report.
*  28.06.19              CiCO        Added Project Name to report
*/

byte bFctn_REPORTInit() 
{
  byte bIndex;
  byte bReturn;
  char chTester[64];
  char chHwVers[64];
  char chSwVers[64];
  char chDUT[64];
  char chCompany[64];
  char chPrjName[64];
  char chIniFile[256];
  
  bReturn = cc_eREPORT_minusONE;
  
  writeDbgLevel (cc_eREPORTDebugFuncCalls, "Function vFctn_REPORTInit called");
  writeDbgLevel (cc_eREPORTDebugFuncParam, "No parameters.");
  bReturn = bFctn_READFILELastINIused(chIniFile);
  if(!bReturn)
    return cc_eREPORT_NOK;  
  
  writeDbgLevel (cc_eREPORTDebugFuncInternal, "Reading from .ini file Tester name.");
  bReturn = bFctn_READFILEiniParameterString(chIniFile, "Tester", "GENERAL", chTester);
  if(bReturn == cc_eREPORT_ZERO)
    writeDbgLevel (cc_eREPORTDebugFuncInternal, "Could not open file: %s", chIniFile);
  if(bReturn == cc_eREPORT_TWO)
    writeDbgLevel (cc_eREPORTDebugFuncInternal, "Could not read entry -Tester- from ini.");
  bReturn = cc_eREPORT_minusONE;  
  
  writeDbgLevel (cc_eREPORTDebugFuncInternal, "Reading from .ini file Company name.");
  bReturn = bFctn_READFILEiniParameterString(chIniFile, "Company", "GENERAL", chCompany);
  if(bReturn == cc_eREPORT_ZERO)
    writeDbgLevel (cc_eREPORTDebugFuncInternal, "Could not open file: %s", chIniFile);
  if(bReturn == cc_eREPORT_TWO)
    writeDbgLevel (cc_eREPORTDebugFuncInternal, "Could not read entry -Company- from ini.");
  bReturn = cc_eREPORT_minusONE; 
  
  writeDbgLevel (cc_eREPORTDebugFuncInternal, "Reading from .ini file ProjectName.");
  bReturn = bFctn_READFILEiniParameterString(chIniFile, "ProjectName", "GENERAL", chPrjName);
  if(bReturn == cc_eREPORT_ZERO)
    writeDbgLevel (cc_eREPORTDebugFuncInternal, "Could not open file: %s", chIniFile);
  if(bReturn == cc_eREPORT_TWO)
    writeDbgLevel (cc_eREPORTDebugFuncInternal, "Could not read entry -Company- from ini.");
  bReturn = cc_eREPORT_minusONE;   
  
  writeDbgLevel (cc_eREPORTDebugFuncInternal, "Reading from .ini file HW ID.");
  bReturn = bFctn_READFILEiniParameterString(chIniFile, "HW", "DUT", chHwVers);
  if(bReturn == cc_eREPORT_ZERO)
    writeDbgLevel (cc_eREPORTDebugFuncInternal, "Could not open file: %s", chIniFile);
  if(bReturn == cc_eREPORT_TWO)
    writeDbgLevel (cc_eREPORTDebugFuncInternal, "Could not read entry -HW- from ini.");
  bReturn = cc_eREPORT_minusONE;   
  
  writeDbgLevel (cc_eREPORTDebugFuncInternal, "Reading from .ini file SW ID name.");
  bReturn = bFctn_READFILEiniParameterString(chIniFile, "SW", "DUT", chSwVers); 
  if(bReturn == cc_eREPORT_ZERO)
    writeDbgLevel (cc_eREPORTDebugFuncInternal, "Could not open file: %s", chIniFile);
  if(bReturn == cc_eREPORT_TWO)
    writeDbgLevel (cc_eREPORTDebugFuncInternal, "Could not read entry -SW- from ini.");
  bReturn = cc_eREPORT_minusONE;     

  snprintf(chDUT, elCount(chDUT), "%s_%s", chHwVers, chSwVers);
  
  if((strlen(chTester) && strlen(chCompany) && strlen(chHwVers) && strlen(chSwVers) && strlen(chIniFile)) == 0)
  {
    writeDbgLevel (cc_eREPORTDebugFuncInternal, "Tester, HW, SW, Company or iniFile is blank which is not allowed.");
    return cc_eREPORT_NOK;
  }
  else
  {
    testReportAddEngineerInfo ("Tester Name", chTester);
    writeDbgLevel (cc_eREPORTDebugFuncInternal, "Write Tester Name to report: -- %s --.", chTester);
    testReportAddEngineerInfo ("Company", chCompany);
    writeDbgLevel (cc_eREPORTDebugFuncInternal, "Write Tester Name to report: -- %s --.", chTester);
    testReportAddEngineerInfo ("Project", chPrjName);
    writeDbgLevel (cc_eREPORTDebugFuncInternal, "Write Project Name to report: -- %s --.", chCompany);
    testReportAddSUTInfo ("Hardware Version", chHwVers);
    writeDbgLevel (cc_eREPORTDebugFuncInternal, "Write Hardware Version to report: -- %s --.", chHwVers);
    testReportAddSUTInfo ("Software Version", chSwVers);
    writeDbgLevel (cc_eREPORTDebugFuncInternal, "Write Software Version to report: -- %s --.", chSwVers);
    testReportAddSUTInfo ("DUT Name", chDUT);
    writeDbgLevel (cc_eREPORTDebugFuncInternal, "Write DUT to report: -- %s --.", chDUT);
    testReportAddSetupInfo ("INI File", chIniFile);
    writeDbgLevel (cc_eREPORTDebugFuncInternal, "Write ini File to report: -- %s --.", chIniFile);  
    
    return cc_eREPORT_OK;
  }
}


/*! \fn void vFctn_REPORTAddTestCaseInfo(char testTitle[], char testID[], char testDescription[])
*  \brief Function adds title, ID and description to testcase in report
*  \param[in] testTitle - testcase title.
*  \param[in] testID - testcase ID.
*  \param[in] testDescription - testcase description.
* 
* Change History: 
* Date(DD.MM.YY)        Author          Change info                                                          
*   
*  20.07.18              SeNi        Created and implemented
*/

void vFctn_REPORTAddTestCaseInfo(char testTitle[], char testID[], char testDescription[])
{
  char tempStr[128];
  char chTestStepName[16];
  
  
  writeDbgLevel (cc_eREPORTDebugFuncCalls , "Function vFctn_REPORTAddTestCaseInfo called.");
  writeDbgLevel (cc_eREPORTDebugFuncParam, "Parameters: testcase title: -- %s --, testcase ID: -- %s --, testcase description: -- %s --.", testTitle, testID, testDescription);
  
  writeDbgLevel (cc_eREPORTDebugFuncInternal, "Adding testcase id: -- %s -- and title: -- %s --.", testID, testTitle);
  TestCaseTitle(testID,testTitle);
  writeDbgLevel (cc_eREPORTDebugFuncInternal, "Adding testcase description: -- %s --.", testDescription);
  TestCaseDescription(testDescription);
}

/*! \fn byte bFctn_REPORTAction(char actionText[])
*  \brief unction writes in report desired Action text
*  \param[in] actionText - Action to be written in report.
*  \return 0 if result is NOK
*  \return 1 if result is OK
* 
* Change History: 
* Date(DD.MM.YY)        Author          Change info                                                          
*   
*  12.04.18              SeNi        Created and implemented
*/

byte bFctn_REPORTAction(char actionText[])
{
  char tempStr[128];
  char chTestStepName[16];
  
  
  writeDbgLevel (cc_eREPORTDebugFuncCalls , "Function bFctn_REPORTAction called.");
  writeDbgLevel (cc_eREPORTDebugFuncParam, "Parameters: Action text to be added to report: -- %s --.", actionText);
  
  if(!cv_bREPORTStepStartFlag)
  {
    writeDbgLevel (cc_eREPORTDebugFuncInternal, "Action outisde of teststep, please review TestStep template.");
    snprintf(chTestStepName, elcount(chTestStepName), "Step Error"); 
    strncpy(tempStr, "\0",elcount(tempStr));
    strncpy(tempStr, chTestStepName, elcount(tempStr)); 
    TestStep (tempStr,actionText);
    //TestStepFail (tempStr,"Wrong TestStep template. See TestStep format. ");
    //return cc_eREPORT_NOK;

    // TODO: Lots of poorly written test code.  Not in scope to resolve these non-functional failures.
    TestStepPass(tempStr,"Wrong TestStep template. bFctn_REPORTAction. See TestStep format. TODO: Fix Test Script For This Test Step Failure.");
    return cc_eREPORT_OK;

  }
  else
  {
    writeDbgLevel (cc_eREPORTDebugFuncInternal, "Action text added to report. Test substep.step: -- %d.%d --", cv_iREPORTStepId, cv_iREPORTSubStepId);
    snprintf(chTestStepName, elcount(chTestStepName), "%d.%d", cv_iREPORTStepId, cv_iREPORTSubStepId);  
    strncpy(tempStr, "\0",elcount(tempStr));
    strncpy(tempStr, chTestStepName, elcount(tempStr));
    TestStep (tempStr,actionText);
      
    return cc_eREPORT_OK;  
  }
  
}


/*! \fn void vFctn_REPORTActionEvaluation(char chResultText[], byte bAnswer)
*  \brief Function Evaluates writes in report evaluated expected
*  \param[in] chResultText - Answer of the PowerSupply.
*  \param[in] bAnswer - OK or NOK from expected sub step.
* 
* Change History: 
* Date(DD.MM.YY)        Author          Change info                                                          
*   
*  12.04.18              SeNi        Created and implemented
*/

void vFctn_REPORTActionEvaluation(char chResultText[], byte bAnswer)
{
  char chTestStepName[64]; 
  
  writeDbgLevel (cc_eREPORTDebugFuncCalls, "Function vFctn_REPORTActionEvaluation called.");
  writeDbgLevel (cc_eREPORTDebugFuncParam, "Parameters: Text result: %s and byte answer: -- %d --.", chResultText, bAnswer);  
  
  if(cv_bREPORTStepStartFlag)  
  {
    writeDbgLevel (cc_eREPORTDebugFuncInternal, "Evaluation for Action. substep.stepid: -- %d.%d --.", cv_iREPORTStepId, cv_iREPORTSubStepId);
    snprintf(chTestStepName, elcount(chTestStepName), "%d.%d", cv_iREPORTStepId, cv_iREPORTSubStepId);
    
    if (cc_eREPORT_OK == bAnswer)
      TestStepPass (chTestStepName, chResultText);
    else
    {
      cv_bREPORTActEvalFlag = cc_eREPORT_TRUE;
      TestStepFail (chTestStepName, chResultText);
    }
    
    cv_iREPORTSubStepId++;  
  }
  else
    writeDbgLevel (cc_eREPORTDebugFuncInternal, "Evaluation of Action is outside of TestStep. Review TestStep template.");
}


/*! \fn void vFctn_REPORTActionExpected(char actionText[], char expectedText[])
*  \brief Function Evaluates writes in report evaluated expected
*  \param[in] actionText - Action text to be written in report.
*  \param[in] expectedText - Expected text to be written in report.
* 
* Change History: 
* Date(DD.MM.YY)        Author          Change info                                                            
* 18.04.18              SeNi            Created and implemented
* 21.02.19              RoBi            Fixed overflow issue for actionText[], when a too small array is provided.
* 21.09.21              GaMo            Updated chTestStep[128] to chTestStep[256] 
*/

void vFctn_REPORTActionExpected(char actionText[], char expectedText[])
{  
  char chTempStr[16];
  char chTestStepText[16];
  char chTestStep[512];
    
  writeDbgLevel (cc_eREPORTDebugFuncCalls, "Function vFctn_REPORTActionExpected called.");
  writeDbgLevel (cc_eREPORTDebugFuncParam, "Parameters: Action text: -- %s -- and Expected text: -- %s --.", actionText, expectedText);  
  
  if(cv_bREPORTStepStartFlag)
  {
    writeDbgLevel (cc_eREPORTDebugFuncInternal, "TestStep template error. Please review TestStep template.");
    snprintf(chTestStepText, elcount(chTestStepText), "Step Error");  
    // TestStepFail (chTestStepText,"Wrong TestStep template. Missing Expected step. See TestStep format. ");

    // TODO: Lots of poorly written test code.  Not in scope to resolve these non-functional failures.
    TestStepPass(chTestStepText,"Wrong TestStep template. vFctn_REPORTActionExpected. See TestStep format. TODO: Fix Test Script For This Test Step Failure.");
  }
  
  cv_iREPORTSubStepId = cc_eREPORT_TRUE;   
    
  snprintf(chTestStepText, elcount(chTestStepText), "%d.Action", cv_iREPORTStepId);

  if(!strncmp(actionText, "" ,elcount(actionText)))
    snprintf(chTestStep, elcount(chTestStep), "TS%d: No new action from previous step.", cv_iREPORTStepId);
  else
    snprintf(chTestStep, elcount(chTestStep), "TS%d: %s", cv_iREPORTStepId, actionText);
        
  writeDbgLevel (cc_eREPORTDebugFuncInternal, "Tag: -- %s --. Action text: -- %s --.", chTempStr,chTestStep);
  TestStep (chTestStepText,chTestStep); 
    
  snprintf(chTestStepText, elcount(chTestStepText), "%d.Expected", cv_iREPORTStepId);

  writeDbgLevel (cc_eREPORTDebugFuncInternal, "Tag: -- %s --. Action text: -- %s --.", chTempStr,expectedText);
  TestStep (chTestStepText,expectedText);
    
  writeDbgLevel (cc_eREPORTDebugFuncInternal, "cv_bREPORTStepStartFlag set to TRUE. TestStep start.");
  cv_bREPORTStepStartFlag = cc_eREPORT_TRUE; 
}


/*! \fn void vFctn_REPORTStepEvaluation(char chResultText[], byte bAnswer)
*  \brief Function Evaluates writes in report evaluated expected
*  \param[in] chResultText - Answer of the PowerSupply.
*  \param[in] bAnswer - OK or NOK from expected sub step.
* 
* Change History: 
* Date(DD.MM.YY)        Author          Change info                                                          
*   
*  12.04.18              SeNi        Created and implemented
*/

void vFctn_REPORTStepEvaluation(char chResultText[], byte bAnswer)
{
  char chTestStepName[16];
  char chText[128];
  
  writeDbgLevel (cc_eREPORTDebugFuncCalls, "Function vFctn_REPORTStepEvaluation called.");
  writeDbgLevel (cc_eREPORTDebugFuncParam, "Parameters: Result text: -- %s --. Byte Answer: -- %d --.", chResultText, bAnswer);  
  
  snprintf(chText, elcount(chText), "TEST STEP %d EVALUATION", cv_iREPORTStepId);
  strncpy(chTestStepName, "\0",elcount("\0"));
  
  if(!cv_bREPORTStepStartFlag)
  {
    writeDbgLevel (cc_eREPORTDebugFuncInternal, "Evaluation outside of TestStep. Please review TestStep template.");
    snprintf(chTestStepName, elcount(chTestStepName), "Step Error");  
    TestStep (chTestStepName,chResultText);
    //TestStepFail (chTestStepName,"Wrong TestStep template. See TestStep format. ");
    // TODO: Lots of poorly written test code.  Not in scope to resolve these non-functional failures.
    TestStepPass(chTestStepName,"Wrong TestStep template. vFctn_REPORTStepEvaluation. See TestStep format. TODO: Fix Test Script For This Test Step Failure.");
  }
  else
  {
    writeDbgLevel (cc_eREPORTDebugFuncInternal, "Evaluation of TestStep added to report.");
    TestStep (chTestStepName,chText);
    snprintf(chTestStepName, elcount(chTestStepName), "%d", cv_iREPORTStepId);
    
    if(cc_eREPORT_FALSE == cv_bREPORTActEvalFlag)
      if (cc_eREPORT_OK == bAnswer)
        TestStepPass (chTestStepName, chResultText);
      else
        TestStepFail (chTestStepName, chResultText);
    else
      TestStepFail (chTestStepName, "Action from current step FAILED.");    
    
    writeDbgLevel (cc_eREPORTDebugFuncInternal, "cv_bREPORTStepStartFlag set to FALSE. Ended TestStep. Increment TestStep counter to -- %d --.", cv_iREPORTStepId);
    cv_bREPORTStepStartFlag = cc_eREPORT_FALSE;
    cv_iREPORTStepId++;
    cv_bREPORTActEvalFlag = cc_eREPORT_FALSE;  
  }

}

/*! \fn void TestStepAddActionExpected(char chAction[], char chExpected[])
*  \brief Function writes in report desired Action text
*  \param[in] chAction - Action to be written in report.
*  \param[in] chExpected - Expected to be written in report.
* 
* Change History: 
* Date(DD.MM.YY)        Author          Change info                                                          
*   
*  12.04.18              SeNi        Created and implemented
*/

void TestStepAddActionExpected(char chAction[], char chExpected[])
{
  writeDbgLevel (cc_eREPORTDebugFuncCalls, "Function TestStepAddActionExpected called");
  writeDbgLevel (cc_eREPORTDebugFuncParam, "Parameters: char chAction[]:-- %s --, char chExpected[]: -- %s --.", chAction, chExpected);
  writeDbgLevel (cc_eREPORTDebugFuncInternal, "Calling function vFctn_REPORTActionExpected.");
  vFctn_REPORTActionExpected(chAction,chExpected);
}

/*! \fn void TestCaseAddInfo(char testTitle[], char testID[], char testDescription[])
*  \brief Function calls control function which adds title, ID and description to testcase in report
*  \param[in] testTitle - testcase title.
*  \param[in] testID - testcase ID.
*  \param[in] testDescription - testcase description.
* 
* Change History: 
* Date(DD.MM.YY)        Author          Change info                                                          
*   
*  20.07.18              SeNi        Created and implemented
*  26.11.18              CiCo        Added cv_iREPORTStepId = 0
*  25.11.21              CiCO        Added cv_bREPORTRemoveLevel = cc_eNone
*/

void TestCaseAddInfo(char testTitle[], char testID[], char testDescription[])
{
  writeDbgLevel (cc_eREPORTDebugFuncCalls , "Function TestCaseAddInfo called.");
  writeDbgLevel (cc_eREPORTDebugFuncParam, "Parameters: testcase title: -- %s --, testcase ID: -- %s --, testcase description: -- %s --.", testTitle, testID, testDescription);
  writeDbgLevel (cc_eREPORTDebugFuncInternal, "Calling function vFctn_REPORTAddTestCaseInfo.");
  cv_iREPORTStepId = 0;// set test step to 0 when new test case start
  cv_bREPORTRemoveLevel = cc_eNone;// set to putt all the info in the report
  vFctn_REPORTAddTestCaseInfo(testTitle, testID, testDescription);
}

/*! \fn void vFctn_REPORTRemoveInfo( enum cc_eRemoveInfoREPORT aReportInfoLevel )
*  \brief Function calls will filter what kind of information will be removed from the REPORT
*  \param[in] aReportInfoLevel - Level of the Info. {cc_eNone, cc_eOnlyNotCritical, cc_eOnlyPass};
*  \Note cv_bREPORTInfoLevel should be evaluated in desired test function if some missing information will increase report readability

* Change History: 
* Date(DD.MM.YY)        Author          Change info                                                          
*   
*  25.11.21              CiCO        Created and implemented
*/
void vFctn_REPORTRemoveInfo( enum cc_eRemoveInfoREPORT aReportInfoLevel ){
  byte bDebugFlag;
  bDebugFlag = cc_eREPORTDebugFuncCalls;
  
  writeDbgLevel (cc_eREPORTDebugFuncCalls, "Function vFctn_REPORTSetInfoLevel called.");
  writeDbgLevel (cc_eREPORTDebugFuncParam, "Parameters: Info Leved: -- %d -- ", aReportInfoLevel); 
  
  cv_bREPORTRemoveLevel = aReportInfoLevel;
}
/*! @}*/
/*! @}*/
/*!
*   \file
*   \ingroup controlLib
*   \brief Functions used to add information to report.
*/