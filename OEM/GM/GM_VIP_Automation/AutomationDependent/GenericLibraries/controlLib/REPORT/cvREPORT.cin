/*@!Encoding:1252*/

/*!
* @defgroup cvREPORT cvREPORT
* @defgroup REPORT REPORT
* @ingroup controlLib
* @{
* @addtogroup cvREPORT
* @{
*/ 

variables
{
  byte cv_bREPORTStepStartFlag     = 0;
  byte cv_bREPORTStepAEFlag        = 0;
  int  cv_iREPORTStepId            = 0;
  int  cv_iREPORTSubStepId         = 1;
  byte cv_bREPORTActEvalFlag       = 0;
  byte cv_bREPORTRemoveLevel = cc_eNone;
}

/*! @}*/
/*! @}*/
/*!
*   \file
*   \ingroup controlLib
*   \brief REPORT control library variables.
*/