/*@!Encoding:1252*/
/*!
* @defgroup ccREADFILE ccREADFILE
* @defgroup READFILE READFILE
* @ingroup controlLib
* @{
* @addtogroup ccREADFILE
* @{
*/ 
variables 
{
  const word cc_wREADFILE_BufferCharLimit = 5000;
  const word cc_wREADFILE_KeywordCharLimit = 500;
  const byte cc_bREADFILE_RegExCharLimit = 50;
  
  // This debug flag will be used to enable/disable the debug messages in all functions of the current module
  // 0x00 - No debug messages displayed (only function calls).
  // 0x01 - Only function call messages displayed (this will always displayed).
  // 0x02 - Function parameter + 0x01.
  // 0x04 - Internal function actions + 0x01 and 0x02.
  // 0xFF - All of the above (function calls, function parameters, internal function actions).
  const byte ccREADFILE_GlobalDebugFlag = 0x01;
}


/*! @}*/
/*! @}*/
/*!
*   \file
*   \ingroup controlLib
*   \brief READFILE control library constants.
*/