/*@!Encoding:1252*/
/*!
* @defgroup tsPDU tsPDU
* @defgroup PDU PDU
* @ingroup testSupportLib
* @{
* @addtogroup tsPDU
* @{
*/ 

includes
{
  #include "tscPDU.cin"
  #include "..\..\controlLib\PDU\cPDU.cin"
}

/*! \fn void A_PDU_WaitForAutosarPDUByName(dbPDU* aPDUNameFromDB, dword aTimeout, enum eExpectedPresence aExpectedPDUPresence, char aBusContext[])
*  \brief Function that executes the action to check if a Autosar PDU name is received in a specific time or not.
*  \param[in] aPDUNameFromDB        - Name of the Autosar PDU from the arxml database.
*  \param[in] aTimeout              - Maximum wait time to check if the Autosar PDU is absent or not.
*  \param[in] aExpectedPDUPresence  - The expected presence of the Autosar PDU: Present or Absent.
* 
*  \return None
*
*  \note 
*     - The aPDUNameFromDB parameter should be dragged/dropped from arxml database listed in CAPL Network Symbols window.\n
*     Check the example in the test file: tsPDU_Tests.can for more details.
*
* Change History: 
* Date(DD.MM.YY)        Author          Change info                                                          
* 20.05.2019             CrJu           Created and implemented
*/

void A_PDU_WaitForAutosarPDUByName(dbPDU* aPDUNameFromDB, dword aTimeout, enum eExpectedPresence aExpectedPDUPresence)
{
  char chAction[250];
  char chFailText[250];
  char chPDUPresenceInfo[250];
  long lResult;
  byte bDebugFlag;
  byte bResultAction;
  
  // Initialization of local variables
  lResult	= NotOk;
  bResultAction = NotOk;
  bDebugFlag = tsc_bPDU_GlobalDebugFlag;
  
  writeDbgLevel(DebugFuncCalls, "Entered A_PDU_WaitForPDUByName().");
  
  if ((byte)DebugFuncParam & bDebugFlag )
    writeDbgLevel(DebugFuncParam, "Parameters: PDU* aPDUNameFromDB, dword aTimeout: -- %d --, eExpectedState aExpectedPDUPresence -- %d -- (0 - ABSENT; 1 - PRESENT)", aTimeout, aExpectedPDUPresence);
  
  snprintf(chAction, elcount(chAction), "Check if the specified Autosar PDU Name is evaluated as: %d (0 - Absent, 1 - Present), within the specified wait time.", aExpectedPDUPresence);
  bResultAction = bFctn_REPORTAction(chAction);

  if(Ok == bResultAction)
  {
    lResult = lFctn_PDU_WaitForAutosarPDUByName(aPDUNameFromDB, aTimeout, chPDUPresenceInfo);
    
    if( Error != lResult)
    {
      if(Present == aExpectedPDUPresence) //Expect the PDU to be present
      {
        //PDU has arrived, as the user expected.
        if ( Ok == lResult )
        {
          vFctn_REPORTActionEvaluation(chPDUPresenceInfo, PASS);
        }
        else //PDU has not arrived, as the user didn't expect.
        {
          vFctn_REPORTActionEvaluation(chPDUPresenceInfo, FAIL);
        }
      }
      else //Expect the PDU to be absent
      {
        //PDU has arrived, as the user didn't expect.
        if ( Ok == lResult )
        {
          vFctn_REPORTActionEvaluation(chPDUPresenceInfo, FAIL);
        }
        else //PDU has not arrived, as the user expected.
        {
          vFctn_REPORTActionEvaluation(chPDUPresenceInfo, PASS);
        }
      }
    }
    else //an error occurred
    {
      vFctn_REPORTActionEvaluation(chPDUPresenceInfo, FAIL);
    }
  }
  else // the reporting function has failed
  {
    snprintf(chFailText, elcount(chFailText), "ERROR: The action text could not be added in the Report. bFctn_REPORTAction() return: %d.", bResultAction);
    vFctn_REPORTActionEvaluation(chFailText, FAIL);
  }
}

/*! \fn void E_PDU_WaitForAutosarPDUByName(dbPDU* aPDUNameFromDB, dword aTimeout, enum eExpectedPresence aExpectedPDUPresence, char aBusContext[])
*  \brief Function that evaluates if a Autosar PDU name is received in a specific time or not.
*  \param[in] aPDUNameFromDB        - Name of the Autosar PDU from the arxml database.
*  \param[in] aTimeout              - Maximum wait time to check if the Autosar PDU is absent or not.
*  \param[in] aExpectedPDUPresence  - The expected presence of the Autosar PDU: Present or Absent.
* 
*  \return None
*
*  \note 
*     - The aPDUNameFromDB parameter should be dragged/dropped from arxml database listed in CAPL Network Symbols window.\n
*     Check the example in the test file: tsPDU_Tests.can for more details.
*
* Change History: 
* Date(DD.MM.YY)        Author          Change info                                                          
* 20.05.2019             CrJu           Created and implemented
*/

void E_PDU_WaitForAutosarPDUByName(dbPDU* aPDUNameFromDB, dword aTimeout, enum eExpectedPresence aExpectedPDUPresence)
{
  char chPDUPresenceInfo[250];
  long lResult;
  byte bDebugFlag;
  
  // Initialization of local variables
  lResult	= NotOk;
  bDebugFlag = tsc_bPDU_GlobalDebugFlag;
  
  writeDbgLevel(DebugFuncCalls, "Entered E_PDU_WaitForPDUByName().");
  
  if ((byte)DebugFuncParam & bDebugFlag )
    writeDbgLevel(DebugFuncParam, "Parameters: PDU* aPDUNameFromDB, dword aTimeout: -- %d --, eExpectedState aExpectedPDUPresence -- %d -- (0 - ABSENT; 1 - PRESENT).", aTimeout, aExpectedPDUPresence);

  lResult = lFctn_PDU_WaitForAutosarPDUByName(aPDUNameFromDB, aTimeout, chPDUPresenceInfo);
    
  if( Error != lResult)
  {
    if(Present == aExpectedPDUPresence) //Expect the PDU to be present
    {
      //PDU has arrived, as the user expected.
      if ( Ok == lResult )
      {
        vFctn_REPORTStepEvaluation(chPDUPresenceInfo, PASS);
      }
      else //PDU has not arrived, as the user didn't expect.
      {
        vFctn_REPORTStepEvaluation(chPDUPresenceInfo, FAIL);
      }
    }
    else //Expect the PDU to be absent
    {
      //PDU has arrived, as the user didn't expect.
      if ( Ok == lResult )
      {
        vFctn_REPORTStepEvaluation(chPDUPresenceInfo, FAIL);
      }
      else //PDU has not arrived, as the user expected.
      {
        vFctn_REPORTStepEvaluation(chPDUPresenceInfo, PASS);
      }
    }
  }
  else //an error occurred
  {
    vFctn_REPORTStepEvaluation(chPDUPresenceInfo, FAIL);
  }
}

/*! \fn void A_PDU_WaitForFrPDUByName(dbFrPDU* aFrPDUNameFromDB, dword aTimeout, enum eExpectedPresence aExpectedPDUPresence)
*  \brief Function that executes the action to check if a Autosar PDU name is received in a specific time or not.
*  \param[in] aFrPDUNameFromDB      - Name of the FrPDU from the arxml database.
*  \param[in] aTimeout              - Maximum wait time to check if the Autosar PDU is absent or not.
*  \param[in] aExpectedPDUPresence  - The expected presence of the Fr PDU: Present or Absent.
* 
*  \return None
*
*  \note 
*     - The aFrPDUNameFromDB parameter should be dragged/dropped from arxml database listed in CAPL Network Symbols window.\n
*     Check the example in the test file: tsPDU_Tests.can for more details.
*
* Change History: 
* Date(DD.MM.YY)        Author          Change info                                                          
* 20.05.2019             CrJu           Created and implemented
*/

void A_PDU_WaitForFrPDUByName(dbFrPDU* aFrPDUNameFromDB, dword aTimeout, enum eExpectedPresence aExpectedPDUPresence)
{
  char chAction[250];
  char chFailText[250];
  char chFrPDUPresenceInfo[250];
  long lResult;
  byte bDebugFlag;
  byte bResultAction;
  
  // Initialization of local variables
  lResult	= NotOk;
  bResultAction = NotOk;
  bDebugFlag = tsc_bPDU_GlobalDebugFlag;
  
  writeDbgLevel(DebugFuncCalls, "Entered A_PDU_WaitForFrPDUByName().");
  
  if ((byte)DebugFuncParam & bDebugFlag )
    writeDbgLevel(DebugFuncParam, "Parameters: FrPDU* aFrPDUNameFromDB, dword aTimeout: -- %d --, eExpectedState aExpectedPDUPresence -- %d -- (0 - ABSENT; 1 - PRESENT)", aTimeout, aExpectedPDUPresence);
  
  snprintf(chAction, elcount(chAction), "Check if the specified Autosar FrPDU Name is evaluated as: %d (0 - Absent, 1 - Present), within the specified wait time.", aExpectedPDUPresence);
  bResultAction = bFctn_REPORTAction(chAction);

  if(Ok == bResultAction)
  {
    lResult = lFctn_PDU_WaitForFrPDUByName(aFrPDUNameFromDB, aTimeout, chFrPDUPresenceInfo);
    
    if( Error != lResult)
    {
      if(Present == aExpectedPDUPresence) //Expect the FrPDU to be present
      {
        //FrPDU has arrived, as the user expected.
        if ( Ok == lResult )
        {
          vFctn_REPORTActionEvaluation(chFrPDUPresenceInfo, PASS);
        }
        else //FrPDU has not arrived, as the user didn't expect.
        {
          vFctn_REPORTActionEvaluation(chFrPDUPresenceInfo, FAIL);
        }
      }
      else //Expect the FrPDU to be absent
      {
        //FrPDU has arrived, as the user didn't expect.
        if ( Ok == lResult )
        {
          vFctn_REPORTActionEvaluation(chFrPDUPresenceInfo, FAIL);
        }
        else //FrPDU has not arrived, as the user expected.
        {
          vFctn_REPORTActionEvaluation(chFrPDUPresenceInfo, PASS);
        }
      }
    }
    else //an error occurred
    {
      vFctn_REPORTActionEvaluation(chFrPDUPresenceInfo, FAIL);
    }
  }
  else // the reporting function has failed
  {
    snprintf(chFailText, elcount(chFailText), "ERROR: The action text could not be added in the Report. bFctn_REPORTAction() return: %d.", bResultAction);
    vFctn_REPORTActionEvaluation(chFailText, FAIL);
  }
}

/*! \fn void E_PDU_WaitForFrPDUByName(dbPDU* aPDUNameFromDB, dword aTimeout, enum eExpectedPresence aExpectedPDUPresence)
*  \brief Function that evaluates if a FrPDU name is received in a specific time or not.
*  \param[in] aFrPDUNameFromDB        - Name of the FrPDU from the arxml database.
*  \param[in] aTimeout              - Maximum wait time to check if the Autosar PDU is absent or not.
*  \param[in] aExpectedPDUPresence  - The expected presence of the Autosar PDU: Present or Absent.
* 
*  \return None
*
*  \note 
*     - The aFrPDUNameFromDB parameter should be dragged/dropped from arxml database listed in CAPL Network Symbols window.\n
*     Check the example in the test file: tsPDU_Tests.can for more details.
*
* Change History: 
* Date(DD.MM.YY)        Author          Change info                                                          
* 03.06.2019             CrJu           Created and implemented
*/

void E_PDU_WaitForFrPDUByName(dbFrPDU* aFrPDUNameFromDB, dword aTimeout, enum eExpectedPresence aExpectedPDUPresence)
{
  char chFrPDUPresenceInfo[250];
  long lResult;
  byte bDebugFlag;
  char chPrintBusContext[25];
  
  // Initialization of local variables
  lResult	= NotOk;
  bDebugFlag = tsc_bPDU_GlobalDebugFlag;
  
  writeDbgLevel(DebugFuncCalls, "Entered E_PDU_WaitForFrPDUByName().");
  
  if ((byte)DebugFuncParam & bDebugFlag )
    writeDbgLevel(DebugFuncParam, "Parameters: PDU* aPDUNameFromDB, dword aTimeout: -- %d --, eExpectedState aExpectedPDUPresence -- %d -- (0 - ABSENT; 1 - PRESENT)", aTimeout, aExpectedPDUPresence);

  lResult = lFctn_PDU_WaitForFrPDUByName(aFrPDUNameFromDB, aTimeout, chFrPDUPresenceInfo);
    
  if( Error != lResult)
  {
    if(Present == aExpectedPDUPresence) //Expect the PDU to be present
    {
      //PDU has arrived, as the user expected.
      if ( Ok == lResult )
      {
        vFctn_REPORTStepEvaluation(chFrPDUPresenceInfo, PASS);
      }
      else //PDU has not arrived, as the user didn't expect.
      {
        vFctn_REPORTStepEvaluation(chFrPDUPresenceInfo, FAIL);
      }
    }
    else //Expect the PDU to be absent
    {
      //PDU has arrived, as the user didn't expect.
      if ( Ok == lResult )
      {
        vFctn_REPORTStepEvaluation(chFrPDUPresenceInfo, FAIL);
      }
      else //PDU has not arrived, as the user expected.
      {
        vFctn_REPORTStepEvaluation(chFrPDUPresenceInfo, PASS);
      }
    }
  }
  else //an error occurred
  {
    vFctn_REPORTStepEvaluation(chFrPDUPresenceInfo, FAIL);
  }
}

/*! \fn void A_PDU_WaitForFrPDUDataByName(dbFrPDU* aFrPDUNameFromDB, byte aExpectedPayloadData[], dword aWaitingTime, enum eCompareType aExpectedCompareAction)
*  \brief Function that executes the action to check if a Autosar PDU is received in a specific time or not, with the expected Equal/NotEqual payload data.
*  \param[in] aFrPDUNameFromDB       - Name of the FrPDU from the arxml database.
*  \param[in] aExpectedPayloadData[] - Byte array with the exact size and desired content of what the received payload should be identical/different.
*  \param[in] aWaitingTime           - Maximum wait time to check if the Autosar PDU is absent or not.
*  \param[in] aExpectedCompareAction - The expected presence of the Fr PDU: Present or Absent.
* 
*  \return None
*
*  \note 
*     - The aFrPDUNameFromDB parameter should be dragged/dropped from arxml database listed in CAPL Network Symbols window.\n
*     Check the example in the test file: tsPDU_Tests.can for more details.
*
* Change History: 
* Date(DD.MM.YY)        Author          Change info                                                          
* 13.06.2019             CrJu           Created and implemented
*/

void A_PDU_WaitForFrPDUDataByName(dbFrPDU* aFrPDUNameFromDB, byte aExpectedPayloadData[], dword aWaitingTime, enum eCompareType aExpectedCompareAction)
{
  char chAction[250];
  char chFailText[250];
  char chFrPDUDataCompareInfo[250];
  long lResult;
  byte bDebugFlag;
  byte bResultAction;
  
  // Initialization of local variables
  lResult	= NotOk;
  bResultAction = NotOk;
  bDebugFlag = tsc_bPDU_GlobalDebugFlag;
  
  writeDbgLevel(DebugFuncCalls, "Entered A_PDU_WaitForFrPDUDataByName().");
  
  if ((byte)DebugFuncParam & bDebugFlag )
    writeDbgLevel(DebugFuncParam, "Parameters: FrPDU* aFrPDUNameFromDB, byte aExpectedPayloadData[], dword aWaitingTime: -- %d --, eCompareType aExpectedCompareAction -- %d -- (0 - ABSENT; 1 - PRESENT)", aWaitingTime, aExpectedCompareAction);
  
  snprintf(chAction, elcount(chAction), "Wait: %dms (if 0, default %d is used) for FrPDU and check if Payload is: %d (0-Equal, 1-NotEqual) with the expected array.", aWaitingTime, cc_dwPDU_DefaultWaitTime, aExpectedCompareAction);
  bResultAction = bFctn_REPORTAction(chAction);

  if(Ok == bResultAction)
  {
    lResult = lFctn_PDU_WaitForFrPDUDataByName(aFrPDUNameFromDB, aExpectedPayloadData, aWaitingTime, chFrPDUDataCompareInfo);
    
    if( Error != lResult)
    {
      if(Equal == aExpectedCompareAction) //Expect the data of FrPDU to be equal with the the expected payload
      {
        //SUCCESS: FrPDU data has identified as IDENTICAL
        if ( Ok == lResult )
        {
          vFctn_REPORTActionEvaluation(chFrPDUDataCompareInfo, PASS);
        }
        else //FAIL: FrPDU data has identified as NOT IDENTICAL, or an error occured, as not expected
        {
          vFctn_REPORTActionEvaluation(chFrPDUDataCompareInfo, FAIL);
        }
      }
      else //Expect the data of FrPDU to NOT be equal with the the expected payload
      {
        //FAIL: FrPDU data has identified as IDENTICAL, as not expected
        if ( Ok == lResult )
        {
          vFctn_REPORTActionEvaluation(chFrPDUDataCompareInfo, FAIL);
        }
        else //SUCCESS: FrPDU data has identified as NOT IDENTICAL, as expected
        {
          vFctn_REPORTActionEvaluation(chFrPDUDataCompareInfo, PASS);
        }
      }
    }
    else //an error occurred
    {
      vFctn_REPORTActionEvaluation(chFrPDUDataCompareInfo, FAIL);
    }
  }
  else // the reporting function has failed
  {
    snprintf(chFailText, elcount(chFailText), "ERROR: The action text could not be added in the Report. bFctn_REPORTAction() return: %d.", bResultAction);
    vFctn_REPORTActionEvaluation(chFailText, FAIL);
  }
}

/*! \fn void E_PDU_WaitForFrPDUDataByName(dbFrPDU* aFrPDUNameFromDB, byte aExpectedPayloadData[], dword aWaitingTime, enum eCompareType aExpectedCompareAction)
*  \brief Function that executes the action to check if a Autosar PDU is received in a specific time or not, with the expected Equal/NotEqual payload data.
*  \param[in] aFrPDUNameFromDB       - Name of the FrPDU from the arxml database.
*  \param[in] aExpectedPayloadData[] - Byte array with the exact size and desired content of what the received payload should be identical/different.
*  \param[in] aWaitingTime           - Maximum wait time to check if the Autosar PDU is absent or not.
*  \param[in] aExpectedCompareAction - The expected presence of the Fr PDU: Equal or NotEqual.
* 
*  \return None
*
*  \note 
*     - The aFrPDUNameFromDB parameter should be dragged/dropped from arxml database listed in CAPL Network Symbols window.\n
*     Check the example in the test file: tsPDU_Tests.can for more details.
*
* Change History: 
* Date(DD.MM.YY)        Author          Change info                                                          
* 13.06.2019             CrJu           Created and implemented
*/

void E_PDU_WaitForFrPDUDataByName(dbFrPDU* aFrPDUNameFromDB, byte aExpectedPayloadData[], dword aWaitingTime, enum eCompareType aExpectedCompareAction)
{
  char chFrPDUDataCompareInfo[250];
  long lResult;
  byte bDebugFlag;
  
  // Initialization of local variables
  lResult	= NotOk;
  bDebugFlag = tsc_bPDU_GlobalDebugFlag;
  
  writeDbgLevel(DebugFuncCalls, "Entered A_PDU_WaitForFrPDUDataByName().");
  
  if ((byte)DebugFuncParam & bDebugFlag )
    writeDbgLevel(DebugFuncParam, "Parameters: FrPDU* aFrPDUNameFromDB, byte aExpectedPayloadData[], dword aWaitingTime: -- %d --, eCompareType aExpectedCompareAction -- %d -- (0 - ABSENT; 1 - PRESENT)", aWaitingTime, aExpectedCompareAction);

  lResult = lFctn_PDU_WaitForFrPDUDataByName(aFrPDUNameFromDB, aExpectedPayloadData, aWaitingTime, chFrPDUDataCompareInfo);
    
  if( Error != lResult)
  {
    if(Equal == aExpectedCompareAction) //Expect the data of FrPDU to be equal with the the expected payload
    {
      //SUCCESS: FrPDU data has identified as IDENTICAL
      if ( Ok == lResult )
      {
        vFctn_REPORTStepEvaluation(chFrPDUDataCompareInfo, PASS);
      }
      else //FAIL: FrPDU data has identified as NOT IDENTICAL, or an error occured, as not expected
      {
        vFctn_REPORTStepEvaluation(chFrPDUDataCompareInfo, FAIL);
      }
    }
    else //Expect the data of FrPDU to NOT be equal with the the expected payload
    {
      //FAIL: FrPDU data has identified as IDENTICAL, as not expected
      if ( Ok == lResult )
      {
        vFctn_REPORTStepEvaluation(chFrPDUDataCompareInfo, FAIL);
      }
      else //SUCCESS: FrPDU data has identified as NOT IDENTICAL, as expected
      {
        vFctn_REPORTStepEvaluation(chFrPDUDataCompareInfo, PASS);
      }
    }
  }
  else //an error occurred
  {
    vFctn_REPORTStepEvaluation(chFrPDUDataCompareInfo, FAIL);
  }
}

/*! \fn void A_PDU_GetData (dbPDU* aPDUNameFromDB, byte aArrayToStorePayloadData[], dword aWaitingTime, char aBusContext[])
*  \brief Function that executes the action to wait an amount of time for the specified Autosar PDU Name and store the payload data in the output byte array.
*  \param[in] aPDUNameFromDB            - Name of the Autosar PDU from the arxml database.
*  \param[in] aArrayToStorePayloadData  - The byte array in which the payload data is copied.
*  \param[in] aWaitingTime              - Maximum wait time, in miliseconds, to check if the Autosar PDU arrives or not (cannot be < 1).
*  \param[in] aBusContext               - The bus context.
* 
*  \return None
*
*  \note 
*     - The aPDUNameFromDB parameter should be dragged/dropped from arxml database listed in CAPL Network Symbols window.\n
*     Check the example in the test file: tsPDU_Tests.can for more details.
*
* Change History: 
* Date(DD.MM.YY)        Author          Change info                                                          
* 22.01.19              GrAn            Created and implemented
*/
void A_PDU_GetData (dbPDU* aPDUNameFromDB, byte aArrayToStorePayloadData[], dword aWaitingTime, char aBusContext[])
{
  char chAction[250];
  char chPassText[250];
  char chFailText[250];
  char chGetPDUDataInfo[250];
  int iResult;
  byte bDebugFlag;
  byte bResultAction;
  word wPayloadSize;
  char chPrintBusContext[26];
  byte bResultPrint;
 
  iResult	= NotOk;
  bResultAction = NotOk;
  bDebugFlag = tsc_bPDU_GlobalDebugFlag;
  bResultPrint = NotOk;
  
  writeDbgLevel(DebugFuncCalls, "Entered A_PDU_GetData().");
  if ( (byte)DebugFuncParam & bDebugFlag )
    writeDbgLevel (DebugFuncParam, "Parameters: dword aWaitingTime: -- %d --", aWaitingTime);
  
  bResultPrint = bFctn_CONV_GetSubString(aBusContext, 0, tsc_wPrintBusContextChars, chPrintBusContext);
  
  if ( (byte)DebugFuncParam & bDebugFlag )
    writeDbgLevel (DebugFuncParam,"chPrintBusContext is %s",chPrintBusContext);
  
  snprintf(chAction, elcount(chAction), "Wait: %dms (if 0, default %dms is used) for specified Autosar PDU and copy the Payload data in the output array on bus context %s.", aWaitingTime, cc_dwPDU_DefaultWaitTime,chPrintBusContext);
  bResultAction = bFctn_REPORTAction(chAction);
  
  if( Ok == bResultAction && Ok == bResultPrint)
  {
    iResult = iFctn_PDU_GetData(aPDUNameFromDB, aArrayToStorePayloadData, aWaitingTime, wPayloadSize, aBusContext, chGetPDUDataInfo);
    
    // Autosar PDU has arrived and the payload data has been successfully copied
    if ( Ok == iResult )
    {
      snprintf(chPassText, elcount(chPassText),"SUCCESS: %s", chGetPDUDataInfo);
      if ( (byte)DebugFuncInternal & bDebugFlag)
        writeDbgLevel (DebugFuncInternal, "PASSED! Result A_PDU_GetData(): %s", chGetPDUDataInfo);
      vFctn_REPORTActionEvaluation(chPassText, PASS);
    }
    else // Autosar PDU didn't arrive, payload could not be copied or an internal error has occurred
    {
      snprintf(chFailText, elcount(chFailText),"FAILED: %s", chGetPDUDataInfo);
      if ( (byte)DebugFuncInternal & bDebugFlag)
        writeDbgLevel (DebugFuncInternal, "FAILED! Result A_PDU_GetData(): %s", chGetPDUDataInfo);
      vFctn_REPORTActionEvaluation(chFailText, FAIL);
    }
  }
  else // the reporting function has failed
  {
    snprintf(chFailText, elcount(chFailText), "ERROR: The action text could not be added in the Report. bFctn_REPORTAction() return: %d.", bResultAction);
    if ( (byte)DebugFuncInternal & bDebugFlag)
      writeDbgLevel (DebugFuncInternal, "FAILED! Result A_PDU_GetData(): %s", chFailText);
    vFctn_REPORTActionEvaluation(chFailText, FAIL);
  }
}

/*! \fn void A_PDU_WaitForDataByName (dbPDU* aPDUNameFromDB, byte aExpectedPayload[], enum eCompareType aExpectedCompareAction, dword aWaitingTime, char aBusContext[])
*  \brief Function that executes the action to check if a Autosar PDU is received in a specific time or not, with the expected Equal/NotEqual payload data.
*  \param[in] aPDUNameFromDB          - Name of the Autosar PDU from the arxml database.
*  \param[in] aExpectedPayload        - Byte array with the exact size and desired content of what the received payload should be identical/different (depending on the aExpectedCompareAction).
*  \param[in] aExpectedCompareAction  - The compare action between the provided array and received payload: Equal or NotEqual.
*  \param[in] aWaitingTime            - Maximum wait time, in miliseconds, to check if the Autosar PDU arrives or not.
*  \param[in] aBusContext             - The bus context.
* 
*  \return None
*
*  \note 
*     - The aPDUNameFromDB parameter should be dragged/dropped from arxml database listed in CAPL Network Symbols window.\n
*     Check the example in test file: tsPDU_Tests.can for more details.
*
* Change History: 
* Date(DD.MM.YY)        Author          Change info                                                          
* 28.01.19              GrAn           Created and implemented
*/
void A_PDU_WaitForDataByName (dbPDU* aPDUNameFromDB, byte aExpectedPayload[], enum eCompareType aExpectedCompareAction, dword aWaitingTime, char aBusContext[])
{
  char chAction[250];
  char chPassText[250];
  char chFailText[250];
  char chPDUDataCompareInfo[250];
  int iResult;
  byte bDebugFlag;
  byte bResultAction;
  char chPrintBusContext[26];
  byte bResultPrint;
 
  iResult	= NotOk;
  bResultAction = NotOk;
  bDebugFlag = tsc_bPDU_GlobalDebugFlag;
  bResultPrint = NotOk;
  
  writeDbgLevel(DebugFuncCalls, "Entered A_PDU_WaitForDataByName().");
  if ( (byte)DebugFuncParam & bDebugFlag )
    writeDbgLevel (DebugFuncParam, "Parameters: dword aWaitingTime: -- %d --, enum eCompareType aExpectedCompareAction -- %d -- (0 - Equal, 1 - NotEqual).", aWaitingTime, aExpectedCompareAction);
  
  bResultPrint = bFctn_CONV_GetSubString(aBusContext, 0, tsc_wPrintBusContextChars,chPrintBusContext);
  
  if ( (byte)DebugFuncParam & bDebugFlag )
    writeDbgLevel (DebugFuncParam, "chPrintBusContext is %s", chPrintBusContext);
  
  snprintf(chAction, elcount(chAction), "Wait: %dms (if 0, default %d is used) for Autosar PDU and check if Payload is: %d (0-Equal, 1-NotEqual) with the expected array on the bus context %s.", aWaitingTime, cc_dwPDU_DefaultWaitTime, aExpectedCompareAction, chPrintBusContext);
  bResultAction = bFctn_REPORTAction(chAction);

  if( Ok == bResultAction && Ok == bResultPrint)
  {
    iResult = iFctn_PDU_WaitForDataByName(aPDUNameFromDB, aExpectedPayload, aExpectedCompareAction, aWaitingTime, aBusContext, chPDUDataCompareInfo);
    
    // Autosar PDU has arrived within the waiting time and its data is as expected (based on aExpectedCompareAction: 0-Equal, 1-NotEqual)
    if ( Ok == iResult )
    {
      snprintf(chPassText, elcount(chPassText),"SUCCESS: %s", chPDUDataCompareInfo);
      if ( (byte)DebugFuncInternal & bDebugFlag)
        writeDbgLevel (DebugFuncInternal, "PASSED! Result A_PDU_WaitForDataByName(): %s", chPDUDataCompareInfo);
      vFctn_REPORTActionEvaluation(chPassText, PASS);
    }
    else // the result is not as expected, incorrect array size, Autosar PDU did not arrive or an internal error has occurred
    {
      snprintf(chFailText, elcount(chFailText),"FAILED: %s", chPDUDataCompareInfo);
      if ( (byte)DebugFuncInternal & bDebugFlag)
        writeDbgLevel (DebugFuncInternal, "FAILED! Result A_PDU_WaitForDataByName(): %s", chPDUDataCompareInfo);
      vFctn_REPORTActionEvaluation(chFailText, FAIL);
    }
  }
  else // the reporting function has failed
  {
    snprintf(chFailText, elcount(chFailText), "ERROR: The action text could not be added in the Report. bFctn_REPORTAction() return: %d.", bResultAction);
    if ( (byte)DebugFuncInternal & bDebugFlag)
      writeDbgLevel (DebugFuncInternal, "FAILED! Result A_PDU_WaitForDataByName(): %s", chFailText);
    vFctn_REPORTActionEvaluation(chFailText, FAIL);
  }
}

/*! \fn void E_PDU_WaitForDataByName(dbPDU* aPDUNameFromDB, byte aExpectedPayload[], enum eCompareType aExpectedCompareAction, dword aWaitingTime, char aBusContext[])
*  \brief Function that checks if a Autosar PDU is received in a specific time or not, with the expected Equal/NotEqual payload data.
*  \param[in] aPDUNameFromDB          - Name of the Autosar PDU from the arxml database.
*  \param[in] aExpectedPayload        - Byte array with the exact size and desired content of what the received payload should be identical/different (depending on the aExpectedCompareAction).
*  \param[in] aExpectedCompareAction  - The compare action between the provided array and received payload: Equal or NotEqual.
*  \param[in] aWaitingTime            - Maximum wait time, in milliseconds, to check if the  Autosar PDU arrives or not.
*  \param[in] aBusContext             - The bus context.
* 
*  \return None
*
*  \note 
*     - The aPDUNameFromDB parameter should be dragged/dropped from arxml database listed in CAPL Network Symbols window.\n
*     Check the example in test file: tsPDU_Tests.can for more details.
*
* Change History: 
* Date(DD.MM.YY)        Author          Change info                                                          
* 28.01.19              GrAn            Created and implemented
*/
void E_PDU_WaitForDataByName(dbPDU* aPDUNameFromDB, byte aExpectedPayload[], enum eCompareType aExpectedCompareAction, dword aWaitingTime, char aBusContext[])
{
  char chPassText[250];
  char chFailText[250];
  char chPDUDataCompareInfo[250];
  byte iResult;
  byte bDebugFlag;
  char chPrintBusContext[26];
  byte bResultPrint;
  
  iResult = NotOk;
  bDebugFlag = tsc_bPDU_GlobalDebugFlag;
  bResultPrint = NotOk;
  
  writeDbgLevel (DebugFuncCalls, "Entered E_PDU_WaitForDataByName().");
  if ( (byte)DebugFuncParam & bDebugFlag )
    writeDbgLevel (DebugFuncParam, "Parameters: dword aWaitingTime: -- %d --, enum eCompareType aExpectedCompareAction -- %d -- (0 - Equal, 1 - NotEqual).", aWaitingTime, aExpectedCompareAction);
  
  bResultPrint = bFctn_CONV_GetSubString(aBusContext, 0, tsc_wPrintBusContextChars,chPrintBusContext);
  
  if ( (byte)DebugFuncParam & bDebugFlag )
    writeDbgLevel (DebugFuncParam,"chPrintBusContext is %s",chPrintBusContext);
  
  if (Ok ==  bResultPrint)
  {
    iResult = iFctn_PDU_WaitForDataByName(aPDUNameFromDB, aExpectedPayload, aExpectedCompareAction, aWaitingTime, aBusContext, chPDUDataCompareInfo);
  }
  else
  {
    snprintf(chPDUDataCompareInfo, elcount(chPDUDataCompareInfo),"The print part of the bus context failed !!!");
  }
    
  // Autosar PDU has arrived within the waiting time and its data is as expected (based on aExpectedCompareAction: 0-Equal, 1-NotEqual)
  if ( Ok == iResult )
  {
    snprintf(chPassText,elcount(chPassText),"SUCCESS: %s", chPDUDataCompareInfo);
    if ( (byte)DebugFuncInternal & bDebugFlag)
      writeDbgLevel (DebugFuncInternal, "PASSED! Result E_PDU_WaitForDataByName(): %s",chPDUDataCompareInfo);
    vFctn_REPORTStepEvaluation(chPassText, PASS);
  }
  else // the result is not as expected, incorrect array size, Autosar PDU did not arrive or an internal error has occurred
  {
    snprintf(chFailText,elcount(chFailText),"FAILED: %s", chPDUDataCompareInfo);
    if ( (byte)DebugFuncInternal & bDebugFlag)
      writeDbgLevel (DebugFuncInternal, "FAILED! Result E_PDU_WaitForDataByName(): %s",chPDUDataCompareInfo);
    vFctn_REPORTStepEvaluation(chFailText, FAIL);
  }
}

/*! \fn int A_PDU_SendFrPDU(dbFrPDU* aFrPDUName, byte aPayloadToBeSent[], byte aNrOfSendingRequests, byte aFlexRayCluster, enum eFlexRayChannels aChannel, char aFrPDUDataCompareInfo[])
*  \brief Function that sends a dynamic FlexRay frame with the desired payload data, on the specified cluster and channel (A or B).
*  \param[in]   aFrPDUName              - The dynamic frame which is going to be sent.
*  \param[in]   aPayloadToBeSent        - Byte array with the desired payload to be sent with the dynamic frame (payload length is determined from the size of the array, which should not be greater than 254 bytes).
*  \param[in]   aNrOfSendingRequests    - How many times the FrPDU to be transmitted. ( N>0: The PDU is transmitted at least n times / -1: The PDU is transmitted in every configured slot / 0: The PDU's default value is transmitted )
*  \param[in]   aFlexRayCluster         - The cluster of the FlexRay protocol. Ex: 1(CH_Flexray), 2(CH_Flexray2).
*  \param[in]   aChannel                - The channel of the flexray (Ex: A or B).
* 
*  \return None
*
*  \note  - If a FrPDU is already on the BUS, it can not be resend for a specific number of times.
*         - The defaul value can not be tested, or it is 0
*
* Change History: 
* Date(DD.MM.YY)        Author          Change info                                                          
* 19.06.19              CrJu            Created and implemented
*/

void A_PDU_SendFrPDU(FrPDU* aFrPDUName, byte aPayloadToBeSent[], byte aNrOfSendingRequests, byte aFlexRayCluster, enum eFlexRayChannels aChannel)
{
  long lResult;
  byte bDebugFlag;
  byte bResultAction;
  char chAction[250];
  char chFailText[250];
  char chPassText[250];
  char chSentPayloadData[250];
  char chFrPDUSentInfo[250];
  
  bDebugFlag = cc_bPDU_GlobalDebugFlag;
  lResult = NotOk;
  
  writeDbgLevel (DebugFuncCalls, "Entered A_PDU_SendFrPDU().");
  
  snprintf(chAction, elcount(chAction), "Send the FrPDU with the specific payload on Cluster: %d and Channel: %d.", aFlexRayCluster, aChannel);
  bResultAction = bFctn_REPORTAction(chAction);
  
  if( bResultAction == Ok )
  {
    lResult = lFctn_PDU_SendFrPDU(aFrPDUName, aPayloadToBeSent, aNrOfSendingRequests, aFlexRayCluster, aChannel, chFrPDUSentInfo);
    
    // The FrPDU was succesfully sent on the bus
    if(lResult == Ok)
    {
      snprintf(chPassText, elcount(chPassText),"SUCCESS: %s", chFrPDUSentInfo);
      if ( (byte)DebugFuncInternal & bDebugFlag)
        writeDbgLevel (DebugFuncInternal, "PASSED! Result A_PDU_GetData(): %s", chFrPDUSentInfo);
      vFctn_REPORTActionEvaluation(chPassText, PASS);
    }
    else // An error occured
    {
      snprintf(chFailText, elcount(chFailText),"SUCCESS: %s", chFrPDUSentInfo);
      if ( (byte)DebugFuncInternal & bDebugFlag)
        writeDbgLevel (DebugFuncInternal, "PASSED! Result A_PDU_GetData(): %s", chFrPDUSentInfo);
      vFctn_REPORTActionEvaluation(chFailText, FAIL);
    }
  }
  else // The reporting function has failed
  {
    snprintf(chFailText, elcount(chFailText), "ERROR: The action text could not be added in the Report. bFctn_REPORTAction() return: %d.", bResultAction);
    if ( (byte)DebugFuncInternal & bDebugFlag)
      writeDbgLevel (DebugFuncInternal, "FAILED! Result A_PDU_GetData(): %s", chFailText);
    vFctn_REPORTActionEvaluation(chFailText, FAIL);
  }
}

/*! \fn void E_PDU_VerifyCycleTime(dbPDU* aPDUNameFromDB, dword aNumberOfSampleTimes, dword aPDUCycleTimeMS, byte aPermittedTimeDiffPerCent, char aBusContext[])
*  \brief Function that checks if an Autosar PDU cycle time is in a given range [aPDUCycleTimeMS - (aPDUCycleTimeMS * aPermittedTimeDiffPerCent/100), aPDUCycleTimeMS + (aPDUCycleTimeMS * aPermittedTimeDiffPerCent/100)] or not for a given number sample times.
*  \param[in]   aPDUNameFromDB                   - Name of the Autosar PDU from the arxml database.
*  \param[in]   aNumberOfSampleTimes             - The number of samples time to test that the cycle time of Autosar PDU is in range or not
*  \param[in]   aPDUCycleTimeMS                  - The Autosar PDU cycle time from data base (in milliseconds)
*  \param[in]   aPermittedTimeDiffPerCent        - The permitted time difference of the upper and lower limit of the cycle time range (per cent).
*  \param[in]   aBusContext                      - The bus context.
* 
*  \return  no return
*
*  \note 
*     - The aPDUNameFromDB parameter should be dragged/dropped from arxml database listed in CAPL Network Symbols window.\n
*     Check the example in the test file: tsPDU_Tests.can for more details.'
*  *  \note 
*     - Example: if a Autosar PDU has a cycle time of 100 milliseconds and the procent is 15. The calculated lower accepted \n
*     value for cycle time is 85ms and upper accepted value for cycle time is 115 ms.
*
* Change History: 
* Date(DD.MM.YY)        Author          Change info                                                          
* 04.02.19              GrAn            Created and implemented
* 06.02.19              GrAn            The implementation is changed. Use a cycle time from database and the number of samples time to be waited instead of the given time to wait. 
*/

void E_PDU_VerifyCycleTime(dbPDU* aPDUNameFromDB, dword aNumberOfSampleTimes, dword aPDUCycleTimeMS, byte aPermittedTimeDiffPerCent, char aBusContext[])
{
  char chPassText[250];
  char chFailText[250];
  char chPDUVerifyCyclicTime[250];
  byte bResult;
  byte bDebugFlag;
  char chPrintBusContext[26];
  byte bResultPrint;
  
  bResult = NotOk;
  bDebugFlag = tsc_bPDU_GlobalDebugFlag;
  bResultPrint = NotOk;
  
  writeDbgLevel (DebugFuncCalls, "Entered E_PDU_VerifyCycleTime().");
  if ( (byte)DebugFuncParam & bDebugFlag )
    writeDbgLevel (DebugFuncParam, "Parameters: dword aNumberOfSampleTimes: -- %d --, dword aPDUCycleTimeMS  --%d--, byte aPermittedTimeDiffPerCent --%d (per cent)--", aNumberOfSampleTimes, aPDUCycleTimeMS,aPermittedTimeDiffPerCent);

  bResultPrint = bFctn_CONV_GetSubString(aBusContext, 0, tsc_wPrintBusContextChars,chPrintBusContext);
  
  if ( (byte)DebugFuncParam & bDebugFlag )
    writeDbgLevel (DebugFuncParam,"chPrintBusContext is %s",chPrintBusContext);
  
  if (Ok == bResultPrint)//bFctn_CONV_PrintPartOfArray was executed succesfully
  {
    bResult = iFctn_PDU_VerifyCycleTime(aPDUNameFromDB, aNumberOfSampleTimes, aPDUCycleTimeMS, aPermittedTimeDiffPerCent, aBusContext, chPDUVerifyCyclicTime);
  }
  else
  {
    snprintf(chPDUVerifyCyclicTime, elcount(chPDUVerifyCyclicTime),"The print part of the bus context failed !!!");
  }
    
  // Autosar PDU cycletime is in range as expected
  if ( Ok == bResult )
  {
    snprintf(chPassText,elcount(chPassText),"SUCCESS: %s", chPDUVerifyCyclicTime);
    if ( (byte)DebugFuncInternal & bDebugFlag)
      writeDbgLevel (DebugFuncInternal, "PASSED! Result E_PDU_VerifyCycleTime(): %s",chPassText);
    vFctn_REPORTStepEvaluation(chPassText, PASS);
  }
  else // the result is not as expected or an error has occurred
  {
    snprintf(chFailText,elcount(chFailText),"FAILED: %s", chPDUVerifyCyclicTime);
    if ( (byte)DebugFuncInternal & bDebugFlag)
      writeDbgLevel (DebugFuncInternal, "FAILED! Result E_PDU_VerifyCycleTime(): %s",chFailText);
    vFctn_REPORTStepEvaluation(chFailText, FAIL);
  }
}

/*! \fn void E_PDU_VerifyCycleTimeForFrPDU(dbFrPDU* aFrPDUNameFromDB, dword aNumberOfSampleTimes, dword aFrPDUCycleTimeMS, byte aPermittedTimeDiffPerCent)
*  \brief Function that checks if an Autosar PDU cycle time is in a given range [aPDUCycleTimeMS - (aPDUCycleTimeMS * aPermittedTimeDiffPerCent/100), aPDUCycleTimeMS + (aPDUCycleTimeMS * aPermittedTimeDiffPerCent/100)] or not for a given number sample times.
*  \param[in]   aFrPDUNameFromDB                 - Name of the FrPDU from the arxml database.
*  \param[in]   aNumberOfSampleTimes             - The number of samples time to test that the cycle time of Autosar PDU is in range or not
*  \param[in]   aFrPDUCycleTimeMS                - The FrPDU cycle time from data base (in milliseconds)
*  \param[in]   aPermittedTimeDiffPerCent        - The permitted time difference of the upper and lower limit of the cycle time range (per cent).
* 
*  \return  no return
*
*  \note 
*     - The aPDUNameFromDB parameter should be dragged/dropped from arxml database listed in CAPL Network Symbols window.\n
*     Check the example in the test file: tsPDU_Tests.can for more details.'
*  *  \note 
*     - Example: if a Autosar PDU has a cycle time of 100 milliseconds and the procent is 15. The calculated lower accepted \n
*     value for cycle time is 85ms and upper accepted value for cycle time is 115 ms.
*
* Change History: 
* Date(DD.MM.YY)        Author          Change info                                                          
* 17.07.19              CrJu            Created and implemented*/

void E_PDU_VerifyCycleTimeForFrPDU(dbFrPDU* aFrPDUNameFromDB, dword aNumberOfSampleTimes, dword aFrPDUCycleTimeMS, byte aPermittedTimeDiffPerCent)
{
  char chPassText[250];
  char chFailText[250];
  char chFrPDUVerifyCyclicTime[250];
  byte bResult;
  byte bDebugFlag;
  
  bResult = NotOk;
  bDebugFlag = tsc_bPDU_GlobalDebugFlag;
  
  writeDbgLevel (DebugFuncCalls, "Entered E_PDU_VerifyCycleTimeForFrPDU().");
  if ( (byte)DebugFuncParam & bDebugFlag )
    writeDbgLevel (DebugFuncParam, "Parameters: dword aNumberOfSampleTimes: -- %d --, dword aFrPDUCycleTimeMS  --%d--, byte aPermittedTimeDiffPerCent --%d (per cent)--", aNumberOfSampleTimes, aFrPDUCycleTimeMS, aPermittedTimeDiffPerCent);
 
  bResult = lFctn_PDU_VerifyCycleTimeForFrPDU(aFrPDUNameFromDB, aNumberOfSampleTimes, aFrPDUCycleTimeMS, aPermittedTimeDiffPerCent, chFrPDUVerifyCyclicTime);
    
  // FrPDU cycletime is in range as expected
  if (Ok == bResult)
  {
    snprintf(chPassText,elcount(chPassText),"SUCCESS: %s", chFrPDUVerifyCyclicTime);
    if ( (byte)DebugFuncInternal & bDebugFlag)
      writeDbgLevel (DebugFuncInternal, "PASSED! Result E_PDU_VerifyCycleTimeForFrPDU(): %s", chPassText);
    vFctn_REPORTStepEvaluation(chPassText, PASS);
  }
  else // the result is not as expected or an error has occurred
  {
    snprintf(chFailText,elcount(chFailText),"FAILED: %s", chFrPDUVerifyCyclicTime);
    if ( (byte)DebugFuncInternal & bDebugFlag)
      writeDbgLevel (DebugFuncInternal, "FAILED! Result E_PDU_VerifyCycleTimeForFrPDU(): %s", chFailText);
    vFctn_REPORTStepEvaluation(chFailText, FAIL);
  }
}

/*! @}*/
/*! @}*/
/*!
*   \file
*   \ingroup testSupportLib
*   \brief Library for handling PDU functionality.
*/
