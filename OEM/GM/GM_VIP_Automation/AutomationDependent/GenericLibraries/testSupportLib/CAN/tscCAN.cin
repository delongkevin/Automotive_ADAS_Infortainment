/*@!Encoding:1252*/
/*!
* @defgroup tscCAN tscCAN
* @defgroup CAN CAN
* @ingroup testSupportLib
* @{
* @addtogroup tscCAN
* @{
*/


variables
{
  enum tsc_eDebugCAN {tsc_eCANDebugOff = 0,
                      tsc_eCANDebugFuncCalls = 1,
                      tsc_eCANDebugFuncParam = 2,
                      tsc_eCANDebugFuncInternal = 3
                     };  
  
  enum tsc_eResultCAN {tsc_eCAN_ERR = -1, 
                       tsc_eCAN_NOK = 0, 
                       tsc_eCAN_OK = 1, 
                       tsc_eCAN_ERR_BUS_CONTEXT = 2, 
                       tsc_eCAN_ERR_TIMEOUT_TOO_SMALL = 3,
                       tsc_eCAN_ERR_NUM_EL_TOO_BIG = 4,
                       tsc_eCAN_ERR_CAN_CHANNEL = 5, 
                       tsc_eCAN_ERR_CAN_CHANNEL_UNAVAILABLE = 6, 
                       tsc_eCAN_CONV_ERR = 7,
                       tsc_eCAN_ARRAY_NOT_SAME_SIZE  = 8,
                       tsc_eCAN_CONVERT_ERROR = 9,
                       tsc_eCAN_MSG_NO_FOUND = 10
                       };
  
  enum tsc_eNumbersCAN {tsc_eCAN_ZERO = 0, 
                       tsc_eCAN_ONE = 1, 
                       tsc_eCAN_TWO = 2, 
                       tsc_eCAN_THREE = 3, 
                       tsc_eCAN_FOUR = 4, 
                       tsc_eCAN_FIVE = 5, 
                       tsc_eCAN_SIX = 6, 
                       tsc_eCAN_SEVEN = 7
                       };
  
  const qword tsc_qwNoMaxElConverted = 100000;
  
  const byte tsc_bNoMaxOfBytes = 8;
  
  const word tsc_wPrintedArrayElements = 128;
  
  const word tsc_wPrintBusContextChars = 25;
  
  // This debug flag will be used to enable/disable the debug messages in all functions of the current module
  // 0x00 - No debug messages displayed (only function calls).
  // 0x01 - Only function call messages displayed (this will always displayed).
  // 0x02 - Function parameter + 0x01.
  // 0x04 - Internal function actions + 0x01 and 0x02.
  // 0xFF - All of the above (function calls, function parameters, internal function actions).
  const byte tsc_bCAN_GlobalDebugFlag = 0x01;
}


/*! @}*/
/*! @}*/
/*!
*   \file
*   \ingroup testSupportLib
*   \brief CAN test support library constants.
*/