/*@!Encoding:1252*/
/*!
* @defgroup bRS232 bRS232
* @defgroup RS232 RS232
* @ingroup baseLib
* @{
* @addtogroup bRS232
* @{
*/ 


includes
{
  #include "bcRS232.cin"
  #include "bvRS232.cin"
}

/*! \fn byte bFctn_RS232OpenPort(int iPort, int iBaudRate, int iDataBits, int iStopBits, int iParity)
*  \brief Function opens and configures a requested Serial Port
*  \param[in] iPort - port number.
*  \param[in] iBaudRate - baud rate for the selected port number.
*  \param[in] iDataBits - number of bits for the selected port number.
*  \param[in] iStopBits - number of stop bits for the selected port number.
*  \param[in] iParity - parity for the selected port number.
*  \return 1 if port is succsesfully opened
*  \return 2 if port opening failed
*  \return 3 if port configuration failed
*  \return 4 if port receive start failed
* 
* Change History: 
* Date(DD.MM.YY)        Author          Change info                                                          
*   
*  15.03.18              SeNi        Created and implemented
*/

byte bFctn_RS232OpenPort(int iPort, int iBaudRate, int iDataBits, int iStopBits, int iParity, int iFlowControl)
{ 
  byte bIndex;
  byte bFlowControlResult;
  byte bDebugFlag;
  
  bDebugFlag = NotOk;
  bIndex = NotOk;
  
  writeDbgLevel (DebugFuncCalls, "Function bFctn_RS232OpenPort called");
  writeDbgLevel (DebugFuncParam, "Parameters: port -- %d --, baudRate -- %d --, number of data bits -- %d --, number of stop bits -- %d --, parity -- %d --.",iPort,iBaudRate,iDataBits,iStopBits,iParity);
  
  if (Ok != RS232Open(iPort))
  {
    bIndex++;
    if ( (byte)DebugFuncInternal & bDebugFlag)
      writeDbgLevel (DebugFuncInternal, "Unable to open port -- %d --", iPort);
  }

  if (Ok != RS232Configure(iPort,iBaudRate,iDataBits,iStopBits,iParity) )
  {
    bIndex++;
    if ( (byte)DebugFuncInternal & bDebugFlag)
      writeDbgLevel (DebugFuncInternal, "Unable to configure port -- %d --", iPort);
  }
  
  if(Ok == iFlowControl) // FlowControl used is 10-hardware FlowControl, use DTR<->DSR
  {
    bFlowControlResult = RS232SetHandshake( iPort, 10, 0, 0, 0, 0 );
    
    if(bFlowControlResult)
    {
      if ( (byte)DebugFuncInternal & bDebugFlag)
        writeDbgLevel (DebugFuncInternal, "Set hardware FlowControl, use DTR<->DSR");
    }
    else
    {
      if ( (byte)DebugFuncInternal & bDebugFlag)
        writeDbgLevel (DebugFuncInternal, "Error during setting the FlowControl!");
      return NotOk;
    }
  }
  else if (NotOk == iFlowControl)
  {
    if ( (byte)DebugFuncInternal & bDebugFlag)
      writeDbgLevel (DebugFuncInternal, "No FlowControl at all");
  }
  else
  {
    //Future FlowControls
  }
    
  if (Ok != RS232Receive(iPort,bv_bRS232DataBuffer,elCount(bv_bRS232DataBuffer)) )
  {
    bIndex++;
    if ( (byte)DebugFuncInternal & bDebugFlag)
      writeDbgLevel (DebugFuncInternal, "Unable to receive on port -- %d --", iPort);
  }
  
  if (NotOk != bIndex)
    return NotOk;
  else
    return Ok;
}


/*! \fn byte bFctn_RS232ClosePort(int iPort) 
*  \brief Function closes a Serial Port
*  \param[in] iPort - port number.
*  \return 0 if port closing failed
*  \return 1 if port is succsesfully closed
* 
* Change History: 
* Date(DD.MM.YY)        Author          Change info                                                          
*   
*  15.03.18              SeNi        Created and implemented
*/

byte bFctn_RS232ClosePort(int iPort)
{
  byte bDebugFlag;
  
  bDebugFlag = NotOk;
  
  writeDbgLevel (DebugFuncCalls, "Function bFctn_RS232ClosePort called");
  writeDbgLevel (DebugFuncParam, "Parameters: port -- %d --",iPort);  
  
  if(Ok == bv_bRS232ReceiveStatus)
    bv_bRS232ReceiveStatus = NotOk;
  
  if (Ok==RS232Close(iPort)) 
  {
    if ( (byte)DebugFuncParam & bDebugFlag)
      writeDbgLevel (DebugFuncInternal, "Port -- %d -- is closed",iPort); 
    return Ok;
  }
  else
  {
    if ( (byte)DebugFuncParam & bDebugFlag)
      writeDbgLevel (DebugFuncInternal, "Port -- %d -- is NOT closed",iPort);  
    return NotOk;
  }

}

/*! \fn byte bFctn_RS232SendData(int iPort, byte bData[])
*  \brief Function sends an array of bytes on an opened Serial Port
*  \param[in] iPort - port number.
*  \param[in] bData - an array of bytes.
*  \return 0 if port closing failed
*  \return 1 if port is succsesfully closed
* 
* Change History: 
* Date(DD.MM.YY)        Author          Change info                                                          
*   
*  15.03.18              SeNi        Created and implemented
*/

byte bFctn_RS232SendData(int iPort, byte bData[], byte bNoBytes) 
{
  byte bIndex;
  byte bDebugFlag;
  
  writeDbgLevel (DebugFuncCalls, "Function bFctn_RS232SendData called");
  writeDbgLevel (DebugFuncParam, "Parameters: port -- %d --, data to send:",iPort);
 
  bDebugFlag = NotOk;
  @sysvar::RS232_SYSVariables::sv_RS232ReceiveStatus = NotOk;
  bv_iSerialPortListen = iPort;
  bv_iRS232Index = NotOk;

  for (bIndex = 0; bIndex < elcount(bData); bIndex++)
  {
    if ( (byte)DebugFuncParam & bDebugFlag)
      writeDbgLevel (DebugFuncInternal, "Byte -- %d -- - send: -- %X --", bIndex, bData[bIndex]);
  }
  
  if (Ok == RS232Send(iPort,bData,bNoBytes))
  {
    if ( (byte)DebugFuncParam & bDebugFlag)
      writeDbgLevel (DebugFuncInternal, "Data was sent on port -- %d --.", iPort);
    return Ok;
  }
  else
  {
    if ( (byte)DebugFuncParam & bDebugFlag)
      writeDbgLevel (DebugFuncInternal, "Data was NOT sent on port -- %d --.", iPort);  
    return NotOk;
  }
}

/*! \fn byte bFctn_RS232SendData(byte aPort, char aCMD2Send[] )
*  \brief Function sends an array of bytes on an opened Serial Port
*  \param[in] aPort - port number
*  \param[in] aCMD2Send - the string that contain the command to send

*  \return 0 if port closing failed
*  \return 1 if port is succsesfully closed
* 
* Change History: 
* Date(DD.MM.YY)        Author          Change info                                                          
*   
*  29.06.20             CiCo          Created and implemented
*/

byte bFctn_RS232SendData(byte aPort, char aCMD2Send[] )
{
  byte bIndex;
  byte bCMD2Send[ bc_bMaxLengthRS232Cmd ];
  long lNoBytes;
  byte bDebugFlag;
  
  writeDbgLevel (DebugFuncCalls, "Function bFctn_RS232SendData called");
  writeDbgLevel (DebugFuncParam, "Parameters: port -- %d --, data to send: %s", aPort, aCMD2Send );
 
  @sysvar::RS232_SYSVariables::sv_RS232ReceiveStatus = NotOk;
  bv_iSerialPortListen = aPort;
  bv_iRS232Index = NotOk;
  bDebugFlag = NotOk;
 
  EncodeString( bCMD2Send, lNoBytes, elcount( bCMD2Send ), aCMD2Send, 65001/*CP_UTF8*/);// convert string to byte array, max length of array is
   
  for (bIndex = 0; bIndex < lNoBytes - 1; bIndex++)
  {
    if ( (byte)DebugFuncInternal & bDebugFlag)
      writeDbgLevel (DebugFuncInternal, "Byte -- %d -- - send: -- %c --", bIndex, bCMD2Send[ bIndex ] );
  }
  
  if (Ok == RS232Send( aPort, bCMD2Send, lNoBytes - 1) )
  {
    if ( (byte)DebugFuncInternal & bDebugFlag)
      writeDbgLevel (DebugFuncInternal, "Data was sent on port -- %d --.", aPort);
    return Ok;
  }
  else
  {
    if ( (byte)DebugFuncInternal & bDebugFlag)
      writeDbgLevel (DebugFuncInternal, "Data was NOT sent on port -- %d --.", aPort);
    return NotOk;
  }
}


/*! @}*/
/*! @}*/
/*!
*   \file
*   \ingroup baseLib
*   \brief Library for handling RS232 communication using CAPL primitve functions.

*/

