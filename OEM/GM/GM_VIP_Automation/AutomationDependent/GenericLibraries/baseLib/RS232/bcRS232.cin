/*@!Encoding:1252*/

/*!
* @defgroup bcRS232 bcRS232
* @defgroup RS232 RS232
* @ingroup baseLib
* @{
* @addtogroup bcRS232
* @{
*/ 

variables 
{
  enum bc_eNumbersRS232 {bc_eRS232_ZERO, bc_eRS232_ONE, bc_eRS232_TWO, bc_eRS232_THREE, bc_eRS232_FOUR, bc_eRS232_FIVE, bc_eRS232_SIX, bc_eRS232_SEVEN};
  const int bc_bMaxLengthRS232Cmd = 50;
}

/*! @}*/
/*! @}*/
/*!
*   \file
*   \ingroup baseLib
*   \brief RS232 base library constants.

*/