/*@!Encoding:1252*/
//********************************************************************************************
//----------------- BK Precision 1687b programmable power supply (RS232) --------------------
//---------- Communication: RS232, 9600 baud, 8 data bits, no parity, 1 stop bit ------------
//---------- Command terminator: \r (CR only, as per BK Precision 1687b programming rules) --
//---------- SOUT1 = output ON,  SOUT0 = output OFF  ----------------------------------------
//---------- VOLT/CURR/SOUT commands return "OK\r" on success --------------------------------
//
// COM PORT CONFIGURATION
// ----------------------
// The port number passed to every function MUST be read from config.cin:
//
//     powersupply_port  (default: 4  ->  COM4)
//
// Change that ONE variable in config.cin to re-target the whole test suite.
// Never pass a literal port number to these functions from test-case code.
//*********************************************************************************************
includes
{
  
}

variables
{
  // No shared mutable I/O buffers — all RS232 buffers are now local to each function
  // to prevent data corruption from concurrent callers.
}

export testfunction Set_voltage(int port, float volt)  // Set output voltage on BK Precision 1687b.
                                                       // port: pass powersupply_port from config.cin
                                                       // volt: desired voltage in Volts (e.g. 12.0)
{
  char  buffer1[100];
  byte  buffer[100];
  byte  buffer3[20];
  dword ret, ret1;
  int   i;

  RS232_Initialize(port);
  // BK Precision 1687b: VOLTnnn where nnn = voltage x 10 (zero-padded 3-digit integer)
  // e.g. 12.0 V -> VOLT120\r
  snprintf(buffer1, elCount(buffer1), "VOLT%03d\r", (int)(volt * 10));
  for(i = 0; i < strlen(buffer1); i++)
  {
    buffer[i] = buffer1[i];
  }
  ret = RS232Send(port, buffer, strlen(buffer1));
  if(ret == 1)
  {
    // BK Precision 1687b responds with "OK\r" to confirm the voltage was accepted.
    // Wait long enough for the supply to echo back before reading the port.
    testWaitForTimeoutSilent(300);
    buffer3[0] = 0; buffer3[1] = 0; buffer3[2] = 0;
    ret1 = RS232Receive(port, buffer3, 3);
    if(ret1 == 1 && buffer3[0] == 'O' && buffer3[1] == 'K')
    {
      testStepPass("", "VOLTAGE set to %.1f V - acknowledged by supply", volt);
    }
    else
    {
      write("WARNING: BK Precision 1687b VOLT ACK not received on COM%d (ret1=%d 0x%02X 0x%02X)", port, ret1, buffer3[0], buffer3[1]);
      testStepFail("", "VOLTAGE set to %.1f V - supply did not acknowledge (COM%d)", volt, port);
    }
  }
  else
  {
    testStepFail("", "Unable to set voltage due to RS232Send error %d on COM%d", ret, port);
  }
  RS232Close(port);
}



export testfunction Read_voltage(int port)  // Read actual output voltage from BK Precision 1687b.
                                            // port: pass powersupply_port from config.cin
{
  char  buffer1[100];
  char  buffer2[100];
  byte  buffer[100];
  byte  buffer3[20];  // Large enough for BK Precision GETD response (9 data bytes + CR)
  dword ret, ret1;
  int   i;

  RS232_Initialize(port);
  // BK Precision 1687b: GETD returns actual display values
  // Response format: VVVVAAAAOM\r (9 data bytes + CR = 10 bytes total)
  //   VVVV = voltage in units of 10 mV  (e.g. "1200" = 12.0 V)
  //   AAAA = current in units of 1 mA   (e.g. "2500" = 2.500 A)
  snprintf(buffer1, elCount(buffer1), "GETD\r");
  for(i = 0; i < strlen(buffer1); i++)
  {
    buffer[i] = buffer1[i];
  }
  ret = RS232Send(port, buffer, strlen(buffer1));
  if(ret == 1)
  {
    testStepPass("", "Voltage read request sent to COM%d", port);
  }
  else
  {
    testStepFail("", "Voltage read request not sent on COM%d - RS232Send error %d", port, ret);
  }
  testWaitForTimeout(500);  // BK Precision 1687b responds in <100 ms; 500 ms is a safe margin
  buffer3[0] = 0;
  ret1 = RS232Receive(port, buffer3, elcount(buffer3));
  if(ret1 == 1)
  {
    // Extract first 4 bytes (voltage in units of 10 mV)
    for(i = 0; i < 4; i++)
    {
      buffer2[i] = buffer3[i];
    }
    buffer2[4] = 0;  // null-terminate
    Teststep("", "Actual voltage: %s x 10 mV (COM%d)", buffer2, port);
  }
  else
    testStepFail("", "Voltage read error on COM%d - no response received", port);
  RS232Close(port);
}

export testfunction Read_current(int port)  // Read actual output current from BK Precision 1687b.
                                            // port: pass powersupply_port from config.cin
{
  char  buffer1[100];
  char  buffer2[100];
  byte  buffer[100];
  byte  buffer3[20];  // Large enough for BK Precision GETD response (9 data bytes + CR)
  dword ret, ret1;
  int   i;

  RS232_Initialize(port);
  // BK Precision 1687b: GETD returns actual display values
  // Response format: VVVVAAAAOM\r (9 data bytes + CR = 10 bytes total)
  //   AAAA = current in units of 1 mA (e.g. "2500" = 2500 mA = 2.500 A)
  snprintf(buffer1, elCount(buffer1), "GETD\r");
  for(i = 0; i < strlen(buffer1); i++)
  {
    buffer[i] = buffer1[i];
  }
  ret = RS232Send(port, buffer, strlen(buffer1));
  if(ret == 1)
  {
    testStepPass("", "Current read request sent to COM%d", port);
  }
  else
  {
    testStepFail("", "Current read request not sent on COM%d - RS232Send error %d", port, ret);
  }
  testWaitForTimeout(500);  // BK Precision 1687b responds in <100 ms; 500 ms is a safe margin
  buffer3[0] = 0;
  ret1 = RS232Receive(port, buffer3, elcount(buffer3));
  if(ret1 == 1)
  {
    // Extract bytes 4-7 (current in units of 1 mA)
    for(i = 0; i < 4; i++)
    {
      buffer2[i] = buffer3[i + 4];
    }
    buffer2[4] = 0;  // null-terminate
    Teststep("", "Actual current: %s mA (COM%d)", buffer2, port);
  }
  else
    testStepFail("", "Current read error on COM%d - no response received", port);
  RS232Close(port);
}

export testfunction Power_OFF_ON(int port, int ctrl)  // Turn power output ON or OFF on BK Precision 1687b.
                                                      // port: pass powersupply_port from config.cin
                                                      // ctrl: 0 = turn output OFF (SOUT0), 1 = turn output ON (SOUT1)
{
  char  buffer1[100];
  byte  buffer[100];
  byte  buffer3[20];
  dword ret, ret1;
  int   i;

  RS232_Initialize(port);
  // BK Precision 1687b: SOUT1 = output ON, SOUT0 = output OFF
  // Each command receives an "OK\r" (3-byte) acknowledgment from the supply.
  snprintf(buffer1, elCount(buffer1), "SOUT%d\r", ctrl);
  for(i = 0; i < strlen(buffer1); i++)
  {
    buffer[i] = buffer1[i];
  }
  ret = RS232Send(port, buffer, strlen(buffer1));
  if(ret == 1)
  {
    // Read back the "OK\r" acknowledgment to confirm the supply executed the command.
    testWaitForTimeoutSilent(300);
    buffer3[0] = 0; buffer3[1] = 0; buffer3[2] = 0;
    ret1 = RS232Receive(port, buffer3, 3);
    if(ret1 == 1 && buffer3[0] == 'O' && buffer3[1] == 'K')
    {
      if(ctrl == 0)
      {
        testStep("", "Power output turned OFF (SOUT0) on COM%d", port);
        testStepPass();
      }
      else
      {
        testStep("", "Power output turned ON (SOUT1) on COM%d", port);
        testStepPass();
      }
    }
    else
    {
      write("WARNING: BK Precision 1687b SOUT%d ACK not received on COM%d (ret1=%d 0x%02X 0x%02X)", ctrl, port, ret1, buffer3[0], buffer3[1]);
      if(ctrl == 0)
      {
        testStepFail("", "Power OFF command sent but supply did not acknowledge (COM%d)", port);
      }
      else
      {
        testStepFail("", "Power ON command sent but supply did not acknowledge (COM%d)", port);
      }
    }
  }
  else
  {
    testStepFail("", "Unable to change power output state on COM%d - RS232Send error %d", port, ret);
  }
  RS232Close(port);
}

void RS232_Initialize(int port)
// Initialize RS232 for BK Precision 1687b: 9600 baud, 8 data bits, 1 stop bit, no parity.
// port: always pass powersupply_port from config.cin - do not hard-code the number here.
//
// The CANoe PowerSupply.can support node polls the same serial port via a 500 ms timer.
// If its timer fires while a test function holds the port the OS rejects the second open.
// Three attempts with a 200 ms gap between them cover the worst-case scenario where
// two successive timer ticks occur before the port is released.
{
  dword port_open;
  int   attempt;
  for(attempt = 1; attempt <= 3; attempt++)
  {
    RS232Close(port);         // safe no-op on an already-closed port
    RS232Configure(port, 9600, 8, 1, 0);
    port_open = RS232Open(port);
    if(port_open == 1)
    {
      if(attempt == 1)
        testStepPass("", "COM%d opened successfully", port);
      else
        testStepPass("", "COM%d opened on attempt %d/3", port, attempt);
      return;
    }
    if(attempt < 3)
    {
      write("RS232_Initialize: COM%d open failed (attempt %d/3), waiting 200 ms...", port, attempt);
      testWaitForTimeoutSilent(200);
    }
  }
  testStepFail("", "COM%d could not be opened after 3 attempts - check that no other node holds the port", port);
}

RS232OnReceive(dword port, byte buffer[], dword number)
{
  
}
