/*@!Encoding:1252*/
/*!
* @defgroup ccDTC ccDTC
* @defgroup DTC DTC
* @ingroup controlLib
* @{
* @addtogroup ccDTC
* @{
*/ 
variables
{
  const byte cc_bDUT_GlobalDebugFlag = 0x01;
  enum cc_eDUT { eDUT1 = 0x0, eDUT2 = 0x1, eDUT3 = 0x2};
}
/*! @}*/
/*! @}*/
/*!
*   \file
*   \ingroup controlLib
*   \brief DTC control library constants
*/