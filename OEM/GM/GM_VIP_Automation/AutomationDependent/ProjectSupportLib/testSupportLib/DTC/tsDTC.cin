/*@!Encoding:1252*/
includes
{
  #include "tscDTC.cin"
  #include "..\..\controlLib\DTC\cDTC.cin"
}

/*!
* @defgroup tsDTC tsDTC
* @defgroup DTC DTC
* @ingroup testSupportLib
* @{
* @addtogroup tsDTC
* @{
*/ 

/*! \fn void E_DTC_CheckSingleDTCbyStatusMask( dword aDTCid, byte aDTCStatusMask )
*  \brief Function to check if requested DTC is present with requested status (DTC mask 0x09 is applied)
*  \param[in] aDTCid          - DTCid to check
*  \param[in] aDTCStatusMask  - DTCstatus to be checked
*  \return None
*
* Change History: 
* Date(DD.MM.YY)        Author          Change info                                                          
*  19.10.23             CiCo            Updated for CCU project.
*/
void E_DTC_CheckSingleDTCbyStatusMask( dword aDTCid, byte aDTCStatusMask )
{
  char chTempText[ cc_dwMaxOfDTC * 256 ];
  byte bDebugFlag;
  byte bRetVal;
  struct cv_sDTC sDTC[1];// struct for one DTC
  
  bDebugFlag = tsc_bDTC_GlobalDebugFlag;
  bRetVal = NotOk;
  snprintf(chTempText,elcount(chTempText),"");
  
  writeDbgLevel(DebugFuncCalls, "Entered E_DTC_CheckSingleDTCbyStatusMask().");
  if ( (byte)DebugFuncParam & bDebugFlag )
    writeDbgLevel ( DebugFuncParam, "Parameters:\n aDTCid: -- %x -- \naDTCStatusMask: -- %x", aDTCid, aDTCStatusMask);
  
  if(0 != aDTCid)
  {
    sDTC[0].dwDTCid = aDTCid; 
    sDTC[0].bDtcStatus = aDTCStatusMask;
    bRetVal = bFctn_DUT_Diag_SetTarget(chTempText);// set ECU target
    if ( (byte)DebugFuncInternal & bDebugFlag)
      writeDbgLevel (DebugFuncInternal, "bFctn_DUT_Diag_SetEcuDiagTarget return: %d. Message: %s", bRetVal, chTempText);
    bRetVal = bFctn_DTC_CheckByStatusMask( sDTC, FALSE, chTempText);
    if ( (byte)DebugFuncInternal & bDebugFlag)
      writeDbgLevel (DebugFuncInternal, "bFctn_DTC_CheckByStatusMask return: %d. Message: %s", bRetVal, chTempText);
    
    if( bRetVal )// evaluation of bFctn_DTC_CheckByStatusMask
    {
      snprintf(chTempText, elcount(chTempText), "SUCCESS: %s", chTempText);
      vFctn_REPORTStepEvaluation(chTempText, PASS); 
    }
    else
    {
      snprintf(chTempText,elcount(chTempText), "FAIL: %s", chTempText);
      vFctn_REPORTStepEvaluation(chTempText, FAIL); 
    }
  }
  else
  {
      snprintf(chTempText,elcount(chTempText),"FAIL: Invalid value for requested DTC ID. Should be other then 0x0");
      vFctn_REPORTStepEvaluation(chTempText, FAIL); 
  }
}

/*! \fn void E_DTC_CheckSingleDTCbyStatusMask( char aDTCid[], byte aDTCStatusMask )
*  \brief Function to check if requested DTC is present with requested status (DTC mask 0x09 is applied)
*  \param[in] aDTCid[]          - DTCid to check in char format (eg. "123456")
*  \param[in] aDTCStatusMask    - DTCstatus to be checked
*  \return None
*
* Change History: 
* Date(DD.MM.YY)        Author          Change info                                                          
*  19.10.23             CiCo            Updated for CCU project.
*/
void E_DTC_CheckSingleDTCbyStatusMask( char aDTCid[], byte aDTCStatusMask )
{
  char chTempText[ cc_dwMaxOfDTC * 256 ];
  byte bDebugFlag;
  byte bRetVal;
  qword qwDTCid;
  char chDTCid[9];
  struct cv_sDTC sDTC[1];// struct for one DTC
  
  bDebugFlag = tsc_bDTC_GlobalDebugFlag;
  bRetVal = NotOk;// 0
  snprintf(chTempText,elcount(chTempText),"");
  
  writeDbgLevel(DebugFuncCalls, "Entered E_CheckSingleDTCbyStatusMask().");
  if ( (byte)DebugFuncParam & bDebugFlag )
    writeDbgLevel ( DebugFuncParam, "Parameters:\n aDTCid: -- 0x%s -- \naDTCStatusMask: -- %x", aDTCid, aDTCStatusMask );
  snprintf( chDTCid, elcount(chDTCid), "0x%s", aDTCid );
  bFctn_CONV_ConvertStringToUnsignedDataType( chDTCid, Type_Dword, qwDTCid, chTempText );
  if ( (byte)DebugFuncInternal & bDebugFlag)
    writeDbgLevel (DebugFuncInternal, "bFctn_CONV_ConvertStringToUnsignedDataType -> Message: %s", chTempText );  
  if(0 != (dword) qwDTCid)
  {
    sDTC[0].dwDTCid = (dword)qwDTCid; 
    sDTC[0].bDtcStatus = aDTCStatusMask;
    bRetVal = bFctn_DUT_Diag_SetTarget(chTempText);// set ECU target
    if ( (byte)DebugFuncInternal & bDebugFlag)
      writeDbgLevel (DebugFuncInternal, "bFctn_DUT_Diag_SetTarget return: %d. Message: %s", bRetVal, chTempText);
    bRetVal = bFctn_DTC_CheckByStatusMask( sDTC, FALSE, chTempText);
    if ( (byte)DebugFuncInternal & bDebugFlag)
      writeDbgLevel (DebugFuncInternal, "bFctn_DTC_CheckByStatusMask return: %d. Message: %s", bRetVal, chTempText );
    
    if( bRetVal )// evaluation of bFctn_DTC_CheckByStatusMask
    {
      snprintf(chTempText, elcount(chTempText), "SUCCESS: %s", chTempText);
      vFctn_REPORTStepEvaluation(chTempText, PASS); 
    }
    else
    {
      snprintf(chTempText,elcount(chTempText), "FAIL: %s", chTempText);
      vFctn_REPORTStepEvaluation(chTempText, FAIL); 
    }
  }
  else
  {
      snprintf(chTempText,elcount(chTempText),"FAIL: Invalid value for requested DTC ID. Should be other then 0x0" );
      vFctn_REPORTStepEvaluation(chTempText, FAIL); 
  }
}

/*! \fn void E_DTC_CheckMultipleDTCbyStatusMask( struct cv_sDTC aDTC[] )
*  \brief Function to check if requested DTC list are present with requested status (DTC mask 0x09 is applied)
*  \param[in] aDTC[]        - DTC to check (see the definition of the struct pv_sDTC)
* 
*  \return None
*
* Change History: 
* Date(DD.MM.YY)        Author          Change info                                                          
*  19.10.23             CiCo            Updated for CCU project.
*/
void E_DTC_CheckMultipleDTCbyStatusMask( struct cv_sDTC aDTC[] )
{
  char chTempText[ cc_dwMaxOfDTC * 256 ];
  byte bDebugFlag;
  byte bRetVal;
  
  bDebugFlag = tsc_bDTC_GlobalDebugFlag;
  bRetVal = NotOk;// 0
  snprintf(chTempText,elcount(chTempText),"");
  
  writeDbgLevel(DebugFuncCalls, "Entered E_DTC_CheckMultipleDTCbyStatusMask().");
  
  if(0 != aDTC[0].dwDTCid )
  {
    bRetVal = bFctn_DUT_Diag_SetTarget(chTempText);// set ECU target
    if ( (byte)DebugFuncInternal & bDebugFlag)
      writeDbgLevel (DebugFuncInternal, "bFctn_Diag_SetEcuDiagTarget return: %d. Message: %s", bRetVal, chTempText);
    bRetVal = bFctn_DTC_CheckByStatusMask( aDTC, TRUE, chTempText);
    if ( (byte)DebugFuncInternal & bDebugFlag)
      writeDbgLevel (DebugFuncInternal, "bFctn_DTC_CheckByStatusMask return: %d. Message: %s", bRetVal, chTempText);
    
    if( bRetVal )// evaluation of bFctn_CheckDTCByStatusMask
    {
      snprintf(chTempText, elcount(chTempText), "SUCCESS: %s", chTempText);
      vFctn_REPORTStepEvaluation(chTempText, PASS); 
    }
    else
    {
      snprintf(chTempText,elcount(chTempText), "FAIL: %s", chTempText);
      vFctn_REPORTStepEvaluation(chTempText, FAIL); 
    }
  }
  else
  {
      snprintf(chTempText,elcount(chTempText),"FAIL: Invalid value for requested DTC ID. Should be other then 0x0");
      vFctn_REPORTStepEvaluation(chTempText, FAIL); 
  }
}

/*! \fn E_DTC_CheckForFaultFree()
*  \brief Function that will check for no DTC present, accepted DTC will be checked also
*
* Change History: 
* Date(DD.MM.YY)        Author          Change info                                                          
*  19.10.23             CiCo            Updated for CCU project.
*/
void E_DTC_CheckForFaultFree()
{
  char chTempText[ cc_dwMaxOfDTC * 256 ];
  byte bDebugFlag;
  byte bRetVal;
  struct cv_sDTC sDTC[1];// struct for one DTC
  
  bDebugFlag = tsc_bDTC_GlobalDebugFlag;
  bRetVal = NotOk;// 0
  snprintf(chTempText,elcount(chTempText),"");
  
  writeDbgLevel(DebugFuncCalls, "Entered E_DTC_CheckForFaultFree().");
 
  sDTC[0].dwDTCid = 0x00; 
  bRetVal = bFctn_DUT_Diag_SetTarget(chTempText);// set ECU target
  if ( (byte)DebugFuncInternal & bDebugFlag)
    writeDbgLevel (DebugFuncInternal, "bFctn_DUT_Diag_SetTarget return: %d. Message: %s", bRetVal, chTempText);
  bRetVal = bFctn_DTC_CheckByStatusMask( sDTC, TRUE, chTempText);
  if ( (byte)DebugFuncInternal & bDebugFlag)
    writeDbgLevel (DebugFuncInternal, "bFctn_DTC_CheckByStatusMask return: %d. Message: %s", bRetVal, chTempText);
  
  if( bRetVal )// evaluation of bFctn_DTC_CheckByStatusMask
  {
    snprintf(chTempText, elcount(chTempText), "SUCCESS: No DTC present.");
    vFctn_REPORTStepEvaluation(chTempText, PASS); 
  }
  else
  {
    snprintf(chTempText,elcount(chTempText), "FAIL: %s", chTempText);
    vFctn_REPORTStepEvaluation(chTempText, FAIL); 
  }
}

/*! @}*/
/*! @}*/
/*!
*   \file
*   \ingroup testSupportLib
*   \brief DTC functions with actions and expected
*/