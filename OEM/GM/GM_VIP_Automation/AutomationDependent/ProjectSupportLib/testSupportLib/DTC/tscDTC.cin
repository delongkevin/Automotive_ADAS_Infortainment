/*@!Encoding:1252*/
/*!
* @defgroup tscDTC tscDTC
* @defgroup DTC DTC
* @ingroup controlLib
* @{
* @addtogroup tscDTC
* @{
*/ 
variables
{
  const byte tsc_bDTC_GlobalDebugFlag = 0x01;
}
/*! @}*/
/*! @}*/
/*!
*   \file
*   \ingroup controlLib
*   \brief DTC test support library constants.
*/