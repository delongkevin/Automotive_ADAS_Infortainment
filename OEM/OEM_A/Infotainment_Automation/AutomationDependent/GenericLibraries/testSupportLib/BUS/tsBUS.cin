/*@!Encoding:1252*/
/*!
* @defgroup tsBUS tsBUS
* @defgroup BUS BUS
* @ingroup testSupportLib
* @{
* @addtogroup tsBUS
* @{
*/


includes
{
  #include "tscBUS.cin"
  #include "..\..\controlLib\BUS\cBUS.cin"
}

/*! \fn void A_BUS_SetContext(char aBusContext[] )
*  \brief Function that sets the context of the required bus.
*  \param[in] aBusContext   - name of Bus context
* 
*  \return No Return
*
* Change History: 
* Date(DD.MM.YY)        Author          Change info                                                          
*   
*  06.07.18              GrAn        Created and implemented
*  27.02.19              CrJu        Added new debug functions / Rewrite the code using the new common variables
*/

void A_BUS_SetContext(char aBusContext[])
{
  char chAction[250];
  char chPassText[250];
  char chFailText[250];
  byte bResultAction;
  byte bResult;
  char chPrintBusContext[30];
  byte bDebugFlag;
  
  //Initialization of local variables
  bDebugFlag = tsc_bBUS_GlobalDebugFlag;
  bResult = NotOk;
  bResultAction = NotOk;
  
  writeDbgLevel (DebugFuncCalls , "Function A_BUS_SetContext entered.");
  
  if((byte)DebugFuncParam & bDebugFlag)
    writeDbgLevel (DebugFuncParam, "Parameters: char aBusContext[] --%s-- ",aBusContext); 
  
  bFctn_CONV_GetSubString(aBusContext, 0, tsc_wBUSPrintBusContextChars, chPrintBusContext); //print in report the first 25 chars from the BusContext
  
  snprintf(chAction, elcount(chAction), "The bus context is set to %s.", chPrintBusContext);
  bResultAction = bFctn_REPORTAction(chAction);
    
  if(bResultAction)
  {
    bResult = bFctn_BUS_SetContext(aBusContext);
    
    if((byte)DebugFuncInternal & bDebugFlag)
        writeDbgLevel (DebugFuncInternal, "Result: bFctn_BUS_SetContext: %d", bResult);
    
    if(Ok == bResult)
    {
      snprintf(chPassText, elcount(chPassText), "The bus context was succesfully set.");
      vFctn_REPORTActionEvaluation(chPassText, PASS);
    }
    else
    {
      snprintf(chFailText, elcount(chFailText), "The bus context was not succesfully set or it does not exist. Check the name from your configuration.");
      vFctn_REPORTActionEvaluation(chFailText, FAIL);
    }
  }
  else // the reporting function has failed
  {
    vFctn_REPORTActionEvaluation("The reporting function has failed and the action text could not be added to the report.", FAIL);
  }
}


/*! \fn void A_BUS_SetSignalPhysical(Signal aSignalName, double aSignalValue)
*   \brief Function that sets a specific physical value for a signal.
*   \param[in] aSignalName   - Signal name from the database.
*   \param[in] aSignalValue  - Signal value
*
*   \return no return
*   \note 
*        - This function can be used just for dbc signals.
*
*  Change History: 
*  Date(DD.MM.YY)        Author          Change info                                                          
*   
*  19.03.2019              CrJu        Created and implemented
*/

void A_BUS_SetSignalPhysical (Signal* aSignalName, double aSignalValue)
{
  char chAction[250];
  char chPassText[250];
  char chFailText[250];
  byte bResultAction;
  byte bDebugFlag;
  
  //Initialization of local variables
  bDebugFlag = tsc_bBUS_GlobalDebugFlag;
  bResultAction = NotOk;  
  
  writeDbgLevel (DebugFuncCalls , "Function A_BUS_SetSignalPhysical entered.");
  
  if((byte)DebugFuncParam & bDebugFlag)
    writeDbgLevel (DebugFuncParam, "Parameters: Signal* aSignalName --%s--, double aSignalValue --%10.2d--",aSignalName.name, aSignalValue);   
  
  snprintf(chAction, elcount(chAction), "Sets the value of specific signal %s to the value %10.2f.",aSignalName.name, aSignalValue);
  bResultAction = bFctn_REPORTAction(chAction);
  
  if(bResultAction == Ok)
  {
    setSignal(aSignalName, aSignalValue);
    snprintf(chPassText, elcount(chPassText), "SUCCES: Sets the value of specific signal %s with value %10.2f .",aSignalName.name, aSignalValue);
    vFctn_REPORTActionEvaluation(chPassText, PASS);
  }
  else
  {
    snprintf(chFailText, elcount(chFailText), "ERROR: The action text could not be added in the Report. bFctn_REPORTAction() return: %d.", bResultAction);
    vFctn_REPORTActionEvaluation(chFailText, FAIL);
  }
}

/*! \fn void A_BUS_SetSignalRaw(Signal aSignalName, int64 aSignalValue)
*   \brief Function that sets a signal value with a specific value (the value of signal can be represented on 4 bytes or less than 4 bytes). 
*   \param[in] aSignalName    - Signal name from the database.
*   \param[in] aSignalValue   - Signal value
*
*   \return no return
*   \note 
*        - This function can be used just for dbc signals.
*
*  Change History: 
*  Date(DD.MM.YY)        Author          Change info                                                          
*   
*  18.03.19              CrJu        Created and implemented
*/

void A_BUS_SetSignalRaw (Signal* aSignalName, int64 aSignalValue)
{
  char chAction[250];
  char chFailText[250];
  char chMappedResponseInfo[250];
  byte bResultAction;
  long lResult;
  byte bDebugFlag;
  
  //Initialization of local variables
  bDebugFlag = tsc_bBUS_GlobalDebugFlag;
  lResult = NotOk;
  bResultAction = NotOk;  
  
  writeDbgLevel (DebugFuncCalls , "Function A_BUS_SetSignalRaw entered.");
  
  if((byte)DebugFuncParam & bDebugFlag)
    writeDbgLevel (DebugFuncParam, "Parameters: Signal* aSignalName --%s--, double aSignalValue --%I64d--",aSignalName.name, aSignalValue);   
  
  snprintf(chAction, elcount(chAction), "Sets the value of specific signal %s to the value %I64d.",aSignalName.name, aSignalValue);
  bResultAction = bFctn_REPORTAction(chAction);
    
  if(bResultAction == Ok)
  {
    lResult = lFctn_BUS_SetSignalRaw(aSignalName, aSignalValue, chMappedResponseInfo);
    
    if(Ok == lResult) //the value of signal was succesfully set
    {
      vFctn_REPORTActionEvaluation(chMappedResponseInfo, PASS);
    }
    else
    {
      vFctn_REPORTActionEvaluation(chMappedResponseInfo, FAIL);
    }
  }
  else
  {
    snprintf(chFailText, elcount(chFailText), "ERROR: The action text could not be added in the Report. bFctn_REPORTAction() return: %d.", bResultAction);
    vFctn_REPORTActionEvaluation(chFailText, FAIL);    
  }
}

/*! \fn void A_BUS_SetSignalByDataArr (Signal* aSignalName, byte aData[], dword aSignalBitCount)
*   \brief Function that sets a signal value with a specific value (the value of signal is represented on a bytes array). 
*   \param[in] aSignalName        - Signal name from the database.
*   \param[in] aData              - Signal value, represented on a bytes array
*   \param[in] aSignalBitCount    - The number of bits
*
*   \return no return
*   \note 
*        - This function can be used just for dbc signals.
*
*  Change History: 
*  Date(DD.MM.YY)        Author          Change info                                                          
*   
*  25.03.2019            CrJu         Created and implemented
* 
*/

void A_BUS_SetSignalByDataArr (Signal* aSignalName, byte aData[], dword aSignalBitCount)
{
  char chAction[250];
  char chFailText[250];
  char chMappedResponseInfo[250];
  char chOutputString[150];
  byte bResultAction;
  long lResult;
  byte bDebugFlag;
  
  //Initialization of local variables
  bDebugFlag = tsc_bBUS_GlobalDebugFlag;
  lResult = NotOk;
  bResultAction = NotOk;  
  
  writeDbgLevel (DebugFuncCalls , "Function A_BUS_SetSignalByDataArr entered.");

  //convert bytes array to string
  bFctn_CONV_ConvertByteArrayToString(aData, chOutputString);
  
  if((byte)DebugFuncParam & bDebugFlag)
    writeDbgLevel (DebugFuncParam, "Parameters: Signal* aSignalName --%s--, byte aData[] --%s--, dword aSignalBitCount",aSignalName.name, chOutputString);   
  
  snprintf(chAction, elcount(chAction), "Sets the value of specific signal %s to the value %s.",aSignalName.name, chOutputString);
  bResultAction = bFctn_REPORTAction(chAction);

  if(bResultAction == Ok)
  {
    lResult = lFctn_BUS_SetSignalByDataArr(aSignalName, aData, aSignalBitCount, chMappedResponseInfo);
    
    if(Ok == lResult) //the value of signal was succesfully set
    {
      vFctn_REPORTActionEvaluation(chMappedResponseInfo, PASS);
    }
    else
    {
      vFctn_REPORTActionEvaluation(chMappedResponseInfo, FAIL);
    }
  }
  else
  {
    snprintf(chFailText, elcount(chFailText), "ERROR: The action text could not be added in the Report. bFctn_REPORTAction() return: %d.", bResultAction);
    vFctn_REPORTActionEvaluation(chFailText, FAIL);    
  }
}

/*! \fn void E_BUS_WaitForSignalMatchPhysical(Signal* aSignalName, dword aTimeToWaitForSignal, float aSignalValue, enum cc_eEqualNotEqualValueBUS aExpectedResult)
*  \brief Function Wait and check if a signal is send with a specific pysycal content (the content of signal cannot be represented on more than 32 bits).
*  \param[in]  aSignalName - Signal name from the database.
*  \param[in]  aTimeToWaitForSignal - Maximum time to be waited (if the value is 0 the function should get the first value of the signal)
*  \param[in]  aSignalValue - The value that will be compared with the value of the signal.
*  \param[in]  aExpectedResult - The compared value is expected to be equal or not equal than signal value.
*
*  \return  no return
*
*  \note 
*         - An timeout must be set before this step (when aTimeToWaitForSignal is zero )
*
* Change History: 
* Date(DD.MM.YY)        Author          Change info                                                          
*   
*  06.07.18              GrAn        Created and implemented
*  26.03.19              CrJu        Refactoring code.
*/

void E_BUS_WaitForSignalMatchPhysical(Signal* aSignalName, dword aTimeToWaitForSignal, float aSignalValue, enum cc_eEqualNotEqualValueBUS aExpectedResult)
{
  char chPassText[250];
  char chFailText[250];
  char chMappedResponseInfo[250];
  long lResult;
  byte bDebugFlag;

  //Initialization of local variables
  lResult  = NotOk;
  bDebugFlag = tsc_bBUS_GlobalDebugFlag;
  
  writeDbgLevel (DebugFuncCalls, "Function E_BUS_WaitForSignalMatchPhysical entered.");
  if ( (byte)DebugFuncParam & bDebugFlag )
    writeDbgLevel (DebugFuncParam, "Parameters: Signal* aSignalName --%s--, dword aTimeToWaitForSignal --%d--, float aSignalValue --%10.2f--,enum cc_eEqualNotEqualValueBUS aExpectedResult --%d--(0 - Not equal, 1 - Equal) ",aSignalName.name,aTimeToWaitForSignal,aSignalValue,aExpectedResult );  
  
  lResult = lFctn_BUS_WaitForSignalMatchPhysical(aSignalName, aTimeToWaitForSignal, aSignalValue, chMappedResponseInfo);

  if (Error != lResult)
  {
    if (tsc_eBUS_EQUAL_VALUE == aExpectedResult)//It is expected that the signal value is equal with compared value
    {
      if (Ok == lResult)//SUCCESS
      {
        vFctn_REPORTStepEvaluation(chMappedResponseInfo, PASS);
      }
      else//FAIL
      {
        vFctn_REPORTStepEvaluation(chMappedResponseInfo, FAIL);
      }
    }
    else//It is expected that the signal value is not equal with compared value
    {
      if (Ok == lResult)//FAIL, because it is expected to not be equal with the given value
      {
        vFctn_REPORTStepEvaluation(chMappedResponseInfo, FAIL);
      }
      else
      {
        vFctn_REPORTStepEvaluation(chMappedResponseInfo, PASS);
      }
    }
  }
  else//an error occurred
  {
    vFctn_REPORTStepEvaluation(chMappedResponseInfo, FAIL);
  }
}

/*! \fn void E_BUS_WaitForSignalMatchRaw(Signal* aSignalName, dword aTimeToWaitForSignal,dword aMsgCycleTime, int64 aSignalValue, enum cc_eEqualNotEqualValueBUS aExpectedResult)
*  \brief Function Wait and check if a signal is send with a specific physical content (the content of signal cannot be represented on more than 32 bits).
*  \param[in]  aSignalName - Signal name from the database.
*  \param[in]  aTimeToWaitForSignal - Maximum time to be waited (if the value is 0 the function should get the first value of the signal)
*  \param[in]  aMsgCycleTime - The message cycle time (from database)
*  \param[in]  aSignalValue - The value that will be compared with the value of the signal.
*  \param[in]  aExpectedResult - The compared value is expected to be equal or not equal than signal value.
*
*  \return no return
*
* Change History: 
* Date(DD.MM.YY)        Author          Change info                                                          
*   
*  06.07.18              CrJu         Created and implemented
*/

void E_BUS_WaitForSignalMatchRaw(Signal* aSignalName, dword aTimeToWaitForSignal, dword aMsgCycleTime, int64 aSignalValue, enum cc_eEqualNotEqualValueBUS aExpectedResult)
{
  char chMappedResponseInfo[250];
  long lResult;
  byte bDebugFlag;
  
  //Initialization of local variables
  bDebugFlag = tsc_bBUS_GlobalDebugFlag;
  lResult = NotOk;
  
  writeDbgLevel (DebugFuncCalls, "Function E_BUS_WaitForSignalMatchRaw entered.");
  
  if ( (byte)DebugFuncParam & bDebugFlag )
    writeDbgLevel (DebugFuncParam, "Parameters: Signal* aSignalName --%s--, dword aTimeToWaitForSignal --%d--, dword aMsgCycleTime --%d--, float aSignalValue --%10.2f--, enum cc_eEqualNotEqualValueBUS aExpectedResult --%d--(0 - Not equal, 1 - Equal) ",aSignalName.name, aTimeToWaitForSignal, aMsgCycleTime, aSignalValue, aExpectedResult );  
  
  lResult = lFctn_BUS_WaitForSignalMatchRaw(aSignalName, aTimeToWaitForSignal, aMsgCycleTime, aSignalValue, chMappedResponseInfo);

  if(Error != lResult)
  {
    if (tsc_eBUS_EQUAL_VALUE == aExpectedResult)//It is expected that the signal value is equal with compared value
    {
      if (Ok == lResult)//SUCCESS
      {
        vFctn_REPORTStepEvaluation(chMappedResponseInfo, PASS); 
      }
      else//FAIL
      {
        vFctn_REPORTStepEvaluation(chMappedResponseInfo, FAIL);
      }
    }
    else//It is expected that the signal value is not equal with compared value
    {
      if (Ok == lResult)//FAIL
      {
        vFctn_REPORTStepEvaluation(chMappedResponseInfo, FAIL);
      }
      else//SUCCES
      {
        vFctn_REPORTStepEvaluation(chMappedResponseInfo, PASS);
      }
    }
  }
  else //an error occurred
  {
    vFctn_REPORTStepEvaluation(chMappedResponseInfo, FAIL);
  }
}

/*! \fn long lFctn_BUS_WaitForSignalMatchByDataArr(Signal* aSignalName, dword aTimeToWaitForSignal, dword aMsgCycleTime, byte aData[], dword aNrOfBytesToCompare, char aMappedResponseInfo)
*  \brief Function wait and check if a signal is send with a specific data bytes content (maxim 8 bytes).
*  \param[in]  aSignalName           - Signal name from the database.
*  \param[in]  aTimeToWaitForSignal  - Maximum time to be waited (if the value is 0 the function should get the first value of the signal)
*  \param[in]  aMsgCycleTime         - The message cycle time (from database)
*  \param[in]  aData                 - The value that will be compared with the value of the signal.
*  \param[in]  aNrOfBytesToCompare   - How many bytes you want to compare from the signal.
*  \param[in]  aExpectedResult       - The compared value is expected to be equal or not equal than signal value.
*
*  \return no return
*
* Change History: 
* Date(DD.MM.YY)        Author          Change info                                                          
*   
*  15.04.2019              CrJu         Created and implemented
*/

void E_BUS_WaitForSignalMatchByDataArr(Signal* aSignalName, dword aTimeToWaitForSignal, dword aMsgCycleTime, byte aData[], byte aNrOfBytesToCompare, enum cc_eEqualNotEqualValueBUS aExpectedResult)
{
  char chMappedResponseInfo[250];
  long lResult;
  byte bDebugFlag;
  
  //Initialization of local variables
  bDebugFlag = tsc_bBUS_GlobalDebugFlag;
  lResult = NotOk;
  
  writeDbgLevel (DebugFuncCalls, "Function E_BUS_WaitForSignalMatchByDataArr entered.");
  
  if ( (byte)DebugFuncParam & bDebugFlag )
    writeDbgLevel (DebugFuncParam, "Parameters: Signal* aSignalName --%s--, dword aTimeToWaitForSignal --%d--, dword aMsgCycleTime --%d--, dword aNrOfBytesToCompare --%d--, enum cc_eEqualNotEqualValueBUS aExpectedResult --%d--(0 - Not equal, 1 - Equal) ",aSignalName.name, aTimeToWaitForSignal, aMsgCycleTime, aNrOfBytesToCompare, aExpectedResult );  
  
  lResult = lFctn_BUS_WaitForSignalMatchByDataArr(aSignalName, aTimeToWaitForSignal, aMsgCycleTime, aData, aNrOfBytesToCompare, chMappedResponseInfo);
  
  if(Error == lResult)//an error occurred
  {
    vFctn_REPORTStepEvaluation(chMappedResponseInfo, FAIL);
  }
  else
  {
    if (tsc_eBUS_EQUAL_VALUE == aExpectedResult)//It is expected that the signal value is equal with compared value
    {
      strncat(chMappedResponseInfo, " (Expected the values to be EQUAL).", elCount(chMappedResponseInfo));
      if (Ok == lResult)//SUCCESS
      {
        vFctn_REPORTStepEvaluation(chMappedResponseInfo, PASS); 
      }
      else//FAIL
      {
        vFctn_REPORTStepEvaluation(chMappedResponseInfo, FAIL);
      }
    }
    else//It is expected that the signal value is not equal with compared value
    {
      strncat(chMappedResponseInfo, " (Expected the values to NOT be EQUAL).", elCount(chMappedResponseInfo));
      if (NotOk == lResult)//SUCCES
      {
        vFctn_REPORTStepEvaluation(chMappedResponseInfo, PASS);
      }
      else//FAIL
      {
        vFctn_REPORTStepEvaluation(chMappedResponseInfo, FAIL);
      }
    }
  }
}

/*! \fn void E_BUS_WaitForSignalMatchRangePhysical(Signal* aSignalName, dword aTimeToWaitForSignal, float aMinValue, float aMaxValue, char aBusContext[], enum cc_eInsideOrOutsideRangeBUS aExpectedResult)
*  \brief Function Wait and check if a message is send with his PHYSICAL values inside or outside of a given range.
*  \param[in]  aSignalName          - Signal name from the database.
*  \param[in]  aTimeToWaitForSignal - Maximum time to be waited (if the value is 0 the function should get the first value of the signal)
*  \param[in]  aMinValue            - The minimum of the signal.
*  \param[in]  aMaxValue            - The maximum of the signal.
*  \param[in]  aBusContext          - the bus name context
*  \param[in]  aExpectedResult      - The compared value is expected to be INSIDE/OUTSIDE of the given range
*
*  \return  no return
*
*  \note 
*         - An timeout must be set before this step (when aTimeToWaitForSignal is zero )
*
* Change History: 
* Date(DD.MM.YY)        Author          Change info                                                          
*
*  06.05.19              CrJu        Created and implemented
*/

void E_BUS_WaitForSignalMatchRangePhysical(Signal* aSignalName, dword aTimeToWaitForSignal, float aMinValue, float aMaxValue, char aBusContext[], enum cc_eInsideOrOutsideRangeBUS aExpectedResult)
{
  char chMappedResponseInfo[250];
  long lResult;
  byte bDebugFlag;

  //Initialization of local variables
  lResult = NotOk;
  bDebugFlag = tsc_bBUS_GlobalDebugFlag;
  
  writeDbgLevel (DebugFuncCalls, "Function E_BUS_WaitForSignalMatchInRangePhysical entered.");
  
  if( (byte)DebugFuncParam & bDebugFlag )
    writeDbgLevel (DebugFuncParam, "Parameters: Signal* aSignalName --%s--, dword aTimeToWaitForSignal --%d--, float aMinValue --%10.2f--,float aMaxValue --%10.2f--, char aBusContext[] --%s--, enum cc_eInsideOrOutsideRangeBUS aExpectedResult --%d--(0 - Outside Range, 1 - Inside Range)  ", aSignalName.name, aTimeToWaitForSignal, aMinValue, aMaxValue, aBusContext, aExpectedResult); 
  
  if(cc_eBUS_InsideRange == aExpectedResult)//it's expected that the value is INSIDE the given range
  {
    //call the 'in-range' function
    lResult = lFctn_BUS_WaitForSignalMatchInRangePhysical(aSignalName, aTimeToWaitForSignal, aMinValue, aMaxValue, aBusContext, chMappedResponseInfo);
    
    if(Ok == lResult)//SUCCES
    {
      vFctn_REPORTStepEvaluation(chMappedResponseInfo, PASS);
    }
    else//FAIL
    {
      vFctn_REPORTStepEvaluation(chMappedResponseInfo, FAIL);
    }
  }
  else//it's expected that the value is OUTSIDE the given range
  {
    //call the 'out-range' function
    lResult = lFctn_BUS_WaitForSignalMatchOutRangePhysical(aSignalName, aTimeToWaitForSignal, aMinValue, aMaxValue, aBusContext, chMappedResponseInfo);
    
    if(Ok == lResult)//SUCCES
    {
      vFctn_REPORTStepEvaluation(chMappedResponseInfo, PASS);
    }
    else//FAIL
    {
      vFctn_REPORTStepEvaluation(chMappedResponseInfo, FAIL);
    }
  }
}

/*! \fn void E_BUS_WaitForSignalMatchRangeRaw(Signal* aSignalName, dword aTimeToWaitForSignal, float aMinValue, float aMaxValue, char aBusContext[], enum cc_eInsideOrOutsideRangeBUS aExpectedResult)
*  \brief Function Wait and check if a message is send with his RAW values inside or outside of a given range.
*  \param[in]  aSignalName          - Signal name from the database.
*  \param[in]  aTimeToWaitForSignal - Maximum time to be waited (if the value is 0 the function should get the first value of the signal)
*  \param[in]  aMsgCycleTime        - The message cycle time (from database)
*  \param[in]  aMinValue            - The minimum of the signal.
*  \param[in]  aMaxValue            - The maximum of the signal.
*  \param[in]  aBusContext          - the bus name context
*  \param[in]  aExpectedResult      - The compared value is expected to be INSIDE/OUTSIDE of the given range
*
*  \return  no return
*
*  \note 
*         - An timeout must be set before this step (when aTimeToWaitForSignal is zero )
*
* Change History: 
* Date(DD.MM.YY)        Author          Change info                                                          
*
*  13.05.19              CrJu        Created and implemented
*/

void E_BUS_WaitForSignalMatchRangeRaw(Signal* aSignalName, dword aTimeToWaitForSignal, dword aMsgCycleTime, float aMinValue, float aMaxValue, char aBusContext[], enum cc_eInsideOrOutsideRangeBUS aExpectedResult)
{
  char chMappedResponseInfo[250];
  long lResult;
  byte bDebugFlag;

  //Initialization of local variables
  lResult = NotOk;
  bDebugFlag = tsc_bBUS_GlobalDebugFlag;
  
  writeDbgLevel (DebugFuncCalls, "Function E_BUS_WaitForSignalMatchInRangePhysical entered.");
  
  if( (byte)DebugFuncParam & bDebugFlag )
    writeDbgLevel (DebugFuncParam, "Parameters: Signal* aSignalName --%s--, dword aTimeToWaitForSignal --%d--, dword aMsgCycleTime --%d--, float aMinValue --%10.2f--,float aMaxValue --%10.2f--, char aBusContext[] --%s--, enum cc_eInsideOrOutsideRangeBUS aExpectedResult --%d--(0 - Outside Range, 1 - Inside Range)  ", aSignalName.name, aTimeToWaitForSignal, aMsgCycleTime, aMinValue, aMaxValue, aBusContext, aExpectedResult); 
  
  if(cc_eBUS_InsideRange == aExpectedResult)//it's expected that the RAW value is INSIDE the given range
  {
    //call the 'in-range' function
    lResult = lFctn_BUS_WaitForSignalMatchInRangeRaw(aSignalName, aTimeToWaitForSignal, aMsgCycleTime, aMinValue, aMaxValue, aBusContext, chMappedResponseInfo);
    
    if(Ok == lResult)//SUCCES
    {
      vFctn_REPORTStepEvaluation(chMappedResponseInfo, PASS);
    }
    else//FAIL
    {
      vFctn_REPORTStepEvaluation(chMappedResponseInfo, FAIL);
    }
  }
  else//it's expected that the RAW value is OUTSIDE the given range
  {
    //call the 'out-range' function
    lResult = lFctn_BUS_WaitForSignalMatchOutRangeRaw(aSignalName, aTimeToWaitForSignal, aMsgCycleTime, aMinValue, aMaxValue, aBusContext, chMappedResponseInfo);
    
    if(Ok == lResult)//SUCCES
    {
      vFctn_REPORTStepEvaluation(chMappedResponseInfo, PASS);
    }
    else//FAIL
    {
      vFctn_REPORTStepEvaluation(chMappedResponseInfo, FAIL);
    }
  }
}

/*! \fn void E_BUS_CheckSigValue4TimePhysical(Signal* aSignalName, dword aTimeToWaitForSignal, float aSignalValue, char aBusContext[])
*  \brief Function Wait and check if a signal physical value is not changing his value during a given time.
*  \param[in]  aSignalName          - Signal name from the database.
*  \param[in]  aTimeToWaitForSignal - The given time that the tester expects that the signal value is not changed
*  \param[in]  aSignalValue         - the expected signal value
*  \param[in] aBusContext           - the bus name context
*
*  \return no return
*  \note 
*        - An timeout must be set before this step
*
* Change History: 
* Date(DD.MM.YY)        Author          Change info                                                          
*   
*  14.05.2019            CrJu        Created and implemented
*/

void E_BUS_CheckSigValue4TimePhysical(Signal* aSignalName, dword aTimeToWaitForSignal, float aSignalValue, char aBusContext[])
{
  char chMappedResponseInfo[250];
  long lResult;
  byte bDebugFlag;

  //Initialization of local variables
  lResult = NotOk;
  bDebugFlag = tsc_bBUS_GlobalDebugFlag;
  
  writeDbgLevel (DebugFuncCalls, "Function E_BUS_CheckSigValue4TimePhysical entered.");
  
  if( (byte)DebugFuncParam & bDebugFlag )
    writeDbgLevel (DebugFuncParam, "Parameters: Signal* aSignalName --%s--, dword aTimeToWaitForSignal --%d--, float aSignalValue --%10.2f--, char aBusContext[] --%s-- ",aSignalName.name,aTimeToWaitForSignal,aSignalValue,aBusContext ); 

  lResult = lFctn_BUS_CheckSigValue4TimePhysical(aSignalName, aTimeToWaitForSignal, aSignalValue, aBusContext, chMappedResponseInfo);
  
  if(Error == lResult) 
  {
    //an error occured
    vFctn_REPORTStepEvaluation(chMappedResponseInfo, FAIL);
  }
  else
  {
    if(Ok == lResult)
    {
      //the signal did not change his value
      vFctn_REPORTStepEvaluation(chMappedResponseInfo, PASS);
    }
    else
    {
      //the signal has changed his value
      vFctn_REPORTStepEvaluation(chMappedResponseInfo, FAIL);
    }
  }
}

/*! \fn void E_BUS_CheckSigValue4TimeRaw(Signal* aSignalName, dword aTimeToWaitForSignal, dword aMsgCycleTime, float aSignalValue, char aBusContext[])
*  \brief Function Wait and check if a signal raw value is not changing his value during a given time.
*  \param[in]  aSignalName          - Signal name from the database.
*  \param[in]  aTimeToWaitForSignal - The given time that the tester expects that the signal value is not changed
*  \param[in]  aMsgCycleTime        - The message cycle time (from database)
*  \param[in]  aSignalValue         - the expected signal value
*  \param[in] aBusContext           - the bus name context
*
*  \return no return
*  \note 
*        - An timeout must be set before this step
*
* Change History: 
* Date(DD.MM.YY)        Author          Change info                                                          
*   
*  14.05.2019            CrJu        Created and implemented
*/

void E_BUS_CheckSigValue4TimeRaw(Signal* aSignalName, dword aTimeToWaitForSignal, dword aMsgCycleTime, int64 aSignalValue)
{
  char chMappedResponseInfo[250];
  long lResult;
  byte bDebugFlag;

  //Initialization of local variables
  lResult = NotOk;
  bDebugFlag = tsc_bBUS_GlobalDebugFlag;
  
  writeDbgLevel (DebugFuncCalls, "Function E_BUS_CheckSigValue4TimePhysical entered.");
  
  if( (byte)DebugFuncParam & bDebugFlag )
    writeDbgLevel (DebugFuncParam, "Parameters: Signal* aSignalName --%s--, dword aTimeToWaitForSignal --%d--, float aSignalValue --%lld--, char aBusContext[] --%s-- ",aSignalName.name, aTimeToWaitForSignal, aSignalValue); 

  
  lResult = lFctn_BUS_CheckSigValue4TimeRaw(aSignalName, aTimeToWaitForSignal, aMsgCycleTime, aSignalValue, chMappedResponseInfo);
  
  if(Error == lResult)
  {
    //an error occured
    vFctn_REPORTStepEvaluation(chMappedResponseInfo, FAIL);
  }
  else
  {
    if(Ok == lResult)
    {
      //the signal did not change his value
      vFctn_REPORTStepEvaluation(chMappedResponseInfo, PASS);
    }
    else
    {
      //the signal has changed his value
      vFctn_REPORTStepEvaluation(chMappedResponseInfo, FAIL);
    }
  }
}

/*! @}*/
/*! @}*/
/*!
*   \file
*   \ingroup testSupportLib
*   \brief BUS functions with actions and expected.
*/