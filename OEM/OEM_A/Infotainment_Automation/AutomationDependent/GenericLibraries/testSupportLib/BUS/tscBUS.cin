/*@!Encoding:1252*/
/*!
* @defgroup tscBUS tscBUS
* @defgroup BUS BUS
* @ingroup testSupportLib
* @{
* @addtogroup tscBUS
* @{
*/


variables
{
  enum tsc_eDebugBUS {tsc_eBUSDebugOff = 0,
                      tsc_eBUSDebugFuncCalls = 1,
                      tsc_eBUSDebugFuncParam = 2,
                      tsc_eBUSDebugFuncInternal = 3
                     };  
  enum tsc_eResultBUS {tsc_eBUS_ERR = -1,
                      tsc_eBUS_NOK = 0, 
                      tsc_eBUS_OK = 1, 
                      tsc_eBUS_ERR_BUS_CONTEXT = 2,  
                      tsc_eBUS_ERR_TIMEOUT = 4, 
                      tsc_eBUS_ERR_LIMITS = 5,
                      tsc_eBUS_ERR_CYCLETIME = 6
                      };
  enum tsc_eEqualNotEqualValueBUS {tsc_eBUS_NOT_EQUAL_VALUE = 0, 
                                   tsc_eBUS_EQUAL_VALUE = 1
                                  };
  
  enum tsc_eNumbersBUS {tsc_eBUS_ZERO = 0, 
                        tsc_eBUS_ONE = 1, 
                        tsc_eBUS_TWO = 2, 
                        tsc_eBUS_THREE = 3, 
                        tsc_eBUS_FOUR = 4, 
                        tsc_eBUS_FIVE = 5, 
                        tsc_eBUS_SIX = 6, 
                        tsc_eBUS_SEVEN = 7
                        };   
  
  const qword tsc_qwBUSNoMaxElConverted = 100000;
  const word tsc_wBUSPrintBusContextChars = 25;
  const word tsc_wBUSNumberBitsOnByte = 8;
  const word tsc_wBUSPrintedArrayElements = 128;
  
  // This debug flag will be used to enable/disable the debug messages in all functions of the current module
  // 0x00 - No debug messages displayed (only function calls).
  // 0x01 - Only function call messages displayed (this will always displayed).
  // 0x02 - Function parameter + 0x01.
  // 0x04 - Internal function actions + 0x01 and 0x02.
  // 0xFF - All of the above (function calls, function parameters, internal function actions).
  const byte tsc_bBUS_GlobalDebugFlag = 0x01;
}


/*! @}*/
/*! @}*/
/*!
*   \file
*   \ingroup testSupportLib
*   \brief CAN test support library constants.
*/