/*@!Encoding:1252*/
/*!
* @defgroup bcCOMMON bcCOMMON
* @defgroup COMMON COMMON
* @ingroup baseLib
* @{
* @addtogroup bcCOMMON
* @{
*/ 

variables
{
  enum eDebug { DebugOff = 0, DebugFuncCalls = 1, DebugFuncParam = 2, DebugFuncInternal = 4 };
  enum eBool { FALSE = 0, TRUE = 1 };
  enum eReportStep {FAIL = 0, PASS = 1 }; 
  enum eCompareType { Equal = 0, NotEqual = 1, Greater = 2, Smaller = 3 };
  enum eExpectedPresence { Absent = 0, Present = 1 };
  enum eActionEvaluation { Error = -1, NotOk = 0, Ok = 1 };
  enum eEnableDisable { Disable = 0, Enable = 1 };
  enum eFlexRayChannels { ChannelA = 1, ChannelB = 2, ChannelAB = 3 };
  enum eDataTypes { Type_Byte = 1, Type_Word = 2, Type_Dword = 3, Type_Int = 4, Type_Long = 5, Type_Int64 = 6, Type_Qword = 7, Type_Float = 8, Type_Double = 9};
  char bc_chPresenceString[2][10] = { "ABSENT", "PRESENT"};
  char bc_chStatusString[2][10] = { "DISABLE", "ENABLE"};
  char bc_chTransmissionError[10][50] = { "TimeOut Waiting for CF", "TimeOut Waiting for FC", 
                                          "Undefined Transmission Error", "TP DLL is busy",
                                          "Unexpected PDU received", "TimeOut trying to send msg", 
                                          "Too many wait frames sent", "Receiver buffer overflow",
                                          "Wrong parameter", "Invalid status in FC frame" };
}

/*! @}*/
/*! @}*/
/*!
*   \file
*   \ingroup baseLib
*   \brief COMMON base global libraries constants.
*/