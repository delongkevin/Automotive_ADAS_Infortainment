/*@!Encoding:1252*/

/*!
* @defgroup ccREPORT ccREPORT
* @defgroup REPORT REPORT
* @ingroup controlLib
* @{
* @addtogroup ccREPORT
* @{
*/

variables
{
  enum cc_eResultREPORT {cc_eREPORT_NOK, cc_eREPORT_OK};
  enum cc_eNumberREPORT {cc_eREPORT_minusONE, cc_eREPORT_ZERO, cc_eREPORT_TWO, cc_eREPORT_THREE};
  enum cc_eBoolREPORT {cc_eREPORT_FALSE, cc_eREPORT_TRUE};
  enum cc_eDebugREPORT {cc_eREPORTDebugOff, cc_eREPORTDebugFuncCalls, cc_eREPORTDebugFuncParam, cc_eREPORTDebugFuncInternal}; 
  enum cc_eRemoveInfoREPORT {cc_eNone, cc_eOnlyNotCritical, cc_eOnlyPass};
}

/*! @}*/
/*! @}*/
/*!
*   \file
*   \ingroup controlLib
*   \brief REPORT control library constants.
*/