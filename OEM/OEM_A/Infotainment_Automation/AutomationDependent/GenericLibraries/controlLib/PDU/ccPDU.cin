/*@!Encoding:1252*/
/*!
* @defgroup ccPDU ccPDU
* @defgroup PDU PDU
* @ingroup controlLib
* @{
* @addtogroup ccPDU
* @{
*/ 
variables 
{

  const dword cc_dwPDU_DefaultWaitTime = 5000; // milliseconds
  
  // This debug flag will be used to enable/disable the debug messages in all functions of the current module
  // 0x00 - No debug messages displayed (only function calls).
  // 0x01 - Only function call messages displayed (this will always displayed).
  // 0x02 - Function parameter + 0x01.
  // 0x04 - Internal function actions + 0x01 and 0x02.
  // 0xFF - All of the above (function calls, function parameters, internal function actions).
  const byte cc_bPDU_GlobalDebugFlag = 0x01;
}

/*! @}*/
/*! @}*/
/*!
*   \file
*   \ingroup controlLib
*   \brief PDU control library constants.
*/