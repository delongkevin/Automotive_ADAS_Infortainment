/*@!Encoding:1252*/

/*!
* @defgroup cPOW cPOW
* @defgroup POWER POWER
* @ingroup controlLib
* @{
* @addtogroup cPOW
* @{
*/ 

includes
{
  #include "..\..\baseLib\RS232\bRS232.cin"
  #include "ccPOW.cin"
}
/*! \fn int iFctn_ConvertFromFixedFormatToMilli(char chNumber[])
*  \brief Function converts a string with floating point to an integer value .
*  \param[in] chNumber - Value to be converted.
*
*  \return a number in mili or -1 in case of error
* 
* Change History: 
* Date(DD.MM.YY)        Author          Change info                                                          
*   
*  11.04.18              SeNi        Created and implemented
*  01.11.23            CiCo        Fix for conversion using a regex pattern
*/

int iFctn_ConvertFromFixedFormatToMilli (char chNumber[])
{
  float fValue      = NotOk;
  long lStartIndex; //string index from which conversion to start - for General Type Power Supply format answer is X YY.YY where X is letter and Y are numbers
  char chFormatedNumber[20];
  
  lStartIndex = strstr_regex(chNumber, "[0-9]*\\.[0-9]");// search for a pattern in form ddd.ddd
  writeDbgLevel (DebugFuncCalls, "Function iFctn_ConvertFromFixedFormatToMilli called.");
  writeDbgLevel (DebugFuncParam, "Parameters: Array of char to be converted -- %s --.", chNumber);  
  if( -1 != lStartIndex ){
    substr_cpy(chFormatedNumber, chNumber, lStartIndex, -1, elcount(chFormatedNumber));
    strtod(chFormatedNumber, fValue);
    fValue = fValue * 1000;
  }
  else
    fValue = -1; // error in finding the pattern
  
  writeDbgLevel (DebugFuncInternal, "Converted value is: --%d --.", fValue);
  
  return fValue;
}


/*! \fn void vFctn_ConvertFromMilliToFixedFormat(long lValue)
*  \brief Function converts an integer value to an array of bytes with floating point.
*  \param[in] lValue - Value to be converted.
* 
* Change History: 
* Date(DD.MM.YY)        Author          Change info                                                          
*   
*  21.03.18              SeNi        Created and implemented
*/

void vFctn_ConvertFromMilliToFixedFormat (long lValue)
{
  int iIndex;
  byte bTemp;
  
  writeDbgLevel (DebugFuncCalls, "Function vFctn_ConvertFromMilliToFixedFormat called.");
  writeDbgLevel (DebugFuncParam, "Parameters: Value to be converted: -- %d --.", lValue);
  
  for(iIndex=0; iIndex<elcount(cv_bPOWSendDataValue);iIndex++)
    cv_bPOWSendDataValue[iIndex] = NotOk;
  
  iIndex = NotOk;
  
  bTemp = lValue / 10000;
  if( bTemp > NotOk )
  {
    cv_bPOWSendDataValue[iIndex] = bTemp + 0x30;
    writeDbgLevel (DebugFuncInternal, "Byte %d from the conversion is: -- %c --",iIndex,cv_bPOWSendDataValue[iIndex]);
    iIndex++;
  }
  lValue -= bTemp*10000;

  bTemp = lValue / 1000;
  cv_bPOWSendDataValue[iIndex] = bTemp + 0x30;
  writeDbgLevel (DebugFuncInternal, "Byte %d from the conversion is: -- %c --",iIndex,cv_bPOWSendDataValue[iIndex]);
  iIndex++;
  lValue -= bTemp*1000;
   
  cv_bPOWSendDataValue[iIndex] = '.';
  writeDbgLevel (DebugFuncInternal, "Byte %d from the conversion is: -- %c --",iIndex,cv_bPOWSendDataValue[iIndex]);
  iIndex++;

  bTemp = lValue / 100;
  cv_bPOWSendDataValue[iIndex] = bTemp + 0x30;
  writeDbgLevel (DebugFuncInternal, "Byte %d from the conversion is: -- %c --",iIndex,cv_bPOWSendDataValue[iIndex]);
  iIndex++;
  lValue -= bTemp*100;
   
  bTemp = lValue / 10;
  cv_bPOWSendDataValue[iIndex] = bTemp + 0x30;
  writeDbgLevel (DebugFuncInternal, "Byte %d from the conversion is: -- %c --",iIndex,cv_bPOWSendDataValue[iIndex]);
  iIndex++;
  lValue -= bTemp*10;
   
  bTemp = lValue / 1;
  cv_bPOWSendDataValue[iIndex] = bTemp + 0x30;
  writeDbgLevel (DebugFuncInternal, "Byte %d from the conversion is: -- %c --",iIndex,cv_bPOWSendDataValue[iIndex]);
  iIndex++;

}


/*! \fn byte bFctn_POWSetVoltage(long lVoltage)
*  \brief Function sets command to set voltage from PowerSupply
*  \param[in] lVoltage - Voltage to set (in milivolts).
*
*  \return  0 - Voltage is not set / Voltage is over maximum
*  \return  1 - Voltage is set
* 
* Change History: 
* Date(DD.MM.YY)        Author          Change info                                                          
*   
*  21.03.18              SeNi        Created and implemented
*  03.02.20              CrJu        Added a new type of power supply
*  07.07.20              CrJu        Updated with new control function: bFctn_POW_SetCommand() and added debug functions
*/

byte bFctn_POWSetVoltage(long lVoltage)
{
  byte bResult;
  byte bDebugFlag;
  double dVoltageToSet;
  char chValueToSet[25];
  char chMappedResponseInfo[250];
  
  bResult = NotOk;
  bDebugFlag = NotOk;
  
  writeDbgLevel (DebugFuncCalls, "Function bFctn_POWSetVoltage called.");
  
  if((byte)DebugFuncInternal & bDebugFlag)
      writeDbgLevel (DebugFuncParam, "Parameters: Voltage in milivolts to set: -- %d --.", lVoltage);
  
  if (cv_lPOWmaxVoltage < lVoltage)
  {
    if((byte)DebugFuncInternal & bDebugFlag)
      writeDbgLevel (DebugFuncInternal, "Voltage is over maximum voltage supported by PowerSupply: %d.", cv_lPOWmaxVoltage);
    return NotOk;
  }
  
  dVoltageToSet = (float)(lVoltage); //transform the mV to V(with floating point)
  dVoltageToSet = dVoltageToSet / 1000;
  
  // BK Precision 1687b: voltage is sent as a 3-digit integer in units of 0.1 V
  // e.g. 12.0 V (lVoltage = 12000 mV) -> lVoltage / 100 = 120 -> "VOLT120\r"
  if(cv_bPOWType == cc_bTypeBKPrecision)
    snprintf(chValueToSet, elCount(chValueToSet), "%03d", (int)(lVoltage / 100));
  else
    snprintf(chValueToSet, elCount(chValueToSet), "%f", dVoltageToSet);
  bResult = bFctn_POW_SetCommand(eSetVoltage, chValueToSet, chMappedResponseInfo);
  
  if(bResult)
  {
    if((byte)DebugFuncInternal & bDebugFlag)
      writeDbgLevel (DebugFuncInternal, chMappedResponseInfo);
    return Ok;
  }
  else
  {
    if((byte)DebugFuncInternal & bDebugFlag)
      writeDbgLevel (DebugFuncInternal, chMappedResponseInfo);
    return NotOk;
  }
}

/*! \fn byte bFctn_POWSetCurrent(int iCurrent)
*  \brief Function sets command to set max current from PowerSupply
*  \param[in] iCurrent - Current to set (in miliamps).
*
*  \return  0 - Current is not set / Current is over maximum
*  \return  1 - Current is set
*
* Change History: 
* Date(DD.MM.YY)        Author          Change info                                                          
*   
*  21.03.18              SeNi        Created and implemented
*  03.02.20              CrJu        Added a new type of power supply
*  07.07.20              CrJu        Updated with new control function: bFctn_POW_SetCommand() and added debug functions
*/

byte bFctn_POWSetCurrent(int iCurrent)
{
  byte bResult;
  byte bDebugFlag;
  double dCurrentToSet;
  char chValueToSet[25];
  char chMappedResponseInfo[250];
  
  bResult = NotOk;
  bDebugFlag = NotOk;
  
  writeDbgLevel (DebugFuncCalls, "Function bFctn_POWSetCurrent called.");
  
  if((byte)DebugFuncInternal & bDebugFlag)
      writeDbgLevel (DebugFuncParam, "Parameters: Current in miliamps to set: -- %d --.", iCurrent);
  
  if (cv_lPOWmaxCurrent < iCurrent)
  {
    if((byte)DebugFuncInternal & bDebugFlag)
      writeDbgLevel (DebugFuncInternal, "Current is over maximum current supported by PowerSupply: %d.", cv_lPOWmaxCurrent);
    return NotOk;
  }
  
  dCurrentToSet = (float)(iCurrent); //transform the mV to V(with floating point)
  dCurrentToSet = dCurrentToSet / 1000;
  
  // BK Precision 1687b: current is sent as a 3-digit integer in units of 0.1 A
  // e.g. 2.5 A (iCurrent = 2500 mA) -> iCurrent / 100 = 25 -> "CURR025\r"
  if(cv_bPOWType == cc_bTypeBKPrecision)
    snprintf(chValueToSet, elCount(chValueToSet), "%03d", (int)(iCurrent / 100));
  else
    snprintf(chValueToSet, elCount(chValueToSet), "%f", dCurrentToSet);
  bResult = bFctn_POW_SetCommand(eSetCurrent, chValueToSet, chMappedResponseInfo);
  
  if(bResult)
  {
    if((byte)DebugFuncInternal & bDebugFlag)
      writeDbgLevel (DebugFuncInternal, chMappedResponseInfo);
    return Ok;
  }
  else
  {
    if((byte)DebugFuncInternal & bDebugFlag)
      writeDbgLevel (DebugFuncInternal, chMappedResponseInfo);
    return NotOk;
  }
}


/*! \fn void vFctn_POWSetActivePOW(byte bPort, int iBaudRate, byte bDataBits, byte bParity, byte bStopBits, byte bType, byte bWaitTime, long lMaxVoltage, long lMaxCurrent, int iSCPIAddress, int iFlowControl, long lWaitForCommand)
*  \brief Function sets the parameters for communication on RS232
*  \param[in] bPort - port number.
*  \param[in] iBaudRate - baud rate for selected device.
*  \param[in] bDataBits - number of data bits.
*  \param[in] bParity - parity.
*  \param[in] bStopBits - number of stop bits.
*  \param[in] bType - type of POW.
*  \param[in] bWaitTime - wait time for answers.
*  \param[in] lMaxVoltage - Maximum voltage allowed.
*  \param[in] lMaxCurrent - Maximum current allower.
*  \param[in] iSCPIAddress - The address of the SCPI power supply. (It is used only for SCPI PS)
*  \param[in] iFlowControl - The FlowControl of the power supply. ( 0 - no FlowControl at all, 1 - hardware FlowControl, use DTR<->DSR )
*  \param[in] lWaitForCommand - The waiting time between seding commands 
*
* Change History: 
* Date(DD.MM.YY)        Author          Change info                                                          
*   
*  28.03.18              SeNi        Created and implemented
*  03.02.20              CrJu        Added a new type of power supply
*  21.06.23              CiCo        Add select commands
*/

void vFctn_POWSetActivePOW(byte bPort, int iBaudRate, byte bDataBits, byte bParity, byte bStopBits, byte bType, byte bWaitTime, long lMaxVoltage, long lMaxCurrent, int iSCPIAddress, int iFlowControl, long lWaitForCommand)
{
  char chMappedResponseInfo[250];
  byte bDebugFlag;
  bDebugFlag = NotOk;
  
  writeDbgLevel (DebugFuncCalls, "Function vFctn_POWSetActivePOW called.");
  writeDbgLevel (DebugFuncParam, "Parameters: byte bPort -- %d --, int iBaudRate -- %d --, byte bDataBits -- %d --, byte bParity -- %d --, byte bStopBits -- %d --, byte bType -- %d --, byte bWaitTime -- %d --, long lMaxVoltage -- %d --, int lMaxCurrent -- %d --", bPort, iBaudRate, bDataBits, bParity, bStopBits, bType, bWaitTime, lMaxVoltage, lMaxCurrent);  

  cv_bPOWPort           =       bPort;    
  cv_iPOWBaudRate       =   iBaudRate;    
  cv_bPOWDataBits       =   bDataBits;    
  cv_bPOWParity         =     bParity;    
  cv_bPOWStopBits       =   bStopBits;   
  cv_bPOWwaitTime       =   bWaitTime; 
  cv_lPOWmaxVoltage     = lMaxVoltage;
  cv_lPOWmaxCurrent     = lMaxCurrent; 
  cv_iPOWSCPIAddress    = iSCPIAddress;
  cv_iPOWFlowControl    = iFlowControl;
  cv_iPOWWaitForCommand = lWaitForCommand;
  
  if(cc_bTypeSCPI != bType)
  {
    cv_bPOWType = bType;   
    //set power supply command number of bytes

    //Define Max Voltage and Max Current in the power supply panel
    bFctn_POW_GetPSCommands((enum cc_ePStype) cv_bPOWType, chMappedResponseInfo);
    if((byte)DebugFuncInternal & bDebugFlag)
      writeDbgLevel (DebugFuncInternal, chMappedResponseInfo);
    sysDefineVariableFloat("PowGeneral_Variables", "VoltageVal", 1, 0, @sysvar::PowGeneral_Variables::MaxVoltage);
    sysDefineVariableFloat("PowGeneral_Variables", "CurrentVal", 1, 0, @sysvar::PowGeneral_Variables::MaxCurrent);
  }
  else if(cc_bTypeSCPI == bType)
  {
    cv_bPOWType = bType;
    bFctn_POW_GetPSCommands((enum cc_ePStype) cv_bPOWType, chMappedResponseInfo);
    if((byte)DebugFuncInternal & bDebugFlag)
      writeDbgLevel (DebugFuncInternal, chMappedResponseInfo);
    //set the Address for SCPI power supply only if the port was closed before
    if(@sysvar::RS232_SYSVariables::sv_RS232PortStatus == Disable)
    {
      lFctn_POW_SetAddressForSCPI(cv_iPOWSCPIAddress);
    }
    else
    {
      @sysvar::PowGeneral_Variables::SCPICommand = 0; //The command for setting address is not sent
    }
    
    //Define Max Voltage and Max Current in the power supply panel
    sysDefineVariableFloat("PowGeneral_Variables", "VoltageVal", 1, 0, @sysvar::PowGeneral_Variables::MaxVoltage);
    sysDefineVariableFloat("PowGeneral_Variables", "CurrentVal", 1, 0, @sysvar::PowGeneral_Variables::MaxCurrent);
  }
  else
  {
    //to be added case - default case at this moment  
  }
}

/*! \fn void bFctn_POWSetON()
*  \brief Function sets PowerSupply Output to ON.
*
*  \return  0 - PS could not be set ON
*  \return  1 - PS is set ON
* 
* Change History: 
* Date(DD.MM.YY)        Author          Change info                                                          
*   
*  11.05.18              SeNi        Created and implemented
*  03.02.20              CrJu        Added a new type of power supply
*  08.07.20              CrJu        Update with the new control function: bFctn_POW_SetCommand()
*/

byte bFctn_POWSetON()
{
  byte bDebugFlag;
  byte bResult;
  char chMappedResponseInfo[250];
  
  bResult = NotOk;
  bDebugFlag = NotOk;
  
  writeDbgLevel (DebugFuncCalls, "Function bFctn_POWSetON called.");
 
  bResult = bFctn_POW_SetCommand(ePowerSupply_ON, "", chMappedResponseInfo);
  
  if(bResult)
  {
    if((byte)DebugFuncInternal & bDebugFlag)
      writeDbgLevel (DebugFuncInternal, chMappedResponseInfo);
    return Ok;
  }
  else
  {
    if((byte)DebugFuncInternal & bDebugFlag)
      writeDbgLevel (DebugFuncInternal, chMappedResponseInfo);
    return NotOk;
  }
}

/*! \fn byte bFctn_POWSetOFF()
*  \brief Function sets PowerSupply Output to OFF.
*
*  \return  0 - PS could not be set OFF
*  \return  1 - PS is set OFF
* 
* Change History: 
* Date(DD.MM.YY)        Author          Change info                                                          
*   
*  11.05.18              SeNi        Created and implemented
*  03.02.20              CrJu        Added a new type of power supply
*  08.07.20              CrJu        Update with the new control function: bFctn_POW_SetCommand()
*/

byte bFctn_POWSetOFF()
{
  byte bDebugFlag;
  byte bResult;
  char chMappedResponseInfo[250];
  
  bResult = NotOk;
  bDebugFlag = NotOk;
  
  writeDbgLevel (DebugFuncCalls, "Function bFctn_POWSetOFF called.");
 
  bResult = bFctn_POW_SetCommand(ePowerSupply_OFF, "", chMappedResponseInfo);
  
  if(bResult)
  {
    if((byte)DebugFuncInternal & bDebugFlag)
      writeDbgLevel (DebugFuncInternal, chMappedResponseInfo);
    return Ok;
  }
  else
  {
    if((byte)DebugFuncInternal & bDebugFlag)
      writeDbgLevel (DebugFuncInternal, chMappedResponseInfo);
    return NotOk;
  }
}

/*! \fn byte bFctn_POWInit(byte bPOWNumber) 
*  \brief Function initializes link to power supply.
*  \param[in] bPOWNumber - PSNumber from ini file to set active.
*
*  \return  0 - PS could not be initialized
*  \return  1 - PS is initialized with success
* 
* Change History: 
* Date(DD.MM.YY)        Author          Change info                                                          
*   
*  12.09.18              SeNi        Created and implemented
*  04.12.19              CiCo        Updated to init the PS with data from ini file only once
*  22.09.20              CrJu        Add doxygen and write debug levels.
*/

byte bFctn_POWInit(byte bPOWNumber) 
{
  byte bResult;
  char chIniFile[256];
  
  writeDbgLevel (DebugFuncCalls, "Function vFctn_POWInit called");
  writeDbgLevel (DebugFuncParam, "Parameters: byte bPOWNumber: %d.", bPOWNumber);
  
  if( NotOk == cv_bGetPowIniStatus )// read from ini only if was not readed
    if( Ok == bFctn_POWReadINI() )
      cv_bGetPowIniStatus = Ok;
    
  if(bPOWNumber < cv_iPOWPSNumber)
  {
    writeDbgLevel (DebugFuncInternal, "The initialization of Power Supply number: %d was successfully done.");
    return Ok;
  }
  else
  {
    writeDbgLevel (DebugFuncInternal, "The initialization of Power Supply number: %d was not completed. Check bFctn_POWReadINI() for more information.");
    return NotOk;
  }
}


/*! \fn byte bFctn_POWReadINI()
*  \brief Function reads power source params from ini file.
*
*  \return  0 - Error reading the ini file
*  \return  1 - All parameters of Power Supply were read ok
* 
* Change History: 
* Date(DD.MM.YY)        Author          Change info                                                          
*   
*  13.09.18              SeNi        Created and implemented
*  23.09.20              CrJu        Complete the doxygen and added the write debug levels
*/

byte bFctn_POWReadINI() 
{
  byte bIndex;
  byte bReturn;
  char chIniFile[256];
  char chEntry[64];
  
  writeDbgLevel (DebugFuncCalls, "Function bFctn_POWReadINI called");

  bReturn = bFctn_READFILELastINIused(chIniFile);
  if(!bReturn)
    return NotOk;
  
  writeDbgLevel (DebugFuncInternal, "Reading from .ini file PSNumber.");
  cv_iPOWPSNumber = lFctn_READFILEiniParameterNumber(chIniFile, "PSNumber", "POWERSUPPLY");
  
  if(Error == cv_iPOWPSNumber)
    return NotOk;
  else
  {
    for(bIndex = 0; bIndex < cv_iPOWPSNumber; bIndex++)
    {
      snprintf(chEntry, elCount(chEntry), "PS%dPresent", bIndex);
      writeDbgLevel (DebugFuncInternal, "Reading from .ini file %s.",chEntry);
      cv_iPOWPSPresentArray[bIndex] = lFctn_READFILEiniParameterNumber(chIniFile, chEntry, "POWERSUPPLY");
      if(Error == cv_iPOWPSPresentArray[bIndex])
        return NotOk;
      
      snprintf(chEntry, elCount(chEntry), "PS%dType", bIndex);
      writeDbgLevel (DebugFuncInternal, "Reading from .ini file %s.",chEntry);
      cv_iPOWPSTypeArray[bIndex] = lFctn_READFILEiniParameterNumber(chIniFile, chEntry, "POWERSUPPLY");
      if(Error == cv_iPOWPSTypeArray[bIndex])
        return NotOk;
        
      snprintf(chEntry, elCount(chEntry), "PS%dCOMPort", bIndex);
      writeDbgLevel (DebugFuncInternal, "Reading from .ini file %s.",chEntry);
      cv_iPOWPSCOMPortArray[bIndex] = lFctn_READFILEiniParameterNumber(chIniFile, chEntry, "POWERSUPPLY");
      if(Error == cv_iPOWPSCOMPortArray[bIndex])
        return NotOk;
        
      snprintf(chEntry, elCount(chEntry), "PS%dDataBits", bIndex);
      writeDbgLevel (DebugFuncInternal, "Reading from .ini file %s.",chEntry);
      cv_iPOWPSDataBitsArray[bIndex] = lFctn_READFILEiniParameterNumber(chIniFile, chEntry, "POWERSUPPLY");
      if(Error == cv_iPOWPSDataBitsArray[bIndex])
        return NotOk;
        
      snprintf(chEntry, elCount(chEntry), "PS%dParity", bIndex);
      writeDbgLevel (DebugFuncInternal, "Reading from .ini file %s.",chEntry);
      cv_iPOWPSParityArray[bIndex] = lFctn_READFILEiniParameterNumber(chIniFile, chEntry, "POWERSUPPLY");
      if(Error == cv_iPOWPSParityArray[bIndex])
        return NotOk;
        
      snprintf(chEntry, elCount(chEntry), "PS%dStopBits", bIndex);
      writeDbgLevel (DebugFuncInternal, "Reading from .ini file %s.",chEntry);
      cv_iPOWPSStopBitsArray[bIndex] = lFctn_READFILEiniParameterNumber(chIniFile, chEntry, "POWERSUPPLY");
      if(Error == cv_iPOWPSStopBitsArray[bIndex])
        return NotOk;
        
      snprintf(chEntry, elCount(chEntry), "PS%dBaudRate", bIndex);
      writeDbgLevel (DebugFuncInternal, "Reading from .ini file %s.",chEntry);
      cv_iPOWPSBaudRateArray[bIndex] = lFctn_READFILEiniParameterNumber(chIniFile, chEntry, "POWERSUPPLY");
      if(Error == cv_iPOWPSBaudRateArray[bIndex])
        return NotOk;
        
      snprintf(chEntry, elCount(chEntry), "PS%dMaxVoltage", bIndex);
      writeDbgLevel (DebugFuncInternal, "Reading from .ini file %s.",chEntry);
      cv_lPOWPSMaxVoltageArray[bIndex] = lFctn_READFILEiniParameterNumber(chIniFile, chEntry, "POWERSUPPLY");
      if(Error == cv_lPOWPSMaxVoltageArray[bIndex])
        return NotOk;
        
      snprintf(chEntry, elCount(chEntry), "PS%dMaxCurrent", bIndex);
      writeDbgLevel (DebugFuncInternal, "Reading from .ini file %s.",chEntry);
      cv_lPOWPSMaxCurrentArray[bIndex] = lFctn_READFILEiniParameterNumber(chIniFile, chEntry, "POWERSUPPLY");
      if(Error == cv_lPOWPSMaxCurrentArray[bIndex])
        return NotOk; 
      
      if(cv_iPOWPSTypeArray[bIndex] == 2) //Read SCPI parameter only if SCPI Type is selected
      {
        snprintf(chEntry, elCount(chEntry), "PS%dSCPIAddress", bIndex);
        writeDbgLevel (DebugFuncInternal, "Reading from .ini file %s.",chEntry);
        cv_iPOWPSSCPIAddress[bIndex] = lFctn_READFILEiniParameterNumber(chIniFile, chEntry, "POWERSUPPLY");
        if(Error == cv_iPOWPSSCPIAddress[bIndex])
          return NotOk;
      }
      
      snprintf(chEntry, elCount(chEntry), "PS%dFlowControl", bIndex);
      writeDbgLevel (DebugFuncInternal, "Reading from .ini file %s.",chEntry);
      cv_iPOWPSFlowControl[bIndex] = lFctn_READFILEiniParameterNumber(chIniFile, chEntry, "POWERSUPPLY");
      if(Error == cv_iPOWPSFlowControl[bIndex])
        return NotOk;
      
      snprintf(chEntry, elCount(chEntry), "PS%dWaitForCommand", bIndex);
      writeDbgLevel (DebugFuncInternal, "Reading from .ini file %s.",chEntry);
      cv_iPOWPSWaitForCommand[bIndex] = lFctn_READFILEiniParameterNumber(chIniFile, chEntry, "POWERSUPPLY");
      if(Error == cv_iPOWPSWaitForCommand[bIndex])
        return NotOk;
    }
    return Ok;
  }
}

/*! \fn byte bFctn_POWSelectPowerSupply(byte bPOWNumber) 
*  \brief Function selects from ini file which Power Supply to set active (0, 1... 8).
*  \param[in] bPOWNumber - PSNumber from ini file to set active.
*
*  \return  0 - PS could not be selected
*  \return  1 - PS was successfully selected
* 
* Change History: 
* Date(DD.MM.YY)        Author          Change info                                                          
*   
*  12.09.18              SeNi        Created and implemented
*  04.12.19              CiCo        Updated with bFctn_POWInit to read data from ini file
*  23.09.20              CrJu        Updated the doxygen and added new debug levels
*/

byte bFctn_POWSelectPowerSupply(byte bPOWNumber) 
{
  byte bResult;
  char chIniFile[256];
  bResult = NotOk;
  writeDbgLevel (DebugFuncCalls, "Function bFctn_POWSelectPowerSupply called");
  writeDbgLevel (DebugFuncParam, "Parameters: byte bPOWNumber: %d.", bPOWNumber);
  
  bResult = bFctn_POWInit( bPOWNumber );
  if(Ok == bResult)
  {
    if(bPOWNumber < cv_iPOWPSNumber)
    {
      writeDbgLevel (DebugFuncInternal, "Power Supply selected is available in ini file, number: %d.", bPOWNumber);
      vFctn_POWSetActivePOW(cv_iPOWPSCOMPortArray[bPOWNumber], cv_iPOWPSBaudRateArray[bPOWNumber], cv_iPOWPSDataBitsArray[bPOWNumber], cv_iPOWPSParityArray[bPOWNumber], cv_iPOWPSStopBitsArray[bPOWNumber], cv_iPOWPSTypeArray[bPOWNumber], cv_wPOWPSWaitTimeForResponse, cv_lPOWPSMaxVoltageArray[bPOWNumber], cv_lPOWPSMaxCurrentArray[bPOWNumber], cv_iPOWPSSCPIAddress[bPOWNumber], cv_iPOWPSFlowControl[bPOWNumber], cv_iPOWPSWaitForCommand[bPOWNumber]);
      return Ok;
    }
    else
    {
      writeDbgLevel (DebugFuncInternal, "Power Supply selected is NOT available in ini file, number selected: %d, number of power supplies: %d.", bPOWNumber, cv_iPOWPSNumber);
      return NotOk;
    }
  }
  else
  {
    writeDbgLevel (DebugFuncInternal, "Error in initialize power supply: %d. See the bFctn_POWInit for more info.", bPOWNumber, cv_iPOWPSNumber);
    return NotOk;  
  }
}

/*! \fn long lFctn_POW_ReadActualVoltage()
*  \brief Function send the command (V?) for reading the voltage of the source.
*
*  \return  1 (Ok)     - The command for read curent voltage has been succesfully sent.
*  \return -1 (Error)  - An error occured.
* 
* Change History: 
* Date(DD.MM.YY)        Author          Change info                                                          
*   
*  23.01.20              CrJu        Created and implemented
*  08.07.20              CrJu        Update with the new control function: bFctn_POW_SetCommand()
*/

long lFctn_POW_ReadActualVoltage()
{
  byte bDebugFlag;
  byte bResult;
  char chMappedResponseInfo[250];
  
  bResult = NotOk;
  bDebugFlag = NotOk;
  
  writeDbgLevel (DebugFuncCalls, "Function lFctn_POW_ReadActualVoltage called.");
 
  bResult = bFctn_POW_SetCommand(eGetPSVoltage, "", chMappedResponseInfo);
  
  if(bResult)
  {
    if((byte)DebugFuncInternal & bDebugFlag)
      writeDbgLevel (DebugFuncInternal, chMappedResponseInfo);
    return Ok;
  }
  else
  {
    if((byte)DebugFuncInternal & bDebugFlag)
      writeDbgLevel (DebugFuncInternal, chMappedResponseInfo);
    return Error;
  }
}

/*! \fn long lFctn_POW_ReadActualCurrent()
*  \brief Function send the command (IO?) for reading the actual current of the source.
*
*  \return  1 (Ok)     - The command for read actual current has been succesfully sent.
*  \return -1 (Error)  - An error occured.
* 
* Change History: 
* Date(DD.MM.YY)        Author          Change info                                                          
*   
*  03.02.20              CrJu        Created and implemented
*  08.07.20              CrJu        Update with the new control function: bFctn_POW_SetCommand()
*/

long lFctn_POW_ReadActualCurrent()
{
byte bDebugFlag;
  byte bResult;
  char chMappedResponseInfo[250];
  
  bResult = NotOk;
  bDebugFlag = NotOk;
  
  writeDbgLevel (DebugFuncCalls, "Function lFctn_POW_ReadActualCurrent called.");
 
  bResult = bFctn_POW_SetCommand(eGetPSCurrent, "", chMappedResponseInfo);
  
  if(bResult)
  {
    if((byte)DebugFuncInternal & bDebugFlag)
      writeDbgLevel (DebugFuncInternal, chMappedResponseInfo);
    return Ok;
  }
  else
  {
    if((byte)DebugFuncInternal & bDebugFlag)
      writeDbgLevel (DebugFuncInternal, chMappedResponseInfo);
    return Error;
  }
}

/*! \fn long lFctn_POW_SetAddressForSCPI(byte aSCPIAddress)
*  \brief Function send the command (INSTrument:NSELect x) for setting the Address of the SCPI power supply
*
*  \param[in] aSCPIAddress - Address of the SCPI power supply.
*
*  \return  1 (Ok)     - The command for setting the Address of the SCPI power supply has been succesfully sent.
*  \return -1 (Error)  - An error occured.
* 
*  \note This function must be CALLED FIRST for SCPI language.
*  \note The  address can be from 1 to 31.
*
* Change History: 
* Date(DD.MM.YY)        Author          Change info                                                          
*   
*  02.03.20              CrJu        Created and implemented
*  08.07.20              CrJu        Update with the new control function: bFctn_POW_SetCommand()
*/

long lFctn_POW_SetAddressForSCPI(byte aSCPIAddress)
{
  byte bIndex;
  int iIndex;
  int iDigit;
  byte bDebugFlag;
  byte bResult;
  char chValueToSet[25];
  char chMappedResponseInfo[250];
  
  iDigit = NotOk;
  bIndex = NotOk;
  bResult = NotOk;
  bDebugFlag = NotOk;
    
  writeDbgLevel (DebugFuncCalls, "Function lFctn_POW_SetAddressForSCPI called.");
  
  if((byte)DebugFuncParam & bDebugFlag)
    writeDbgLevel (DebugFuncParam, "Parameters: SCPI Address: %d.", aSCPIAddress);
  
  snprintf(chValueToSet, elCount(chValueToSet), "%d", aSCPIAddress);
  bResult = bFctn_POW_SetCommand(eSelectAddress, chValueToSet, chMappedResponseInfo);
  
  //Set the flag for openning the port
  @sysvar::RS232_SYSVariables::sv_RS232PortStatus = Enable;
  
  if(bResult)
  {
    //Set the flag for sending the SCPI command
    @sysvar::PowGeneral_Variables::SCPICommand = 1;
    
    if((byte)DebugFuncInternal & bDebugFlag)
      writeDbgLevel (DebugFuncInternal, chMappedResponseInfo);
    return Ok;
  }
  else
  {
    if((byte)DebugFuncInternal & bDebugFlag)
      writeDbgLevel (DebugFuncInternal, chMappedResponseInfo);
    return Error;
  }
}
  
/*! \fn byte bFctn_POW_SetCommand(enum cc_eCommandToSend aCommandToSend, char aValue[], char aMappedResponseInfo[])
*  \brief Function sends a Command to the Power Supply, with a specific Value.
*  \param[in] aCommandToSend       - Commands to send can be: eSetVoltage / eSetCurrent / ePowerSupply_ON / ePowerSupply_OFF
*  \param[in] aValue               - Value to be sent for setting voltage/current. It must be format of: XX.xxx V/A. For ON or OFF, it can be empty
*  \param[out] aMappedResponseInfo - Extra information regarding the function output (displayed in the test report).
*
*  \return 
* 
* Change History: 
* Date(DD.MM.YY)        Author          Change info                                                          
*   
*  23.06.20              CrJu        Created and implemented
*  21.06.23              CiCo        Updated with predifined commands
*/

byte bFctn_POW_SetCommand(enum cc_eCommandToSend aCommandToSend, char aValue[], char aMappedResponseInfo[])
{
  byte bDebugFlag;
  char chCMD[50]; 
  char chTerminates[4];
  
  bDebugFlag = NotOk;
  
  // BK Precision 1687b uses CR (\r) only as command terminator; all others use CR+LF
  if(cv_bPOWType == cc_bTypeBKPrecision)
    strncpy(chTerminates, "\r", elCount(chTerminates));
  else
    strncpy(chTerminates, "\r\n", elCount(chTerminates));
  
  writeDbgLevel (DebugFuncCalls, "Function bFctn_POW_SetCommand called.");
  if((byte)DebugFuncParam & bDebugFlag)
    writeDbgLevel (DebugFuncParam, "Parameters: Command to send: -- %d -- with value: %s.", aCommandToSend, aValue);
  
  switch (aCommandToSend){
    case ePowerSupply_ON:
    {
      snprintf(aMappedResponseInfo, elCount(aMappedResponseInfo), "Set Power Supply ON.");
      snprintf(chCMD, elCount(chCMD), "%s%s", cv_stGenericCommands.chSetOn, chTerminates);
      break;
    }
    case ePowerSupply_OFF:
    {
      snprintf(aMappedResponseInfo, elCount(aMappedResponseInfo), "Set Power Supply OFF.");
      snprintf(chCMD, elCount(chCMD), "%s%s", cv_stGenericCommands.chSetOff, chTerminates);
      break;
    }
    case eSetVoltage:
    {
      snprintf(aMappedResponseInfo, elCount(aMappedResponseInfo), "Set Voltage of Power Supply to: %s V.", aValue);
      snprintf(chCMD, elCount(chCMD), "%s%s%s", cv_stGenericCommands.chSetVoltage, aValue, chTerminates);
      break;
    }
    case eSetCurrent:
    {
      snprintf(aMappedResponseInfo, elCount(aMappedResponseInfo), "Set Current of Power Supply to: %s A.", aValue);
      snprintf(chCMD, elCount(chCMD), "%s%s%s", cv_stGenericCommands.chSetCurrent, aValue, chTerminates);
      break;
    }
    case eGetPSCurrent:
    {
      snprintf(aMappedResponseInfo, elCount(aMappedResponseInfo), "Read Current consumption from Power Supply.");
      snprintf(chCMD, elCount(chCMD), "%s%s", cv_stGenericCommands.chGetCurrent, chTerminates);
      break;
    }
    case eGetPSVoltage:
    {
      snprintf(aMappedResponseInfo, elCount(aMappedResponseInfo), "Read Voltage from Power Supply.");
      snprintf(chCMD, elCount(chCMD), "%s%s", cv_stGenericCommands.chGetVoltage, chTerminates);
      write("chCMD %s",chCMD);
      break;
    }
    case eGetPSStatus:
    {
      snprintf(aMappedResponseInfo, elCount(aMappedResponseInfo), "Read Status of Power Supply.");
      snprintf(chCMD, elCount(chCMD), "%s%s", cv_stGenericCommands.chGetStatus, chTerminates);
      break;
    }
    case eSelectAddress:
    {
      snprintf(aMappedResponseInfo, elCount(aMappedResponseInfo), "Select SCPI addres for Power Supply.");
      snprintf(chCMD, elCount(chCMD), "%s%s", cv_stGenericCommands.chSelectAddress, chTerminates);
      break;
    }
    default:
      snprintf(aMappedResponseInfo, elCount(aMappedResponseInfo), "Request command not set. Invalid request. Only setter requests can be used for this function.");
      if((byte)DebugFuncInternal & bDebugFlag)
        writeDbgLevel (DebugFuncInternal, aMappedResponseInfo);
      return NotOk; 
  }
  
  // debug for command to send
  if((byte)DebugFuncInternal & bDebugFlag)
    writeDbgLevel (DebugFuncInternal,"%s %s" ,aMappedResponseInfo, chCMD); 
  
  if(Ok == bFctn_RS232OpenPort(cv_bPOWPort, cv_iPOWBaudRate, cv_bPOWDataBits, cv_bPOWStopBits, cv_bPOWParity, cv_iPOWFlowControl))
  {
    if(Ok == bFctn_RS232SendData(cv_bPOWPort, chCMD))
    {
      if((byte)DebugFuncInternal & bDebugFlag)
        writeDbgLevel (DebugFuncInternal, aMappedResponseInfo);
      return Ok;
    }
    else
    {
      snprintf(aMappedResponseInfo, elCount(aMappedResponseInfo), "Failed to send data on port: %d. Check the ini. file to be correct.", cv_bPOWPort);
      if((byte)DebugFuncInternal & bDebugFlag)
        writeDbgLevel (DebugFuncInternal, aMappedResponseInfo);
      return NotOk;
    }
  }
  else
  {
    snprintf(aMappedResponseInfo, elCount(aMappedResponseInfo), "Failed to open port: %d. Check the ini. file to be correct.", cv_bPOWPort);
    if((byte)DebugFuncInternal & bDebugFlag)
      writeDbgLevel (DebugFuncInternal, aMappedResponseInfo);
    return NotOk; 
  }
}

/*! \fn byte bFctn_POW_GetPSCommands(enum cc_ePStype aPStype, char aMappedResponseInfo[])
*  \brief Function to set the availble commands for power supply.
*  \param[in]  aPStype       - Power Supply type: eGeneral, eSCPI, eGeneralDual_1, eGeneralDual_2
*  \param[out] aMappedResponseInfo - Extra information regarding the function output.
*
*  \return  1 (Ok)     - Commands available for use.
*  \return  0 (NotOk)  - An error occured.
* 
* Change History: 
* Date(DD.MM.YY)        Author          Change info                                                          
*   
*  21.06.23              CiCo        Created and implemented
*/
byte bFctn_POW_GetPSCommands(enum cc_ePStype aPStype, char aMappedResponseInfo[])
{
  byte bDebugFlag;
  
  writeDbgLevel (DebugFuncCalls, "Function bFctn_POW_GetPSCommands called.");
  if((byte)DebugFuncParam & bDebugFlag)
    writeDbgLevel (DebugFuncParam, "Parameters: PS Type: -- %d --", aPStype);
  
  switch (aPStype) {
    case eGeneral:
      memcpy(cv_stGenericCommands, cc_stPS_General);
      break;
    case eGeneralDual_1:
      memcpy(cv_stGenericCommands, cc_stPS_GeneralDual_1);
      break;
    case eGeneralDual_2:
      memcpy(cv_stGenericCommands, cc_stPS_GeneralDual_2);
      break;
    case eSCPI :
      memcpy(cv_stGenericCommands, cc_stPS_SCPI);
      break;
    case eBKPrecision:
      memcpy(cv_stGenericCommands, cc_stPS_BKPrecision);
      break;
    default :
      snprintf(aMappedResponseInfo, elCount(aMappedResponseInfo), "Commands for power supply are not defined %d", aPStype);
      if((byte)DebugFuncInternal & bDebugFlag)
        writeDbgLevel (DebugFuncInternal, aMappedResponseInfo);
      return NotOk;
      break;
  }
  snprintf(aMappedResponseInfo, elCount(aMappedResponseInfo), "Commands for power supply available for -> %d", aPStype);
  if((byte)DebugFuncInternal & bDebugFlag)
    writeDbgLevel (DebugFuncInternal, aMappedResponseInfo);
  return Ok;
}

/*! @}*/
/*! @}*/
/*!
*   \file
*   \ingroup controlLib
*   \brief Power Supply functions.
*/