/*@!Encoding:1252*/
/*!
* @defgroup cBUS cBUS
* @defgroup BUS BUS
* @ingroup controlLib
* @{
* @addtogroup cBUS
* @{
*/ 


includes
{
  #include "ccBUS.cin"
}

/*! \fn byte bFctn_BUS_SetContext(char aBusContext[], char aMappedResponseInfo[])
*  \brief Function that sets the context of the CAPL block.
*  \param[in] aBusContext - name of Bus context 
*
*  \return 1(Ok)    - The bus name exists
*  \return 0(NotOk) - The bus name does not exists
*
* Change History: 
* Date(DD.MM.YY)        Author          Change info                                                          
*
*  06.07.18              GrAn        Created and implemented
*  04.12.18              GrAn        More writeDbgLevel() calls added for debug purposes.
*  27.02.19              CrJu        Refactoring the code / Added new debug functions
*/

byte bFctn_BUS_SetContext(char aBusContext[])
{
  dword dwBusContext;
  dword dwReturnValue_setPrimitive;
  byte bReturnValue;
  byte bDebugFlag;
  
  //Initialize the return value
  bDebugFlag = tsc_bBUS_GlobalDebugFlag;
  bReturnValue = NotOk;  
  dwReturnValue_setPrimitive = NotOk; 
  
  writeDbgLevel (DebugFuncCalls , "Function bFctn_BUS_SetContext called.");
  
  if( (byte)DebugFuncParam & bDebugFlag)
    writeDbgLevel (DebugFuncParam, "Parameters: char aBusContext[] -- %s--", aBusContext);  
  
  dwBusContext = GetBusNameContext(aBusContext);
  
  //if the bus context does not exists return an error
  if (NotOk == dwBusContext)
  {
    if( (byte)DebugFuncInternal & bDebugFlag)
      writeDbgLevel (DebugFuncInternal, "The specified bus does not exist.");
    return NotOk;
  }
  else
  {
    dwReturnValue_setPrimitive = SetBusContext(dwBusContext);
    
    if( (byte)DebugFuncInternal & bDebugFlag)
    {
      writeDbgLevel (DebugFuncInternal, "Get bus context: -- %s --. Result: -- %d --.", aBusContext, dwBusContext);
      writeDbgLevel (DebugFuncInternal, "Set bus context: -- %d --.", dwBusContext);
    }
    
    //Check if the CAPL primitive was executed OK
    if (dwReturnValue_setPrimitive)
    {
      if( (byte)DebugFuncInternal & bDebugFlag)
        writeDbgLevel (DebugFuncInternal, "The bus context was succesfully set.");
      bReturnValue = Ok;
    }
    else
    {
      if( (byte)DebugFuncInternal & bDebugFlag)
        writeDbgLevel (DebugFuncInternal, "The bus context was not succesfully set. Check the name from your configuration.");
      bReturnValue = NotOk;
    }
  }
  
  return bReturnValue;
}

/*! \fn long lFctn_BUS_SetSignalRaw(Signal* aSignalName, int64 aSignalValue, char aMappedResponseInfo[])
*   \brief Function that sets a specific raw value for a signal (This function can be used for signals with more than 32 bits length). 
*   \param[in] aSignalName            - Signal name from the database.
*   \param[in] aSignalValue           - Signal value
*   \param[out] aMappedResponseInfo   - the information which is going to be printed in the report 
*
*   \return  1 (Ok)      - the signal was set to the specified value
*   \return -1 (Error)   - General Error
*
*  \note
*        - This function can be used just for dbc signals.
*
*  Change History: 
*  Date(DD.MM.YY)        Author          Change info                                                          
*   
*  18.03.2019             CrJu           Created and implemented 
*/

long lFctn_BUS_SetSignalRaw (Signal* aSignalName, int64 aSignalValue, char aMappedResponseInfo[])
{
  long lReturnValue;
  long lReturnSetSignal;
  byte bDebugFlag;
  
  //Initialize the return value
  bDebugFlag = tsc_bBUS_GlobalDebugFlag; 
  lReturnValue = NotOk; 
  lReturnSetSignal = Error;
  
  writeDbgLevel (DebugFuncCalls , "Function lFctn_BUS_SetSignal called.");
  
  if( (byte)DebugFuncParam & bDebugFlag)
    writeDbgLevel (DebugFuncParam, "Parameters: Signal* aSignalName --%s--, double aSignalValue --%I64d--", aSignalName.name, aSignalValue);  
 
  lReturnSetSignal = setRawSignal (aSignalName, aSignalValue);
  
  if (0 == lReturnSetSignal )//primitive setRawSignal executed successfull
  {
    snprintf(aMappedResponseInfo, elcount(aMappedResponseInfo), "SUCCES: Sets the value of specific signal %s to the value %I64d .",aSignalName.name, aSignalValue);
    lReturnValue = Ok;
  }
  else//General error on primitive setRawSignal
  {
    snprintf(aMappedResponseInfo, elcount(aMappedResponseInfo), "FAIL: Cannot be set the value of specific signal %s to the value %I64d . ",aSignalName.name, aSignalValue);
    lReturnValue = Error;
  }
  
  if( (byte)DebugFuncInternal & bDebugFlag)
    writeDbgLevel (DebugFuncInternal, "Function lFctn_BUS_SetSignal lReturnValue -- %d --.", lReturnValue);
  
  return lReturnValue;
}

/*! \fn long lFctn_BUS_SetSignalByDataArr(Signal* aSignalName, byte aData[], dword aSignalBitCount, char aMappedResponseInfo[])
*   \brief Function that sets a signal value with a specific value (This function can be used for signals with more than 32 bits length). 
*   \param[in] aSignalName            - Signal name from the database.
*   \param[in] aData                  - Signal value
*   \param[in] aSignalBitCount        - The length of the signal, in bits
*   \param[out] aMappedResponseInfo   - the information which is going to be printed in the report 
*
*   \return  0 (NotOk)   - the signal cannot be set to the specified value
*   \return  1 (Ok)      - the signal was set to the specified value
*   \return -1 (Error)   - General Error
*
*  \note 
*        - This function can be used just for dbc signals.
*
*  Change History: 
*  Date(DD.MM.YY)        Author          Change info                                                          
*   
*  18.03.2019             CrJu           Created and implemented 
*/

long lFctn_BUS_SetSignalByDataArr (Signal* aSignalName, byte aData[], dword aSignalBitCount, char aMappedResponseInfo[])
{
  long lReturnValue;
  long lReturnSetSignal;
  byte bDebugFlag;
  
  //Initialize the return value
  bDebugFlag = tsc_bBUS_GlobalDebugFlag; 
  lReturnValue = NotOk;
  lReturnSetSignal = Error;
  
  writeDbgLevel (DebugFuncCalls , "Function lFctn_BUS_SetSignalByDataArr called.");
  
  if( (byte)DebugFuncParam & bDebugFlag)
    writeDbgLevel (DebugFuncParam, "Parameters: Signal* aSignalName --%s--, byte aData[] --%10.2f--", aSignalName.name);  
 
  if(elCount(aData) > (aSignalBitCount / cc_bBUSNumberBitsOnByte))
  {
    snprintf(aMappedResponseInfo, elcount(aMappedResponseInfo), "FAIL: The data length is bigger than the signal length.");
    return Error;
  }
  
  lReturnSetSignal = setRawSignal (aSignalName, aData, elCount(aData));
      
  if (0 == lReturnSetSignal )
  {
    snprintf(aMappedResponseInfo, elcount(aMappedResponseInfo), "SUCCES: Sets the value of specific signal %s.",aSignalName.name);
    lReturnValue = Ok;
  }
  else//General error on primitive setRawSignal
  {
    snprintf(aMappedResponseInfo, elcount(aMappedResponseInfo), "FAIL: Cannot be set the value of specific signal %s.",aSignalName.name);
    lReturnValue = Error;
  }
  
  if( (byte)DebugFuncInternal & bDebugFlag)
    writeDbgLevel (DebugFuncInternal, "Function lFctn_BUS_SetSignal lReturnValue -- %d --.", lReturnValue);
  
  return lReturnValue;
}

/*! \fn long lFctn_BUS_WaitForSignalMatchPhysical(Signal* aSignalName, dword aTimeToWaitForSignal, float aSignalValue, char aMappedResponseInfo[])
*  \brief Function wait and check if a signal is send with a specific physical content (the content of signal cannot be represented on more than 32 bits).
*  \param[in]  aSignalName          - Signal name from the database.
*  \param[in]  aTimeToWaitForSignal - Maximum time to be waited (if the value is 0 the function should get the first value of the signal)
*  \param[in]  aSignalValue         - The value that will be compared with the value of the signal.
*  \param[out] aMappedResponseInfo  - the information which is going to be printed in the report 
*
*  \return   0 (NotOk)  - if the signal does not have the expected value
*  \return   1 (Ok)     - if the signal has the expected value
*  \return  -1 (Error)  - a general error occurred.
*
*  \note 
*         - An timeout must be set before this step (when aTimeToWaitForSignal is zero )
*
* Change History: 
* Date(DD.MM.YY)        Author          Change info                                                          
*   
*  06.07.18              GrAn        Created and implemented
*  26.11.18              GrAn        The code was refactorized (the multiple decision if statements used).
*  26.03.19              CrJu        Refactoring the code.
*/

long lFctn_BUS_WaitForSignalMatchPhysical(Signal* aSignalName, dword aTimeToWaitForSignal, float aSignalValue, char aMappedResponseInfo[])
{
  float fSignalValue;
  long lResultTestWait;
  byte bDebugFlag;
  
  //Initialization of local variable
  bDebugFlag = tsc_bBUS_GlobalDebugFlag;
  fSignalValue = 0;
  lResultTestWait = NotOk;
  
  writeDbgLevel (DebugFuncCalls, "Function lFctn_BUS_WaitForSignalMatchPhysical called.");
  
  if((byte)DebugFuncParam & bDebugFlag)
    writeDbgLevel (DebugFuncParam, "Parameters: Signal* aSignalName --%s-- , dword aTimeToWaitForSignal --%d--, float aSignalValue --%10.2f--,enum cc_eEqualNotEqualValueBUS aExpectedResult --%d--(0 - Not equal, 1 - Equal) ",aSignalName.name, aTimeToWaitForSignal, aSignalValue);  
  
  if (0 == aTimeToWaitForSignal)//if aTimeToWaitForSignal is 0 - the function should get the first value of the signal
  {
    //Get the signal value
    fSignalValue = getSignal(aSignalName);
    
    if (fSignalValue == aSignalValue)//if the signal value is equal with the given value, as expected
    {
        snprintf(aMappedResponseInfo, elcount(aMappedResponseInfo), "The signal searched %s has the value: %10.2f.", aSignalName.name,aSignalValue);
        return Ok;
    }
    else//the signal value is not equal with the expected one
    {
      snprintf(aMappedResponseInfo, elcount(aMappedResponseInfo), "The signal searched %s does not have the value %10.2f.",aSignalName.name,aSignalValue);
      return NotOk;
    }
  }
  else//if aTimeToWaitForSignal is greater than zero
  {
    //Checks the given value against the value of the signal
    lResultTestWait = testWaitForSignalMatch(aSignalName, aSignalValue, aTimeToWaitForSignal);
      
    if (lResultTestWait == Ok)
    {
      snprintf(aMappedResponseInfo, elcount(aMappedResponseInfo), "The signal searched %s in %d ms, has the value: %10.2f.", aSignalName.name, aTimeToWaitForSignal, aSignalValue);
      return Ok;
    }
    else if (NotOk == lResultTestWait) 
    {
      snprintf(aMappedResponseInfo, elcount(aMappedResponseInfo), "The signal searched %s in %d ms, does not have the value: %10.2f.", aSignalName.name, aTimeToWaitForSignal, aSignalValue);
      return NotOk;
    }
    else
    {
      snprintf(aMappedResponseInfo, elcount(aMappedResponseInfo), "General error occurred!");
      return Error;
    }
  }
}

/*! \fn long lFctn_BUS_WaitForSignalMatchRaw(Signal* aSignalName, dword aTimeToWaitForSignal, dword aMsgCycleTime, int64 aSignalValue, char aMappedResponseInfo[])
*  \brief Function Wait and check if a signal is send with a specific raw content (This function can be used for signals with more than 32 bits length).
*  \param[in]  aSignalName          - Signal name from the database.
*  \param[in]  aTimeToWaitForSignal - Maximum time to be waited (if the value is 0 the function should get the first value of the signal)
*  \param[in]  aMsgCycleTime        - The message cycle time (from database)
*  \param[in]  aSignalValue         - The value that will be compared with the value of the signal.
*  \param[out] aMappedResponseInfo  - the information which is going to be printed in the report 
*
*  \return  0 (NotOk) - if the signal values are not in range 
*  \return  1 (Ok)    - if the signal values are in range
*  \return -1 (Error) - if the message cycle time is zero / the timeout provided is smaller than message cycle time

*
* Change History: 
* Date(DD.MM.YY)        Author          Change info                                                          
*   
*  06.07.18              GrAn        Created and implemented
*  12.04.18              GrAn        The function was rewritten. Some conditions were merged and more comments were added.
*  08.04.19              CrJu        Refactoring the code / Added new debug functions
*/

long lFctn_BUS_WaitForSignalMatchRaw(Signal* aSignalName, dword aTimeToWaitForSignal, dword aMsgCycleTime, int64 aSignalValue, char aMappedResponseInfo[])
{
  byte bResult;
  int64 i64RawSignalValue;
  dword dwNoOfIteration;
  dword dwLastWaitTimeout;
  dword dwCheckIteration;
  byte bDebugFlag;
  
  //Initialization of local variables
  bDebugFlag = tsc_bBUS_GlobalDebugFlag;
  bResult = NotOk;
  i64RawSignalValue = 0;
  
  writeDbgLevel (DebugFuncCalls, "Function bFctn_BUS_WaitForSignalMatchRaw called.");
  
  if( (byte)DebugFuncParam & bDebugFlag)
    writeDbgLevel (DebugFuncParam, "Parameters: Signal* aSignalName --%s--, dword aTimeToWaitForSignal --%d--,dword aMsgCycleTime --%d--, int64 aSignalValue --%I64d-- ",aSignalName.name, aTimeToWaitForSignal, aMsgCycleTime, aSignalValue);  
 
  //If the aTimeToWaitForSignal is bigger than zero and is less than message cycle time, then report an error
  if ((aTimeToWaitForSignal > 0) && (aTimeToWaitForSignal < aMsgCycleTime))
  {
    snprintf(aMappedResponseInfo, elcount(aMappedResponseInfo), "Error: The message cycle time is bigger than the TimeToWaitForSignal.");
    return Error;
  }
  
  //if cycle time is zero return an error
  if (0 == aMsgCycleTime)
  {
    snprintf(aMappedResponseInfo, elcount(aMappedResponseInfo), "Error: The message cycle time is zero.");
    return Error;
  }
  
  if (0 == aTimeToWaitForSignal)//if aTimeToWaitForSignal is 0 - the function should get the first value of the signal
  {
    //Wait for the first signal value
    testWaitForTimeout(aMsgCycleTime);
    //Get the value of the signal
    i64RawSignalValue = getRawSignal(aSignalName);
      
    if (i64RawSignalValue == aSignalValue)//if the signal value is equal with the expected one
    {
      //Succes, exit the function
      snprintf(aMappedResponseInfo, elcount(aMappedResponseInfo), "The signal searched %s has the value: %I64d.", aSignalName.name, aSignalValue);
      return Ok;
    } 
    else //if the signal value is not equal with the expected one
    {
      //Error, exit the function
      snprintf(aMappedResponseInfo, elcount(aMappedResponseInfo), "The signal searched %s does not have the value: %I64d.", aSignalName.name, aSignalValue);
      return NotOk;
    }
  }
  else//if aTimeToWaitForSignal is greater than zero
  {
    //How many cycle time checks iterations to wait for signal
    dwNoOfIteration = aTimeToWaitForSignal / aMsgCycleTime;
    
    //Last Timeout to be waited
    dwLastWaitTimeout = aTimeToWaitForSignal - (dwNoOfIteration * aMsgCycleTime);
    
    //Check every cycle time the value of the signal
    for (dwCheckIteration = 0; dwCheckIteration <= dwNoOfIteration; dwCheckIteration++ )
    {
      //Test the signal value every cycle time
      if (dwCheckIteration != dwNoOfIteration)
      {
        //Get the value of the signal
        i64RawSignalValue = getRawSignal(aSignalName);
      
        if (i64RawSignalValue == aSignalValue)//if the signal value is equal with the expected one
        {
          //Succes, exit the function
          snprintf(aMappedResponseInfo, elcount(aMappedResponseInfo), "The signal searched %s has the value: %I64d.", aSignalName.name, aSignalValue);
          return Ok;
        }
        else //if the signal value is not equal with the expected one
        {
          bResult = NotOk;
        }
       
       //Wait the message cycle time
       testWaitForTimeout(aMsgCycleTime);        
      }
      else
      {
        //If the last timeout is not zero, wait the needed time
        if (dwLastWaitTimeout != 0 )
        {
          //wait for last remaining time
          testWaitForTimeout(dwLastWaitTimeout);
        }
        else 
        {
          //Do nothing
        }
          
        //Get the value of the signal
        i64RawSignalValue = getRawSignal(aSignalName);
        
        if (i64RawSignalValue == aSignalValue)//if the signal value is equal with the expected one
        {
          //Succes, exit the function
          snprintf(aMappedResponseInfo, elcount(aMappedResponseInfo), "The signal searched %s has the value: %I64d.", aSignalName.name, aSignalValue);
          return Ok;
        }  
        else //if the signal value is not equal with the expected one
        {
          bResult = NotOk;
        }
      }
    }
  }
  
  if( bResult == NotOk)
  {
    snprintf(aMappedResponseInfo, elcount(aMappedResponseInfo), "The signal searched %s does not have the value: %I64d.", aSignalName.name, aSignalValue);
  }
  
  return bResult;
}

/*! \fn long lFctn_BUS_WaitForSignalMatchByDataArr(Signal* aSignalName, dword aTimeToWaitForSignal, dword aMsgCycleTime, byte aData[], dword aNrOfBytesToCompare, char aMappedResponseInfo[])
*  \brief Function wait and check if a signal is send with a specific data bytes content (This function can be used for signals with more than 32 bits length, but maxim 8 bytes.)
*  \param[in]  aSignalName           - Signal name from the database..
*  \param[in]  aTimeToWaitForSignal  - Maximum time to be waited (if the value is 0 the function should get the first value of the signal)
*  \param[in]  aMsgCycleTime         - The message cycle time (from database)
*  \param[in]  aData                 - The value that will be compared with the value of the signal.
*  \param[in]  aNrOfBytesToCompare   - How many bytes you want to compare from the signal.
*  \param[out] aMappedResponseInfo   - the information which is going to be printed in the report 
*
*  \return  0 (NotOk)  - if the signal values are not in range 
*  \return  1 (Ok)     - if the signal has the expected value
*  \return -1 (Error)  - a general error occurred / the message cycle time is zero / the timeout provided is smaller than message cycle time / the bytes array to compare is bigger than 8 bytes
*
*  \note 
*         - An timeout must be set before this step (when aTimeToWaitForSignal is zero)
*         - It works for signals represented on 8 bytes or less
*         - The return of the primitive 'getRawSignal' is 4 in case of succes, not 0, like in documentation
*
* Change History: 
* Date(DD.MM.YY)        Author          Change info                                                          
*   
*  09.04.2019            CrJu         Created and implemented
*/

long lFctn_BUS_WaitForSignalMatchByDataArr(Signal* aSignalName, dword aTimeToWaitForSignal, dword aMsgCycleTime, byte aData[], byte aNrOfBytesToCompare, char aMappedResponseInfo[])
{
  char chCompareArrayInfo[250];
  byte bSignalValue[8];
  byte bCompareResult;
  byte bByteIndex;
  byte bDebugFlag;
  byte bResult;
  long lResultPrimitive;
  dword dwNoOfIteration;
  dword dwLastWaitTimeout;
  dword dwCheckIteration;
  
  //Initialization of local variable
  bDebugFlag = tsc_bBUS_GlobalDebugFlag;
  
  writeDbgLevel (DebugFuncCalls, "Function lFctn_BUS_WaitForSignalMatchByDataArr called.");
  
  if( (byte)DebugFuncParam & bDebugFlag)
    writeDbgLevel (DebugFuncParam, "Parameters: Signal* aSignalName --%s-- , dword aTimeToWaitForSignal --%d--, float aMsgCycleTime --%10.2f--, byte aData[], dword aNrOfBytesToCompare --%d--",aSignalName.name, aTimeToWaitForSignal, aMsgCycleTime, aNrOfBytesToCompare);  
  
  //If the aTimeToWaitForSignal is bigger than zero and is less than message cycle time, then report an error
  if((aTimeToWaitForSignal > 0) && (aTimeToWaitForSignal < aMsgCycleTime))
  {
    snprintf(aMappedResponseInfo, elcount(aMappedResponseInfo), "Error: The message cycle time is bigger than the TimeToWaitForSignal.");
    return Error;
  }
  
  //if cycle time is zero return an error
  if(0 == aMsgCycleTime)
  {
    snprintf(aMappedResponseInfo, elcount(aMappedResponseInfo), "Error: The message cycle time is zero.");
    return Error;
  }
  
  //if the bytes array to compare is bigger than 8 bytes, return an error
  if(elCount(aData) > elCount(bSignalValue))
  {
    snprintf(aMappedResponseInfo, elcount(aMappedResponseInfo), "Error: The bytes array you want to compare is bigger than 8 bytes.");
    return Error;
  }
  
  //if the length of the expected byte array is smaller than the number of bytes you want to compare, return an error
  if(aNrOfBytesToCompare > elCount(aData))
  {
    snprintf(aMappedResponseInfo, elcount(aMappedResponseInfo), "Error: The length of the expected byte array is smaller than the number of bytes you want to compare :%d.", aNrOfBytesToCompare);
    return Error;
  }
  
  if (0 == aTimeToWaitForSignal)//if aTimeToWaitForSignal is 0 - the function should get the first value of the signal
  {
    //Get the signal value
    lResultPrimitive = getRawSignal(aSignalName, bSignalValue, elCount(bSignalValue));
    
    if(lResultPrimitive == 4) //Primitive was executed with succes
    {
      bCompareResult = bFctn_CONV_CompareByteArrays(bSignalValue, aData, aNrOfBytesToCompare, chCompareArrayInfo);
      
      if(bCompareResult == Ok)
      {
        snprintf(aMappedResponseInfo, elcount(aMappedResponseInfo), chCompareArrayInfo);
        return Ok;
      }
      else
      {
        snprintf(aMappedResponseInfo, elcount(aMappedResponseInfo), chCompareArrayInfo);
        return NotOk; 
      }
    }
    else //The primitive has reported an error
    {
      snprintf(aMappedResponseInfo, elcount(aMappedResponseInfo), "General error on calling the primitive 'getRawSignal'.");
      return Error;
    }
  }
  else//if aTimeToWaitForSignal is greater than zero
  {
    //How many cycle time checks iterations to wait for signal
    dwNoOfIteration = aTimeToWaitForSignal / aMsgCycleTime;
    
    //Last Timeout to be waited
    dwLastWaitTimeout = aTimeToWaitForSignal - (dwNoOfIteration * aMsgCycleTime);
    
    //Check every cycle time the value of the signal
    for (dwCheckIteration = 0; dwCheckIteration <= dwNoOfIteration; dwCheckIteration++ )
    {
      //Test the signal value every cycle time
      if (dwCheckIteration != dwNoOfIteration)
      {
        //Get the value of the signal
        lResultPrimitive = getRawSignal(aSignalName, bSignalValue, (elCount(bSignalValue)-1) );
        
        if(lResultPrimitive == 4) //Primitive was executed with succes
        {
          //Compare the bytes arrays
          bCompareResult = bFctn_CONV_CompareByteArrays(bSignalValue, aData, aNrOfBytesToCompare, chCompareArrayInfo);
          
          if(bCompareResult == Ok)
          {
            snprintf(aMappedResponseInfo, elcount(aMappedResponseInfo), chCompareArrayInfo);
            return Ok;
          }
          else
          {
            snprintf(aMappedResponseInfo, elcount(aMappedResponseInfo), chCompareArrayInfo);
            bResult = NotOk; 
          }
         }
         else //The primitive has reported an error
         {
           snprintf(aMappedResponseInfo, elcount(aMappedResponseInfo), "General error on calling the primitive 'getRawSignal'.");
           return Error;
         }
      
      //Wait the message cycle time
      testWaitForTimeout(aMsgCycleTime);
      }
      else //the last cycle time has passed, but we still need to wait some time
      {
        //If the last timeout is not zero, wait the needed time
        if (dwLastWaitTimeout != 0 )
        {
          //wait for last remaining time
          testWaitForTimeout(dwLastWaitTimeout);
        }
          
        //Get the value of the signal
        lResultPrimitive = getRawSignal(aSignalName, bSignalValue, elCount(bSignalValue));
        
        if(lResultPrimitive == 4) //Primitive was executed with succes
        {
          //Compare the bytes arrays
          bCompareResult = bFctn_CONV_CompareByteArrays(bSignalValue, aData, aNrOfBytesToCompare, chCompareArrayInfo);
        
          if(bCompareResult == Ok)
          {
            snprintf(aMappedResponseInfo, elcount(aMappedResponseInfo), chCompareArrayInfo);
            return Ok;
          }
          else
          {
            snprintf(aMappedResponseInfo, elcount(aMappedResponseInfo), chCompareArrayInfo);
            bResult = NotOk;
          }
        }
        else //The primitive has reported an error
        {
          snprintf(aMappedResponseInfo, elcount(aMappedResponseInfo), "General error on calling the primitive 'getRawSignal'.");
          return Error;
        }
      }
    }
  }
  return bResult;
}

/*! \fn long lFctn_BUS_WaitForSignalMatchInRangePhysical(Signal* aSignalName, dword aTimeToWaitForSignal, double aMinValue, double aMaxValue, char aBusContext[], char aMappedResponseInfo[])
*  \brief Function Wait and check if a message is send with his values inside(inclusive limits) of a given range or not. Function is used for phisical values.
*  \param[in]  aSignalName          - Signal name from the database.
*  \param[in]  aTimeToWaitForSignal - Maximum time to be waited (if the value is 0 the function should get the first value of the signal)
*  \param[in]  aMinValue            - The minimum of the signal.
*  \param[in]  aMaxValue            - The maximum of the signal.
*  \param[in] aBusContext           - the bus name context
*  \param[out] aMappedResponseInfo  - the information which is going to be printed in the report 
*
*  \return  0 (NotOk)   - if the signal values are not in range
*  \return  1 (Ok)      - if the signal values are in range
*  \return -1 (Error)   - general error (lower limit is bigger than higher limit / the bus context name is wrong)
*
*  \note 
*         - An timeout must be set before this step (when aTimeToWaitForSignal is zero)
*
* Change History: 
* Date(DD.MM.YY)        Author          Change info                                                          
*   
*  06.07.18              GrAn         Created and implemented
*  12.04.18              GrAn         More writeDbgLevel () added for debug purposes.
*  23.04.19              CrJu         Refactoring the code / Added new debug functions
*/

long lFctn_BUS_WaitForSignalMatchInRangePhysical(Signal* aSignalName, dword aTimeToWaitForSignal, float aMinValue, float aMaxValue, char aBusContext[], char aMappedResponseInfo[])
{
  long lResult;
  float fSignalInRange;
  byte bResult_SetContext;
  dword dwResultChk;
  byte bDebugFlag;
  
  //Initialization of local variables
  lResult = NotOk;
  fSignalInRange = NotOk;
  bResult_SetContext = NotOk;
  bDebugFlag = tsc_bBUS_GlobalDebugFlag;
  dwResultChk = 0;
  
  writeDbgLevel (DebugFuncCalls, "Function lFctn_BUS_WaitForSignalMatchInRangePhysical called.");
  
  if( (byte)DebugFuncParam & bDebugFlag)
    writeDbgLevel (DebugFuncParam, "Parameters: Signal* aSignalName --%s--, dword aTimeToWaitForSignal --%d--, float aMinValue --%10.2f--, float aMaxValue --%10.2f--,  char aBusContext[] --%s-- ",aSignalName.name, aTimeToWaitForSignal,aMinValue, aMaxValue,aBusContext );  
  
  //Setting the bus Context
  bResult_SetContext = bFctn_BUS_SetContext(aBusContext);
  
  //Check if the bus context name is wrong
  if (bResult_SetContext == NotOk)
  {
    snprintf(aMappedResponseInfo, elcount(aMappedResponseInfo), "Error: The bus context name is wrong.");
    return Error;
  }
  
  //if lower limit is bigger than higher limit, return an error
  if (aMinValue > aMaxValue)
  {
    snprintf(aMappedResponseInfo, elcount(aMappedResponseInfo), "Error: Lower limit is bigger than higher limit.");
    return Error;
  }

  if (0 == aTimeToWaitForSignal)//if aTimeToWaitForSignal is 0 - the function should get the first value of the signal
  {
    fSignalInRange = getSignal(aSignalName);

    //Test if the signal value is inside given limits
    if ((fSignalInRange >= aMinValue) && (fSignalInRange <= aMaxValue))
    {
      snprintf(aMappedResponseInfo, elcount(aMappedResponseInfo), "The value of the signal: %10.3f, is inside the given limits: %10.2f - %10.2f.", fSignalInRange, aMinValue, aMaxValue);
      return Ok;
    }
    else
    {
      snprintf(aMappedResponseInfo, elcount(aMappedResponseInfo), "The value of the signal: %10.3f, is outside the given limits: %10.2f - %10.2f.", fSignalInRange, aMinValue, aMaxValue);
      return NotOk;
    }
  }
  else//if aTimeToWaitForSignal is greater than zero
  {
    //Test if the signal values are outside given limits
    dwResultChk = ChkStart_MsgSignalValueRangeViolation (aSignalName,aMinValue,aMaxValue); 

    //check was created successfull
    if(dwResultChk)
    {
      //Check whether the specified condition was already broken (at least one time the condition was not fulfilled).
		  TestAddCondition(dwResultChk);
      //Wait the specified time
	    TestWaitForTimeout(aTimeToWaitForSignal);  
    
      if (0 == testCheckCondition(dwResultChk))  /*Condition was not broken (all checks were OK) */
      {
        //Remove the event object that was added as condition
        TestRemoveCondition(dwResultChk);
        snprintf(aMappedResponseInfo, elcount(aMappedResponseInfo), "The value of the signal is inside the given limits: %10.2f - %10.2f.", aMinValue, aMaxValue);
        return Ok;
      }
      else//Condition was broken (at least one time the condition was not fulfilled).
      {
        //Remove the event object that was added as condition
        TestRemoveCondition(dwResultChk);
        snprintf(aMappedResponseInfo, elcount(aMappedResponseInfo), "Condition was broken (the value of the signal might be OUTSIDE the limits).");
        return NotOk;
      }
    }
    else//An error occurred
    {
      snprintf(aMappedResponseInfo, elcount(aMappedResponseInfo), "Check could not be created and must not be referenced.");
      return Error;
    }
  }
}

/*! \fn long lFctn_BUS_WaitForSignalMatchOutRangePhysical(Signal* aSignalName, dword aTimeToWaitForSignal, double aMinValue, double aMaxValue, char aBusContext[], char aMappedResponseInfo[])
*  \brief Function Wait and check if a message is send with his values outside of a given range or not. Function is used for phisical values.
*  \param[in]  aSignalName          - Signal name from the database.
*  \param[in]  aTimeToWaitForSignal - Maximum time to be waited (if the value is 0 the function should get the first value of the signal)
*  \param[in]  aMinValue            - The minimum of the signal.
*  \param[in]  aMaxValue            - The maximum of the signal.
*  \param[in] aBusContext           - the bus name context
*  \param[out] aMappedResponseInfo  - the information which is going to be printed in the report 
*
*  \return  0 (NotOk)   - if the signal values are not in range
*  \return  1 (Ok)      - if the signal values are in range
*  \return -1 (Error)   - general error
*
*  \note 
*         - An timeout must be set before this step (when aTimeToWaitForSignal is zero)
*         - The value may not be equal with the limits
*
* Change History: 
* Date(DD.MM.YY)        Author          Change info                                                          
*   
*  06.07.18              GrAn         Created and implemented
*  12.04.18              GrAn         More writeDbgLevel () added for debug purposes.
*  06.05.19              CrJu         Refactoring the code / Added new debug functions
*/

long lFctn_BUS_WaitForSignalMatchOutRangePhysical(Signal* aSignalName, dword aTimeToWaitForSignal, float aMinValue, float aMaxValue, char aBusContext[], char aMappedResponseInfo[])
{
  long lResult;
  float fSignalInRange;
  byte bResult_SetContext;
  dword dwResultChk;
  byte bDebugFlag;
  
  //Initialization of local variables
  lResult = NotOk;
  fSignalInRange = NotOk;
  bResult_SetContext = NotOk;
  bDebugFlag = tsc_bBUS_GlobalDebugFlag;
  dwResultChk = 0;
  
  writeDbgLevel (DebugFuncCalls, "Function lFctn_BUS_WaitForSignalMatchInRangePhysical called.");
  
  if( (byte)DebugFuncParam & bDebugFlag)
    writeDbgLevel (DebugFuncParam, "Parameters: Signal* aSignalName --%s--, dword aTimeToWaitForSignal --%d--, float aMinValue --%10.2f--, float aMaxValue --%10.2f--,  char aBusContext[] --%s-- ",aSignalName.name, aTimeToWaitForSignal,aMinValue, aMaxValue,aBusContext );  
  
  //Setting the bus Context
  bResult_SetContext = bFctn_BUS_SetContext(aBusContext);
  
  //Check if the bus context name is wrong
  if (bResult_SetContext == NotOk)
  {
    snprintf(aMappedResponseInfo, elcount(aMappedResponseInfo), "Error: The bus context name is wrong.");
    return Error;
  }
  
  //if lower limit is bigger than higher limit, return an error
  if (aMinValue > aMaxValue)
  {
    snprintf(aMappedResponseInfo, elcount(aMappedResponseInfo), "Error: Lower limit is bigger than higher limit.");
    return Error;
  }

  if (0 == aTimeToWaitForSignal)//if aTimeToWaitForSignal is 0 - the function should get the first value of the signal
  {
    fSignalInRange = getSignal(aSignalName);

    //Test if the signal value is inside given limits
    if ((fSignalInRange < aMinValue) || (fSignalInRange > aMaxValue))
    {
      snprintf(aMappedResponseInfo, elcount(aMappedResponseInfo), "The value of the signal: %10.3f, is outside the given limits: %10.2f - %10.2f.", fSignalInRange, aMinValue, aMaxValue);
      return Ok;
    }
    else
    {
      snprintf(aMappedResponseInfo, elcount(aMappedResponseInfo), "The value of the signal: %10.3f, is inside the given limits: %10.2f - %10.2f.", fSignalInRange, aMinValue, aMaxValue);
      return NotOk;
    }
  }
  else//if aTimeToWaitForSignal is greater than zero
  {
    //Test if the signal values are outside given limits
    dwResultChk = ChkStart_MsgSignalValueInvalid (aSignalName,aMinValue,aMaxValue); 

    //check was created successfull
    if(dwResultChk)
    {
      //Check whether the specified condition was already broken (at least one time the condition was not fulfilled).
		  TestAddCondition(dwResultChk);
      //Wait the specified time
	    TestWaitForTimeout(aTimeToWaitForSignal);  
    
      if (0 == testCheckCondition(dwResultChk))  /*Condition was not broken (all checks were OK) */
      {
        //Remove the event object that was added as condition
        TestRemoveCondition(dwResultChk);
        snprintf(aMappedResponseInfo, elcount(aMappedResponseInfo), "The value of the signal is outside the given limits: %10.2f - %10.2f.", aMinValue, aMaxValue);
        return Ok;
      }
      else//Condition was broken (at least one time the condition was not fulfilled).
      {
        //Remove the event object that was added as condition
        TestRemoveCondition(dwResultChk);
        snprintf(aMappedResponseInfo, elcount(aMappedResponseInfo), "Condition was broken (the value of the signal might be INSIDE the limits).");
        return NotOk;
      }
    }
    else//An error occurred
    {
      snprintf(aMappedResponseInfo, elcount(aMappedResponseInfo), "Check could not be created and must not be referenced.");
      return Error;
    }
  }
}

/*! \fn long lFctn_BUS_WaitForSignalMatchInRangeRaw(Signal* aSignalName, dword aTimeToWaitForSignal, dword aMsgCycleTime, int64 aMinValue, int64 aMaxValue, char aBusContext[], char aMappedResponseInfo[])
*  \brief Function Wait and check if a message is send with his values inside of a given range or not. Function is used for raw values.
*  \param[in]  aSignalName          - Signal name from the database.
*  \param[in]  aTimeToWaitForSignal - Maximum time to be waited (if the value is 0 the function should get the first value of the signal)
*  \param[in]  aMsgCycleTime        - The message cycle time (from database)
*  \param[in]  aMinValue            - The minimum of the signal.
*  \param[in]  aMaxValue            - The maximum of the signal.
*  \param[in]  aBusContext          - the bus name context
*  \param[out] aMappedResponseInfo  - the information which is going to be printed in the report 
*
*  \return  0(NotOk) - if the signal values are not in range
*  \return  1(Ok)    - if the signal values are in range
*  \return -1(Error) - an error occured (Message cycle time is zero / lower limit is bigger than higher limit / timeout provided is smaller than message cycle time / bus cotext name is wrong)
*
* Change History: 
* Date(DD.MM.YY)        Author          Change info                                                          
*   
*  06.07.18              GrAn        Created and implemented
*  12.04.18              GrAn        The function was rewritten. Some unneded code parts were removed. More comments were added.
*  10.05.19              CrJu        Refactoring the code / Added new debug functions
*/

long lFctn_BUS_WaitForSignalMatchInRangeRaw(Signal* aSignalName, dword aTimeToWaitForSignal, dword aMsgCycleTime, int64 aMinValue, int64 aMaxValue, char aBusContext[], char aMappedResponseInfo[])
{
  byte bResult;
  int64 i64RawSignalValue;
  byte bResult_SetContext;
  dword dwNoOfIteration;
  dword dwLastWaitTimeout;
  dword dwCheckIteration;
  byte bDebugFlag;

  //Initialization of local variables
  bResult = NotOk;
  i64RawSignalValue = 0;
  bResult_SetContext =  NotOk;
  bDebugFlag = tsc_bBUS_GlobalDebugFlag;
  
  writeDbgLevel (DebugFuncCalls , "Function bFctn_BUS_WaitForSignalMatchInRangeRaw called.");
  
  if( (byte)DebugFuncParam & bDebugFlag)
    writeDbgLevel (DebugFuncParam, "Parameters: Signal* aSignalName --%s--, dword aTimeToWaitForSignal --%d--, dword aMsgCycleTime --%d--, int64 aMinValue --%lld-- , int64 aMaxValue --%lld--, char aBusContext[] --%s-- ",aSignalName.name, aTimeToWaitForSignal, aMsgCycleTime, aMinValue, aMaxValue, aBusContext);

  //Setting the bus Context
  bResult_SetContext = bFctn_BUS_SetContext(aBusContext);
 
  //Check if the bus context name is wrong
  if (bResult_SetContext == NotOk)
  {
    snprintf(aMappedResponseInfo, elcount(aMappedResponseInfo), "Error: The bus context name is wrong.");
    return Error;
  }

  //if the cycle time is bigger than time to wait for signal, return an error
  if ((aTimeToWaitForSignal > 0) && (aTimeToWaitForSignal < aMsgCycleTime))
  {
    snprintf(aMappedResponseInfo, elcount(aMappedResponseInfo), "Error: The cycle time is bigger than time to wait for signal.");
    return Error;
  }
  
  //if lower limit is bigger than higher limit, return an error
  if (aMinValue > aMaxValue)
  {
    snprintf(aMappedResponseInfo, elcount(aMappedResponseInfo), "Error: Lower limit is bigger than higher limit.");
    return Error;
  }
  
  if (0 == aMsgCycleTime)//if cycle time is zero, return an error
  {
    snprintf(aMappedResponseInfo, elcount(aMappedResponseInfo), "Error: Cycle time is zero.");
    return Error;
  }
  
  if (0 == aTimeToWaitForSignal)//if aTimeToWaitForSignal is 0 - the function should get the first value of the signal
  {
    //Wait for the first signal value
    testWaitForTimeout(aMsgCycleTime);
    
    //Take the signal value
    i64RawSignalValue = getRawSignal(aSignalName);

    //Test if the signal value is inside given limits
    if ((i64RawSignalValue >= aMinValue) && (i64RawSignalValue <= aMaxValue))//The value of signal is in range
    {
      snprintf(aMappedResponseInfo, elcount(aMappedResponseInfo), "The raw value of the signal: %lld, is inside the given limits: %lld - %lld.", i64RawSignalValue, aMinValue, aMaxValue);
      return Ok;
    }
    else//The value of signal is not in range
    {
      snprintf(aMappedResponseInfo, elcount(aMappedResponseInfo), "The raw value of the signal: %lld, is not inside the given limits: %lld - %lld.", i64RawSignalValue, aMinValue, aMaxValue);
      return NotOk;
    }
  }
  else//if aTimeToWaitForSignal is greater than zero
  {
    //How many cycle time checks iterations to wait for signal
    dwNoOfIteration = aTimeToWaitForSignal / aMsgCycleTime;
    
    //Last Timeout to be waited
    dwLastWaitTimeout = aTimeToWaitForSignal - (dwNoOfIteration * aMsgCycleTime);
    
    //Test the signal value every cycle time
    for (dwCheckIteration = 0; dwCheckIteration <= dwNoOfIteration; dwCheckIteration++ )
    {
      //Test the signal value every cycle time, except the last Iteration
      if (dwCheckIteration != dwNoOfIteration)
      {
        //Take the signal value
        i64RawSignalValue = getRawSignal(aSignalName);
      
        //Test if the signal value is in range or not
        if ((i64RawSignalValue >= aMinValue) && (i64RawSignalValue <= aMaxValue))//The value of signal is in range
        {
          //Success, remain in loop
          snprintf(aMappedResponseInfo, elcount(aMappedResponseInfo), "The raw value of the signal: %lld, is inside the given limits: %lld - %lld.", i64RawSignalValue, aMinValue, aMaxValue);
          bResult = Ok;
        }
        else //The value of signal is not in range
        {
          //Error, exit from function
          snprintf(aMappedResponseInfo, elcount(aMappedResponseInfo), "The raw value of the signal: %lld, is not inside the given limits: %lld - %lld.", i64RawSignalValue, aMinValue, aMaxValue);
          return NotOk;
        }
          
        //Wait the message cycle time
        testWaitForTimeout(aMsgCycleTime);        
      }
      else //it's the last Iteration
      {
        //Wait the remaining time 
        if (dwLastWaitTimeout != 0)
        {
          testWaitForTimeout(dwLastWaitTimeout);
        }
          
        //Take the signal value
        i64RawSignalValue = getRawSignal(aSignalName);
      
        //Test if the signal value is in range or not
        if ((i64RawSignalValue >= aMinValue) && (i64RawSignalValue <= aMaxValue))//The value of signal is in range
        {
          snprintf(aMappedResponseInfo, elcount(aMappedResponseInfo), "The raw value of the signal: %lld, is inside the given limits: %lld - %lld.", i64RawSignalValue, aMinValue, aMaxValue);
          bResult = Ok;
        }
        else//The value of signal is not in range
        {
          //Error, exit from function
          snprintf(aMappedResponseInfo, elcount(aMappedResponseInfo), "The raw value of the signal: %lld, is not inside the given limits: %lld - %lld.", i64RawSignalValue, aMinValue, aMaxValue);
          return NotOk;
        }
      }
    }
  }
  
  return bResult;  
}

/*! \fn long lFctn_BUS_WaitForSignalMatchOutRangeRaw(Signal* aSignalName, dword aTimeToWaitForSignal, dword aMsgCycleTime, int64 aMinValue, int64 aMaxValue, char aBusContext[], char aMappedResponseInfo[])
*  \brief Function Wait and check if a message is send with his values outside of a given range or not. Function is used for raw values.
*  \param[in]  aSignalName          - Signal name from the database.
*  \param[in]  aTimeToWaitForSignal - Maximum time to be waited (if the value is 0 the function should get the first value of the signal)
*  \param[in]  aMsgCycleTime        - The message cycle time (from database)
*  \param[in]  aMinValue            - The minimum of the signal.
*  \param[in]  aMaxValue            - The maximum of the signal.
*  \param[in]  aBusContext          - the bus name context
*  \param[out] aMappedResponseInfo  - the information which is going to be printed in the report 
*
*  \return  0(NotOk) - if the signal values are not in range
*  \return  1(Ok)    - if the signal values are in range
*  \return -1(Error) - an error occured (Message cycle time is zero / lower limit is bigger than higher limit / timeout provided is smaller than message cycle time / bus cotext name is wrong)
*
* Change History: 
* Date(DD.MM.YY)        Author          Change info                                                          
*   
*  06.07.18              GrAn        Created and implemented
*  04.12.18              GrAn        The function was rewritten. Some unneded code parts were removed. More comments were added.
*  13.05.19              CrJu        Refactoring the code / Added new debug functions
*/

long lFctn_BUS_WaitForSignalMatchOutRangeRaw(Signal* aSignalName, dword aTimeToWaitForSignal, dword aMsgCycleTime, int64 aMinValue, int64 aMaxValue, char aBusContext[], char aMappedResponseInfo[])
{
  byte bResult;
  int64 i64RawSignalValue;
  byte bResult_SetContext;
  dword dwNoOfIteration;
  dword dwLastWaitTimeout;
  dword dwCheckIteration;
  byte bDebugFlag;

  //Initialization of local variables
  bResult = NotOk;
  i64RawSignalValue = 0;
  bResult_SetContext =  NotOk;
  bDebugFlag = tsc_bBUS_GlobalDebugFlag;
  
  writeDbgLevel (DebugFuncCalls , "Function bFctn_BUS_WaitForSignalMatchInRangeRaw called.");
  
  if( (byte)DebugFuncParam & bDebugFlag)
    writeDbgLevel (DebugFuncParam, "Parameters: Signal* aSignalName --%s--, dword aTimeToWaitForSignal --%d--, dword aMsgCycleTime --%d--, int64 aMinValue --%lld-- , int64 aMaxValue --%lld--, char aBusContext[] --%s-- ",aSignalName.name, aTimeToWaitForSignal, aMsgCycleTime, aMinValue, aMaxValue, aBusContext);

  //Setting the bus Context
  bResult_SetContext = bFctn_BUS_SetContext(aBusContext);
 
  //Check if the bus context name is wrong
  if (bResult_SetContext == NotOk)
  {
    snprintf(aMappedResponseInfo, elcount(aMappedResponseInfo), "Error: The bus context name is wrong.");
    return Error;
  }

  //if the cycle time is bigger than time to wait for signal, return an error
  if ((aTimeToWaitForSignal > 0) && (aTimeToWaitForSignal < aMsgCycleTime))
  {
    snprintf(aMappedResponseInfo, elcount(aMappedResponseInfo), "Error: The cycle time is bigger than time to wait for signal.");
    return Error;
  }
  
  //if lower limit is bigger than higher limit, return an error
  if (aMinValue > aMaxValue)
  {
    snprintf(aMappedResponseInfo, elcount(aMappedResponseInfo), "Error: Lower limit is bigger than higher limit.");
    return Error;
  }
  
  //if cycle time is zero, return an error
  if (0 == aMsgCycleTime)
  {
    snprintf(aMappedResponseInfo, elcount(aMappedResponseInfo), "Error: Cycle time is zero.");
    return Error;
  }
  
  if (0 == aTimeToWaitForSignal)//if aTimeToWaitForSignal is 0 - the function should get the first value of the signal
  {
    //Wait for the first signal value
    testWaitForTimeout(aMsgCycleTime);
    
    //Take the signal value
    i64RawSignalValue = getRawSignal(aSignalName);

    //Test if the signal value is inside given limits
    if ((i64RawSignalValue < aMinValue) || (i64RawSignalValue > aMaxValue))//The value of signal is outside the range
    {
      snprintf(aMappedResponseInfo, elcount(aMappedResponseInfo), "The raw value of the signal: %lld, is outside the given limits: %lld - %lld.", i64RawSignalValue, aMinValue, aMaxValue);
      return Ok;
    }
    else//The value of signal is not in range
    {
      snprintf(aMappedResponseInfo, elcount(aMappedResponseInfo), "The raw value of the signal: %lld, is not outside the given limits: %lld - %lld.", i64RawSignalValue, aMinValue, aMaxValue);
      return NotOk;
    }
  }
  else//if aTimeToWaitForSignal is greater than zero
  {
    //How many cycle time checks iterations to wait for signal
    dwNoOfIteration = aTimeToWaitForSignal / aMsgCycleTime;
    
    //Last Timeout to be waited
    dwLastWaitTimeout = aTimeToWaitForSignal - (dwNoOfIteration * aMsgCycleTime);
    
    //Test the signal value every cycle time
    for (dwCheckIteration = 0; dwCheckIteration <= dwNoOfIteration; dwCheckIteration++ )
    {
      //Test the signal value every cycle time, except the last Iteration
      if (dwCheckIteration != dwNoOfIteration)
      {
        //Take the signal value
        i64RawSignalValue = getRawSignal(aSignalName);
      
        //Test if the signal value is outside the range or not
        if ((i64RawSignalValue < aMinValue) || (i64RawSignalValue > aMaxValue))//The value of signal is outside the range
        {
          //Success, remain in loop
          snprintf(aMappedResponseInfo, elcount(aMappedResponseInfo), "The raw value of the signal: %lld, is outside the given limits: %lld - %lld.", i64RawSignalValue, aMinValue, aMaxValue);
          bResult = Ok;
        }
        else //The value of signal is in range
        {
          //Error, exit from function
          snprintf(aMappedResponseInfo, elcount(aMappedResponseInfo), "The raw value of the signal: %lld, is not outside the given limits: %lld - %lld.", i64RawSignalValue, aMinValue, aMaxValue);
          return NotOk;
        }
          
        //Wait the message cycle time
        testWaitForTimeout(aMsgCycleTime);        
      }
      else //it's the last Iteration
      {
        //Wait the remaining time 
        if (dwLastWaitTimeout != 0)
        {
          testWaitForTimeout(dwLastWaitTimeout);
        }
          
        //Take the signal value
        i64RawSignalValue = getRawSignal(aSignalName);
      
        //Test if the signal value is outside the range or not
        if ((i64RawSignalValue < aMinValue) || (i64RawSignalValue > aMaxValue))//The value of signal is in range
        {
          snprintf(aMappedResponseInfo, elcount(aMappedResponseInfo), "The raw value of the signal: %lld, is outside the given limits: %lld - %lld.", i64RawSignalValue, aMinValue, aMaxValue);
          bResult = Ok;
        }
        else//The value of signal is in range
        {
          //Error, exit from function
          snprintf(aMappedResponseInfo, elcount(aMappedResponseInfo), "The raw value of the signal: %lld, is not outside the given limits: %lld - %lld.", i64RawSignalValue, aMinValue, aMaxValue);
          return NotOk;
        }
      }
    }
  }
  
  return bResult; 
}

/*! \fn long lFctn_BUS_CheckSigValue4TimePhysical(Signal* aSignalName, dword aTimeToWaitForSignal, float aSignalValue, char aBusContext[], char aMappedResponseInfo[])
*  \brief Function Wait and check if a physical signal value is not changing his value during a given time.
*  \param[in]  aSignalName          - Signal name from the database.
*  \param[in]  aTimeToWaitForSignal - The given time that the tester expects that the signal value is not changed
*  \param[in]  aSignalValue         - the expected signal value
*  \param[in]  aBusContext          - the bus name context
*  \param[out] aMappedResponseInfo  - the information which is going to be printed in the report 
*
*  \return  0 (NotOk) - if the signal values are changed
*  \return  1 (Ok)    - if the signal values are not changed
*  \return -1 (Error) - error (the bus context name is wrong / the time to wait for signal is zero / the signal does not have the expected value)
*
*  \note 
*          - An timeout must be set before this step
*
* Change History: 
* Date(DD.MM.YY)        Author          Change info                                                          
*   
*  06.07.18              GrAn        Created and implemented
*  23.11.18              GrAn        Changed the comments for check part of the condition.
*  14.05.19              CrJu        Refactoring the code / Added new debug functions
*/

long lFctn_BUS_CheckSigValue4TimePhysical(Signal* aSignalName, dword aTimeToWaitForSignal, float aSignalValue, char aBusContext[], char aMappedResponseInfo[])
{
  long lResult;
  float fSignalValue;
  byte bResult_SetContext;
  dword dwResultChk;
  byte bDebugFlag;
  
  fSignalValue = 0;
  dwResultChk = NotOk;
  bResult_SetContext = NotOk;
  bDebugFlag = tsc_bBUS_GlobalDebugFlag;
  
  writeDbgLevel (DebugFuncCalls, "Function lFctn_BUS_CheckSigValue4TimePhysical called.");
  
  if( (byte)DebugFuncParam & bDebugFlag)
    writeDbgLevel (DebugFuncParam, "Parameters: Signal* aSignalName --%s--, dword aTimeToWaitForSignal --%d--, float aSignalValue --%u--, char aBusContext[] --%s-- ",aSignalName.name, aTimeToWaitForSignal,aSignalValue,aBusContext );  
  
  //Setting the bus Context
  bResult_SetContext = bFctn_BUS_SetContext(aBusContext);
 
  //Check if the bus context name is wrong
  if (bResult_SetContext == NotOk)
  {
    snprintf(aMappedResponseInfo, elcount(aMappedResponseInfo), "Error: The bus context name is wrong.");
    return Error;
  }
  
  //If the time to wait for signal is zero, return an error
  if (0 == aTimeToWaitForSignal)
  {
    snprintf(aMappedResponseInfo, elcount(aMappedResponseInfo), "Error: The time to wait for signal is zero.");
    return Error;
  }
  
  fSignalValue = getSignal(aSignalName);
  
  //if the signal does not have the expected value return an error
  if (aSignalValue != fSignalValue)
  {
    snprintf(aMappedResponseInfo, elcount(aMappedResponseInfo), "The signal value: %10.3f is different than the expected one: %10.3f.", fSignalValue, aSignalValue);
    return NotOk;
  }
  
  //if signal value has the exepected value, check if the signal value changes during aTimeToWaitForSignal ms
  dwResultChk = ChkStart_SignalValueChange (aSignalName);

  //check was created successfull
  if(dwResultChk)
  {
    //Check whether the specified condition was already broken (at least one time the condition was not fulfilled).
		TestAddCondition(dwResultChk);
	  //Wait the specified time
    TestWaitForTimeout(aTimeToWaitForSignal);
    
    if (0 == testCheckCondition(dwResultChk))  /*Condition was not broken (all checks were OK) */
    {
      //Remove the event object that was added as condition
      TestRemoveCondition(dwResultChk);
      snprintf(aMappedResponseInfo, elcount(aMappedResponseInfo), "The signal searched %s doesn't change his value %10.2f during %d ms.", aSignalName.name, aSignalValue, aTimeToWaitForSignal);
      return Ok;
    }
    else//Condition was broken (at least one time the condition was not fulfilled).
    {
      //Remove the event object that was added as condition
      TestRemoveCondition(dwResultChk);
      snprintf(aMappedResponseInfo, elcount(aMappedResponseInfo), "The signal searched %s has changed his value %10.2f during %d ms.", aSignalName.name, aSignalValue, aTimeToWaitForSignal);
      return NotOk;
    }
  }
	else//General Error
  {
    snprintf(aMappedResponseInfo, elcount(aMappedResponseInfo), "General Error!");
    return Error;
  }
}

/*! \fn long lFctn_BUS_CheckSigValue4TimeRaw(Signal* aSignalName, dword aTimeToWaitForSignal,dword aMsgCycleTime, int64 aSignalValue, char aMappedResponseInfo[])
*  \brief Function Wait and check if a raw signal value is not changing his value during a given time.
*  \param[in]  aSignalName          - Signal name from the database.
*  \param[in]  aTimeToWaitForSignal - Maximum time to be waited (if the value is 0 the function should get the first value of the signal)
*  \param[in]  aMsgCycleTime        - The message cycle time (from database)
*  \param[in]  aSignalValue         - The value that will be compared with the value of the signal.
*  \param[out] aMappedResponseInfo  - the information which is going to be printed in the report 
*
*  \return  0(NotOk) - if the signal does not have the expected value
*  \return  1(Ok)    - if the signal has the expected value
*  \return -1(Error) - the timeout provided is smaller than message cycle time or is zero / the message cycle time is zero
*
* Change History: 
* Date(DD.MM.YY)        Author          Change info                                                          
*   
*  06.07.18              GrAn        Created and implemented
*  04.12.18              GrAn        The function was rewritten. Some unneded code parts were removed. More comments were added.
*  14.05.19              CrJu        Refactoring the code / Added new debug functions
*/

long lFctn_BUS_CheckSigValue4TimeRaw(Signal* aSignalName, dword aTimeToWaitForSignal, dword aMsgCycleTime, int64 aSignalValue, char aMappedResponseInfo[])
{
  long lResult;
  int64 i64RawSignalValue;
  dword dwNoOfIteration;
  dword dwLastWaitTimeout;
  dword dwCheckIteration;
  byte bDebugFlag;
  
  //Initialization of local variables
  lResult = NotOk;
  i64RawSignalValue = 0;
  bDebugFlag = tsc_bBUS_GlobalDebugFlag;
  
  writeDbgLevel (DebugFuncCalls, "Function bFctn_BUS_CheckSigValue4TimeRaw called.");
  
  if( (byte)DebugFuncParam & bDebugFlag)
    writeDbgLevel (DebugFuncParam, "Parameters:  Signal* aSignalName --%s--, dword aTimeToWaitForSignal --%d--, dword aMsgCycleTime --%d--, int64 aSignalValue --%lld-- ",aSignalName.name, aTimeToWaitForSignal,aMsgCycleTime,aSignalValue);  
  
  //if the cycle time is bigger than time to wait for signal, return an error
  if ((aTimeToWaitForSignal > 0) && (aTimeToWaitForSignal < aMsgCycleTime))
  {
    snprintf(aMappedResponseInfo, elcount(aMappedResponseInfo), "Error: The cycle time is bigger than time to wait for signal.");
    return Error;
  }
  
  //if cycle time is zero, return an error
  if (0 == aMsgCycleTime)
  {
    snprintf(aMappedResponseInfo, elcount(aMappedResponseInfo), "Error: Cycle time is zero.");
    return Error;
  }
  
  //If aTimeToWaitForSignal is zero, return an error
  if (0 == aTimeToWaitForSignal)
  {
    snprintf(aMappedResponseInfo, elcount(aMappedResponseInfo), "Error: The time to wait for signal is zero.");
    return Error;
  }
  else//if aTimeToWaitForSignal is greater than zero
  {
    //How many cycle time checks iterations to wait for signal
    dwNoOfIteration = aTimeToWaitForSignal / aMsgCycleTime;
    
    //Last Timeout to be waited
    dwLastWaitTimeout = aTimeToWaitForSignal - (dwNoOfIteration * aMsgCycleTime);
    
    //Test the signal value every cycle time
    for (dwCheckIteration = 0; dwCheckIteration <= dwNoOfIteration; dwCheckIteration++ )
    {
      //Test the signal value every cycle time
      if (dwCheckIteration != dwNoOfIteration)
      {
        //Get the signal value
        i64RawSignalValue = getRawSignal(aSignalName);

        //Test that the signal value is the expected one or not
        if (i64RawSignalValue == aSignalValue)//the signal value is equal with given one as expected
        {
          //Success, remain in loop
          snprintf(aMappedResponseInfo, elcount(aMappedResponseInfo), "The signal searched %s doesn't change his raw value %lld during %d ms.", aSignalName.name, aSignalValue, aTimeToWaitForSignal);
          lResult = Ok;
        }
        else//the signal value is not equal with given one as not expected
        {
          //Not Ok, exit the function
          snprintf(aMappedResponseInfo, elcount(aMappedResponseInfo), "The signal searched %s has changed his raw value %lld during %d ms.", aSignalName.name, aSignalValue, aTimeToWaitForSignal);
          return NotOk;
        }
        
        //Wait for the message cycle time, to test the signal value again
        testWaitForTimeout(aMsgCycleTime);
      }
      else
      {
        //Wait for remaining time
        if (dwLastWaitTimeout != 0 )
        {
          //wait for last remaining time
          testWaitForTimeout(dwLastWaitTimeout);
        }
         
        //Get the signal value
        i64RawSignalValue = getRawSignal(aSignalName);
      
        //Test that the signal value is the expected one or not
        if (i64RawSignalValue == aSignalValue)//the signal value is equal with given one as expected
        {
          //Success
          snprintf(aMappedResponseInfo, elcount(aMappedResponseInfo), "The signal searched %s doesn't change his raw value %lld during %d ms.", aSignalName.name, aSignalValue, aTimeToWaitForSignal);
          lResult = Ok;
        }
        else//the signal value is not equal with given one as not expected
        {
          //Not Ok, exit the function
          snprintf(aMappedResponseInfo, elcount(aMappedResponseInfo), "The signal searched %s has changed his raw value %lld during %d ms.", aSignalName.name, aSignalValue, aTimeToWaitForSignal);
          return NotOk;
        }
      }
    }
  }
  
  return lResult;
}

/*! @}*/
/*! @}*/
/*!
*   \file
*   \ingroup controlLib
*   \brief Basic BUS functions that use CAPL primitive functions.
*/