/*@!Encoding:1252*/
/*!
* @defgroup cvDIAG cvDIAG
* @defgroup DIAGNOSTICS DIAGNOSTICS
* @ingroup controlLib
* @{
* @addtogroup cvDIAG
* @{
*/ 
variables
{ 
  byte  cv_bDiag_TimeoutFlag = 0; // linked to: bFctn_DIAGSetResponseTimeout function
  dword cv_dwDiag_RespTimeout = 2000; // inked to: bFctn_DIAGSetResponseTimeout function, default time to use to avoid 0
}


/*! @}*/
/*! @}*/
/*!
*   \file
*   \ingroup controlLib
*   \brief DIAG test control library variables.
*/