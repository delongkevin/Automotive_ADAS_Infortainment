/*@!Encoding:1252*/
includes
{ 
  #include "LIB_SA2.cin"
}

variables
{
  const long FLASHING_ODX_MAX_DATA_SIZE = 0xFFFFFF; // in bytes  
  const long FLASHING_MTU_SIZE = 1024;  // related to MAX_DIAG_REQ_SIZE
  const long FLASHING_MAX_BLOCK_AMOUNT = 3;
  
  struct OdxDataBlock
  {
    byte datablockId;
    dword crc32;
    char dbName[256];
    char flashdataId[256];
    long compressedSize;
    long uncompressedSize;
    byte compressMethod;
    char dataString[2*FLASHING_ODX_MAX_DATA_SIZE];
    byte rollingCounter;
    long bytesOffset;
    long bytesLeft;
  };
  
  struct ParsedOdx
  {
    char flashIdString[256];
    char ecuMemId[256];
    char sa2[256];
    char alfid[256];
    struct OdxDataBlock dataBlock[FLASHING_MAX_BLOCK_AMOUNT];
    byte dataBlockAmount;
  };
  
  struct ParsedOdx myOdx; // stuct for global usage, to avoid bigger memory usage
}

long _findStringBetweenStrings(long file, long revind, char str1[], char str2[], char output[])
{
  long firstOccurence, lastOccurence;
  char oneLine[2*FLASHING_ODX_MAX_DATA_SIZE];
  char regex[1024];
  
  if(revind) fileRewind(file);
  
  snprintf(regex, elcount(regex), "%s(.*)%s", str1, str2);
  firstOccurence = -1;
  lastOccurence = -1;
  while((firstOccurence == -1 ) && (fileGetString(oneLine,elcount(oneLine),file) == 1))
  {
    firstOccurence = strstr_regex(oneLine, regex);
    lastOccurence = strstr_regex(oneLine, str2);
  }
  if(firstOccurence != -1)
  {
    memcpy_off(output, 0, oneLine, firstOccurence+strlen(str1), lastOccurence-(firstOccurence+strlen(str1)));
    output[lastOccurence-(firstOccurence+strlen(str1))] = 0; // string null termination
    //write("output: '%s'", output);
  }  
  return firstOccurence;
}

void FlashingParseOdx(char path[], struct ParsedOdx odx)
{
  /* Currently support only for single block ODX */
  const long FPO_DEBUG = 0;
  
  long fileHandle;
  char regex[1024], foundString[1024];
  long idx;
  
  fileHandle = OpenFileRead(path,0);
  
  if ( fileHandle!=0 )
  {
    odx.dataBlockAmount = 0;
    
    _findStringBetweenStrings(fileHandle, 1, "<FLASH ID=\"", "\">", odx.flashIdString);
    if(FPO_DEBUG) write("odx.flashIdString: '%s'", odx.flashIdString);
    _findStringBetweenStrings(fileHandle, 1, "<ECU-MEM ID=\"", "\">", odx.ecuMemId);
    if(FPO_DEBUG) write("odx.ecuMemId: '%s'", odx.ecuMemId);    
    _findStringBetweenStrings(fileHandle, 1, "<SECURITY-METHOD TYPE=", "SA2</SECURITY-METHOD>", odx.sa2);    
    _findStringBetweenStrings(fileHandle, 0, "<FW-SIGNATURE TYPE=\"A_BYTEFIELD\">", "</FW-SIGNATURE>", odx.sa2);
    if(FPO_DEBUG) write("odx.sa2: '%s'", odx.sa2);    
    _findStringBetweenStrings(fileHandle, 1, "<SECURITY-METHOD TYPE=", "ALFID</SECURITY-METHOD>", odx.alfid);
    _findStringBetweenStrings(fileHandle, 0, "<FW-SIGNATURE TYPE=\"A_BYTEFIELD\">", "</FW-SIGNATURE>", odx.alfid);
    if(FPO_DEBUG) write("odx.alfid: '%s'", odx.alfid);
    
    while(_findStringBetweenStrings(fileHandle, 0, "<SECURITY-METHOD TYPE=", "CRC32</SECURITY-METHOD>", foundString) != -1 )
    {
      _findStringBetweenStrings(fileHandle, 0, "<FW-CHECKSUM TYPE=\"A_BYTEFIELD\">", "</FW-CHECKSUM>", foundString);
      snprintf(foundString, elCount(foundString), "0x%s", foundString); // convert to hex string
      strtoul(foundString, odx.dataBlock[odx.dataBlockAmount].crc32);
      if(FPO_DEBUG) write("odx.dataBlock[%d].crc32: '%X'", odx.dataBlockAmount, odx.dataBlock[0].crc32);
      _findStringBetweenStrings(fileHandle, 0, "<VALIDITY-FOR TYPE=\"A_ASCIISTRING\">", "</VALIDITY-FOR>", odx.dataBlock[odx.dataBlockAmount].dbName);
      if(FPO_DEBUG) write("odx.dataBlock[%d].dbName: '%s'", odx.dataBlockAmount, odx.dataBlock[odx.dataBlockAmount].dbName);    
      odx.dataBlockAmount++;
    }
    
    for(idx=0; idx<odx.dataBlockAmount; idx++)
    {
      snprintf(regex, elCount(regex), "<DATABLOCK ID=\"%s.%s", odx.ecuMemId, odx.dataBlock[idx].dbName);
      _findStringBetweenStrings(fileHandle, 1, regex, "\" TYPE=\"FLASH_DATA\">", foundString);
      _findStringBetweenStrings(fileHandle, 0, "<FLASHDATA-REF ID-REF=\"", "\"></FLASHDATA-REF>", odx.dataBlock[idx].flashdataId);
      if(FPO_DEBUG) write("odx.dataBlock[%d].flashdataId: '%s'", idx, odx.dataBlock[idx].flashdataId);  
      _findStringBetweenStrings(fileHandle, 0, "<SOURCE-START-ADDRESS>", "</SOURCE-START-ADDRESS", foundString);
      odx.dataBlock[idx].datablockId = atol(foundString);
      if(FPO_DEBUG) write("odx.dataBlock[%d].datablockId: '%02X'", idx, odx.dataBlock[idx].datablockId);
      _findStringBetweenStrings(fileHandle, 0, "<COMPRESSED-SIZE>", "</COMPRESSED-SIZE>", foundString);
      odx.dataBlock[idx].compressedSize = atol(foundString);
      if(FPO_DEBUG) write("odx.dataBlock[%d].compressedSize: '%d'", idx, odx.dataBlock[idx].compressedSize);
      _findStringBetweenStrings(fileHandle, 0, "<UNCOMPRESSED-SIZE>", "</UNCOMPRESSED-SIZE>", foundString);
      odx.dataBlock[idx].uncompressedSize = atol(foundString);
      if(FPO_DEBUG) write("odx.dataBlock[%d].uncompressedSize: '%d'", idx, odx.dataBlock[idx].uncompressedSize);
      snprintf(regex, elCount(regex), "<FLASHDATA ID=\"%s", odx.dataBlock[idx].flashdataId);
      _findStringBetweenStrings(fileHandle, 1, regex, "xsi:type=\"INTERN-FLASHDATA\">", foundString);
      _findStringBetweenStrings(fileHandle, 0, "<ENCRYPT-COMPRESS-METHOD TYPE=\"A_BYTEFIELD\">", "</ENCRYPT-COMPRESS-METHOD>", foundString);
      snprintf(foundString, elCount(foundString), "0x%s", foundString); // convert to hex string
      odx.dataBlock[idx].compressMethod = atol(foundString) & 0xFF;    
      if(FPO_DEBUG) write("odx.dataBlock[%d].compressMethod: '%02X'", idx, odx.dataBlock[idx].compressMethod);
      _findStringBetweenStrings(fileHandle, 0, "<DATA>", "</DATA>", odx.dataBlock[idx].dataString);    
      if(FPO_DEBUG) write("odx.dataBlock[%d].dataString (len: %d): '%s'", idx, strlen(odx.dataBlock[idx].dataString), odx.dataBlock[idx].dataString);
    }    
    fileClose (fileHandle);
  }
  else
  {
    write ("File '%s' was not opened for read access.", path);
  }
}

long FlashingDataTransfer(struct OdxDataBlock block, byte counter)
{
  char transferDataReq[32 + 3*FLASHING_MTU_SIZE]; // 32 for service ID + counter, rest is for data
  
  block.rollingCounter = counter;
  if(block.bytesLeft >= FLASHING_MTU_SIZE)
  {
    memcpy_off(transferDataReq, 0, block.dataString, 2*block.bytesOffset, 2*FLASHING_MTU_SIZE); // byte is stored on 2 chars
    transferDataReq[2*FLASHING_MTU_SIZE] = 0; // string null termination
  }
  else
  {
    memcpy_off(transferDataReq, 0, block.dataString, 2*block.bytesOffset, 2*block.bytesLeft); // byte is stored on 2 chars
    transferDataReq[2*block.bytesLeft] = 0; // string null termination
  }

  snprintf(transferDataReq, elCount(transferDataReq), "36 %02X %s", block.rollingCounter, transferDataReq);
  SendDiagRequestTS(MFK5, "Transfer data", transferDataReq, "76", "FF");
  
  block.bytesOffset += FLASHING_MTU_SIZE;  
  block.bytesLeft -= FLASHING_MTU_SIZE;
  if(block.bytesLeft >= 0)
  {
    block.rollingCounter++;
    return 1;
  }
  else
  {
    return 0;
  }
}

long FlashingDataTransferStart(struct OdxDataBlock block)
{
  block.bytesOffset = 0;
  block.bytesLeft = strlen(block.dataString)/2;
  return FlashingDataTransfer(block, 1);
}

long FlashingDataTransferContinue(struct OdxDataBlock block)
{
  return FlashingDataTransfer(block, block.rollingCounter);
}

void FlashingGetBootloaderSecurityAccess()
{
  dword sa_seed, sa_key;
  SendDiagRequestTS(MFK5, "Request Seed Bootloader", "27 11", "67 11 00 00 00 00", "FF FF 00 00 00 00");
  sa_seed = (MFK5.diagResp[2] << 24) + (MFK5.diagResp[3] << 16) + (MFK5.diagResp[4] << 8) + MFK5.diagResp[5];
  SA2CalculateKey(myOdx.sa2, sa_seed, sa_key);  
  snprintf(stepTemporaryString, elCount(stepTemporaryString), "27 12 %02X %02X %02X %02X", (sa_key >> 24) & 0xFF, (sa_key >> 16) & 0xFF, (sa_key >> 8) & 0xFF, (sa_key >> 0) & 0xFF);
  SendDiagRequestTS(MFK5, "Send Key Bootloader", stepTemporaryString, "67 12", "FF FF");
}

void FlashingWriteFingerprint(byte year, byte month, byte day, dword vwDeviceNumber, dword importerNumber, dword workshopNumber)
{
  qword num, tmp;
  
  num = 0;
  tmp = 0;
  
  tmp = vwDeviceNumber & 0x1FFFFF;  // 21 bits
  num |= tmp << 27;                 // 17 + 10
  
  tmp = importerNumber & 0x3FF;     // 10 bits
  num |= tmp << 17;                 // 17
  
  tmp = workshopNumber & 0x1FFFF;   // 17 bits
  num |= tmp;
  
  snprintf(stepTemporaryString, elCount(stepTemporaryString), "2E F1 5A %02d %02d %02d %02I64X %02I64X %02I64X %02I64X %02I64X %02I64X", year % 99, month % 99, day % 99, (num >> 40) & 0xFF, (num >> 32) & 0xFF, (num >> 24) & 0xFF, (num >> 16) & 0xFF, (num >> 8) & 0xFF, (num >> 0) & 0xFF);
  SendDiagRequestTS(MFK5, "Write Fingerprint", stepTemporaryString, "6E F1 5A", "FF FF FF");
}

void FlashingWriteFingerprintActualDate(dword vwDeviceNumber, dword importerNumber, dword workshopNumber)
{
  long tm[9];
  getLocalTime(tm);
  
  FlashingWriteFingerprint(tm[5]-100, tm[4]+1, tm[3], vwDeviceNumber, importerNumber, workshopNumber);
}

void FlashingWriteFingerprintActualDateDefaultNumbers()
{
  FlashingWriteFingerprintActualDate(100, 200, 300);
}

void FlashingPreconditions()
{  
  SendDiagRequestTS(MFK5, "Enter Extended Session", "10 03", "50 03", "FF FF");
  SendDiagRequestTS(MFK5, "Start Routine - Check Programming Preconditions", "31 01 02 03", "71 01 02 03", "FF FF FF FF");
  SendDiagRequestTS(MFK5, "Enter Programming Session", "10 02", "50 02", "FF FF");
  FlashingGetBootloaderSecurityAccess();
  FlashingWriteFingerprintActualDateDefaultNumbers();
  diagStopTesterPresent();
}

void FlashingEraseMemory(struct OdxDataBlock block)
{
  snprintf(stepTemporaryString, elCount(stepTemporaryString), "31 01 FF 00 01 %02X", block.datablockId);  // last byte of req is block ID
  SendDiagRequestTS(MFK5, "Start Routine - Erase Memory", stepTemporaryString, "71 01 FF 00 00", "FF FF FF FF FF");
}

void FlashingRequestDownload(struct OdxDataBlock block)
{
  snprintf(stepTemporaryString, elCount(stepTemporaryString), "34 %02X 41 %02X %02X %02X %02X %02X", block.compressMethod, block.datablockId, (block.uncompressedSize >> 24) & 0xFF, (block.uncompressedSize >> 16) & 0xFF, (block.uncompressedSize >> 8) & 0xFF, (block.uncompressedSize >> 0) & 0xFF); // 34 xx 41 yy zz zz zz zz -> xx - compression/encrypt, yy - block ID, zz - uncompressed size
  SendDiagRequestTS(MFK5, "Request Download", stepTemporaryString, "74", "FF");
}

void FlashingBlockPostconditions(struct OdxDataBlock block)
{
  SendDiagRequestTS(MFK5, "Request Transfer Exit", "37", "77", "FF");
  snprintf(stepTemporaryString, elCount(stepTemporaryString), "31 01 02 02 %02X %02X %02X %02X", (block.crc32 >> 24) & 0xFF, (block.crc32 >> 16) & 0xFF, (block.crc32 >> 8) & 0xFF, (block.crc32 >> 0) & 0xFF );  // 4 last bytes of req is CRC32
  SendDiagRequestTS(MFK5, "Start Routine - Check Memory", stepTemporaryString, "71 01 02 02 00", "FF FF FF FF FF"); 
}

void FlashingPostconditions()
{
  SendDiagRequestTS(MFK5, "Start Routine - Check Programming Dependencies", "31 01 FF 01", "71 01 FF 01 00", "FF FF FF FF FF");
  SendDiagRequestTS(MFK5, "Reset ECU", "11 01", "51 01", "FF FF");
  testWaitForTimeout(5*1000);
  SendDiagRequestTS(MFK5, "Enter Default Session", "10 01", "50 01", "FF FF");
}