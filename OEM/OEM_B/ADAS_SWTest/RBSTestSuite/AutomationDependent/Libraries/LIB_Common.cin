/*@!Encoding:1252*/
/*
   LIB Common  - collection of usefull functions for i.e. tests.
   All tests should have included this library - other needed libraries are already included (i.e. diagnostic or bench controll).

   Last modification: 16 Jun 2020
              Author: Radoslaw Karasinski
*/
includes
{
  #include "LIB_Diagnostic.cin"
  #include "LIB_Flashing.cin"
  #include "LIB_Test_Bench_Control.cin"
}

variables
{
  const long MAX_WAITING_TIME_FOR_VISION_MS = 40*1000;  
  const long LDA_TIMESTAMP_UPDATE_WAIT_VALUE = 100;
  
  enum ValueBoundaryCheck
  {
    BOUNDARY_LEFT_OPEN_RIGHT_OPEN,
    BOUNDARY_LEFT_OPEN_RIGHT_CLOSED,
    BOUNDARY_LEFT_CLOSED_RIGHT_OPEN,
    BOUNDARY_LEFT_CLOSED_RIGHT_CLOSED
  };
}

testcase Stop_CANoe(char TestDescription[], char TestRequirements[], char TestParameters[])
{
  stop();
}

void TestWaitTS(long timeout)
{
  if(timeout>0)
  {
    ReportStep();
    snprintf(stepTemporaryString, elCount(stepTemporaryString), "Wait %d milliseconds.", timeout);
    ReportAction(stepTemporaryString);
    
    testWaitForTimeout(timeout);
  }
}

void SetSpeedValueMeterPerSecondsTS(float speedMeterPerSeconds)
{
  ReportStep();
  snprintf(stepTemporaryString, elCount(stepTemporaryString), "Set speed value to %.02f m/s.", speedMeterPerSeconds);
  ReportAction(stepTemporaryString);
  snprintf(stepTemporaryString, elCount(stepTemporaryString), "Speed value should be set to %.02f m/s.", speedMeterPerSeconds);
  ReportExpected(stepTemporaryString);
  @MEnv_VDSOVx3dXIXVDSO05XIXVLANFAS_SET_FLT_1 = speedMeterPerSeconds;
  testWaitForTimeout(100);
  
  snprintf(stepTemporaryString, elCount(stepTemporaryString), "Speed value was set to %.02f m/s.", @MEnv_VDSOVx3dXIXVDSO05XIXVLANFAS_GET_FLT_1);
  if(CompareFloatsWithAccuracy(speedMeterPerSeconds, @MEnv_VDSOVx3dXIXVDSO05XIXVLANFAS_GET_FLT_1, PERCENTAGE_ACCURACY))
  {
    ReportObservedPassed(stepTemporaryString);    
  }
  else
  {
    ReportObservedFailed(stepTemporaryString);
  }  
}

void SetSpeedValueKilometersPerHourTS(float speedKilometersPerHour)
{
  SetSpeedValueMeterPerSecondsTS(0.277777778 * speedKilometersPerHour);
}

void SetYawRateTS(float yaw_rate)
{
  ReportStep();
  snprintf(stepTemporaryString, elCount(stepTemporaryString), "Set yaw rate to %.04f rad/s.", yaw_rate);
  ReportAction(stepTemporaryString);
  snprintf(stepTemporaryString, elCount(stepTemporaryString), "Yaw rate value should be set to %.04f rad/s.", yaw_rate);
  ReportExpected(stepTemporaryString);
  $VDSO_AgvYawRateOfsCmp_XIX_VDSO_07_XIX_VLAN_FAS = yaw_rate;
  testWaitForTimeout(100);
  
  snprintf(stepTemporaryString, elCount(stepTemporaryString), "Yaw rate value was set to %.04f rad/s.", $VDSO_AgvYawRateOfsCmp_XIX_VDSO_07_XIX_VLAN_FAS);
  if(CompareFloatsWithAccuracy(yaw_rate, $VDSO_AgvYawRateOfsCmp_XIX_VDSO_07_XIX_VLAN_FAS, PERCENTAGE_ACCURACY))
  {
    ReportObservedPassed(stepTemporaryString);    
  }
  else
  {
    ReportObservedFailed(stepTemporaryString);
  }  
}

void SetLatAccelTS(float lat)
{
  ReportStep();
  snprintf(stepTemporaryString, elCount(stepTemporaryString), "Set lattitude acceleration to %.04f m/s^2.", lat);
  ReportAction(stepTemporaryString);
  snprintf(stepTemporaryString, elCount(stepTemporaryString), "Lattitude acceleration value should be set to %.04f m/s^2.", lat);
  ReportExpected(stepTemporaryString);
  $VDSO_ALatOfsCmp_XIX_VDSO_02_XIX_VLAN_FAS = lat;
  testWaitForTimeout(100);
  
  snprintf(stepTemporaryString, elCount(stepTemporaryString), "Lattitude acceleration value was set to %.04f m/s^2.", $VDSO_ALatOfsCmp_XIX_VDSO_02_XIX_VLAN_FAS);
  if(CompareFloatsWithAccuracy(lat, $VDSO_ALatOfsCmp_XIX_VDSO_02_XIX_VLAN_FAS, PERCENTAGE_ACCURACY))
  {
    ReportObservedPassed(stepTemporaryString);    
  }
  else
  {
    ReportObservedFailed(stepTemporaryString);
  }  
}

void CheckIfEcuInVisionViaDiagnosticTS()
{
  SendDiagRequestTS(MFK5, "Enter Extended Session", "10 03", "50 03 00 32 01 F4", "FF FF FF FF FF FF");
  SendDiagRequestTS(MFK5, "Check if ECU is in VISION mode.", "22 10 00", "62 10 00 02", "FF FF FF FF");
}

//long CheckIfEcuInVisionViaEthernetSignals()
//{
//  // return 1 if is in VISION, 0 if not
//  //const long MAX_TIMEOUT = 1000;
//  
//  //setSignalStartValues(LDA_FC1_XIX_VLAN_FAS);
//  //testWaitForSignalInRange(LDA_FC1_TimestampSeconds_XIX_LDA_FC1_XIX_VLAN_FAS, 0, LDA_FC1_TimestampSeconds_XIX_LDA_FC1_XIX_VLAN_FAS.DefaultValue - 2, MAX_TIMEOUT);
//  return $LDA_FC1_TimestampSeconds_XIX_LDA_FC1_XIX_VLAN_FAS != 0xFFFFFFFFFFFCLL;
//}

/*
long CheckIfEcuInVisionViaEthernetSignals()
{
  // return 1 if is in VISION, 0 if not
  dword prevValue; 
  
  prevValue = $LDA_FC1_TimestampNanoseconds_XIX_LDA_FC1_XIX_VLAN_FAS.raw;
  testWaitForTimeout(LDA_TIMESTAMP_UPDATE_WAIT_VALUE);  // wait for signal update
  if( ($LDA_FC1_TimestampNanoseconds_XIX_LDA_FC1_XIX_VLAN_FAS.raw != LDA_FC1_TimestampNanoseconds_XIX_LDA_FC1_XIX_VLAN_FAS.DefaultValue) &&
      ($LDA_FC1_TimestampNanoseconds_XIX_LDA_FC1_XIX_VLAN_FAS.raw != prevValue) )
  {
    return 1; // ECU in VISION
  }
  
  return 0; // ECU not in VISION
}
*/
long CheckIfEcuInVisionViaEthernetSignals()
{
  // return 1 if is in VISION, 0 if not
  dword prevValue; 
  
  prevValue = $WLA_FC1_TimestampNanoseconds_XIX_WLA_FC1_Obj_Header_XIX_VLAN_FAS.raw;
  testWaitForTimeout(LDA_TIMESTAMP_UPDATE_WAIT_VALUE);  // wait for signal update
  if( ($WLA_FC1_TimestampNanoseconds_XIX_WLA_FC1_Obj_Header_XIX_VLAN_FAS.raw != WLA_FC1_TimestampNanoseconds_XIX_WLA_FC1_Obj_Header_XIX_VLAN_FAS.DefaultValue) &&
      ($WLA_FC1_TimestampNanoseconds_XIX_WLA_FC1_Obj_Header_XIX_VLAN_FAS.raw != prevValue) )
  {
    return 1; // ECU in VISION
  }
  
  return 0; // ECU not in VISION
}

long TestWaitForEnteringVision(long timeout)
{
  // function return 1 if reached VISION in defined time, or 0 if it don't entered
  
  float startTime;
  
  startTime = timeNowFloat()/100.0;  
  while(timeNowFloat()/100.0 - startTime < timeout)
  {    
    if(CheckIfEcuInVisionViaEthernetSignals())
    {
      return 1;
    }
    testWaitForTimeout(1);
  }
  return 0;  
}

long TestWaitForEnteringVision()
{
  return TestWaitForEnteringVision(MAX_WAITING_TIME_FOR_VISION_MS);
}

long TestWaitForEnteringVisionTS(long timeout)
{
  // function return 1 if reached VISION in defined time, or 0 if it don't entered
  float checkingStartTime;
  
  ReportStep();
  snprintf(stepTemporaryString, elCount(stepTemporaryString), "Wait maximum %d ms untill ECU will enter VISION.", timeout);
  ReportAction(stepTemporaryString);
  snprintf(stepTemporaryString, elCount(stepTemporaryString), "ECU should enter VISION in %d ms.", timeout);
  ReportExpected(stepTemporaryString);
  
  checkingStartTime = timeNowFloat()/100.0;
  if(TestWaitForEnteringVision(timeout))
  {
    snprintf(stepTemporaryString, elCount(stepTemporaryString), "ECU entered VISION in %d ms.", (long)((timeNowFloat()/100.0)-checkingStartTime));
    ReportObservedPassed(stepTemporaryString);    
    return 1;
  }
  else
  {
    snprintf(stepTemporaryString, elCount(stepTemporaryString), "ECU didn't entered VISION in %d ms.", timeout);
    ReportObservedFailed(stepTemporaryString);
    return 0;
  }
}

long TestWaitForEnteringVisionTS()
{
  return TestWaitForEnteringVisionTS(MAX_WAITING_TIME_FOR_VISION_MS);
}

void TestWaitForEnteringVisionWithResetsTS()
{
  float checkingStartTime;
  long visionEnteringTime;
  
  ReportStep();
  ReportAction("Wait untill ECU will enter VISION (reset KL30 if needed).");
  ReportExpected("ECU should enter VISION");
  
  checkingStartTime = timeNowFloat()/100.0;
  while(TestWaitForEnteringVision() == 0)
  {
    KL30ResetTS();
  }
  
  visionEnteringTime = (long)((timeNowFloat()/100.0)-checkingStartTime);
  
  if(visionEnteringTime == LDA_TIMESTAMP_UPDATE_WAIT_VALUE)
  {
    snprintf(stepTemporaryString, elCount(stepTemporaryString), "ECU was already in VISION.");
  }
  else
  {
    snprintf(stepTemporaryString, elCount(stepTemporaryString), "ECU entered VISION in %d ms.", visionEnteringTime);
  }
  ReportObservedPassed(stepTemporaryString);   
}

/*
long TestWaitForRawSignalMatch(signal * sig, int64 expectedValue, dword maxTimeout)
{
  float startTimeMs, endTimeMs;
  
  startTimeMs = timeNowFloat()/100.0;   
  while((getRawSignal(sig) != expectedValue)  && (((timeNowFloat()/100.0)-startTimeMs) < maxTimeout)) // wait until signal will reach expected value
  {
    testWaitForTimeout(1);
  }
  endTimeMs = timeNowFloat()/100.0;
  
  if((endTimeMs-startTimeMs) < maxTimeout)
  {
    if(getRawSignal(sig) == expectedValue)
    {
      return 1; // Wait state is exited due to condition fulfillment
    }
    else
    {
      return -2;  // Signal is not valid  
    }
  }
  else
  {
    return 0; // Wait state is exited due to a timeout
  }
}
*/

long TestWaitForRawSignalInRange(signal * sig, int64 lowLimit, int64 highLimit, dword maxTimeout)
{
  float startTimeMs, endTimeMs;
  
  startTimeMs = timeNowFloat()/100.0;
  while( ((timeNowFloat()/100.0)-startTimeMs) < maxTimeout )
  {
    if(((getRawSignal(sig) >= lowLimit) && (getRawSignal(sig) <= highLimit)))
    {
      break;
    }
    testWaitForTimeout(1);
  }    
  endTimeMs = timeNowFloat()/100.0;
  
  if((endTimeMs-startTimeMs) < maxTimeout)
  {
    if((lowLimit <= getRawSignal(sig)) && (getRawSignal(sig) <= highLimit))
    {
      return 1; // Wait state is exited due to condition fulfillment
    }
    else
    {
      return -2;  // Signal is not valid  
    }
  }
  else
  {
    return 0; // Wait state is exited due to a timeout
  }
}






long TestWaitForValueInRangeSig(signal * sig, int64 minValue, int64 maxValue, long maxTimeout, long boundary)
{
  float startTimeMs;
  long shouldBreak;
  int64 tmpVal;
  
  
  if(maxTimeout < 0)
  {
    maxTimeout = 0;
  }
  shouldBreak = 0;
  startTimeMs = timeNowFloat()/100.0;
  
  while(((timeNowFloat()/100.0)-startTimeMs) < maxTimeout )
  {
    tmpVal = getRawSignal(sig);
    switch(boundary)
    {
      case BOUNDARY_LEFT_OPEN_RIGHT_OPEN:    if(((tmpVal > minValue) && (tmpVal < maxValue))) { shouldBreak = 1; } break;
      case BOUNDARY_LEFT_OPEN_RIGHT_CLOSED: if(((tmpVal > minValue) && (tmpVal <= maxValue))) { shouldBreak = 1; } break;
      case BOUNDARY_LEFT_CLOSED_RIGHT_OPEN:  if(((tmpVal >= minValue) && (tmpVal < maxValue))) { shouldBreak = 1; } break;        
      default:
      case BOUNDARY_LEFT_CLOSED_RIGHT_CLOSED:  if(((tmpVal >= minValue) && (tmpVal <= maxValue))) { shouldBreak = 1; } break;
    }
    
    if(shouldBreak)
    {
      return 1;
    }
    
    testWaitForTimeout(1);
  }
  return 0;
}

long TestWaitForValueInRangeSysVarInt(sysvarInt  * sVar, int64 minValue, int64 maxValue, long maxTimeout, long boundary)
{
  float startTimeMs;
  long shouldBreak;
  int64 tmpVal;
  
  if(maxTimeout < 0)
  {
    maxTimeout = 0;
  }
  shouldBreak = 0;
  startTimeMs = timeNowFloat()/100.0;
   
  while(((timeNowFloat()/100.0)-startTimeMs) < maxTimeout )
  {
    tmpVal = @sVar;
    switch(boundary)
    {
      case BOUNDARY_LEFT_OPEN_RIGHT_OPEN:    if(((tmpVal > minValue) && (tmpVal < maxValue))) { shouldBreak = 1; } break;
      case BOUNDARY_LEFT_OPEN_RIGHT_CLOSED: if(((tmpVal > minValue) && (tmpVal <= maxValue))) { shouldBreak = 1; } break;
      case BOUNDARY_LEFT_CLOSED_RIGHT_OPEN:  if(((tmpVal >= minValue) && (tmpVal < maxValue))) { shouldBreak = 1; } break;        
      default:
      case BOUNDARY_LEFT_CLOSED_RIGHT_CLOSED:  if(((tmpVal >= minValue) && (tmpVal <= maxValue))) { shouldBreak = 1; } break;
    }
    
    if(shouldBreak)
    {
      return 1;
    }
    
    testWaitForTimeout(1);
  }
  return 0;
}

long TestWaitForValueInRangeSysVarLongLong(sysvarLongLong  * sVar, int64 minValue, int64 maxValue, long maxTimeout, long boundary)
{
  float startTimeMs;
  long shouldBreak;
  int64 tmpVal;
  
  if(maxTimeout < 0)
  {
    maxTimeout = 0;
  }
  shouldBreak = 0;
  startTimeMs = timeNowFloat()/100.0;
      
  while(((timeNowFloat()/100.0)-startTimeMs) < maxTimeout )
  {
    tmpVal = @sVar;
    switch(boundary)
    {
      case BOUNDARY_LEFT_OPEN_RIGHT_OPEN:    if(((tmpVal > minValue) && (tmpVal < maxValue))) { shouldBreak = 1; } break;
      case BOUNDARY_LEFT_OPEN_RIGHT_CLOSED: if(((tmpVal > minValue) && (tmpVal <= maxValue))) { shouldBreak = 1; } break;
      case BOUNDARY_LEFT_CLOSED_RIGHT_OPEN:  if(((tmpVal >= minValue) && (tmpVal < maxValue))) { shouldBreak = 1; } break;        
      default:
      case BOUNDARY_LEFT_CLOSED_RIGHT_CLOSED:  if(((tmpVal >= minValue) && (tmpVal <= maxValue))) { shouldBreak = 1; } break;
    }
    
    if(shouldBreak)
    {
      return 1;
    }
    
    testWaitForTimeout(1);
  }
  return 0;
}

long TestWaitForValueInRangeSysVarFloat(sysvarFloat * sVar, float minValue, float maxValue, long maxTimeout, long boundary)
{
  float startTimeMs;
  long shouldBreak;
  float tmpVal;
  
  if(maxTimeout < 0)
  {
    maxTimeout = 0;
  }
  shouldBreak = 0;
  startTimeMs = timeNowFloat()/100.0;
      
  while(((timeNowFloat()/100.0)-startTimeMs) < maxTimeout )
  {
    tmpVal = @sVar;
    switch(boundary)
    {
      case BOUNDARY_LEFT_OPEN_RIGHT_OPEN:    if(((tmpVal > minValue) && (tmpVal < maxValue))) { shouldBreak = 1; } break;
      case BOUNDARY_LEFT_OPEN_RIGHT_CLOSED: if(((tmpVal > minValue) && (tmpVal <= maxValue))) { shouldBreak = 1; } break;
      case BOUNDARY_LEFT_CLOSED_RIGHT_OPEN:  if(((tmpVal >= minValue) && (tmpVal < maxValue))) { shouldBreak = 1; } break;        
      default:
      case BOUNDARY_LEFT_CLOSED_RIGHT_CLOSED:  if(((tmpVal >= minValue) && (tmpVal <= maxValue))) { shouldBreak = 1; } break;
    }
    
    if(shouldBreak)
    {
      return 1;
    }
    
    testWaitForTimeout(1);
  }
  return 0;
}

void AddToReportValueInRangeIntTS(char sVarName[], int64 minValue, int64 maxValue, long maxTimeout, long settingTime, int64 value, long verdict)
{  
  ReportStep();
  snprintf(stepTemporaryString, elCount(stepTemporaryString), "Check value of signal %s.", sVarName);
  ReportAction(stepTemporaryString);
  snprintf(stepTemporaryString, elCount(stepTemporaryString), "Signal %s should be in range (%lld - %lld).", sVarName, minValue, maxValue);
  ReportExpected(stepTemporaryString);
  snprintf(stepTemporaryString, elCount(stepTemporaryString), "Signal %s is set to %lld", sVarName, value);
  if(verdict)
  {
    if((maxTimeout > 0) && (settingTime > 0))
    {
      snprintf(stepTemporaryString, elCount(stepTemporaryString), "%s (was set after %d ms)", stepTemporaryString, settingTime);
    }
    strncat(stepTemporaryString, ".", elCount(stepTemporaryString)); 
    ReportObservedPassed(stepTemporaryString);    
  }
  else
  {
    strncat(stepTemporaryString, ".", elCount(stepTemporaryString)); 
    ReportObservedFailed(stepTemporaryString);
  }
}

void AddToReportValueInRangeFloatTS(char sVarName[], float minValue, float maxValue, long maxTimeout, long settingTime, float value, long verdict)
{  
  ReportStep();
  snprintf(stepTemporaryString, elCount(stepTemporaryString), "Check value of signal %s.", sVarName);
  ReportAction(stepTemporaryString);
  snprintf(stepTemporaryString, elCount(stepTemporaryString), "Signal %s should be in range (%.03f - %.03f).", sVarName, minValue, maxValue);
  ReportExpected(stepTemporaryString);
  snprintf(stepTemporaryString, elCount(stepTemporaryString), "Signal %s is set to %.03f", sVarName, value);
  if(verdict)
  {
    if((maxTimeout > 0) && (settingTime > 0))
    {
      snprintf(stepTemporaryString, elCount(stepTemporaryString), "%s (was set after %d ms)", stepTemporaryString, settingTime);
    }
    strncat(stepTemporaryString, ".", elCount(stepTemporaryString)); 
    ReportObservedPassed(stepTemporaryString);    
  }
  else
  {
    strncat(stepTemporaryString, ".", elCount(stepTemporaryString)); 
    ReportObservedFailed(stepTemporaryString);
  }
}

void TestWaitForValueInRangeSigTS(signal * sig, int64 minValue, int64 maxValue, long maxTimeout, long boundary)
{
  int64 tmpSignalValue;
  float startTimeMs, endTimeMs;
  long settingTime, ret;
  
  startTimeMs = timeNowFloat()/100.0;
  ret = TestWaitForValueInRangeSig(sig, minValue, maxValue, maxTimeout, boundary);
  endTimeMs = timeNowFloat()/100.0;
  
  settingTime = endTimeMs - startTimeMs;
  AddToReportValueInRangeIntTS(sig.name, minValue, maxValue, maxTimeout, settingTime, getRawSignal(sig), ret);
}

void TestWaitForValueInRangeSigTS(signal * sig, int64 minValue, int64 maxValue, long maxTimeout)
{
  TestWaitForValueInRangeSigTS(sig, minValue, maxValue, maxTimeout, BOUNDARY_LEFT_CLOSED_RIGHT_CLOSED);
}

void TestWaitForValueInRangeSysVarIntTS(sysvarInt * sVar, int64 minValue, int64 maxValue, long maxTimeout, long boundary)
{
  int64 tmpSignalValue;
  float startTimeMs, endTimeMs;
  long settingTime, ret;
  
  startTimeMs = timeNowFloat()/100.0;
  ret = TestWaitForValueInRangeSysVarInt(sVar, minValue, maxValue, maxTimeout, boundary);
  endTimeMs = timeNowFloat()/100.0;
  
  settingTime = endTimeMs - startTimeMs;
  AddToReportValueInRangeIntTS(sVar.name, minValue, maxValue, maxTimeout, settingTime, @sVar, ret);
}

void TestWaitForValueInRangeSysVarIntTS(sysvarInt * sVar, int64 minValue, int64 maxValue, long maxTimeout)
{
  TestWaitForValueInRangeSysVarIntTS(sVar, minValue, maxValue, maxTimeout, BOUNDARY_LEFT_CLOSED_RIGHT_CLOSED);
}

void TestWaitForValueInRangeSysVarLongLongTS(sysvarLongLong * sVar, int64 minValue, int64 maxValue, long maxTimeout, long boundary)
{
  int64 tmpSignalValue;
  float startTimeMs, endTimeMs;
  long settingTime, ret;
  
  startTimeMs = timeNowFloat()/100.0;
  ret = TestWaitForValueInRangeSysVarLongLong(sVar, minValue, maxValue, maxTimeout, boundary);
  endTimeMs = timeNowFloat()/100.0;
  
  settingTime = endTimeMs - startTimeMs;
  AddToReportValueInRangeIntTS(sVar.name, minValue, maxValue, maxTimeout, settingTime, @sVar, ret);
}

void TestWaitForValueInRangeSysVarLongLongTS(sysvarLongLong  * sVar, int64 minValue, int64 maxValue, long maxTimeout)
{
  TestWaitForValueInRangeSysVarLongLongTS(sVar, minValue, maxValue, maxTimeout, BOUNDARY_LEFT_CLOSED_RIGHT_CLOSED);
}

void TestWaitForValueInRangeSysVarFloatTS(sysvarFloat * sVar, float minValue, float maxValue, long maxTimeout, long boundary)
{
  float startTimeMs, endTimeMs;
  long settingTime, ret;
  
  startTimeMs = timeNowFloat()/100.0;
  ret = TestWaitForValueInRangeSysVarFloat(sVar, minValue, maxValue, maxTimeout, boundary);
  endTimeMs = timeNowFloat()/100.0;
  
  settingTime = endTimeMs - startTimeMs;
  AddToReportValueInRangeIntTS(sVar.name, minValue, maxValue, maxTimeout, settingTime, @sVar, ret);
}

void TestWaitForValueInRangeSysVarFloatTS(sysvarFloat * sVar, float minValue, float maxValue, long maxTimeout)
{
  TestWaitForValueInRangeSysVarFloatTS(sVar, minValue, maxValue, maxTimeout, BOUNDARY_LEFT_CLOSED_RIGHT_CLOSED);
}

void CheckSigValueEqualTS(char varName[], int64 expectedValue, long maxTimeout, long settingTime, int64 value)
{
  ReportStep();
  snprintf(stepTemporaryString, elCount(stepTemporaryString), "Check value of signal %s.", varName);
  ReportAction(stepTemporaryString);
  snprintf(stepTemporaryString, elCount(stepTemporaryString), "Signal %s should be set to %lld.", varName, expectedValue);
  ReportExpected(stepTemporaryString);
  snprintf(stepTemporaryString, elCount(stepTemporaryString), "Signal %s is set to %lld", varName, value);
  if(value == expectedValue)
  {
    if((maxTimeout > 0) && (settingTime > 0))
    {
      snprintf(stepTemporaryString, elCount(stepTemporaryString), "%s (was set after %d ms)", stepTemporaryString, settingTime);
    }
    strncat(stepTemporaryString, ".", elCount(stepTemporaryString)); 
    ReportObservedPassed(stepTemporaryString);    
  }
  else
  {
    strncat(stepTemporaryString, ".", elCount(stepTemporaryString)); 
    ReportObservedFailed(stepTemporaryString);
  } 
}

void TestWaitForValueSigTS(signal * sig, int64 expectedValue, long maxTimeout)
{
  float startTimeMs, endTimeMs;
  long settingTime;
  
  startTimeMs = timeNowFloat()/100.0;
  TestWaitForRawSignalMatch(sig, expectedValue, maxTimeout);
  endTimeMs = timeNowFloat()/100.0;
  
  settingTime = endTimeMs - startTimeMs;
  CheckSigValueEqualTS(sig.name, expectedValue, maxTimeout, settingTime, GetRawSignal(sig));
}

void TestWaitForValueSigByDescriptionTS(signal * sig, char value[], long maxTimeout)
{
  int64 tmpSignalValue;
  getSignalValueForDescription(sig, value, tmpSignalValue);  
  TestWaitForValueSigTS(sig, tmpSignalValue, maxTimeout); 
}

void TestWaitForValueSysVarIntTS(sysvarInt * sVar, int64 expectedValue, long maxTimeout)
{
  float startTimeMs, endTimeMs;
  long settingTime;
  
  startTimeMs = timeNowFloat()/100.0;
  /*
  if(maxTimeout > 0)
  {    
    while((@sVar != expectedValue)  && (((timeNowFloat()/100.0)-startTimeMs) < maxTimeout)) // wait until signal will reach expected value
    {
      testWaitForTimeout(1);
    }    
  }
  */
  TestWaitForValueInRangeSysVarIntTS(sVar, expectedValue, expectedValue, maxTimeout);
  endTimeMs = timeNowFloat()/100.0;
  
  settingTime = endTimeMs - startTimeMs;
  CheckSigValueEqualTS(sVar.name, expectedValue, maxTimeout, settingTime, @sVar);  
}

void TestWaitForValueSysVarLongLongTS(sysvarLongLong * sVar, int64 expectedValue, long maxTimeout)
{
  float startTimeMs, endTimeMs;
  long settingTime;
  
  startTimeMs = timeNowFloat()/100.0;
  /*
  if(maxTimeout > 0)
  {    
    while((@sVar != expectedValue)  && (((timeNowFloat()/100.0)-startTimeMs) < maxTimeout)) // wait until signal will reach expected value
    {
      testWaitForTimeout(1);
    }    
  }
  */
  TestWaitForValueInRangeSysVarLongLongTS(sVar, expectedValue, expectedValue, maxTimeout);
  endTimeMs = timeNowFloat()/100.0;
  
  settingTime = endTimeMs - startTimeMs;
  CheckSigValueEqualTS(sVar.name, expectedValue, maxTimeout, settingTime, @sVar);  
}

void TestWaitForValueSysVarFloatTS(sysvarFloat * sVar, float expectedValue, long maxTimeout)
{
  float startTimeMs, endTimeMs;
  long settingTime;
  
  startTimeMs = timeNowFloat()/100.0;
  /*
  if(maxTimeout > 0)
  {    
    while((@sVar != expectedValue)  && (((timeNowFloat()/100.0)-startTimeMs) < maxTimeout)) // wait until signal will reach expected value
    {
      testWaitForTimeout(1);
    }    
  }
  */
  TestWaitForValueInRangeSysVarFloatTS(sVar, expectedValue, expectedValue, maxTimeout);
  endTimeMs = timeNowFloat()/100.0;
  
  settingTime = endTimeMs - startTimeMs;
  CheckSigValueEqualTS(sVar.name, expectedValue, maxTimeout, settingTime, @sVar);  
}


void TestSetSignalTS(signal * sig, float setSigValue, long timeoutMs)
{
  float getSigValue;
  
  ReportStep();
  snprintf(stepTemporaryString, elCount(stepTemporaryString), "Set signal %s value to %.05f.", sig.name, setSigValue);
  ReportAction(stepTemporaryString);
  snprintf(stepTemporaryString, elCount(stepTemporaryString), "Signal %s should be set to %.05f.", sig.name, setSigValue);
  ReportExpected(stepTemporaryString);
  $sig = setSigValue;
  if(timeoutMs > 0)
  {
    testWaitForTimeout(timeoutMs);
  }
  getSigValue = $sig;
  snprintf(stepTemporaryString, elCount(stepTemporaryString), "Signal %s is set to %.05f.", sig.name, getSigValue);
  if(CompareFloatsWithAccuracy(setSigValue, getSigValue, 5))
  {
    ReportObservedPassed(stepTemporaryString);    
  }
  else
  {
    ReportObservedFailed(stepTemporaryString);
  }
}

void DisableAllTxMessagesTS()
{
  ReportStep();
  ReportAction("Disable all TX messages on RBS.");
  ReportExpected("All TX messages send by RBS should be disabled.");
  @MEnv_StopAllTxMessages_SET_INT_2 = 1;
  ReportObservedPassed("All TX messages sent by RBS were disabled.");
}

void EnableAllTxMessagesTS()
{
  ReportStep();
  ReportAction("Enable all TX messages on RBS.");
  ReportExpected("All TX messages send by RBS should be enabled.");
  @MEnv_StopAllTxMessages_SET_INT_2 = 0;
  ReportObservedPassed("All TX messages sent by RBS were enabled.");
}

long TestWaitForEcuGoToSleep(long timeoutMs)
{
  const float MAX_SLEEP_CURRENT = 0.010;  // 10 mA
  float startTimeMs, endTimeMs;
  
  startTimeMs = timeNowFloat()/100.0;
  while(timeNowFloat()/100.0 < startTimeMs + timeoutMs)
  {
    if(GetKL30CurrentConsumption() < MAX_SLEEP_CURRENT)
    {
      break;
    }
    testWaitForTimeout(1);
  }
  endTimeMs = timeNowFloat()/100.0;
  
  return endTimeMs < (startTimeMs + timeoutMs);
}

void TestWaitForEcuGoToSleepTS(long timeoutMs)
{
  float startTimeMs, endTimeMs;
  
  ReportStep();
  snprintf(stepTemporaryString, elCount(stepTemporaryString), "Wait maximum %d ms untill ECU will go to sleep.", timeoutMs);
  ReportAction(stepTemporaryString);
  snprintf(stepTemporaryString, elCount(stepTemporaryString), "ECU should go to sleep below %d ms.", timeoutMs);
  ReportExpected(stepTemporaryString);
  
  startTimeMs = timeNowFloat()/100.0;
  TestWaitForEcuGoToSleep(timeoutMs);
  endTimeMs = timeNowFloat()/100.0;
  
  if(endTimeMs < (startTimeMs + timeoutMs))
  {
    snprintf(stepTemporaryString, elCount(stepTemporaryString), "ECU went to sleep in %d ms.", (long)(endTimeMs-startTimeMs));
    ReportObservedPassed(stepTemporaryString);
  }
  else
  {
    snprintf(stepTemporaryString, elCount(stepTemporaryString), "ECU did not went to sleep in %d ms.", timeoutMs);
    ReportObservedFailed(stepTemporaryString);
  }  
}

void CheckKL30CurrentConsumptionTS(float desiredConsumption)
{
  float consumption;
  
  ReportStep();
  ReportAction("Check KL_30 power consumption.");
  snprintf(stepTemporaryString, elCount(stepTemporaryString), "KL_30 power consumption should be below %.3f [A].", desiredConsumption);
  ReportExpected(stepTemporaryString);
  
  consumption = GetKL30CurrentConsumption();
  snprintf(stepTemporaryString, elCount(stepTemporaryString), "Actual KL_30 power consumption is equal %.3f [A].", consumption);
  if(consumption < desiredConsumption)
  {
    ReportObservedPassed(stepTemporaryString);
  }
  else
  {
    ReportObservedFailed(stepTemporaryString);
  }  
}
