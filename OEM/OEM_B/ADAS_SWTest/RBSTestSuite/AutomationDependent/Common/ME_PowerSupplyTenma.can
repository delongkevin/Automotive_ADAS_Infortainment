/*@!Encoding:1252*/
includes
{
  
}

variables
{
  const long DEBUG = 0;
  
  long PORT_NUMBER = 0; // will be initialized from sysvar
  const long BITS_PER_SECOND = 9600;
  const long DATA_BITS = 8;
  const long STOP_BITS = 1;
  const long PARITY = 0;
  
   // GLOBAL
  const int kBUFFER_SIZE = 1000;
  const int kINFO        = 1;
  const int kWARN        = 2;
  const int kERROR       = 3;  
    
   // data is copied from callback buffer to gReceiverBuffer (collects data)
  byte gReceiverCallbackBuffer[kBUFFER_SIZE];

  byte gReceiverBuffer[kBUFFER_SIZE];
  byte gEmptyBuffer   [kBUFFER_SIZE];
  long gNumberOfReceivedBytes = 0;

  // state variable
  byte gSending = 0;

  // timer for indication of data reception 
  msTimer tBytesReceived;
  
  // enum for power supply state
  enum PsOutputState
  {
    PS_DISABLE = 0,
    PS_ENABLE = 1
  };
  
  msTimer tPoolRequests, tStartTimer;
  char ptPreviousCommand[kBUFFER_SIZE];
  char TENMA_REQUEST_VOLTAGE[8] = "VOUT1?";
  char TENMA_REQUEST_CURRENT[8] = "IOUT1?";
    
  byte stateMachine;
  
  float prevSetVolgate;
  long prevOutputState;
}

/*
on EthernetPacket *
{  
  //if(this.dir == rx && this.doip.IsAvailable())
  if(this.doip.IsAvailable())
  {
    if(swapWord(this.doip.word(2)) == 0x0004) // Vehicle announcement/Identification response
    {
      diagSetTarget("BV_FrontSensoDriveAssisSysteUDS_Physical");
      
      write("Reconnect to BV_FrontSensoDriveAssisSysteUDS_Physical... ");
      diagDisconnectChannel();
      diagCloseChannel();
      diagConnectChannel();
    }
  }
}
*/

on preStart
{
  PORT_NUMBER = @sysvar::PowerSupply::ComPortNumber;
  InitSerialPort();  
}

on start
{
  PORT_NUMBER = @sysvar::PowerSupply::ComPortNumber;
  setTimer(tStartTimer, 1000);  // make a delay before start
}

on timer tStartTimer
{
  TenmaRestartStateMachine();
}

on preStop
{  
  stateMachine = 0xFF;
  gSending = 0;
  cancelTimer(tPoolRequests);  
  cancelTimer(tBytesReceived);  
  TenmaSetOutput(PS_DISABLE); 
  DeferStop(500);
  write("\n\n\n\n\n somebody called pre-stop!");
}

on stopMeasurement
{
  Rs232Close(PORT_NUMBER);
  CompleteStop();
}

/// RS232 functions
InitSerialPort()
{
  // close serial port (port may have changed, former port shall not remain open)
  if(Rs232Close(PORT_NUMBER)==1)
  {
    if(DEBUG) writeLineEx(0,kINFO, "Serial port %d successfully closed.", PORT_NUMBER);
  }
  else
    writeLineEx(0,kERROR,"An error occurred during closing of the serial port %d.", PORT_NUMBER);    

  // set state (close aborts all open requests)
  gSending = 0;

  // open the serial port (comes up with Windows defaults)
  if(Rs232Open(PORT_NUMBER)==1)
  {
    if(DEBUG) writeLineEx(0,kINFO, "Serial port %d successfully opened.", PORT_NUMBER);    
  }
  else
    writeLineEx(0,kERROR,"An error occurred during opening of the serial port %d.", PORT_NUMBER);    

  // configure the serial port
  // - just take the panel content
  if(Rs232Configure(PORT_NUMBER,BITS_PER_SECOND,DATA_BITS,STOP_BITS,PARITY)==1)
  {
    if(DEBUG) writeLineEx(0,kINFO, "Serial port %d successfully initialized.", PORT_NUMBER);    
  }
  else
    writeLineEx(0,kERROR,"An error occurred during initialization of the serial port %d.", PORT_NUMBER);    
  
  // port, handshake, xonLim, xoffLim, xonChar, xoffChar, writeTimeout
  // without last timeout parameter: use default timeout
  // for transmission of small amounts of data one may not need to use handshake ! 
  // e.g. 33 for RTS/CTS as second parameter for large volumes of data, 0 for small volumes
  if(Rs232SetHandshake(PORT_NUMBER, 0, 0, 0, 0, 0))
  {
    if(DEBUG) writeLineEx(0,kINFO, "Handshake parameters for serial port %d successfully configured.", PORT_NUMBER);    
  }
  else
    writeLineEx(0,kERROR,"An error occurred during the serial port %d configuration of handshake parameters.", PORT_NUMBER);

  // set buffer for reception (otherwise callback would not work)
  if(Rs232Receive(PORT_NUMBER, gReceiverCallbackBuffer, kBUFFER_SIZE))
  {
    if(DEBUG) writeLineEx(0,kINFO, "Receiver buffer for serial port %d successfully set.", PORT_NUMBER);    
  }
  else
    writeLineEx(0,kERROR,"An error occurred during setting the receiver buffer for serial port %d.", PORT_NUMBER); 
}

/// RS232 functions
SendDataOverRS232(long numberOfBytes, byte buffer[])
{
  if(gSending)
  {
    writeLineEx(0,kWARN,"Ongoing transmission, please wait for completion of previous one !");
    return;
  }
  
  if(numberOfBytes<=0)
  {
    writeLineEx(0,kWARN,"Only more than one byte can be transmitted ! Please fill in some characters to send !");
    return;
  } 

  if(0==Rs232Send(PORT_NUMBER, buffer, numberOfBytes))
  {
    writeLineEx(0,kERROR,"An error occurred during write of block of data to the serial port %d.", PORT_NUMBER);
    return;
  }
  else
  {
    if(DEBUG) writeLineEx(0,kINFO, "Write block of bytes to serial port %d worked well.", PORT_NUMBER);    
    memcpy(ptPreviousCommand, buffer, numberOfBytes);  // make copy of previous command to verify what was asked
  }

  // set state
  gSending = 1;
}

/// RS232 functions
SendStringOverRS232(char string[])
{
  byte internalBuffer[kBUFFER_SIZE];
  
  memcpy(internalBuffer, string, strlen(string));
  if(DEBUG) writeLineEx(0,kINFO, "Write string over serial port %d (string: '%s').", PORT_NUMBER, string);    
  SendDataOverRS232(strlen(string), internalBuffer);  
}

/// RS232 functions
on timer tBytesReceived
{
  char tmpString[kBUFFER_SIZE];
  char tmpValue[8];
  float floatValue;
    
  memcpy(tmpString, gReceiverBuffer, gNumberOfReceivedBytes);
  tmpString[gNumberOfReceivedBytes+1] = 0; // end of string
  
  if(DEBUG)
  {
    writeLineEx(0,kINFO, "Serial port %d received data: '%s'.", PORT_NUMBER, tmpString);
  }
    
  memcpy_off(tmpValue, 0, gReceiverBuffer, 0, 5);
  tmpValue[6] = 0; //string null termination
  strtod(tmpValue, floatValue);
  
  if(strncmp(TENMA_REQUEST_VOLTAGE, ptPreviousCommand, strlen(TENMA_REQUEST_VOLTAGE)) == 0) // actuall output voltage
  {    
    @sysvar::PowerSupply::ActualOutputVoltage = floatValue;
  }
  else if(strncmp(TENMA_REQUEST_CURRENT, ptPreviousCommand, strlen(TENMA_REQUEST_CURRENT)) == 0) // actuall current consumption
  {
    @sysvar::PowerSupply::ActualOutputCurrent = floatValue;
  }
  else
  {
    // curently other options aren't supported
  }
  
  ptPreviousCommand[0] = 0; //string null termination  
  
  // reset buffer
  gNumberOfReceivedBytes = 0;
  
  setTimerCyclic(tPoolRequests, 100);
}

on timer tPoolRequests
{
  if(stateMachine == 0)   // init connection with Tenma power supply - not neededed in fact
  {
    stateMachine = 1;
    return;
  }
  
  if(stateMachine == 1) // set voltage on Tenma power supply
  {
    if(prevSetVolgate != @sysvar::PowerSupply::SetVoltage)
    {
      TenmaSetVoltage(@sysvar::PowerSupply::SetVoltage);
      prevSetVolgate = @sysvar::PowerSupply::SetVoltage;
      stateMachine = 2;
      return;
    }
    else
    {
      stateMachine = 2; // do not return, go to next state
    }
  }
  
  if(stateMachine == 2)  // set proper output state on Tenma power supply
  {
    if(prevOutputState != @sysvar::PowerSupply::OutputState)
    {
      if(@sysvar::PowerSupply::OutputState == 0)
      {
        TenmaSetOutput(PS_DISABLE);    
      }
      else
      {
        TenmaSetOutput(PS_ENABLE);
      }
      prevOutputState = @sysvar::PowerSupply::OutputState;
      stateMachine = 3;
      return;
    }
    else
    {
      stateMachine = 3; // do not return, go to next state
    }
  }
  
  if(stateMachine == 3)  // get actuall voltage and current on Tenma power supply
  {
    TenmaRequestActuallVoltage();
    stateMachine = 4;
    return;
  }
  if(stateMachine == 4)  // get actuall voltage and current on Tenma power supply
  {
    TenmaRequestActuallCurrent();
    stateMachine = 1;
    return;
  }
}

/// RS232 functions
RS232OnReceive( dword port, byte buffer[], dword number )
{
  dword numberOfBytesToCopy;
  
  // collect data as long as buffer has space for it
  if ( (gNumberOfReceivedBytes+number)>kBUFFER_SIZE )
  {
    numberOfBytesToCopy = kBUFFER_SIZE-gNumberOfReceivedBytes; // no more than that ! it is full now
  }
  else
  {
    numberOfBytesToCopy = number;
  }

  if ( numberOfBytesToCopy==0 )
  {
    return; // nothing to add
  }

  memcpy_off(gReceiverBuffer,gNumberOfReceivedBytes,buffer,0,numberOfBytesToCopy);
  gNumberOfReceivedBytes += numberOfBytesToCopy; 
  
  cancelTimer(tPoolRequests);  
  cancelTimer(tBytesReceived);
  setTimer(tBytesReceived, 50);
}

/// RS232 functions
RS232OnSend( dword port, byte buffer[], dword number )
{
  // set state
  gSending = 0;

  if(DEBUG) writeLineEx(0,kINFO,"Transmission of %d bytes from port %d completed !", number, port);
}

/// RS232 functions
RS232OnError( dword port, dword errorFlags )
{
  // set state
  gSending = 0;

  writeLineEx(0,kERROR,"Error handler called with error code %d !", errorFlags);

  if ( errorFlags & 1 )
    writeLineEx(0,1,"%d informs of send error",errorFlags);
  if ( errorFlags & 2 )
    writeLineEx(0,1,"%d informs of receive error",errorFlags);
  if ( errorFlags & 4 )
    writeLineEx(0,1,"%d informs of frame error",errorFlags);
  if ( errorFlags & 8 )
    writeLineEx(0,1,"%d informs of parity error",errorFlags);
  if ( errorFlags & 16 )
    writeLineEx(0,1,"%d informs of overrun error",errorFlags);
  if ( errorFlags & 32 )
    writeLineEx(0,1,"%d informs of receiver overrun error",errorFlags);
  if ( errorFlags & 64 )
    writeLineEx(0,1,"%d informs of break state",errorFlags);
  if ( errorFlags & 128 )
    writeLineEx(0,1,"%d informs of send timeout error",errorFlags);
  
  TenmaRestartStateMachine();
}

/// Tenma functions
void TenmaSendCommand(char command[])
{
  SendStringOverRS232(command); // no additional things (line termination etc) needed, send as is
}
 
/// Tenma functions
void TenmaSetOutput(enum PsOutputState state)
{
  if(state == PS_DISABLE)
  {
    TenmaSendCommand("OUT0");
  }
  else
  {
    TenmaSendCommand("OUT1");
  }  
}

/// Tenma functions
void TenmaSetVoltage(float desiredVoltage)
{
  const float HIGH_VOLTAGE_LEVEL = 24.5;  // can be changed, if ECU will survive bigger voltage
  char outputBuffer[64];
  
  if(desiredVoltage < HIGH_VOLTAGE_LEVEL)
  {
    snprintf(outputBuffer, elCount(outputBuffer), "VSET1:%.2f", desiredVoltage);
    TenmaSendCommand(outputBuffer); 
  }
  else
  {
    writeLineEx(0,kERROR,"Desired voltage for Tenma is too big (%.2f [V]), maximum is %.2f [V]!", desiredVoltage, HIGH_VOLTAGE_LEVEL);
  }  
}

/// Tenma functions
void TenmaRequestActuallVoltage()
{
  TenmaSendCommand(TENMA_REQUEST_VOLTAGE);
}

/// Tenma functions
void TenmaRequestActuallCurrent()
{
  TenmaSendCommand(TENMA_REQUEST_CURRENT);
}

/// Tenma functions
void TenmaRestartStateMachine()
{
  cancelTimer(tPoolRequests);
  cancelTimer(tBytesReceived);
  
  InitSerialPort();
  
  stateMachine = 0;
  gSending = 0;
  setTimerCyclic(tPoolRequests, 100);
}

on key 'r'
{
  writeLineEx(0,kINFO,"Restarting state machine!");
  TenmaRestartStateMachine();
}
