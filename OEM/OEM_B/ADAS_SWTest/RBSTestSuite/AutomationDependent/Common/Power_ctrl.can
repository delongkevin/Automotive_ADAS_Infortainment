/*@!Encoding:1252*/
//********************************************************************************************
//----------------- Initial version 1.0: created by : Ramagopal Bandi-------------------------
//------------------Updted for Network Node usage and ON key: Saurabh bandewar----------------
//---------- this script works for Tenma programmable power supplies--------------------------
//*********************************************************************************************
includes
{

}

variables
{
  dword port_open,ret,ret1;
  char buffer1[100];
  char buffer2[100];
  int i;
  byte buffer[100];
  byte buffer3[10];
  byte buffer4[10];
  long COM_PORT = 6; 
}


  

Set_voltage(int port,float volt)      // Function is used to set to desired voltage port: Check the USB COM number in device manager
                                                          //                                            volt: Voltage  
{
  RS232_Initilize(port);
  snprintf(buffer1,elCount(buffer1),"VSET1:%0.2f\n OUT1\n",volt);  
  for(i=0;i<strlen(buffer1);i++)
  {
    buffer[i] = buffer1[i];
  }
  ret = RS232Send(port,buffer,strlen(buffer1));
  if(ret == 1)
  {
    write("","VOLTAGE Set to is %0.2f",volt);      
  }
  else
  {
    write("","Not Able to set the Voltage due to error %d",ret);    
  }  

}

Read_voltage(int port)  // Function is used to read voltage (port: Check the USB COM number in device manager)                                           
{
  RS232_Initilize(port);
  snprintf(buffer1,elCount(buffer1),"VOUT1?\r\n");  
  for(i=0;i<strlen(buffer1);i++)
  {
    buffer[i] = buffer1[i];
  }
  ret = RS232Send(port,buffer,elcount(buffer));
    if(ret == 1)
  {
    write("","VOLTAGE read request sent");      
  }
  else
  {
    write("","VOLTAGE read request not sent");    
  }  
  ret1 =  RS232Receive(COM_PORT,buffer3,elcount(buffer3));  
  for(i=0;i<2000;i++);
//  write("datrial port%c",buffer3[0]);
  if(ret1 == 1)
  {
    for(i=0;i<elcount(buffer3);i++)
   {
    buffer2[i] = buffer3[i];    
    }
   write("","Voltage is %s",buffer2);
  }
  else
  write("","read error");
}

Power_OFF_ON(int port,int ctrl) // Function is used to On and OFf the Power supply ctrl: 0 - OFF ad 1 - ON    
{ 
  RS232_Initilize(port);
  snprintf(buffer1,elCount(buffer1),"OUT%d\n",ctrl);  
  for(i=0;i<strlen(buffer1);i++)
  {
    buffer[i] = buffer1[i];
  }
  ret = RS232Send(COM_PORT,buffer,strlen(buffer1));
  if(ret == 1)
  {
    if(ctrl == 0)
    {
    write("","Power is OFF  %d",ctrl);  
    
    }
    else
    {
    write("","Power is ON %d",ctrl); 
    
    }
   }
  else
  {
    write("","Unable do On or OFF due to error %d",ret);
  }
}

void RS232_Initilize(int port)  // Initilization of RS232 port
{
  RS232Configure(port,9600,8,1,0);  
  port_open = RS232Open(port);  
  if(port_open == 1)
    write("","Port %d succesfully opened",port);
  else
    write("","Port %d open not succesful",port);  
}


on key '1'
 {
  Power_OFF_ON(COM_PORT,1);
  write("power supply is ON");
 }

on key '0'
{
  Power_OFF_ON(COM_PORT,0);
  write("power supply is OFF");
}

on sysvar_update sysvar::PowerSupply::SetVoltage
{
  Set_voltage(COM_PORT,sysGetVariableFloat("PowerSupply","SetVoltage"));
  writeEx(1,1,"Voltage is set to %fv",sysGetVariableFloat("PowerSupply","SetVoltage"));
}


