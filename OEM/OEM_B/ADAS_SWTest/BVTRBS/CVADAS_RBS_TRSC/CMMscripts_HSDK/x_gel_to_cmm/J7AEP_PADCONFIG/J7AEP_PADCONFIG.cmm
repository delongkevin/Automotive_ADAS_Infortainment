LOCAL &function &args
ENTRY &function %LINE &args
// -- *
// --  * \file  J7AEP_PADCONFIG.GEL
// --  *
// --  * \brief GEL File to set the pinmux 
// --  Copyright (c) 2021, Texas Instruments Incorporated
// --  * All rights reserved.
// --  *
// --  * Redistribution and use in source and binary forms, with or without
// --  * modification, are permitted provided that the following conditions
// --  * are met:
// --  *
// --  * *  Redistributions of source code must retain the above copyright
// --  *    notice, this list of conditions and the following disclaimer.
// --  *
// --  * *  Redistributions in binary form must reproduce the above copyright
// --  *    notice, this list of conditions and the following disclaimer in the
// --  *    documentation and/or other materials provided with the distribution.
// --  *
// --  * *  Neither the name of Texas Instruments Incorporated nor the names of
// --  *    its contributors may be used to endorse or promote products derived
// --  *    from this software without specific prior written permission.
// --  *
// --  * THIS SOFTWARE IS PROVIDED BY THE COPYRIGHT HOLDERS AND CONTRIBUTORS "AS IS"
// --  * AND ANY EXPRESS OR IMPLIED WARRANTIES, INCLUDING, BUT NOT LIMITED TO,
// --  * THE IMPLIED WARRANTIES OF MERCHANTABILITY AND FITNESS FOR A PARTICULAR
// --  * PURPOSE ARE DISCLAIMED. IN NO EVENT SHALL THE COPYRIGHT OWNER OR
// --  * CONTRIBUTORS BE LIABLE FOR ANY DIRECT, INDIRECT, INCIDENTAL, SPECIAL,
// --  * EXEMPLARY, OR CONSEQUENTIAL DAMAGES (INCLUDING, BUT NOT LIMITED TO,
// --  * PROCUREMENT OF SUBSTITUTE GOODS OR SERVICES; LOSS OF USE, DATA, OR PROFITS;
// --  * OR BUSINESS INTERRUPTION) HOWEVER CAUSED AND ON ANY THEORY OF LIABILITY,
// --  * WHETHER IN CONTRACT, STRICT LIABILITY, OR TORT (INCLUDING NEGLIGENCE OR
// --  * OTHERWISE) ARISING IN ANY WAY OUT OF THE USE OF THIS SOFTWARE,
// --  * EVEN IF ADVISED OF THE POSSIBILITY OF SUCH DAMAGE. 
// --  * macro definitions
// --  Register Definitions
LOCAL &__M3_CID_BASE
&__M3_CID_BASE=(0xE000EFF0)
LOCAL &__M3_CID_7_0
&__M3_CID_7_0=(0x0000000D)
LOCAL &__M3_CID_15_8
&__M3_CID_15_8=(0x000000E0)
LOCAL &__M3_CID_23_16
&__M3_CID_23_16=(0x00000005)
LOCAL &__M3_CID_31_24
&__M3_CID_31_24=(0x000000B1)
LOCAL &__MAIN_MMR_BASE
&__MAIN_MMR_BASE=(0x80100000)
LOCAL &__WKUP_MMR_BASE
&__WKUP_MMR_BASE=(0x63000000)
LOCAL &__PAD0OFFSET
&__PAD0OFFSET=(0x0001C000)
LOCAL &__KICK0
&__KICK0=(0x68EF3490)
LOCAL &__KICK1
&__KICK1=(0xD172BC5A)

GLOBAL &path_J7AEP_PADCONFIG_cmm
&path_J7AEP_PADCONFIG_cmm=OS.PPF()
IF "&function"!=""
(
	GOSUB &function &args
)
ELSE
(
	GOSUB __GeL_MeNu_CrEaTe
)
ENDDO
// -- Internal function to unlock the Main SoC Padconfig MMRs.

unlockMainPads:
(
	Data.Set D:(((Var.VALUE(&__MAIN_MMR_BASE)+0x9008))) %Long Var.VALUE(&__KICK0)
	Data.Set D:(((Var.VALUE(&__MAIN_MMR_BASE)+0x900C))) %Long Var.VALUE(&__KICK1)
	Data.Set D:(((Var.VALUE(&__MAIN_MMR_BASE)+0x1D008))) %Long Var.VALUE(&__KICK0)
	Data.Set D:(((Var.VALUE(&__MAIN_MMR_BASE)+0x1D00C))) %Long Var.VALUE(&__KICK1)
	RETURN
)
// -- Internal function to unlock the WKUP/MCU domain Padconfig MMRs.

unlockWkupPads:
(
	Data.Set D:(((Var.VALUE(&__WKUP_MMR_BASE)+0x9008))) %Long Var.VALUE(&__KICK0)
	Data.Set D:(((Var.VALUE(&__WKUP_MMR_BASE)+0x900C))) %Long Var.VALUE(&__KICK1)
	Data.Set D:(((Var.VALUE(&__WKUP_MMR_BASE)+0x1D008))) %Long Var.VALUE(&__KICK0)
	Data.Set D:(((Var.VALUE(&__WKUP_MMR_BASE)+0x1D00C))) %Long Var.VALUE(&__KICK1)
	RETURN
)

__GeL_MeNu_CrEaTe:
(
	MENU.ReProgram
	(
		ADD
		MENU
		(
			POPUP "GEL"
			(
				POPUP "Padconfig"
				(
					MENUITEM "setPadConfig" 
					(
						DO "&path_J7AEP_PADCONFIG_cmm" setPadConfig_dialog
					)
				)
			)
		)
	)
	RETURN
)

setPadConfig_dialog:
(
	LOCAL &domain &pindex &muxmode &iomode
	&domain=0
	&pindex=0
	&muxmode=0
	&iomode=0
	DIALOG
	(
		HEADER "setPadConfig"
		POS 0. 0. 29.
		TEXT "WKUP (0) Main (1): "
		POS 0. 1. 29.
		TEXT "Pad index: "
		POS 0. 2. 29.
		TEXT "Mux mode: "
		POS 0. 3. 29.
		TEXT "Input (0) Output (1) IO (2)"
		POS 29. 0. 10.
		EDIT "" "&domain=*"
		POS 29. 1. 10.
		EDIT "" "&pindex=*"
		POS 29. 2. 10.
		EDIT "" "&muxmode=*"
		POS 29. 3. 10.
		EDIT "" "&iomode=*"
		POS 0. 4. 39.
		BUTTON "Execute" 
		(
			DO &path_J7AEP_PADCONFIG_cmm setPadConfig &domain &pindex &muxmode &iomode
		)
	)
	RETURN
)

setPadConfig:
(
	ENTRY &__VF0 &__VF1 &__VF2 &__VF3
	
	Var.NEW unsigned long long \domain
	VAR.ASSIGN \domain=&__VF0
	
	Var.NEW unsigned long long \pindex
	VAR.ASSIGN \pindex=&__VF1
	
	Var.NEW unsigned long long \muxmode
	VAR.ASSIGN \muxmode=&__VF2
	
	Var.NEW unsigned long long \iomode
	VAR.ASSIGN \iomode=&__VF3
	
	
	Var.NEW unsigned int \padoffset
	Var.NEW unsigned int \regval
	Var.Assign \regval=0x00000000
	Var.IF ((\domain)==0x0)
	(
		GOSUB unlockWkupPads
		Var.Assign \padoffset=(&__WKUP_MMR_BASE+&__PAD0OFFSET)
	)
	ELSE
	(
		Var.IF ((\domain)==0x1)
		(
			GOSUB unlockMainPads
			Var.Assign \padoffset=(&__MAIN_MMR_BASE+&__PAD0OFFSET)
		)
	)
	Var.Assign \padoffset=((\pindex*0x4)+\padoffset)
	Var.Assign \regval=\muxmode
	Var.IF ((\iomode)==0x0)
	(
		Var.Assign \regval=(0x08230000+(\regval))
	)
	ELSE
	(
		Var.IF ((\iomode)==0x1)
		(
			Var.Assign \regval=(0x08010000+(\regval))
		)
		ELSE
		(
			Var.IF ((\iomode)==0x2)
			(
				Var.Assign \regval=(0x08030000+(\regval))
			)
		)
	)
	AREA.Select
	PRINT "writing " %HEX Var.VALUE(\regval) " to address: " %HEX Var.VALUE(\padoffset) ""
	PRINT ""
	Data.Set D:(((Var.VALUE(\padoffset)))) %Long Var.VALUE(\regval)
	RETURN
)
