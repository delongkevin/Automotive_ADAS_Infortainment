/*@!Encoding:1252*/
  variables
{
  diagRequest CVADAS_0001_00000000_000.* diag_Request;
  byte diag_Response[300];
  msTimer CM_TCH_STAT;
}



on start
{
  @IL::Klemme15=0;
  @IL::Klemme30=0;
  $CmdIgnSts=0;
  @MEnv_Read_Proxi_DID_0x2024=0;
  sendDiagRequestFor_Read_Proxi_DID_0x2024();
  @User_Node::CM_TCH_STAT_SET_INT_1=0;
  @User_Node::X_Cordinate_SET_INT_1=0;
  @User_Node::Y_Cordinate_SET_INT_1=0;
  @MEnv_IgnStatus_GET_INT_1 = 0;
  @MEnv_IgnStatus_SET_INT_1 = 0;
  @MEnv_DisplayResX_SET_INT_1=0;
  @MEnv_DisplayResY_SET_INT_1=0;
  @MEnv_ManualDisplayRes_SET_INT_1=0;
  
}

On envVar MEnv_Send_Read_Proxi_DID_0x2024
{
   if(@this==1) sendDiagRequestFor_Read_Proxi_DID_0x2024();
}


void sendDiagRequestFor_Read_Proxi_DID_0x2024()
{
  @MEnv_Read_Proxi_DID_0x2024=0;
  diagResize(diag_Request,3);
  DiagSetPrimitiveByte(diag_Request,0,0x22);
  DiagSetPrimitiveByte(diag_Request,1,0x20);
  DiagSetPrimitiveByte(diag_Request,2,0x24);
  diagSendRequest(diag_Request);
  write("Request Sent for Read_Proxi_DID_0x2024");
  
}


on diagResponse CVADAS_0001_00000000_000.*{
  int i;
  
  this.GetPrimitiveData(diag_Response,elCount(diag_Response));
  if(diag_Response[2] != 0x78)
  
     if((diag_Response[0] == 0x62) && (diag_Response[1] == 0x20) && (diag_Response[2] == 0x24))
    {
       @MEnv_Read_Proxi_DID_0x2024=1;
       write("Response received for Read_Proxi_DID_0x2024");
       @MEnv_Proxi_Radio_Display_Type_SET_INT_1=(diag_Response[187] & 0xF);
        @MEnv_Forward_facing_camera_SET_INT_1=(diag_Response[179] & 0x2);
    }
    else if(diag_Response[0] == 0x7F)
    {
      
      write("Proxi data read error");
    }
   

}




on envVar MEnv_Rear_360_soft_button_SET_INT_1
{
  if(@this==1)
   { 
   
      if(@MEnv_Proxi_Radio_Display_Type_SET_INT_1==0x07)
      { 
        @User_Node::CM_TCH_STAT_SET_INT_1=1;
        @User_Node::X_Cordinate_SET_INT_1=80;
        @User_Node::Y_Cordinate_SET_INT_1=830;
    }
    else if(@MEnv_Proxi_Radio_Display_Type_SET_INT_1== 0x02 || @MEnv_Proxi_Radio_Display_Type_SET_INT_1 == 0x09 )
    {  @User_Node::CM_TCH_STAT_SET_INT_1=1;
       @User_Node::X_Cordinate_SET_INT_1=80;
       @User_Node::Y_Cordinate_SET_INT_1=710;
    }

  else {
  //do nothing 
        }
  }
  
}
on envVar MEnv_Front_360_soft_button_SET_INT_1
{
   if(@this==1)
   { 
   if(@MEnv_Proxi_Radio_Display_Type_SET_INT_1==0x07)
      { @User_Node::CM_TCH_STAT_SET_INT_1=1;
        @User_Node::X_Cordinate_SET_INT_1=500;
        @User_Node::Y_Cordinate_SET_INT_1=830;
      }
   else if(@MEnv_Proxi_Radio_Display_Type_SET_INT_1== 0x02 || @MEnv_Proxi_Radio_Display_Type_SET_INT_1 == 0x09 )
    {  @User_Node::CM_TCH_STAT_SET_INT_1=1;
       @User_Node::X_Cordinate_SET_INT_1=420;
       @User_Node::Y_Cordinate_SET_INT_1=700;
    }
   else {
  //do nothing 
        }
  }
}

on envVar MEnv_RCPV_soft_button_SET_INT_1
{
   if(@this==1)
   { 
   if(@MEnv_Proxi_Radio_Display_Type_SET_INT_1==0x07)
      { @User_Node::CM_TCH_STAT_SET_INT_1=1;
        @User_Node::X_Cordinate_SET_INT_1=220;
        @User_Node::Y_Cordinate_SET_INT_1=830;
      }
   else if(@MEnv_Proxi_Radio_Display_Type_SET_INT_1== 0x02 || @MEnv_Proxi_Radio_Display_Type_SET_INT_1 == 0x09 )
    {  @User_Node::CM_TCH_STAT_SET_INT_1=1;
       @User_Node::X_Cordinate_SET_INT_1=180;
       @User_Node::Y_Cordinate_SET_INT_1=700;
    }
   else {
  //do nothing 
        }
  }
} 


on envVar MEnv_FCPV_soft_button_SET_INT_1
{
  if(@this==1)
   { 
   if(@MEnv_Proxi_Radio_Display_Type_SET_INT_1==0x07)
      { @User_Node::CM_TCH_STAT_SET_INT_1=1;
        @User_Node::X_Cordinate_SET_INT_1=350;
        @User_Node::Y_Cordinate_SET_INT_1=830;
      }
   else if(@MEnv_Proxi_Radio_Display_Type_SET_INT_1== 0x02 || @MEnv_Proxi_Radio_Display_Type_SET_INT_1 == 0x09 )
    {  @User_Node::CM_TCH_STAT_SET_INT_1=1;
       @User_Node::X_Cordinate_SET_INT_1=300;
       @User_Node::Y_Cordinate_SET_INT_1=700;
    }
   else {
  //do nothing 
        }
  }
}
on envVar MEnv_FFCV_soft_button_SET_INT_1
{
  if(@this==1)
   { 
   if(@MEnv_Proxi_Radio_Display_Type_SET_INT_1==0x07)
      { @User_Node::CM_TCH_STAT_SET_INT_1=1;
        @User_Node::X_Cordinate_SET_INT_1=780;
        @User_Node::Y_Cordinate_SET_INT_1=830;
      }
   else if(@MEnv_Proxi_Radio_Display_Type_SET_INT_1== 0x02 || @MEnv_Proxi_Radio_Display_Type_SET_INT_1 == 0x09 )
    {  @User_Node::CM_TCH_STAT_SET_INT_1=1;
       @User_Node::X_Cordinate_SET_INT_1=670;
       @User_Node::Y_Cordinate_SET_INT_1=700;
    }
   else {
  //do nothing 
        }
  }
}


on envVar MEnv_BURV_soft_button_SET_INT_1
{
  if(@this==1)
   { 
   if(@MEnv_Proxi_Radio_Display_Type_SET_INT_1==0x07)
      { @User_Node::CM_TCH_STAT_SET_INT_1=1;
        @User_Node::X_Cordinate_SET_INT_1=640;
        @User_Node::Y_Cordinate_SET_INT_1=830;
      }
   else if(@MEnv_Proxi_Radio_Display_Type_SET_INT_1== 0x02 || @MEnv_Proxi_Radio_Display_Type_SET_INT_1 == 0x09 )
    {  @User_Node::CM_TCH_STAT_SET_INT_1=1;
       @User_Node::X_Cordinate_SET_INT_1=545;
       @User_Node::Y_Cordinate_SET_INT_1=700;
    }
   else {
}
  }
}
on envVar MEnv_Zoom_In_soft_button_SET_INT_1
{
 if(@this==1)
   { 
   if(@MEnv_Proxi_Radio_Display_Type_SET_INT_1==0x07)
      { @User_Node::CM_TCH_STAT_SET_INT_1=1;
        @User_Node::X_Cordinate_SET_INT_1=70;
        @User_Node::Y_Cordinate_SET_INT_1=70;
      }
   else if(@MEnv_Proxi_Radio_Display_Type_SET_INT_1== 0x02 || @MEnv_Proxi_Radio_Display_Type_SET_INT_1 == 0x09 )
    {  @User_Node::CM_TCH_STAT_SET_INT_1=1;
       @User_Node::X_Cordinate_SET_INT_1=70;
       @User_Node::Y_Cordinate_SET_INT_1=70;
    }
   else { 
}
  }
}

on envVar MEnv_Zoom_Out_soft_button_SET_INT_1
{
  if(@this==1)
   { 
   if(@MEnv_Proxi_Radio_Display_Type_SET_INT_1==0x07)
      { @User_Node::CM_TCH_STAT_SET_INT_1=1;
        @User_Node::X_Cordinate_SET_INT_1=70;
        @User_Node::Y_Cordinate_SET_INT_1=70;
      }
   else if(@MEnv_Proxi_Radio_Display_Type_SET_INT_1== 0x02 || @MEnv_Proxi_Radio_Display_Type_SET_INT_1 == 0x09 )
    {  @User_Node::CM_TCH_STAT_SET_INT_1=1;
       @User_Node::X_Cordinate_SET_INT_1=70;
       @User_Node::Y_Cordinate_SET_INT_1=70;
    }
   else { 
}
}
}


on envVar MEnv_Exit_soft_button_SET_INT_1
{
  if(@this==1)
   { 
   if(@MEnv_Proxi_Radio_Display_Type_SET_INT_1==0x07)
      { @User_Node::CM_TCH_STAT_SET_INT_1=1;
        @User_Node::X_Cordinate_SET_INT_1=1150;
        @User_Node::Y_Cordinate_SET_INT_1=60;
      }
   else if(@MEnv_Proxi_Radio_Display_Type_SET_INT_1== 0x02 || @MEnv_Proxi_Radio_Display_Type_SET_INT_1 == 0x09 )
    {  @User_Node::CM_TCH_STAT_SET_INT_1=1;
       @User_Node::X_Cordinate_SET_INT_1=970;
       @User_Node::Y_Cordinate_SET_INT_1=60;
    }
   else { 
}
}
}
on envVar MEnv_Auto_Pan_soft_button_SET_INT_1
{
  if(@this==1)
   { 
   if(@MEnv_Proxi_Radio_Display_Type_SET_INT_1==0x07)
      { @User_Node::CM_TCH_STAT_SET_INT_1=1;
        @User_Node::X_Cordinate_SET_INT_1=250;
        @User_Node::Y_Cordinate_SET_INT_1=830;
      }
   else if(@MEnv_Proxi_Radio_Display_Type_SET_INT_1== 0x02 || @MEnv_Proxi_Radio_Display_Type_SET_INT_1 == 0x09 )
    {  @User_Node::CM_TCH_STAT_SET_INT_1=1;
       @User_Node::X_Cordinate_SET_INT_1=90;
       @User_Node::Y_Cordinate_SET_INT_1=710;
    }
   else { 
}
  }
}

on envVar MEnv_Right_Pan_soft_button_SET_INT_1
{
  if(@this==1)
   { 
   if(@MEnv_Proxi_Radio_Display_Type_SET_INT_1==0x07)
      { @User_Node::CM_TCH_STAT_SET_INT_1=1;
        @User_Node::X_Cordinate_SET_INT_1=810;
        @User_Node::Y_Cordinate_SET_INT_1=830;
      }
   else if(@MEnv_Proxi_Radio_Display_Type_SET_INT_1== 0x02 || @MEnv_Proxi_Radio_Display_Type_SET_INT_1 == 0x09 )
    {  @User_Node::CM_TCH_STAT_SET_INT_1=1;
       @User_Node::X_Cordinate_SET_INT_1=690;
       @User_Node::Y_Cordinate_SET_INT_1=710;
    }
   else { 
}
  }
}

on envVar MEnv_Left_Pan_soft_button_SET_INT_1
{
  if(@this==1)
   { 
   if(@MEnv_Proxi_Radio_Display_Type_SET_INT_1==0x07)
      { @User_Node::CM_TCH_STAT_SET_INT_1=1;
        @User_Node::X_Cordinate_SET_INT_1=380;
        @User_Node::Y_Cordinate_SET_INT_1=830;
      }
   else if(@MEnv_Proxi_Radio_Display_Type_SET_INT_1== 0x02 || @MEnv_Proxi_Radio_Display_Type_SET_INT_1 == 0x09 )
    {  @User_Node::CM_TCH_STAT_SET_INT_1=1;
       @User_Node::X_Cordinate_SET_INT_1=330;
       @User_Node::Y_Cordinate_SET_INT_1=710;
    }
   else { 
}
  }
}

on envVar MEnv_Aux_SET_INT_1
{
  
  if(@this==1)
   { 
   if(@MEnv_Proxi_Radio_Display_Type_SET_INT_1==0x07)
      {
        if(@MEnv_Forward_facing_camera_SET_INT_1==0)
        { @User_Node::CM_TCH_STAT_SET_INT_1=1;
          @User_Node::X_Cordinate_SET_INT_1=920;
          @User_Node::Y_Cordinate_SET_INT_1=830;
        }
        else if(@MEnv_Forward_facing_camera_SET_INT_1==1)
        { @User_Node::CM_TCH_STAT_SET_INT_1=1;
          @User_Node::X_Cordinate_SET_INT_1=780;
          @User_Node::Y_Cordinate_SET_INT_1=830;
        }
      }
   else if(@MEnv_Proxi_Radio_Display_Type_SET_INT_1== 0x02 || @MEnv_Proxi_Radio_Display_Type_SET_INT_1 == 0x09 )
    {
        if(@MEnv_Forward_facing_camera_SET_INT_1==0)
        { @User_Node::CM_TCH_STAT_SET_INT_1=1;
          @User_Node::X_Cordinate_SET_INT_1=790;
          @User_Node::Y_Cordinate_SET_INT_1=710;
        }
        else if(@MEnv_Forward_facing_camera_SET_INT_1==1)
        { @User_Node::CM_TCH_STAT_SET_INT_1=1;
          @User_Node::X_Cordinate_SET_INT_1=670;
          @User_Node::Y_Cordinate_SET_INT_1=710;
        }
      }
   else 
    { 
       }
  }}

  
  
  on envVar MEnv_More_Cams_SET_INT_1
{
   if(@this==1)
   { 
   if(@MEnv_Proxi_Radio_Display_Type_SET_INT_1==0x07)
      {
        if(@MEnv_Forward_facing_camera_SET_INT_1==0)
        { @User_Node::CM_TCH_STAT_SET_INT_1=1;
          @User_Node::X_Cordinate_SET_INT_1=1090;
          @User_Node::Y_Cordinate_SET_INT_1=830;
        }
        else if(@MEnv_Forward_facing_camera_SET_INT_1==1)
        { @User_Node::CM_TCH_STAT_SET_INT_1=1;
          @User_Node::X_Cordinate_SET_INT_1=1020;
          @User_Node::Y_Cordinate_SET_INT_1=830;
        }
      }
   else if(@MEnv_Proxi_Radio_Display_Type_SET_INT_1== 0x02 || @MEnv_Proxi_Radio_Display_Type_SET_INT_1 == 0x09 )
    {
        if(@MEnv_Forward_facing_camera_SET_INT_1==0)
        { @User_Node::CM_TCH_STAT_SET_INT_1=1;
          @User_Node::X_Cordinate_SET_INT_1=930;
          @User_Node::Y_Cordinate_SET_INT_1=710;
        }
        else if(@MEnv_Forward_facing_camera_SET_INT_1==1)
        { @User_Node::CM_TCH_STAT_SET_INT_1=1;
          @User_Node::X_Cordinate_SET_INT_1=870;
          @User_Node::Y_Cordinate_SET_INT_1=710;
        }
      }
  else 
    { 
       }
  }
}

//*-*-*-*-*-*-*-*-*-*-*-*-*-*-*-*-*-*-*-*-*-*-*-*-*-
//THA-PANEL


on sysvar User_Node::THA_Soft_Button
{
  if(@this==1)
   { 
   if(@MEnv_Proxi_Radio_Display_Type_SET_INT_1==0x07)
      { @User_Node::CM_TCH_STAT_SET_INT_1=1;
        @User_Node::X_Cordinate_SET_INT_1=1100;
        @User_Node::Y_Cordinate_SET_INT_1=50;
      }
   else if(@MEnv_Proxi_Radio_Display_Type_SET_INT_1== 0x02 || @MEnv_Proxi_Radio_Display_Type_SET_INT_1 == 0x09 )
    {  @User_Node::CM_TCH_STAT_SET_INT_1=1;
       @User_Node::X_Cordinate_SET_INT_1=950;
       @User_Node::Y_Cordinate_SET_INT_1=50;
    }
   else { 
}
  }
}

on sysvar User_Node::Confirm_Button
{
  if(@this==1)
   { 
   if(@MEnv_Proxi_Radio_Display_Type_SET_INT_1==0x07)
      { @User_Node::CM_TCH_STAT_SET_INT_1=1;
        @User_Node::X_Cordinate_SET_INT_1=50;
        @User_Node::Y_Cordinate_SET_INT_1=800;
      }
   else if(@MEnv_Proxi_Radio_Display_Type_SET_INT_1== 0x02 || @MEnv_Proxi_Radio_Display_Type_SET_INT_1 == 0x09 )
    {  @User_Node::CM_TCH_STAT_SET_INT_1=1;
       @User_Node::X_Cordinate_SET_INT_1=100;
       @User_Node::Y_Cordinate_SET_INT_1=700;
    }
   else { 
}
  }
}

on sysvar User_Node::THA_Mnvr_Start_Button 
{
  if(@this==1)
   { 
   if(@MEnv_Proxi_Radio_Display_Type_SET_INT_1==0x07)
      { @User_Node::CM_TCH_STAT_SET_INT_1=1;
        @User_Node::X_Cordinate_SET_INT_1=50;
        @User_Node::Y_Cordinate_SET_INT_1=800;
      }
   else if(@MEnv_Proxi_Radio_Display_Type_SET_INT_1== 0x02 || @MEnv_Proxi_Radio_Display_Type_SET_INT_1 == 0x09 )
    {  @User_Node::CM_TCH_STAT_SET_INT_1=1;
       @User_Node::X_Cordinate_SET_INT_1=100;
       @User_Node::Y_Cordinate_SET_INT_1=700;
    }
   else { 
}
  }
}

on sysvar User_Node::Zoom_out_Button 
{
  if(@this==1)
   { 
   if(@MEnv_Proxi_Radio_Display_Type_SET_INT_1==0x07)
      { @User_Node::CM_TCH_STAT_SET_INT_1=1;
        @User_Node::X_Cordinate_SET_INT_1=50;
        @User_Node::Y_Cordinate_SET_INT_1=50;
      }
   else if(@MEnv_Proxi_Radio_Display_Type_SET_INT_1== 0x02 || @MEnv_Proxi_Radio_Display_Type_SET_INT_1 == 0x09 )
    {  @User_Node::CM_TCH_STAT_SET_INT_1=1;
       @User_Node::X_Cordinate_SET_INT_1=50;
       @User_Node::Y_Cordinate_SET_INT_1=50;
    }
   else { 
}
  }
}


on sysvar User_Node::Image_Defeat_Cancel_Button
{
  if(@this==1)
   { 
   if(@MEnv_Proxi_Radio_Display_Type_SET_INT_1==0x07)
      { @User_Node::CM_TCH_STAT_SET_INT_1=1;
        @User_Node::X_Cordinate_SET_INT_1=1100;
        @User_Node::Y_Cordinate_SET_INT_1=50;
      }
   else if(@MEnv_Proxi_Radio_Display_Type_SET_INT_1== 0x02 || @MEnv_Proxi_Radio_Display_Type_SET_INT_1 == 0x09 )
    {  @User_Node::CM_TCH_STAT_SET_INT_1=1;
       @User_Node::X_Cordinate_SET_INT_1=950;
       @User_Node::Y_Cordinate_SET_INT_1=50;
    }
   else { 
}
  }
}

on sysvar User_Node::Screen_touch
{
  if(@this==1)
   { 
   if(@MEnv_Proxi_Radio_Display_Type_SET_INT_1==0x07)
      { @User_Node::CM_TCH_STAT_SET_INT_1=1;
        @User_Node::X_Cordinate_SET_INT_1=600;
        @User_Node::Y_Cordinate_SET_INT_1=300;
      }
   else if(@MEnv_Proxi_Radio_Display_Type_SET_INT_1== 0x02 || @MEnv_Proxi_Radio_Display_Type_SET_INT_1 == 0x09 )
    {  @User_Node::CM_TCH_STAT_SET_INT_1=1;
       @User_Node::X_Cordinate_SET_INT_1=600;
       @User_Node::Y_Cordinate_SET_INT_1=300;
    }
   else { 
}
  }
}






//*-*-*-*-*-*-*-*-*-*-*-*-*-*-*-*-*-*-*-*-*-*-*-*-*-
//THA-PANEL



on sysvar User_Node::X_Cordinate_SET_INT_1
{
  if(@User_Node::X_Cordinate_SET_INT_1!=0)
  {
  write("XCord");
  
  $TELEMATIC_FD_5::CM_TCH_X_COORD=@User_Node::X_Cordinate_SET_INT_1;
    @User_Node::X_Cordinate_SET_INT_1=0;
  }
}


on sysvar User_Node::Y_Cordinate_SET_INT_1
{
  if(@User_Node::Y_Cordinate_SET_INT_1!=0)
  {
  write("YCord");
  
  $TELEMATIC_FD_5::CM_TCH_Y_COORD=@User_Node::Y_Cordinate_SET_INT_1;
    @User_Node::Y_Cordinate_SET_INT_1=0;
  }
}

on sysvar User_Node::CM_TCH_STAT_SET_INT_1
{
  if(@User_Node::CM_TCH_STAT_SET_INT_1!=0)
  {
  write("CM_TCH_STAT");
  $TELEMATIC_FD_5::CM_TCH_STAT=@User_Node::CM_TCH_STAT_SET_INT_1;
  setTimer(CM_TCH_STAT, 2000);
  @User_Node::CM_TCH_STAT_SET_INT_1=0;
  }
}

on timer CM_TCH_STAT
{
  
  $TELEMATIC_FD_5::CM_TCH_STAT=0;
  cancelTimer(CM_TCH_STAT);
}

on envVar MEnv_ManualDisplayRes_SET_INT_1
{
  if(@this==1)
   {
  @User_Node::CM_TCH_STAT_SET_INT_1=1;
  @User_Node::X_Cordinate_SET_INT_1=@MEnv_DisplayResX_SET_INT_1;
  @User_Node::Y_Cordinate_SET_INT_1=@MEnv_DisplayResY_SET_INT_1;
  }
  
  else 
    { 
       }
}

on sysvar Message_Control::CameraDisplaySta2
{
  $CameraDisplaySts2 = @this;
}

on signal CameraDisplaySts2
{
  @Message_Control::CameraDisplaySta2 = this;
}