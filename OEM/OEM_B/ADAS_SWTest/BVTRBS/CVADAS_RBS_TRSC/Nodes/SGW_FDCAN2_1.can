/*@!Encoding:1252*/
includes
{
  // Import required CAPL include files
  //--- begin generated part --- Block start #Hdr_Includes#; do not delete this line and do not add application code in this code block!
  /* #ChannelStart# |CAN1| #BusStart# |FDCAN2_1| */
  /* #ChannelEnd# |CAN1| #BusEnd# |FDCAN2_1| */
  //--- end generated part --- Block end #Hdr_Includes#; do not delete this line! Add application code below this line.
  //--- begin generated part --- Block start #Body_Includes#; do not delete this line and do not add application code in this code block!
  /* #ChannelStart# |CAN1| #BusStart# |FDCAN2_1| */
  #include "..\CAPL\Vector-IL-KL30-Helper_CAN1.cin"
  #include "..\CAPL\Vector-NM-Panel-Helper_CAN1.cin"
  #include "..\CAPL\Vector-NM-ASR-Helper_CAN1.cin"
  /* #ChannelEnd# |CAN1| #BusEnd# |FDCAN2_1| */
  //--- end generated part --- Block end #Body_Includes#; do not delete this line! Add application code below this line.
}

variables
{
  // Define global variables for this CAPL file

  /*--- #GenHeader Begin# --- begin generated comment ---
  | Generated on Tuesday, November 15, 2022, 19:51:27
  | By ModelGenerator for Vector 1.5.4.10, ModelGeneratorVectorDLL 1.5.4.41
  | Package Vector 4.0.21
  | Target Bus: FDCAN2_1; Channel: CAN1; DB Cluster: FDCAN2_1;
  | From Database: FDCAN2.dbc
  | CANoe Version 15.5.23.0
    --- #GenHeader End  # --- end generated comment --- */

  char gECU[256] = "SGW";
  //--- begin generated part --- Block start #Hdr_GlobalVariables#; do not delete this line and do not add application code in this code block!
  /* #ChannelStart# |CAN1| #BusStart# |FDCAN2_1| */
  /* #ChannelEnd# |CAN1| #BusEnd# |FDCAN2_1| */
  //--- end generated part --- Block end #Hdr_GlobalVariables#; do not delete this line! Add application code below this line.
  //--- begin generated part --- Block start #Body_GlobalVariables#; do not delete this line and do not add application code in this code block!
  /* #ChannelStart# |CAN1| #BusStart# |FDCAN2_1| */
  char gCAN1BusName[256] = "FDCAN2_1";
  int gCAN1Channel = 1; //// The channel the bus is attached to

  long gCAN1DisturbanceMode;
  long gCAN1DisturbanceCount;
  long gCAN1DisturbanceValue;
  long gCAN1DisturbanceContinueMode;
  double gCAN1DisturbancePeriod;
  /* #ChannelEnd# |CAN1| #BusEnd# |FDCAN2_1| */
  //--- end generated part --- Block end #Body_GlobalVariables#; do not delete this line! Add application code below this line.
}

on preStart
{
  // Initialize CAPL includes and node's modules/DLLs
  //--- begin generated part --- Block start #Hdr_OnInit#; do not delete this line and do not add application code in this code block!
  /* #ChannelStart# |CAN1| #BusStart# |FDCAN2_1| */
  /* #ChannelEnd# |CAN1| #BusEnd# |FDCAN2_1| */
  //--- end generated part --- Block end #Hdr_OnInit#; do not delete this line! Add application code below this line.
  //--- begin generated part --- Block start #Body_OnInit#; do not delete this line and do not add application code in this code block!
  /* #ChannelStart# |CAN1| #BusStart# |FDCAN2_1| */
  ILCAN1_OnInit();
  NMCAN1_OnInit();
  /* #ChannelEnd# |CAN1| #BusEnd# |FDCAN2_1| */
  //--- end generated part --- Block end #Body_OnInit#; do not delete this line! Add application code below this line.
}

on start
{
  // Start CAPL includes and node's modules/DLLs
  //--- begin generated part --- Block start #Hdr_OnStart#; do not delete this line and do not add application code in this code block!
  /* #ChannelStart# |CAN1| #BusStart# |FDCAN2_1| */
  /* #ChannelEnd# |CAN1| #BusEnd# |FDCAN2_1| */
  //--- end generated part --- Block end #Hdr_OnStart#; do not delete this line! Add application code below this line.
  //--- begin generated part --- Block start #Body_OnStart#; do not delete this line and do not add application code in this code block!
  /* #ChannelStart# |CAN1| #BusStart# |FDCAN2_1| */
  ILCAN1_OnStart();
  NMCAN1_OnStart();
  /* #ChannelEnd# |CAN1| #BusEnd# |FDCAN2_1| */
  //--- end generated part --- Block end #Body_OnStart#; do not delete this line! Add application code below this line.
}

on preStop
{
  // Prepare stopping
  //--- begin generated part --- Block start #Hdr_OnStopping#; do not delete this line and do not add application code in this code block!
  /* #ChannelStart# |CAN1| #BusStart# |FDCAN2_1| */
  /* #ChannelEnd# |CAN1| #BusEnd# |FDCAN2_1| */
  //--- end generated part --- Block end #Hdr_OnStopping#; do not delete this line! Add application code below this line.
  //--- begin generated part --- Block start #Body_OnStopping#; do not delete this line and do not add application code in this code block!
  /* #ChannelStart# |CAN1| #BusStart# |FDCAN2_1| */
  /* #ChannelEnd# |CAN1| #BusEnd# |FDCAN2_1| */
  //--- end generated part --- Block end #Body_OnStopping#; do not delete this line! Add application code below this line.
}

on stopMeasurement
{
  // Stop actions
  //--- begin generated part --- Block start #Hdr_OnStop#; do not delete this line and do not add application code in this code block!
  /* #ChannelStart# |CAN1| #BusStart# |FDCAN2_1| */
  /* #ChannelEnd# |CAN1| #BusEnd# |FDCAN2_1| */
  //--- end generated part --- Block end #Hdr_OnStop#; do not delete this line! Add application code below this line.
  //--- begin generated part --- Block start #Body_OnStop#; do not delete this line and do not add application code in this code block!
  /* #ChannelStart# |CAN1| #BusStart# |FDCAN2_1| */
  /* #ChannelEnd# |CAN1| #BusEnd# |FDCAN2_1| */
  //--- end generated part --- Block end #Body_OnStop#; do not delete this line! Add application code below this line.
}

void StartSim(dword busContext, int busActive, int mode)
{
  // Called when ... due to ...
  //   mode == 1: ILControlResume
  //   mode == 2: ILControlStart
  //   mode == 3: ILControlSimulationOn
  //--- begin generated part --- Block start #Hdr_StartSim#; do not delete this line and do not add application code in this code block!
  /* #ChannelStart# |CAN1| #BusStart# |FDCAN2_1| */
  /* #ChannelEnd# |CAN1| #BusEnd# |FDCAN2_1| */
  //--- end generated part --- Block end #Hdr_StartSim#; do not delete this line! Add application code below this line.
  //write("[%.6f %NODE_NAME%] StartSim(0x%X, %d, %d)", TimeNowNS()/1e9, busContext, busActive, mode);
  //--- begin generated part --- Block start #Body_StartSim#; do not delete this line and do not add application code in this code block!
  /* #ChannelStart# |CAN1| #BusStart# |FDCAN2_1| */
  /* #ChannelEnd# |CAN1| #BusEnd# |FDCAN2_1| */
  //--- end generated part --- Block end #Body_StartSim#; do not delete this line! Add application code below this line.
}

void StopSim(dword busContext, int busActive, int mode)
{
  // Called when ... due to ...
  //   mode == 1: ILControlWait
  //   mode == 2: ILControlStop
  //   mode == 3: ILControlSimulationOff
  //--- begin generated part --- Block start #Hdr_StopSim#; do not delete this line and do not add application code in this code block!
  /* #ChannelStart# |CAN1| #BusStart# |FDCAN2_1| */
  /* #ChannelEnd# |CAN1| #BusEnd# |FDCAN2_1| */
  //--- end generated part --- Block end #Hdr_StopSim#; do not delete this line! Add application code below this line.
  //write("[%.6f %NODE_NAME%] StopSim(0x%X, %d, %d)", TimeNowNS()/1e9, busContext, busActive, mode);
  //--- begin generated part --- Block start #Body_StopSim#; do not delete this line and do not add application code in this code block!
  /* #ChannelStart# |CAN1| #BusStart# |FDCAN2_1| */
  /* #ChannelEnd# |CAN1| #BusEnd# |FDCAN2_1| */
  //--- end generated part --- Block end #Body_StopSim#; do not delete this line! Add application code below this line.
}

on sysvar_update sysvar::IL::Klemme15
{
  // Handle system state variable
  //--- begin generated part --- Block start #Hdr_KL15_Klemme15#; do not delete this line and do not add application code in this code block!
  /* #ChannelStart# |CAN1| #BusStart# |FDCAN2_1| */
  /* #ChannelEnd# |CAN1| #BusEnd# |FDCAN2_1| */
  //--- end generated part --- Block end #Hdr_KL15_Klemme15#; do not delete this line! Add application code below this line.
  //--- begin generated part --- Block start #Body_KL15_Klemme15#; do not delete this line and do not add application code in this code block!
  /* #ChannelStart# |CAN1| #BusStart# |FDCAN2_1| */
  ILCAN1_OnEnvKlemme15(@this);
  /* #ChannelEnd# |CAN1| #BusEnd# |FDCAN2_1| */
  //--- end generated part --- Block end #Body_KL15_Klemme15#; do not delete this line! Add application code below this line.
}

on sysvar_update sysvar::IL::Klemme30
{
  // Handle system state variable
  //--- begin generated part --- Block start #Hdr_KL30_Klemme30#; do not delete this line and do not add application code in this code block!
  /* #ChannelStart# |CAN1| #BusStart# |FDCAN2_1| */
  /* #ChannelEnd# |CAN1| #BusEnd# |FDCAN2_1| */
  //--- end generated part --- Block end #Hdr_KL30_Klemme30#; do not delete this line! Add application code below this line.
  //--- begin generated part --- Block start #Body_KL30_Klemme30#; do not delete this line and do not add application code in this code block!
  /* #ChannelStart# |CAN1| #BusStart# |FDCAN2_1| */
  ILCAN1_OnEnvKlemme30(@this);
  /* #ChannelEnd# |CAN1| #BusEnd# |FDCAN2_1| */
  //--- end generated part --- Block end #Body_KL30_Klemme30#; do not delete this line! Add application code below this line.
}

dword applILTxPending(long aId, dword aDlc, byte data[])
{
  dword ret = 1;
  //--- begin generated part --- Block start #Hdr_applILTxPending#; do not delete this line and do not add application code in this code block!
  /* #ChannelStart# |CAN1| #BusStart# |FDCAN2_1| */
  /* #ChannelEnd# |CAN1| #BusEnd# |FDCAN2_1| */
  //--- end generated part --- Block end #Hdr_applILTxPending#; do not delete this line! Add application code below this line.
  //--- begin generated part --- Block start #Body_applILTxPending#; do not delete this line and do not add application code in this code block!
  /* #ChannelStart# |CAN1| #BusStart# |FDCAN2_1| */
  /* #ChannelEnd# |CAN1| #BusEnd# |FDCAN2_1| */
  //--- end generated part --- Block end #Body_applILTxPending#; do not delete this line! Add application code below this line.
  return ret;
}

void Nm_NetworkStartInd()
{
  // Callback of CAN AUTOSAR NM DLL
  dword lBusContext;
  //--- begin generated part --- Block start #Hdr_Nm_NetworkStartInd#; do not delete this line and do not add application code in this code block!
  /* #ChannelStart# |CAN1| #BusStart# |FDCAN2_1| */
  /* #ChannelEnd# |CAN1| #BusEnd# |FDCAN2_1| */
  //--- end generated part --- Block end #Hdr_Nm_NetworkStartInd#; do not delete this line! Add application code below this line.
  lBusContext = GetBusContext();
  //--- begin generated part --- Block start #Body_Nm_NetworkStartInd#; do not delete this line and do not add application code in this code block!
  /* #ChannelStart# |CAN1| #BusStart# |FDCAN2_1| */
  if (lBusContext == gNMCAN1_BusContext) NMCAN1_IndNetworkStart();
  /* #ChannelEnd# |CAN1| #BusEnd# |FDCAN2_1| */
  //--- end generated part --- Block end #Body_Nm_NetworkStartInd#; do not delete this line! Add application code below this line.
  SetBusContext(lBusContext);
}

void Nm_NetworkModeInd()
{
  // Callback of CAN AUTOSAR NM DLL
  dword lBusContext;
  //--- begin generated part --- Block start #Hdr_Nm_NetworkModeInd#; do not delete this line and do not add application code in this code block!
  /* #ChannelStart# |CAN1| #BusStart# |FDCAN2_1| */
  /* #ChannelEnd# |CAN1| #BusEnd# |FDCAN2_1| */
  //--- end generated part --- Block end #Hdr_Nm_NetworkModeInd#; do not delete this line! Add application code below this line.
  lBusContext = GetBusContext();
  //--- begin generated part --- Block start #Body_Nm_NetworkModeInd#; do not delete this line and do not add application code in this code block!
  /* #ChannelStart# |CAN1| #BusStart# |FDCAN2_1| */
  if (lBusContext == gNMCAN1_BusContext) NMCAN1_IndNetworkMode();
  /* #ChannelEnd# |CAN1| #BusEnd# |FDCAN2_1| */
  //--- end generated part --- Block end #Body_Nm_NetworkModeInd#; do not delete this line! Add application code below this line.
  SetBusContext(lBusContext);
}

void Nm_NetworkTimeoutInd()
{
  // Callback of CAN AUTOSAR NM DLL
  dword lBusContext;
  //--- begin generated part --- Block start #Hdr_Nm_NetworkTimeoutInd#; do not delete this line and do not add application code in this code block!
  /* #ChannelStart# |CAN1| #BusStart# |FDCAN2_1| */
  /* #ChannelEnd# |CAN1| #BusEnd# |FDCAN2_1| */
  //--- end generated part --- Block end #Hdr_Nm_NetworkTimeoutInd#; do not delete this line! Add application code below this line.
  lBusContext = GetBusContext();
  //--- begin generated part --- Block start #Body_Nm_NetworkTimeoutInd#; do not delete this line and do not add application code in this code block!
  /* #ChannelStart# |CAN1| #BusStart# |FDCAN2_1| */
  if (lBusContext == gNMCAN1_BusContext) NMCAN1_IndNetworkTimeout();
  /* #ChannelEnd# |CAN1| #BusEnd# |FDCAN2_1| */
  //--- end generated part --- Block end #Body_Nm_NetworkTimeoutInd#; do not delete this line! Add application code below this line.
  SetBusContext(lBusContext);
}

void Nm_PrepareBusSleepModeInd()
{
  // Callback of CAN AUTOSAR NM DLL
  dword lBusContext;
  //--- begin generated part --- Block start #Hdr_Nm_PrepareBusSleepModeInd#; do not delete this line and do not add application code in this code block!
  /* #ChannelStart# |CAN1| #BusStart# |FDCAN2_1| */
  /* #ChannelEnd# |CAN1| #BusEnd# |FDCAN2_1| */
  //--- end generated part --- Block end #Hdr_Nm_PrepareBusSleepModeInd#; do not delete this line! Add application code below this line.
  lBusContext = GetBusContext();
  //--- begin generated part --- Block start #Body_Nm_PrepareBusSleepModeInd#; do not delete this line and do not add application code in this code block!
  /* #ChannelStart# |CAN1| #BusStart# |FDCAN2_1| */
  if (lBusContext == gNMCAN1_BusContext) NMCAN1_IndPrepareBusSleepMode();
  /* #ChannelEnd# |CAN1| #BusEnd# |FDCAN2_1| */
  //--- end generated part --- Block end #Body_Nm_PrepareBusSleepModeInd#; do not delete this line! Add application code below this line.
  SetBusContext(lBusContext);
}

void Nm_BusSleepModeInd()
{
  // Callback of CAN AUTOSAR NM DLL
  dword lBusContext;
  //--- begin generated part --- Block start #Hdr_Nm_BusSleepModeInd#; do not delete this line and do not add application code in this code block!
  /* #ChannelStart# |CAN1| #BusStart# |FDCAN2_1| */
  /* #ChannelEnd# |CAN1| #BusEnd# |FDCAN2_1| */
  //--- end generated part --- Block end #Hdr_Nm_BusSleepModeInd#; do not delete this line! Add application code below this line.
  lBusContext = GetBusContext();
  //--- begin generated part --- Block start #Body_Nm_BusSleepModeInd#; do not delete this line and do not add application code in this code block!
  /* #ChannelStart# |CAN1| #BusStart# |FDCAN2_1| */
  if (lBusContext == gNMCAN1_BusContext) NMCAN1_IndBusSleepMode();
  /* #ChannelEnd# |CAN1| #BusEnd# |FDCAN2_1| */
  //--- end generated part --- Block end #Body_Nm_BusSleepModeInd#; do not delete this line! Add application code below this line.
  SetBusContext(lBusContext);
}

void Nm_StateChangeNotification(long previousState, long currentState)
{
  // Callback of CAN AUTOSAR NM DLL
  dword lBusContext;
  //--- begin generated part --- Block start #Hdr_Nm_StateChangeNotification#; do not delete this line and do not add application code in this code block!
  /* #ChannelStart# |CAN1| #BusStart# |FDCAN2_1| */
  /* #ChannelEnd# |CAN1| #BusEnd# |FDCAN2_1| */
  //--- end generated part --- Block end #Hdr_Nm_StateChangeNotification#; do not delete this line! Add application code below this line.
  lBusContext = GetBusContext();
  //--- begin generated part --- Block start #Body_Nm_StateChangeNotification#; do not delete this line and do not add application code in this code block!
  /* #ChannelStart# |CAN1| #BusStart# |FDCAN2_1| */
  if (lBusContext == gNMCAN1_BusContext) NMCAN1_IndStateChangeNotification(previousState, currentState);
  /* #ChannelEnd# |CAN1| #BusEnd# |FDCAN2_1| */
  //--- end generated part --- Block end #Body_Nm_StateChangeNotification#; do not delete this line! Add application code below this line.
  SetBusContext(lBusContext);
}

//--- begin generated part --- Block start <#Helper_Functions#> do not delete this line and do not add application code in this code block!
/* #ChannelStart# |CAN1| #BusStart# |FDCAN2_1| */
/* #ChannelEnd# |CAN1| #BusEnd# |FDCAN2_1| */
//--- end generated part --- Block end <#Helper_Functions#> do not delete this line! Add application code below this line.

//--- begin generated part --- Block start <#SysVar_Handler#> do not delete this line and do not add application code in this code block!
/* #ChannelStart# |CAN1| #BusStart# |FDCAN2_1| */
on sysvar_update sysvar::IL_CAN1::NODES::N_SGW::EnableNode
{
  ILCAN1_Enable(@this && @sysvar::IL_CAN1::enable_AllNodes);
}

on sysvar_update sysvar::IL_CAN1::enable_AllNodes
{
  ILCAN1_Enable(@this && @sysvar::IL_CAN1::NODES::N_SGW::EnableNode);
}

on sysvar_update sysvar::NM_CAN1::NODES::N_SGW::DeactivateNM
{
  if( @this == 1 || @sysvar::NM_CAN1::StateControl::DeactivateNM == 1)
  {
    NMCAN1_Enable(0);
  }
  else
  {
    NMCAN1_Enable(1);
  }
}

on sysvar_update sysvar::NM_CAN1::StateControl::DeactivateNM
{
  if( @this == 1 || @sysvar::NM_CAN1::NODES::N_SGW::DeactivateNM == 1)
  {
    NMCAN1_Enable(0);
  }
  else
  {
    NMCAN1_Enable(1);
  }
}

on sysvar_update sysvar::IL_CAN1::NODES::N_SGW::MESSAGES::FOTA_MASTER::TIMINGS::EnableCyclic
{
  if (@this == 1)
  {
    SetBusContext(gILCAN1_BusContext);
    ILFaultInjectionEnableMsg  (FDCAN2_1::SGW::FOTA_MASTER);
  }
  else
  {
    SetBusContext(gILCAN1_BusContext);
    ILFaultInjectionDisableMsg (FDCAN2_1::SGW::FOTA_MASTER);
  }
}

on sysvar_update sysvar::IL_CAN1::NODES::N_SGW::MESSAGES::FOTA_MASTER::TIMINGS::SetNormalCycle
{
  if (@this == 1 && @sysvar::IL_CAN1::NODES::N_SGW::MESSAGES::FOTA_MASTER::TIMINGS::EnableCyclic)
  {
    @sysvar::IL_CAN1::NODES::N_SGW::MESSAGES::FOTA_MASTER::TIMINGS::SelectedPeriod = 0;
  }
}

on sysvar_update sysvar::IL_CAN1::NODES::N_SGW::MESSAGES::FOTA_MASTER::TIMINGS::SetNewCycleContinously
{
  if (@this == 1 && @sysvar::IL_CAN1::NODES::N_SGW::MESSAGES::FOTA_MASTER::TIMINGS::EnableCyclic)
  {
    @sysvar::IL_CAN1::NODES::N_SGW::MESSAGES::FOTA_MASTER::TIMINGS::SelectedPeriod = -1;
  }
}

on sysvar_update sysvar::IL_CAN1::NODES::N_SGW::MESSAGES::FOTA_MASTER::TIMINGS::SelectedPeriod
{
  if (@this == 0 && @sysvar::IL_CAN1::NODES::N_SGW::MESSAGES::FOTA_MASTER::TIMINGS::EnableCyclic)
  {
    SetBusContext(gILCAN1_BusContext);
    gCAN1DisturbancePeriod = @sysvar::IL_CAN1::NODES::N_SGW::MESSAGES::FOTA_MASTER::TIMINGS::NormalCyclePeriod;
    ILFaultInjectionResetMsgCycleTime(FDCAN2_1::SGW::FOTA_MASTER);
  }
  else if (@this == 1 && @sysvar::IL_CAN1::NODES::N_SGW::MESSAGES::FOTA_MASTER::TIMINGS::EnableCyclic)
  {
    SetBusContext(gILCAN1_BusContext);
    gCAN1DisturbancePeriod = @sysvar::IL_CAN1::NODES::N_SGW::MESSAGES::FOTA_MASTER::TIMINGS::ActiveCyclePeriod;
    ILFaultInjectionSetMsgCycleTime(FDCAN2_1::SGW::FOTA_MASTER, gCAN1DisturbancePeriod);
  }
  else if (@this == -1 && @sysvar::IL_CAN1::NODES::N_SGW::MESSAGES::FOTA_MASTER::TIMINGS::EnableCyclic)
  {
    SetBusContext(gILCAN1_BusContext);
    gCAN1DisturbancePeriod = @sysvar::IL_CAN1::NODES::N_SGW::MESSAGES::FOTA_MASTER::TIMINGS::CyclePeriod;
    ILFaultInjectionSetMsgCycleTime(FDCAN2_1::SGW::FOTA_MASTER, gCAN1DisturbancePeriod);
  }
}

on sysvar_update sysvar::IL_CAN1::NODES::N_SGW::MESSAGES::FOTA_MASTER::TIMINGS::SendOnce
{
  if (@this == 1)
  {
    SetBusContext(gILCAN1_BusContext);
    ILSetMsgEvent(FDCAN2_1::SGW::FOTA_MASTER);
  }
}

on sysvar_update sysvar::IL_CAN1::NODES::N_SGW::MESSAGES::PDC_INFO_FD_ETM::TIMINGS::EnableCyclic
{
  if (@this == 1)
  {
    SetBusContext(gILCAN1_BusContext);
    ILFaultInjectionEnableMsg  (FDCAN2_1::SGW::PDC_INFO_FD_ETM);
  }
  else
  {
    SetBusContext(gILCAN1_BusContext);
    ILFaultInjectionDisableMsg (FDCAN2_1::SGW::PDC_INFO_FD_ETM);
  }
}

on sysvar_update sysvar::IL_CAN1::NODES::N_SGW::MESSAGES::PDC_INFO_FD_ETM::TIMINGS::SetNormalCycle
{
  if (@this == 1 && @sysvar::IL_CAN1::NODES::N_SGW::MESSAGES::PDC_INFO_FD_ETM::TIMINGS::EnableCyclic)
  {
    @sysvar::IL_CAN1::NODES::N_SGW::MESSAGES::PDC_INFO_FD_ETM::TIMINGS::SelectedPeriod = 0;
  }
}

on sysvar_update sysvar::IL_CAN1::NODES::N_SGW::MESSAGES::PDC_INFO_FD_ETM::TIMINGS::SetNewCycleContinously
{
  if (@this == 1 && @sysvar::IL_CAN1::NODES::N_SGW::MESSAGES::PDC_INFO_FD_ETM::TIMINGS::EnableCyclic)
  {
    @sysvar::IL_CAN1::NODES::N_SGW::MESSAGES::PDC_INFO_FD_ETM::TIMINGS::SelectedPeriod = -1;
  }
}

on sysvar_update sysvar::IL_CAN1::NODES::N_SGW::MESSAGES::PDC_INFO_FD_ETM::TIMINGS::SelectedPeriod
{
  if (@this == 0 && @sysvar::IL_CAN1::NODES::N_SGW::MESSAGES::PDC_INFO_FD_ETM::TIMINGS::EnableCyclic)
  {
    SetBusContext(gILCAN1_BusContext);
    gCAN1DisturbancePeriod = @sysvar::IL_CAN1::NODES::N_SGW::MESSAGES::PDC_INFO_FD_ETM::TIMINGS::NormalCyclePeriod;
    ILFaultInjectionResetMsgCycleTime(FDCAN2_1::SGW::PDC_INFO_FD_ETM);
  }
  else if (@this == 1 && @sysvar::IL_CAN1::NODES::N_SGW::MESSAGES::PDC_INFO_FD_ETM::TIMINGS::EnableCyclic)
  {
    SetBusContext(gILCAN1_BusContext);
    gCAN1DisturbancePeriod = @sysvar::IL_CAN1::NODES::N_SGW::MESSAGES::PDC_INFO_FD_ETM::TIMINGS::ActiveCyclePeriod;
    ILFaultInjectionSetMsgCycleTime(FDCAN2_1::SGW::PDC_INFO_FD_ETM, gCAN1DisturbancePeriod);
  }
  else if (@this == -1 && @sysvar::IL_CAN1::NODES::N_SGW::MESSAGES::PDC_INFO_FD_ETM::TIMINGS::EnableCyclic)
  {
    SetBusContext(gILCAN1_BusContext);
    gCAN1DisturbancePeriod = @sysvar::IL_CAN1::NODES::N_SGW::MESSAGES::PDC_INFO_FD_ETM::TIMINGS::CyclePeriod;
    ILFaultInjectionSetMsgCycleTime(FDCAN2_1::SGW::PDC_INFO_FD_ETM, gCAN1DisturbancePeriod);
  }
}

on sysvar_update sysvar::IL_CAN1::NODES::N_SGW::MESSAGES::PDC_INFO_FD_ETM::TIMINGS::SendOnce
{
  if (@this == 1)
  {
    SetBusContext(gILCAN1_BusContext);
    ILSetMsgEvent(FDCAN2_1::SGW::PDC_INFO_FD_ETM);
  }
}

on sysvar_update sysvar::IL_CAN1::NODES::N_SGW::MESSAGES::PDC_INFO_FD_SGW::TIMINGS::EnableCyclic
{
  if (@this == 1)
  {
    SetBusContext(gILCAN1_BusContext);
    ILFaultInjectionEnableMsg  (FDCAN2_1::SGW::PDC_INFO_FD_SGW);
  }
  else
  {
    SetBusContext(gILCAN1_BusContext);
    ILFaultInjectionDisableMsg (FDCAN2_1::SGW::PDC_INFO_FD_SGW);
  }
}

on sysvar_update sysvar::IL_CAN1::NODES::N_SGW::MESSAGES::PDC_INFO_FD_SGW::TIMINGS::SetNormalCycle
{
  if (@this == 1 && @sysvar::IL_CAN1::NODES::N_SGW::MESSAGES::PDC_INFO_FD_SGW::TIMINGS::EnableCyclic)
  {
    @sysvar::IL_CAN1::NODES::N_SGW::MESSAGES::PDC_INFO_FD_SGW::TIMINGS::SelectedPeriod = 0;
  }
}

on sysvar_update sysvar::IL_CAN1::NODES::N_SGW::MESSAGES::PDC_INFO_FD_SGW::TIMINGS::SetNewCycleContinously
{
  if (@this == 1 && @sysvar::IL_CAN1::NODES::N_SGW::MESSAGES::PDC_INFO_FD_SGW::TIMINGS::EnableCyclic)
  {
    @sysvar::IL_CAN1::NODES::N_SGW::MESSAGES::PDC_INFO_FD_SGW::TIMINGS::SelectedPeriod = -1;
  }
}

on sysvar_update sysvar::IL_CAN1::NODES::N_SGW::MESSAGES::PDC_INFO_FD_SGW::TIMINGS::SelectedPeriod
{
  if (@this == 0 && @sysvar::IL_CAN1::NODES::N_SGW::MESSAGES::PDC_INFO_FD_SGW::TIMINGS::EnableCyclic)
  {
    SetBusContext(gILCAN1_BusContext);
    gCAN1DisturbancePeriod = @sysvar::IL_CAN1::NODES::N_SGW::MESSAGES::PDC_INFO_FD_SGW::TIMINGS::NormalCyclePeriod;
    ILFaultInjectionResetMsgCycleTime(FDCAN2_1::SGW::PDC_INFO_FD_SGW);
  }
  else if (@this == 1 && @sysvar::IL_CAN1::NODES::N_SGW::MESSAGES::PDC_INFO_FD_SGW::TIMINGS::EnableCyclic)
  {
    SetBusContext(gILCAN1_BusContext);
    gCAN1DisturbancePeriod = @sysvar::IL_CAN1::NODES::N_SGW::MESSAGES::PDC_INFO_FD_SGW::TIMINGS::ActiveCyclePeriod;
    ILFaultInjectionSetMsgCycleTime(FDCAN2_1::SGW::PDC_INFO_FD_SGW, gCAN1DisturbancePeriod);
  }
  else if (@this == -1 && @sysvar::IL_CAN1::NODES::N_SGW::MESSAGES::PDC_INFO_FD_SGW::TIMINGS::EnableCyclic)
  {
    SetBusContext(gILCAN1_BusContext);
    gCAN1DisturbancePeriod = @sysvar::IL_CAN1::NODES::N_SGW::MESSAGES::PDC_INFO_FD_SGW::TIMINGS::CyclePeriod;
    ILFaultInjectionSetMsgCycleTime(FDCAN2_1::SGW::PDC_INFO_FD_SGW, gCAN1DisturbancePeriod);
  }
}

on sysvar_update sysvar::IL_CAN1::NODES::N_SGW::MESSAGES::PDC_INFO_FD_SGW::TIMINGS::SendOnce
{
  if (@this == 1)
  {
    SetBusContext(gILCAN1_BusContext);
    ILSetMsgEvent(FDCAN2_1::SGW::PDC_INFO_FD_SGW);
  }
}

on sysvar_update sysvar::IL_CAN1::NODES::N_SGW::MESSAGES::PDC_INFO_FD_TBM::TIMINGS::EnableCyclic
{
  if (@this == 1)
  {
    SetBusContext(gILCAN1_BusContext);
    ILFaultInjectionEnableMsg  (FDCAN2_1::SGW::PDC_INFO_FD_TBM);
  }
  else
  {
    SetBusContext(gILCAN1_BusContext);
    ILFaultInjectionDisableMsg (FDCAN2_1::SGW::PDC_INFO_FD_TBM);
  }
}

on sysvar_update sysvar::IL_CAN1::NODES::N_SGW::MESSAGES::PDC_INFO_FD_TBM::TIMINGS::SetNormalCycle
{
  if (@this == 1 && @sysvar::IL_CAN1::NODES::N_SGW::MESSAGES::PDC_INFO_FD_TBM::TIMINGS::EnableCyclic)
  {
    @sysvar::IL_CAN1::NODES::N_SGW::MESSAGES::PDC_INFO_FD_TBM::TIMINGS::SelectedPeriod = 0;
  }
}

on sysvar_update sysvar::IL_CAN1::NODES::N_SGW::MESSAGES::PDC_INFO_FD_TBM::TIMINGS::SetNewCycleContinously
{
  if (@this == 1 && @sysvar::IL_CAN1::NODES::N_SGW::MESSAGES::PDC_INFO_FD_TBM::TIMINGS::EnableCyclic)
  {
    @sysvar::IL_CAN1::NODES::N_SGW::MESSAGES::PDC_INFO_FD_TBM::TIMINGS::SelectedPeriod = -1;
  }
}

on sysvar_update sysvar::IL_CAN1::NODES::N_SGW::MESSAGES::PDC_INFO_FD_TBM::TIMINGS::SelectedPeriod
{
  if (@this == 0 && @sysvar::IL_CAN1::NODES::N_SGW::MESSAGES::PDC_INFO_FD_TBM::TIMINGS::EnableCyclic)
  {
    SetBusContext(gILCAN1_BusContext);
    gCAN1DisturbancePeriod = @sysvar::IL_CAN1::NODES::N_SGW::MESSAGES::PDC_INFO_FD_TBM::TIMINGS::NormalCyclePeriod;
    ILFaultInjectionResetMsgCycleTime(FDCAN2_1::SGW::PDC_INFO_FD_TBM);
  }
  else if (@this == 1 && @sysvar::IL_CAN1::NODES::N_SGW::MESSAGES::PDC_INFO_FD_TBM::TIMINGS::EnableCyclic)
  {
    SetBusContext(gILCAN1_BusContext);
    gCAN1DisturbancePeriod = @sysvar::IL_CAN1::NODES::N_SGW::MESSAGES::PDC_INFO_FD_TBM::TIMINGS::ActiveCyclePeriod;
    ILFaultInjectionSetMsgCycleTime(FDCAN2_1::SGW::PDC_INFO_FD_TBM, gCAN1DisturbancePeriod);
  }
  else if (@this == -1 && @sysvar::IL_CAN1::NODES::N_SGW::MESSAGES::PDC_INFO_FD_TBM::TIMINGS::EnableCyclic)
  {
    SetBusContext(gILCAN1_BusContext);
    gCAN1DisturbancePeriod = @sysvar::IL_CAN1::NODES::N_SGW::MESSAGES::PDC_INFO_FD_TBM::TIMINGS::CyclePeriod;
    ILFaultInjectionSetMsgCycleTime(FDCAN2_1::SGW::PDC_INFO_FD_TBM, gCAN1DisturbancePeriod);
  }
}

on sysvar_update sysvar::IL_CAN1::NODES::N_SGW::MESSAGES::PDC_INFO_FD_TBM::TIMINGS::SendOnce
{
  if (@this == 1)
  {
    SetBusContext(gILCAN1_BusContext);
    ILSetMsgEvent(FDCAN2_1::SGW::PDC_INFO_FD_TBM);
  }
}

on sysvar_update sysvar::IL_CAN1::NODES::N_SGW::MESSAGES::PDC_INFO_FD_VRM::TIMINGS::EnableCyclic
{
  if (@this == 1)
  {
    SetBusContext(gILCAN1_BusContext);
    ILFaultInjectionEnableMsg  (FDCAN2_1::SGW::PDC_INFO_FD_VRM);
  }
  else
  {
    SetBusContext(gILCAN1_BusContext);
    ILFaultInjectionDisableMsg (FDCAN2_1::SGW::PDC_INFO_FD_VRM);
  }
}

on sysvar_update sysvar::IL_CAN1::NODES::N_SGW::MESSAGES::PDC_INFO_FD_VRM::TIMINGS::SetNormalCycle
{
  if (@this == 1 && @sysvar::IL_CAN1::NODES::N_SGW::MESSAGES::PDC_INFO_FD_VRM::TIMINGS::EnableCyclic)
  {
    @sysvar::IL_CAN1::NODES::N_SGW::MESSAGES::PDC_INFO_FD_VRM::TIMINGS::SelectedPeriod = 0;
  }
}

on sysvar_update sysvar::IL_CAN1::NODES::N_SGW::MESSAGES::PDC_INFO_FD_VRM::TIMINGS::SetNewCycleContinously
{
  if (@this == 1 && @sysvar::IL_CAN1::NODES::N_SGW::MESSAGES::PDC_INFO_FD_VRM::TIMINGS::EnableCyclic)
  {
    @sysvar::IL_CAN1::NODES::N_SGW::MESSAGES::PDC_INFO_FD_VRM::TIMINGS::SelectedPeriod = -1;
  }
}

on sysvar_update sysvar::IL_CAN1::NODES::N_SGW::MESSAGES::PDC_INFO_FD_VRM::TIMINGS::SelectedPeriod
{
  if (@this == 0 && @sysvar::IL_CAN1::NODES::N_SGW::MESSAGES::PDC_INFO_FD_VRM::TIMINGS::EnableCyclic)
  {
    SetBusContext(gILCAN1_BusContext);
    gCAN1DisturbancePeriod = @sysvar::IL_CAN1::NODES::N_SGW::MESSAGES::PDC_INFO_FD_VRM::TIMINGS::NormalCyclePeriod;
    ILFaultInjectionResetMsgCycleTime(FDCAN2_1::SGW::PDC_INFO_FD_VRM);
  }
  else if (@this == 1 && @sysvar::IL_CAN1::NODES::N_SGW::MESSAGES::PDC_INFO_FD_VRM::TIMINGS::EnableCyclic)
  {
    SetBusContext(gILCAN1_BusContext);
    gCAN1DisturbancePeriod = @sysvar::IL_CAN1::NODES::N_SGW::MESSAGES::PDC_INFO_FD_VRM::TIMINGS::ActiveCyclePeriod;
    ILFaultInjectionSetMsgCycleTime(FDCAN2_1::SGW::PDC_INFO_FD_VRM, gCAN1DisturbancePeriod);
  }
  else if (@this == -1 && @sysvar::IL_CAN1::NODES::N_SGW::MESSAGES::PDC_INFO_FD_VRM::TIMINGS::EnableCyclic)
  {
    SetBusContext(gILCAN1_BusContext);
    gCAN1DisturbancePeriod = @sysvar::IL_CAN1::NODES::N_SGW::MESSAGES::PDC_INFO_FD_VRM::TIMINGS::CyclePeriod;
    ILFaultInjectionSetMsgCycleTime(FDCAN2_1::SGW::PDC_INFO_FD_VRM, gCAN1DisturbancePeriod);
  }
}

on sysvar_update sysvar::IL_CAN1::NODES::N_SGW::MESSAGES::PDC_INFO_FD_VRM::TIMINGS::SendOnce
{
  if (@this == 1)
  {
    SetBusContext(gILCAN1_BusContext);
    ILSetMsgEvent(FDCAN2_1::SGW::PDC_INFO_FD_VRM);
  }
}

on sysvar_update sysvar::IL_CAN1::NODES::N_SGW::MESSAGES::TBM_FD_2::TIMINGS::EnableCyclic
{
  if (@this == 1)
  {
    SetBusContext(gILCAN1_BusContext);
    ILFaultInjectionEnableMsg  (FDCAN2_1::SGW::TBM_FD_2);
  }
  else
  {
    SetBusContext(gILCAN1_BusContext);
    ILFaultInjectionDisableMsg (FDCAN2_1::SGW::TBM_FD_2);
  }
}

on sysvar_update sysvar::IL_CAN1::NODES::N_SGW::MESSAGES::TBM_FD_2::TIMINGS::SetNormalCycle
{
  if (@this == 1 && @sysvar::IL_CAN1::NODES::N_SGW::MESSAGES::TBM_FD_2::TIMINGS::EnableCyclic)
  {
    @sysvar::IL_CAN1::NODES::N_SGW::MESSAGES::TBM_FD_2::TIMINGS::SelectedPeriod = 0;
  }
}

on sysvar_update sysvar::IL_CAN1::NODES::N_SGW::MESSAGES::TBM_FD_2::TIMINGS::SetNewCycleContinously
{
  if (@this == 1 && @sysvar::IL_CAN1::NODES::N_SGW::MESSAGES::TBM_FD_2::TIMINGS::EnableCyclic)
  {
    @sysvar::IL_CAN1::NODES::N_SGW::MESSAGES::TBM_FD_2::TIMINGS::SelectedPeriod = -1;
  }
}

on sysvar_update sysvar::IL_CAN1::NODES::N_SGW::MESSAGES::TBM_FD_2::TIMINGS::SelectedPeriod
{
  if (@this == 0 && @sysvar::IL_CAN1::NODES::N_SGW::MESSAGES::TBM_FD_2::TIMINGS::EnableCyclic)
  {
    SetBusContext(gILCAN1_BusContext);
    gCAN1DisturbancePeriod = @sysvar::IL_CAN1::NODES::N_SGW::MESSAGES::TBM_FD_2::TIMINGS::NormalCyclePeriod;
    ILFaultInjectionResetMsgCycleTime(FDCAN2_1::SGW::TBM_FD_2);
  }
  else if (@this == 1 && @sysvar::IL_CAN1::NODES::N_SGW::MESSAGES::TBM_FD_2::TIMINGS::EnableCyclic)
  {
    SetBusContext(gILCAN1_BusContext);
    gCAN1DisturbancePeriod = @sysvar::IL_CAN1::NODES::N_SGW::MESSAGES::TBM_FD_2::TIMINGS::ActiveCyclePeriod;
    ILFaultInjectionSetMsgCycleTime(FDCAN2_1::SGW::TBM_FD_2, gCAN1DisturbancePeriod);
  }
  else if (@this == -1 && @sysvar::IL_CAN1::NODES::N_SGW::MESSAGES::TBM_FD_2::TIMINGS::EnableCyclic)
  {
    SetBusContext(gILCAN1_BusContext);
    gCAN1DisturbancePeriod = @sysvar::IL_CAN1::NODES::N_SGW::MESSAGES::TBM_FD_2::TIMINGS::CyclePeriod;
    ILFaultInjectionSetMsgCycleTime(FDCAN2_1::SGW::TBM_FD_2, gCAN1DisturbancePeriod);
  }
}

on sysvar_update sysvar::IL_CAN1::NODES::N_SGW::MESSAGES::TBM_FD_2::TIMINGS::SendOnce
{
  if (@this == 1)
  {
    SetBusContext(gILCAN1_BusContext);
    ILSetMsgEvent(FDCAN2_1::SGW::TBM_FD_2);
  }
}

on sysvar_update sysvar::IL_CAN1::NODES::N_SGW::MESSAGES::TBM_SCHEDULE_FD_2::TIMINGS::EnableCyclic
{
  if (@this == 1)
  {
    SetBusContext(gILCAN1_BusContext);
    ILFaultInjectionEnableMsg  (FDCAN2_1::SGW::TBM_SCHEDULE_FD_2);
  }
  else
  {
    SetBusContext(gILCAN1_BusContext);
    ILFaultInjectionDisableMsg (FDCAN2_1::SGW::TBM_SCHEDULE_FD_2);
  }
}

on sysvar_update sysvar::IL_CAN1::NODES::N_SGW::MESSAGES::TBM_SCHEDULE_FD_2::TIMINGS::SetNormalCycle
{
  if (@this == 1 && @sysvar::IL_CAN1::NODES::N_SGW::MESSAGES::TBM_SCHEDULE_FD_2::TIMINGS::EnableCyclic)
  {
    @sysvar::IL_CAN1::NODES::N_SGW::MESSAGES::TBM_SCHEDULE_FD_2::TIMINGS::SelectedPeriod = 0;
  }
}

on sysvar_update sysvar::IL_CAN1::NODES::N_SGW::MESSAGES::TBM_SCHEDULE_FD_2::TIMINGS::SetNewCycleContinously
{
  if (@this == 1 && @sysvar::IL_CAN1::NODES::N_SGW::MESSAGES::TBM_SCHEDULE_FD_2::TIMINGS::EnableCyclic)
  {
    @sysvar::IL_CAN1::NODES::N_SGW::MESSAGES::TBM_SCHEDULE_FD_2::TIMINGS::SelectedPeriod = -1;
  }
}

on sysvar_update sysvar::IL_CAN1::NODES::N_SGW::MESSAGES::TBM_SCHEDULE_FD_2::TIMINGS::SelectedPeriod
{
  if (@this == 0 && @sysvar::IL_CAN1::NODES::N_SGW::MESSAGES::TBM_SCHEDULE_FD_2::TIMINGS::EnableCyclic)
  {
    SetBusContext(gILCAN1_BusContext);
    gCAN1DisturbancePeriod = @sysvar::IL_CAN1::NODES::N_SGW::MESSAGES::TBM_SCHEDULE_FD_2::TIMINGS::NormalCyclePeriod;
    ILFaultInjectionResetMsgCycleTime(FDCAN2_1::SGW::TBM_SCHEDULE_FD_2);
  }
  else if (@this == 1 && @sysvar::IL_CAN1::NODES::N_SGW::MESSAGES::TBM_SCHEDULE_FD_2::TIMINGS::EnableCyclic)
  {
    SetBusContext(gILCAN1_BusContext);
    gCAN1DisturbancePeriod = @sysvar::IL_CAN1::NODES::N_SGW::MESSAGES::TBM_SCHEDULE_FD_2::TIMINGS::ActiveCyclePeriod;
    ILFaultInjectionSetMsgCycleTime(FDCAN2_1::SGW::TBM_SCHEDULE_FD_2, gCAN1DisturbancePeriod);
  }
  else if (@this == -1 && @sysvar::IL_CAN1::NODES::N_SGW::MESSAGES::TBM_SCHEDULE_FD_2::TIMINGS::EnableCyclic)
  {
    SetBusContext(gILCAN1_BusContext);
    gCAN1DisturbancePeriod = @sysvar::IL_CAN1::NODES::N_SGW::MESSAGES::TBM_SCHEDULE_FD_2::TIMINGS::CyclePeriod;
    ILFaultInjectionSetMsgCycleTime(FDCAN2_1::SGW::TBM_SCHEDULE_FD_2, gCAN1DisturbancePeriod);
  }
}

on sysvar_update sysvar::IL_CAN1::NODES::N_SGW::MESSAGES::TBM_SCHEDULE_FD_2::TIMINGS::SendOnce
{
  if (@this == 1)
  {
    SetBusContext(gILCAN1_BusContext);
    ILSetMsgEvent(FDCAN2_1::SGW::TBM_SCHEDULE_FD_2);
  }
}

on sysvar_update sysvar::IL_CAN1::NODES::N_SGW::MESSAGES::TELEMATIC_FD_1::TIMINGS::EnableCyclic
{
  if (@this == 1)
  {
    SetBusContext(gILCAN1_BusContext);
    ILFaultInjectionEnableMsg  (FDCAN2_1::SGW::TELEMATIC_FD_1);
  }
  else
  {
    SetBusContext(gILCAN1_BusContext);
    ILFaultInjectionDisableMsg (FDCAN2_1::SGW::TELEMATIC_FD_1);
  }
}

on sysvar_update sysvar::IL_CAN1::NODES::N_SGW::MESSAGES::TELEMATIC_FD_1::TIMINGS::SetNormalCycle
{
  if (@this == 1 && @sysvar::IL_CAN1::NODES::N_SGW::MESSAGES::TELEMATIC_FD_1::TIMINGS::EnableCyclic)
  {
    @sysvar::IL_CAN1::NODES::N_SGW::MESSAGES::TELEMATIC_FD_1::TIMINGS::SelectedPeriod = 0;
  }
}

on sysvar_update sysvar::IL_CAN1::NODES::N_SGW::MESSAGES::TELEMATIC_FD_1::TIMINGS::SetNewCycleContinously
{
  if (@this == 1 && @sysvar::IL_CAN1::NODES::N_SGW::MESSAGES::TELEMATIC_FD_1::TIMINGS::EnableCyclic)
  {
    @sysvar::IL_CAN1::NODES::N_SGW::MESSAGES::TELEMATIC_FD_1::TIMINGS::SelectedPeriod = -1;
  }
}

on sysvar_update sysvar::IL_CAN1::NODES::N_SGW::MESSAGES::TELEMATIC_FD_1::TIMINGS::SelectedPeriod
{
  if (@this == 0 && @sysvar::IL_CAN1::NODES::N_SGW::MESSAGES::TELEMATIC_FD_1::TIMINGS::EnableCyclic)
  {
    SetBusContext(gILCAN1_BusContext);
    gCAN1DisturbancePeriod = @sysvar::IL_CAN1::NODES::N_SGW::MESSAGES::TELEMATIC_FD_1::TIMINGS::NormalCyclePeriod;
    ILFaultInjectionResetMsgCycleTime(FDCAN2_1::SGW::TELEMATIC_FD_1);
  }
  else if (@this == 1 && @sysvar::IL_CAN1::NODES::N_SGW::MESSAGES::TELEMATIC_FD_1::TIMINGS::EnableCyclic)
  {
    SetBusContext(gILCAN1_BusContext);
    gCAN1DisturbancePeriod = @sysvar::IL_CAN1::NODES::N_SGW::MESSAGES::TELEMATIC_FD_1::TIMINGS::ActiveCyclePeriod;
    ILFaultInjectionSetMsgCycleTime(FDCAN2_1::SGW::TELEMATIC_FD_1, gCAN1DisturbancePeriod);
  }
  else if (@this == -1 && @sysvar::IL_CAN1::NODES::N_SGW::MESSAGES::TELEMATIC_FD_1::TIMINGS::EnableCyclic)
  {
    SetBusContext(gILCAN1_BusContext);
    gCAN1DisturbancePeriod = @sysvar::IL_CAN1::NODES::N_SGW::MESSAGES::TELEMATIC_FD_1::TIMINGS::CyclePeriod;
    ILFaultInjectionSetMsgCycleTime(FDCAN2_1::SGW::TELEMATIC_FD_1, gCAN1DisturbancePeriod);
  }
}

on sysvar_update sysvar::IL_CAN1::NODES::N_SGW::MESSAGES::TELEMATIC_FD_1::TIMINGS::SendOnce
{
  if (@this == 1)
  {
    SetBusContext(gILCAN1_BusContext);
    ILSetMsgEvent(FDCAN2_1::SGW::TELEMATIC_FD_1);
  }
}

on sysvar_update sysvar::IL_CAN1::NODES::N_SGW::MESSAGES::TELEMATIC_FD_11::TIMINGS::EnableCyclic
{
  if (@this == 1)
  {
    SetBusContext(gILCAN1_BusContext);
    ILFaultInjectionEnableMsg  (FDCAN2_1::SGW::TELEMATIC_FD_11);
  }
  else
  {
    SetBusContext(gILCAN1_BusContext);
    ILFaultInjectionDisableMsg (FDCAN2_1::SGW::TELEMATIC_FD_11);
  }
}

on sysvar_update sysvar::IL_CAN1::NODES::N_SGW::MESSAGES::TELEMATIC_FD_11::TIMINGS::SetNormalCycle
{
  if (@this == 1 && @sysvar::IL_CAN1::NODES::N_SGW::MESSAGES::TELEMATIC_FD_11::TIMINGS::EnableCyclic)
  {
    @sysvar::IL_CAN1::NODES::N_SGW::MESSAGES::TELEMATIC_FD_11::TIMINGS::SelectedPeriod = 0;
  }
}

on sysvar_update sysvar::IL_CAN1::NODES::N_SGW::MESSAGES::TELEMATIC_FD_11::TIMINGS::SetNewCycleContinously
{
  if (@this == 1 && @sysvar::IL_CAN1::NODES::N_SGW::MESSAGES::TELEMATIC_FD_11::TIMINGS::EnableCyclic)
  {
    @sysvar::IL_CAN1::NODES::N_SGW::MESSAGES::TELEMATIC_FD_11::TIMINGS::SelectedPeriod = -1;
  }
}

on sysvar_update sysvar::IL_CAN1::NODES::N_SGW::MESSAGES::TELEMATIC_FD_11::TIMINGS::SelectedPeriod
{
  if (@this == 0 && @sysvar::IL_CAN1::NODES::N_SGW::MESSAGES::TELEMATIC_FD_11::TIMINGS::EnableCyclic)
  {
    SetBusContext(gILCAN1_BusContext);
    gCAN1DisturbancePeriod = @sysvar::IL_CAN1::NODES::N_SGW::MESSAGES::TELEMATIC_FD_11::TIMINGS::NormalCyclePeriod;
    ILFaultInjectionResetMsgCycleTime(FDCAN2_1::SGW::TELEMATIC_FD_11);
  }
  else if (@this == 1 && @sysvar::IL_CAN1::NODES::N_SGW::MESSAGES::TELEMATIC_FD_11::TIMINGS::EnableCyclic)
  {
    SetBusContext(gILCAN1_BusContext);
    gCAN1DisturbancePeriod = @sysvar::IL_CAN1::NODES::N_SGW::MESSAGES::TELEMATIC_FD_11::TIMINGS::ActiveCyclePeriod;
    ILFaultInjectionSetMsgCycleTime(FDCAN2_1::SGW::TELEMATIC_FD_11, gCAN1DisturbancePeriod);
  }
  else if (@this == -1 && @sysvar::IL_CAN1::NODES::N_SGW::MESSAGES::TELEMATIC_FD_11::TIMINGS::EnableCyclic)
  {
    SetBusContext(gILCAN1_BusContext);
    gCAN1DisturbancePeriod = @sysvar::IL_CAN1::NODES::N_SGW::MESSAGES::TELEMATIC_FD_11::TIMINGS::CyclePeriod;
    ILFaultInjectionSetMsgCycleTime(FDCAN2_1::SGW::TELEMATIC_FD_11, gCAN1DisturbancePeriod);
  }
}

on sysvar_update sysvar::IL_CAN1::NODES::N_SGW::MESSAGES::TELEMATIC_FD_11::TIMINGS::SendOnce
{
  if (@this == 1)
  {
    SetBusContext(gILCAN1_BusContext);
    ILSetMsgEvent(FDCAN2_1::SGW::TELEMATIC_FD_11);
  }
}

on sysvar_update sysvar::IL_CAN1::NODES::N_SGW::MESSAGES::TELEMATIC_FD_14::TIMINGS::EnableCyclic
{
  if (@this == 1)
  {
    SetBusContext(gILCAN1_BusContext);
    ILFaultInjectionEnableMsg  (FDCAN2_1::SGW::TELEMATIC_FD_14);
  }
  else
  {
    SetBusContext(gILCAN1_BusContext);
    ILFaultInjectionDisableMsg (FDCAN2_1::SGW::TELEMATIC_FD_14);
  }
}

on sysvar_update sysvar::IL_CAN1::NODES::N_SGW::MESSAGES::TELEMATIC_FD_14::TIMINGS::SetNormalCycle
{
  if (@this == 1 && @sysvar::IL_CAN1::NODES::N_SGW::MESSAGES::TELEMATIC_FD_14::TIMINGS::EnableCyclic)
  {
    @sysvar::IL_CAN1::NODES::N_SGW::MESSAGES::TELEMATIC_FD_14::TIMINGS::SelectedPeriod = 0;
  }
}

on sysvar_update sysvar::IL_CAN1::NODES::N_SGW::MESSAGES::TELEMATIC_FD_14::TIMINGS::SetNewCycleContinously
{
  if (@this == 1 && @sysvar::IL_CAN1::NODES::N_SGW::MESSAGES::TELEMATIC_FD_14::TIMINGS::EnableCyclic)
  {
    @sysvar::IL_CAN1::NODES::N_SGW::MESSAGES::TELEMATIC_FD_14::TIMINGS::SelectedPeriod = -1;
  }
}

on sysvar_update sysvar::IL_CAN1::NODES::N_SGW::MESSAGES::TELEMATIC_FD_14::TIMINGS::SelectedPeriod
{
  if (@this == 0 && @sysvar::IL_CAN1::NODES::N_SGW::MESSAGES::TELEMATIC_FD_14::TIMINGS::EnableCyclic)
  {
    SetBusContext(gILCAN1_BusContext);
    gCAN1DisturbancePeriod = @sysvar::IL_CAN1::NODES::N_SGW::MESSAGES::TELEMATIC_FD_14::TIMINGS::NormalCyclePeriod;
    ILFaultInjectionResetMsgCycleTime(FDCAN2_1::SGW::TELEMATIC_FD_14);
  }
  else if (@this == 1 && @sysvar::IL_CAN1::NODES::N_SGW::MESSAGES::TELEMATIC_FD_14::TIMINGS::EnableCyclic)
  {
    SetBusContext(gILCAN1_BusContext);
    gCAN1DisturbancePeriod = @sysvar::IL_CAN1::NODES::N_SGW::MESSAGES::TELEMATIC_FD_14::TIMINGS::ActiveCyclePeriod;
    ILFaultInjectionSetMsgCycleTime(FDCAN2_1::SGW::TELEMATIC_FD_14, gCAN1DisturbancePeriod);
  }
  else if (@this == -1 && @sysvar::IL_CAN1::NODES::N_SGW::MESSAGES::TELEMATIC_FD_14::TIMINGS::EnableCyclic)
  {
    SetBusContext(gILCAN1_BusContext);
    gCAN1DisturbancePeriod = @sysvar::IL_CAN1::NODES::N_SGW::MESSAGES::TELEMATIC_FD_14::TIMINGS::CyclePeriod;
    ILFaultInjectionSetMsgCycleTime(FDCAN2_1::SGW::TELEMATIC_FD_14, gCAN1DisturbancePeriod);
  }
}

on sysvar_update sysvar::IL_CAN1::NODES::N_SGW::MESSAGES::TELEMATIC_FD_14::TIMINGS::SendOnce
{
  if (@this == 1)
  {
    SetBusContext(gILCAN1_BusContext);
    ILSetMsgEvent(FDCAN2_1::SGW::TELEMATIC_FD_14);
  }
}

on sysvar_update sysvar::IL_CAN1::NODES::N_SGW::MESSAGES::TELEMATIC_FD_5::TIMINGS::EnableCyclic
{
  if (@this == 1)
  {
    SetBusContext(gILCAN1_BusContext);
    ILFaultInjectionEnableMsg  (FDCAN2_1::SGW::TELEMATIC_FD_5);
  }
  else
  {
    SetBusContext(gILCAN1_BusContext);
    ILFaultInjectionDisableMsg (FDCAN2_1::SGW::TELEMATIC_FD_5);
  }
}

on sysvar_update sysvar::IL_CAN1::NODES::N_SGW::MESSAGES::TELEMATIC_FD_5::TIMINGS::SetNormalCycle
{
  if (@this == 1 && @sysvar::IL_CAN1::NODES::N_SGW::MESSAGES::TELEMATIC_FD_5::TIMINGS::EnableCyclic)
  {
    @sysvar::IL_CAN1::NODES::N_SGW::MESSAGES::TELEMATIC_FD_5::TIMINGS::SelectedPeriod = 0;
  }
}

on sysvar_update sysvar::IL_CAN1::NODES::N_SGW::MESSAGES::TELEMATIC_FD_5::TIMINGS::SetNewCycleContinously
{
  if (@this == 1 && @sysvar::IL_CAN1::NODES::N_SGW::MESSAGES::TELEMATIC_FD_5::TIMINGS::EnableCyclic)
  {
    @sysvar::IL_CAN1::NODES::N_SGW::MESSAGES::TELEMATIC_FD_5::TIMINGS::SelectedPeriod = -1;
  }
}

on sysvar_update sysvar::IL_CAN1::NODES::N_SGW::MESSAGES::TELEMATIC_FD_5::TIMINGS::SelectedPeriod
{
  if (@this == 0 && @sysvar::IL_CAN1::NODES::N_SGW::MESSAGES::TELEMATIC_FD_5::TIMINGS::EnableCyclic)
  {
    SetBusContext(gILCAN1_BusContext);
    gCAN1DisturbancePeriod = @sysvar::IL_CAN1::NODES::N_SGW::MESSAGES::TELEMATIC_FD_5::TIMINGS::NormalCyclePeriod;
    ILFaultInjectionResetMsgCycleTime(FDCAN2_1::SGW::TELEMATIC_FD_5);
  }
  else if (@this == 1 && @sysvar::IL_CAN1::NODES::N_SGW::MESSAGES::TELEMATIC_FD_5::TIMINGS::EnableCyclic)
  {
    SetBusContext(gILCAN1_BusContext);
    gCAN1DisturbancePeriod = @sysvar::IL_CAN1::NODES::N_SGW::MESSAGES::TELEMATIC_FD_5::TIMINGS::ActiveCyclePeriod;
    ILFaultInjectionSetMsgCycleTime(FDCAN2_1::SGW::TELEMATIC_FD_5, gCAN1DisturbancePeriod);
  }
  else if (@this == -1 && @sysvar::IL_CAN1::NODES::N_SGW::MESSAGES::TELEMATIC_FD_5::TIMINGS::EnableCyclic)
  {
    SetBusContext(gILCAN1_BusContext);
    gCAN1DisturbancePeriod = @sysvar::IL_CAN1::NODES::N_SGW::MESSAGES::TELEMATIC_FD_5::TIMINGS::CyclePeriod;
    ILFaultInjectionSetMsgCycleTime(FDCAN2_1::SGW::TELEMATIC_FD_5, gCAN1DisturbancePeriod);
  }
}

on sysvar_update sysvar::IL_CAN1::NODES::N_SGW::MESSAGES::TELEMATIC_FD_5::TIMINGS::SendOnce
{
  if (@this == 1)
  {
    SetBusContext(gILCAN1_BusContext);
    ILSetMsgEvent(FDCAN2_1::SGW::TELEMATIC_FD_5);
  }
}

/* #ChannelEnd# |CAN1| #BusEnd# |FDCAN2_1| */
//--- end generated part --- Block end <#SysVar_Handler#> do not delete this line! Add application code below this line.

//--- begin generated part --- Block start <#MsgUpdateFcns#> do not delete this line and do not add application code in this code block!
/* #ChannelStart# |CAN1| #BusStart# |FDCAN2_1| */
/* #ChannelEnd# |CAN1| #BusEnd# |FDCAN2_1| */
//--- end generated part --- Block end <#MsgUpdateFcns#> do not delete this line! Add application code below this line.



//if(aId ==CRC_TELEMATIC_FD14 .id)// No CRC for thise signal
//    {
//        byte dataarray[32];
//        if( @sysvar::message_control::FD_CAN_2::alive_counter_CRC_TELEMATIC_FD14 == 0)
//        {
//            if(MsgCtr_CRC_TELEMATIC_FD14 <15)
//            {
//                MsgCtr_CRC_TELEMATIC_FD14 ++;
//            }
//            else
//            {
//                MsgCtr_CRC_TELEMATIC_FD14= 0;
//            }
//            data[22]=MsgCtr_CRC_TELEMATIC_FD14 ;
//        }
//        if(@sysvar::message_control::FD_CAN_2::crc_CRC_TELEMATIC_FD14== 0)
//        {
//            for(i=0;i<23;i++)
//            {
//                dataarray[i] = data[i];
//            }
//            Crc_CalculateCRC8(dataarray, 31, 0, 23, 0, 0xFF, crc);
//            data[23]=crc;
//        }
//    }
//	



//		if(aId ==MC_TELEMATIC_FD14  .id)// No CRC for thise signal
//    {
//        byte dataarray[32];
//        if( @sysvar::message_control::FD_CAN_2::alive_counter_MC_TELEMATIC_FD14 == 0)
//        {
//            if(MsgCtr_MC_TELEMATIC_FD14  <15)
//            {
//                MsgCtr_MC_TELEMATIC_FD14  ++;
//            }
//            else
//            {
//                MsgCtr_MC_TELEMATIC_FD14 = 0;
//            }
//            data[22]=MsgCtr_MC_TELEMATIC_FD14  ;
//        }
//        if(@sysvar::message_control::FD_CAN_2::crc_MC_TELEMATIC_FD14 == 0)
//        {
//            for(i=0;i<23;i++)
//            {
//                dataarray[i] = data[i];
//            }
//            Crc_CalculateCRC8(dataarray, 31, 0, 23, 0, 0xFF, crc);
//            data[23]=crc;
//        }
//    }
//	


//			if(aId ==CRC_TELEMATIC_FD11.id)// No CRC for thise signal
//    {
//        byte dataarray[32];
//        if( @sysvar::message_control::FD_CAN_2::alive_counter_CRC_TELEMATIC_FD11 == 0)
//        {
//            if(CRC_TELEMATIC_FD11  <15)
//            {
//                MsgCtr_CRC_TELEMATIC_FD11  ++;
//            }
//            else
//            {
//                MsgCtr_CRC_TELEMATIC_FD11 = 0;
//            }
//            data[22]=MsgCtr_CRC_TELEMATIC_FD11  ;
//        }
//        if(@sysvar::message_control::FD_CAN_2::crc_CRC_TELEMATIC_FD11 == 0)
//        {
//            for(i=0;i<23;i++)
//            {
//                dataarray[i] = data[i];
//            }
//            Crc_CalculateCRC8(dataarray, 31, 0, 23, 0, 0xFF, crc);
//            data[23]=crc;
//        }
//    }



//
//			if(aId ==MC_TELEMATIC_FD11.id)// No CRC for thise signal
//    {
//        byte dataarray[32];
//        if( @sysvar::message_control::FD_CAN_2::alive_counter_MC_TELEMATIC_FD11== 0)
//        {
//            if(MC_TELEMATIC_FD11  <15)
//            {
//                MsgCtr_MC_TELEMATIC_FD11 ++;
//            }
//            else
//            {
//                MsgCtr_MC_TELEMATIC_FD11= 0;
//            }
//            data[22]=MsgCtr_MC_TELEMATIC_FD11  ;
//        }
//        if(@sysvar::message_control::FD_CAN_2::crc_MC_TELEMATIC_FD11 == 0)
//        {
//            for(i=0;i<23;i++)
//            {
//                dataarray[i] = data[i];
//            }
//            Crc_CalculateCRC8(dataarray, 31, 0, 23, 0, 0xFF, crc);
//            data[23]=crc;
//        }
	

