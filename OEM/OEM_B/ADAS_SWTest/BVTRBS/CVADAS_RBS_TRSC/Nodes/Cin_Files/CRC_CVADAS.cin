/*@!Encoding:1252*/

includes
{
  #include "Database.cin"
  #include "MsgCounter_CVADAS.cin"
}

variables
{
int channel =0;
char CRC_Sys_Var_Buffer[500];
dword Stop_Frames = 1;
}

//on sysvar_update Stop::Stop_all_Tx
//{
//  write("Stop_Frames: %d", @this);
//  Stop_Frames= @this;
//}



dword applILTxPending(long aId, dword aDlc, byte data[])
{
 
  dword ret = 1;
  dword crc, i;
  long value;
  for(i=0; i< NumberOfRxMessages; i++)
  {
    if(valOfId(aId)==MessagesPAM[i].ID)
    {
      if((strncmp("BSM", MessagesPAM[i].transmitter, 50) == 0))
      {
        channel = 2;
      }
      else if((strncmp("ECM", MessagesPAM[i].transmitter, 50) == 0))
      {
        channel = 2;
      }
      else
      {
        channel = 1;
      }
     //  write(" %d , %s  %d", i, MessagesPAM[i].transmitter,  M_counter[i][1] );
      if(MessagesPAM[i].CRC_Applicable == 1)
      { 
        data[aDlc-10] = (data[aDlc-10] & 0xF0) | (M_counter[i][channel] & 0x0F);  
        snprintf(CRC_Sys_Var_Buffer, elcount(CRC_Sys_Var_Buffer), "CRC_Stop::%s", MessagesPAM[i].Name);
        if(0 == sysGetVariableInt("message_control", CRC_Sys_Var_Buffer))
        {
         Crc_CalculateCRC8(data, aDlc-1, 0, aDlc-9, 0, 0, crc);
         // Crc_CalculateCRC8(dataarray, 31, 0, 23, 0, 0, crc);
         data[aDlc-9]=crc;        
        }
          else 
          {
            if (@sysvar::message_control::CRC_Stop::Freeze_CRC == 1)
            {
              Crc_CalculateCRC8(data, aDlc-1, 0, aDlc-9, 0, 0, crc);
              data[aDlc-9] = @sysvar::message_control::CRC_Stop::CRC_Set; 
              write("CRC_Stop = 1");
            }
            else
            {
              data[aDlc-9] = crc + 0001;
            }
          }
        
      }
    }
  }
  ret = Stop_Frames;
  return ret; 
}
