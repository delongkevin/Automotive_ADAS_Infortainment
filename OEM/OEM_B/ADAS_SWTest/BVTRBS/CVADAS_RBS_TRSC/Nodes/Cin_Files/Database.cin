/*@!Encoding:1252*/
variables
{
  
 struct CANMessages{
  char Name[50];
  long ID;
  char ID_Format[50];
  int DLC;
  char TxMethod[50];
  int cycleTimems;
  char transmitter[50];
  int CRC_Applicable;
  };
 
 const int NumberOfRxMessages = 76;//In structure CANMessages MessagesPAM if you add or remove can message incremenet or decrement arraysize [NumberOfRxMessages]
 struct CANMessages MessagesPAM[NumberOfRxMessages] =
{
{"ADAS_FD_INFO_C2", 0x119, "CAN FD Standard", 32, "Cyclic", 10, "CADM2", 1}, 
{"AGSM_FD_2", 0x1DC, "CAN FD Standard", 32, "Cyclic", 20, "BCM", 1}, 
{"ASCM_FD_1", 0x52F, "CAN FD Standard", 32, "Cyclic", 200, "BCM", 1}, 
{"ASCM_FD_2", 0x5A5, "CAN FD Standard", 32, "Cyclic", 1000, "BCM", 1}, 
{"BCM_FD_10", 0x481, "CAN FD Standard", 32, "Cyclic", 500, "BCM", 1}, 
{"BCM_FD_12", 0x597, "CAN FD Standard", 32, "Cyclic", 100, "BCM", 1}, 
{"BCM_FD_2", 0x100, "CAN FD Standard", 32, "Cyclic", 10, "BCM", 1}, 
{"BCM_FD_27", 0x59C, "CAN FD Standard", 32, "Cyclic", 1000, "BCM", 1}, 
{"BCM_FD_29", 0x5BE, "CAN FD Standard", 32, "Cyclic", 1000, "BCM", 1}, 
{"BCM_FD_3", 0x2EE, "CAN FD Standard", 32, "Cyclic", 50, "BCM", 1}, 
{"BCM_FD_7", 0x723, "CAN FD Standard", 32, "Cyclic", 1000, "BCM", 1}, 
{"BCM_FD_9", 0x42A, "CAN FD Standard", 32, "Cyclic", 250, "BCM", 1}, 
{"BRAKE2_FD_1", 0x101, "CAN FD Standard", 64, "Cyclic", 10, "BSM2", 1}, 
{"BRAKE_FD_1", 0x201, "CAN FD Standard", 32, "Cyclic", 20, "BCM", 1}, 
{"BRAKE_FD_2", 0x102, "CAN FD Standard", 64, "Cyclic", 10, "BCM", 1}, 
{"BRAKE_FD_3", 0x103, "CAN FD Standard", 32, "Cyclic", 10, "BCM", 1}, 
{"BRAKE_FD_4", 0x261, "CAN FD Standard", 32, "Cyclic", 100, "BCM", 1}, 
{"BRAKE_FD_5", 0x483, "CAN FD Standard", 32, "Cyclic", 500, "BCM", 1}, 
{"BRAKE_FD_7", 0x202, "CAN FD Standard", 32, "Cyclic", 20, "BCM", 1}, 
{"CFG_DATA_CODE_REQUEST", 0x1E114000, "CAN FD Extended", 6, "NoMsgSendType", 0, "BCM", 0}, 
{"DIAGNOSTIC_REQUEST_FD_FUNCTIONAL", 0x18DBFEF2, "CAN FD Extended", 64, "NoMsgSendType", 0, "SGW", 0}, 
{"DIAGNOSTIC_REQUEST_FUNC_FOTA", 0x18DBFEF5, "CAN FD Extended", 64, "NoMsgSendType", 0, "SGW", 0},
{"DIAGNOSTIC_REQUEST_FD_PAM", 0x18DAA0F2, "CAN FD Extended", 64, "NoMsgSendType", 0, "SGW", 0}, 
{"DIAGNOSTIC_REQUEST_FUNCTIONAL", 0x18DBFEF1, "CAN Extended", 8, "NoMsgSendType", 0, "SGW", 0}, 
{"DIAGNOSTIC_REQUEST_PAM", 0x18DAA0F1, "CAN Extended", 8, "NoMsgSendType", 0, "SGW", 0}, 
{"DRIVETRAIN_FD_3", 0x42C, "CAN FD Standard", 32, "Cyclic", 100, "BCM", 1}, 
{"ENGINE_FD_2", 0x106, "CAN FD Standard", 64, "Cyclic", 10, "BCM", 1}, 
{"ENGINE_FD_5", 0x206, "CAN FD Standard", 32, "Cyclic", 20, "BCM", 1}, 
{"ENGINE_FD_7", 0x5A8, "CAN FD Standard", 32, "Cyclic", 1000, "BCM", 1}, 
{"EPS_FD_1", 0x108, "CAN FD Standard", 32, "Cyclic", 10, "EPS", 1}, 
{"EPS_FD_2", 0x420, "CAN FD Standard", 32, "Cyclic", 100, "EPS", 1}, 
{"GLOB_NAV_FD_C2", 0x20E, "CAN FD Standard", 32, "Cyclic", 20, "CADM2", 1}, 
{"IPC_FD_1", 0x725, "CAN FD Standard", 32, "Cyclic", 1000, "BCM", 1}, 
{"IPC_VEHICLE_SETUP", 0x5A3, "CAN FD Standard", 48, "Cyclic", 1000, "BCM", 0}, 
{"NM_BCM", 0x1E384000, "CAN FD Extended", 2, "NoMsgSendType", 0, "BCM", 0}, 
{"NM_BSM2", 0x1E384094, "CAN FD Extended", 2, "NoMsgSendType", 0, "BSM2", 0}, 
{"NM_CADM2", 0x1E38408E, "CAN FD Extended", 2, "NoMsgSendType", 0, "CADM2", 0}, 
{"NM_EPS", 0x1E384002, "CAN FD Extended", 2, "NoMsgSendType", 0, "EPS", 0}, 
{"NM_ORC", 0x1E38401A, "CAN FD Extended", 2, "NoMsgSendType", 0, "ORC", 0}, 
{"NM_SGW", 0x1E384070, "CAN FD Extended", 2, "NoMsgSendType", 0, "SGW", 0}, 
{"NM_TRLR_REV", 0x1E3840B1, "CAN FD Extended", 2, "NoMsgSendType", 0, "TRSKM", 0}, 
{"ORC_FD_1", 0x263, "CAN FD Standard", 32, "Cyclic", 100, "ORC", 1}, 
{"PDC_INFO_FD_ADCM", 0x1E360025, "CAN FD Extended", 12, "Cyclic", 1000, "BCM", 0}, 
{"PDC_INFO_FD_BCM", 0x1E360000, "CAN FD Extended", 48, "Cyclic", 1000, "BCM", 0}, 
{"PDC_INFO_FD_BSM2", 0x1E360094, "CAN FD Extended", 12, "Cyclic", 1000, "BSM2", 0}, 
{"PDC_INFO_FD_CADM2", 0x1E36008E, "CAN FD Extended", 12, "Cyclic", 1000, "CADM2", 0}, 
{"PDC_INFO_FD_EPS", 0x1E360002, "CAN FD Extended", 12, "Cyclic", 1000, "EPS", 0}, 
{"PDC_INFO_FD_ORC", 0x1E36001A, "CAN FD Extended", 12, "Cyclic", 1000, "ORC", 0}, 
{"PDC_INFO_FD_SGW", 0x1E360070, "CAN FD Extended", 64, "Cyclic", 1000, "SGW", 0}, 
{"PDC_INFO_FD_TRLR_REV", 0x1E3600B1, "CAN FD Extended", 12, "Cyclic", 1000, "TRSKM", 0}, 
{"TELEMATIC_FD_11", 0x260, "CAN FD Standard", 32, "Cyclic", 100, "SGW", 1}, 
{"TELEMATIC_FD_14", 0x5B9, "CAN FD Standard", 32, "Cyclic", 1000, "SGW", 1}, 
{"TELEMATIC_FD_5", 0x594, "CAN FD Standard", 32, "Cyclic", 1000, "SGW", 1}, 
{"TRANSM_FD_1", 0x116, "CAN FD Standard", 64, "Cyclic", 10, "BCM", 1}, 
{"TRANSM_FD_2", 0x208, "CAN FD Standard", 32, "Cyclic", 20, "BCM", 1}, 
{"TRANSM_FD_4", 0x5AA, "CAN FD Standard", 32, "Cyclic", 1000, "BCM", 1}, 
{"TRSKM_FD_1", 0x5C4, "CAN FD Standard", 32, "Cyclic", 1000, "TRSKM", 1}, 
{"VIN", 0x41D, "CAN FD Standard", 32, "Cyclic", 100, "BCM", 0}, 
{"ADAS_FD_INFO", 0x118, "CAN FD Standard", 32, "Cyclic", 10, "CADM", 1}, 
{"BRAKE_FD_1", 0x201, "CAN FD Standard", 32, "Cyclic", 20, "BSM", 1}, 
{"BRAKE_FD_2", 0x102, "CAN FD Standard", 64, "Cyclic", 10, "BSM", 1}, 
{"BRAKE_FD_3", 0x103, "CAN FD Standard", 32, "Cyclic", 10, "BSM", 1}, 
//{"BRAKE_FD_4", 0x261, "CAN FD Standard", 32, "Cyclic", 100, "BSM", 1}, 
{"BRAKE_FD_5", 0x483, "CAN FD Standard", 32, "Cyclic", 500, "BSM", 1}, 
{"BRAKE_FD_6", 0xCD, "CAN FD Standard", 64, "Cyclic", 10, "BSM", 1}, 
//{"BRAKE_FD_7", 0x202, "CAN FD Standard", 32, "Cyclic", 20, "BSM", 1}, 
{"ENGINE_FD_2", 0x106, "CAN FD Standard", 64, "Cyclic", 10, "ECM", 1}, 
{"ENGINE_FD_5", 0x206, "CAN FD Standard", 32, "Cyclic", 20, "ECM", 1}, 
{"ENGINE_FD_7", 0x5A8, "CAN FD Standard", 32, "Cyclic", 1000, "ECM", 1}, 
{"EPS_FD_1", 0x108, "CAN FD Standard", 32, "Cyclic", 10, "EPS", 1}, 
{"EPS_FD_2", 0x420, "CAN FD Standard", 32, "Cyclic", 100, "EPS", 1}, 
{"NM_BSM", 0x1E384006, "CAN FD Extended", 2, "NoMsgSendType", 0, "BSM", 0}, 
{"NM_BSM2", 0x1E384094, "CAN FD Extended", 2, "NoMsgSendType", 0, "BSM2", 0}, 
{"NM_CADM", 0x1E38408D, "CAN FD Extended", 2, "NoMsgSendType", 0, "CADM", 0}, 
{"NM_ECM", 0x1E384001, "CAN FD Extended", 2, "NoMsgSendType", 0, "ECM", 0}, 
{"NM_EPS", 0x1E384002, "CAN FD Extended", 2, "NoMsgSendType", 0, "EPS", 0}, 
{"NM_ORC", 0x1E38401A, "CAN FD Extended", 2, "NoMsgSendType", 0, "ORC", 0}, 
{"PT_TORQUE_FD_1", 0xFF, "CAN FD Standard", 48, "Cyclic", 10, "ECM", 1} 
};

}