VERSION ""

NS_ :

BS_:

BU_: CANOE BSM BSM2 CADM CVADAS ECM EPS ORC EVCU2
VAL_TABLE_ ME_Hydra3defs_E_CalibStatus_t 4 "ME_Hydra3defs_E_CalibAbortFailed" 3 "ME_Hydra3defs_E_CalibCompSuccess" 2 "ME_Hydra3defs_E_CalibRunning" 1 "ME_Hydra3defs_E_CalibPending" 0 "ME_Hydra3defs_E_CalibNotStarted" -1 "ME_Hydra3defs_E_CalStatSzeEnforc" ;
VAL_TABLE_ ME_Hydra3defs_E_EOLErrorCode_t 25 "e_EOL_PRECONDITION_NOT_CORRECT" 24 " e_EOL_WRONG_CAMERA_SOFTWARE" 23 "e_EOL_PRECOND_NOT_CORRECT_DOORS" 22 "e_EOL_PRECOND_NOT_CORRECT_VELOC" 21 "e_EOL_HMOGRAPHY_ESTIMATION_ERROR" 20 "e_EOL_ABORTED" 19 "e_EOL_NOT_CALIBRATED" 18 "e_EOL_RESULT_EXCEED_QUAL_LIM" 17 "e_EOL_TARGET_IDENTIF_ERROR_RIGHT" 16 "e_EOL_TARGET_IDENTIF_ERROR_LEFT" 9 "e_EOL_TARGET_NOT_FOUND_RIGHT" 8 "e_EOL_TARGET_NOT_FOUND_LEFT" 7 "e_EOL_TARGET_NOT_FOUND_INIT" 6 "e_EOL_VARIANT_CODING_ISSUE" 5 "e_EOL_MISSING_INTERNAL_LINK" 4 "e_EOL_PRECON_NOT_CORRECT_NUMCAMS" 3 "e_EOL_PRECOND_NOT_CORRECT_VRANGE" 2 "e_EOL_MISSING_SOFTWARE" 1 "e_EOL_CALIBRATION_SUCCESS" 0 "e_EOL_CALIBRATION_IN_PROCESS " -1 "e_EOLErrorCode_Size_Enforcer " ;
VAL_TABLE_ ME_Hydra3defs_E_OCErrorCode_t 8 "e_OC_Num" 7 "e_OC_UnexpectedRequest" 6 "e_OC_InvalidSavedData" 5 "e_OC_InvalidConfiguration" 4 "e_OC_CalibrationError" 3 "e_OC_FeatureCollectionError" 2 "e_OC_StartFail" 1 "e_OC_InitFail" 0 "  e_OC_NoError " -1 "e_OCErrorCode_Size_Enforcer " ;
VAL_TABLE_ aZynqM_E_ModuleState_OC_STM_t -1 "aZynqM_E_OC_STM_Size_Enforcer0xF" 18 "aZynqM_E_OC_STM_NumStates" 17 "aZynqM_E_OC_STM_End" 16 "aZynqM_E_OC_STM_Error" 9 "aZynqM_E_OC_STM_Stop" 8 "aZynqM_E_OC_STM_Resume" 7 "aZynqM_E_OC_STM_Paused" 6 "aZynqM_E_OC_STM_Pause" 5 " aZynqM_E_OC_STM_CheckStatus" 4 "aZynqM_E_OC_STM_StartCamCalib" 3 "aZynqM_E_OC_STM_SelectCurrCam" 2 "aZynqM_E_OC_STM_Idle" 1 "aZynqM_E_OC_STM_Init" 0 "aZynqM_E_OC_STM_NotInit " ;
VAL_TABLE_ aZynqM_E_ModuleState_SC_STM_t 19 "  aZynqM_E_SC_STM_NumStates" 18 "aZynqM_E_SC_STM_E_End" 17 "aZynqM_E_SC_STM_E_Error" 16 "aZynqM_E_SC_STM_E_Stop" 9 "aZynqM_E_SC_STM_E_Resume" 8 "aZynqM_E_SC_STM_E_Paused" 7 "aZynqM_E_SC_STM_E_Pause" 6 "aZynqM_E_SC_STM_E_CheckStatus" 5 "aZynqM_E_SC_STM_E_StartCamCalib" 4 "aZynqM_E_SC_STM_E_SelectCurrCam" 3 "aZynqM_E_SC_STM_E_WaitEEPROMRead" 2 "  aZynqM_E_SC_STM_E_Idle" 1 "aZynqM_E_SC_STM_E_Init" 0 "aZynqM_E_SC_STM_E_NotInit " -1 "  aZynqM_E_SC_STM_Size_Enforcer " ;
VAL_TABLE_ aZynqM_E_ModuleState_EOL_STM_t 9 "aZynqM_E_EOL_STM_NumStates" 8 "aZynqM_E_EOL_STM_E_End" 7 "aZynqM_E_EOL_STM_E_Error" 6 " aZynqM_E_EOL_STM_E_Stop" 5 "aZynqM_E_EOL_STM_E_CheckStatus" 4 "aZynqM_E_EOL_STM_E_StartCamCalib" 3 "aZynqM_E_EOL_STM_E_SelectCurrCam" 2 "aZynqM_E_EOL_STM_E_Idle" 1 "aZynqM_E_EOL_STM_E_Init" 0 "aZynqM_E_EOL_STM_E_NotInit" -1 "aZynqM_E_EOL_STM_Size_Enforcer" ;
VAL_TABLE_ objConf_e 3 "Conf_High" 2 "Conf_Med" 1 "Conf_Low" 0 "Conf_None" ;
VAL_TABLE_ frontSensorDetHealth_e 3 "SNA" 2 "Not_Active_failure" 1 "Not_Active_blocked" 0 "Active" ;
VAL_TABLE_ TeTRSC_e_TRSCStat 7 "TeTRSC_e_TRSCStat_SNA" 6 "TeTRSC_e_TRSCStat_Fault" 5 "TeTRSC_e_TRSCStat_ActiveHoldOvr" 4 "TeTRSC_e_TRSCStat_Active" 3 "TeTRSC_e_TRSCStat_PreActive" 2 "TeTRSC_e_TRSCStat_Calibrating" 1 "TeTRSC_e_TRSCStat_Standby" 0 "TeTRSC_e_TRSCStat_Off      " -1 "TeTRSC_e_TRSCStat_MAX" ;
VAL_TABLE_ TeTRSC_e_TrlrCalInfo 2 "TeTRSC_e_TrlrCalInfo_Undefined" 1 "TeTRSC_e_TrlrCalInfo_Calibrated" 0 "TrlrCalInfo_NotCalibrated" -1 "TeTRSC_e_TrlrCalInfo_MAX" ;
VAL_TABLE_ TeTRSC_e_TrlrAngSign 1 "Anticlockwise" 0 "Clockwise" ;
VAL_TABLE_ ME_Hydra2defs_E_ZoomLevel_t 1 "M_ZoomLevel_Zoom" 0 "M_ZoomLevel_Normal" ;
VAL_TABLE_ ME_Hydra2defs_E_ViewType_t 37 "ViewCount          " 36 "BlindRight" 35 "BlindLeft" 34 "THAZoomRearView2   " 33 "THAZoomRearView1   " 32 "THANormalRearView  " 31 "TRGRightCurbView   " 30 "TRGLeftCurbView   " 29 "FrontWithTiretracks" 28 "TRGRightZoomView   " 27 "TRGRightView  " 26 "TRGLeftZoomView " 25 "TRGLeftView        " 24 "TRG34L14RZoomView  " 23 "TRG34L14RView      " 22 "TRG14L34RZoomView  " 21 "TRG14L34RView      " 20 "TRG5050ZoomView   " 19 "TRG5050View        " 18 "CHMSL_ZoomView     " 17 "CHMSL_NormalView " 16 "BUZRV      " 15 "BUNRV       " 14 "RVCOnlyZoomView    " 13 "RVCOnlyNormalView  " 12 "NonViewRequested   " 11 "QuadView   " 10 "RAW_ECU   " 9 "RAW_5th       " 8 "RAW_Right       " 7 "RAW_Rear           " 6 "RAW_Left   " 5 "RAW_Front  " 4 "RearCrossView      " 3 "FrontCrossView     " 2 "RearTopView        " 1 "FrontTopView       " 0 "NoView             " ;
VAL_TABLE_ ME_Hydra2defs_E_SystemState_t 2 "RVC_Only" 1 "SystemONVideoON" 0 "SystemONVideoOFF" ;
VAL_TABLE_ ME_Hydra2defs_E_FFClatch_t 1 "M_FFClatch_Set" 0 "M_FFClatch_NotSet" ;
VAL_TABLE_ aSigConverter_E_VC_Trans_Equip_t 2 "TRANS_SNA      " 1 "TRANS_MANUAL   " 0 "TRANS_AUTOMATIC" ;
VAL_TABLE_ aSigConverter_E_TRSC_STAT_t 597 "TRSC_INVALID    " 7 "TRSC_SNA        " 4 "TRSC_ACTIVE     " 3 "TRSC_PRE_ACTIVE " 2 "TRSC_CALIBRATING" 1 "TRSC_STANDBY    " 0 "TRSC_OFF        " ;
VAL_TABLE_ aSigConverter_E_TGW_DISP_STAT_t 21 "TGW_DISP_STAT_SNA    " 7 "DISP_SVS_MORECAMS_POPUP" 6 "DISP_WIRLESS_CAMERA  " 5 "TGW_DISP_STAT_SNA    " 4 "DISP_REAR_CAMERA     " 0 "DISP_OFF     " ;
VAL_TABLE_ aSigConverter_E_REV_GEAR_t 2 "REV_GEAR_SNA" 1 "REV_GEAR_ENGAGED" 0 "REV_GEAR_NOT_ENGAGED" ;
VAL_TABLE_ aSigConverter_E_PRND_STAT_t 21 "PRND_STAT_SNA  " 16 "PRND_STAT_UNDEF" 5 "PRND_STAT_NOT_R" 4 "PRND_STAT_D    " 3 "PRND_STAT_N    " 2 "PRND_STAT_R    " 1 "PRND_STAT_P    " 0 "PRND_STAT_NA   " ;
VAL_TABLE_ aSigConverter_E_NetCfg_TRSCM_t 2 "TRSCM_Prsnt_SNA  " 1 "TRSCM_Prsnt_TRUE " 0 "TRSCM_Prsnt_FALSE" ;
VAL_TABLE_ aSigConverter_E_LRWS_ST_t 4 "LRWS_ST_SNA    " 3 "LRWS_ST_ERR_INI" 2 "LRWS_ST_ERR    " 1 "LRWS_ST_INI    " 0 "LRWS_ST_OK     " ;
VAL_TABLE_ aSigConverter_E_CmdIgnStat_t 7 "IGN_SNA    " 5 "IGN_START  " 4 "IGN_RUN    " 3 "IGN_OFF_ACC" 2 "IGN_ACC    " 1 "IGN_OFF    " 0 "IGN_LK     " ;
VAL_TABLE_ aSigConverter_E_CM_TCH_STAT_t 7 "CM_TCH_STAT_SNA" 6 "TCH_CFG_MAX    " 5 "TCH_CFG_OFFSET " 4 "TCH_CFG_RES    " 2 "TCH_PS_CAN     " 1 "TCH_PSD     " 0 "TCH_NOT_PSD    " ;
VAL_TABLE_ aSigConverter_E_CamDisplaySts2_t 14 "CameraDisplaySts2_View14" 13 "CameraDisplaySts2_View13" 12 "CameraDisplaySts2_View12" 11 "CameraDisplaySts2_View11" 10 "CameraDisplaySts2_View10" 9 "CameraDisplaySts2_View9" 8 "CameraDisplaySts2_View8" 7 "CameraDisplaySts2_View7" 6 "CameraDisplaySts2_View6" 5 "CameraDisplaySts2_View5" 4 "CameraDisplaySts2_View4" 3 "CameraDisplaySts2_View3" 2 "CameraDisplaySts2_View2   " 1 "CameraDisplaySts2_View1   " 0 "CameraDisplaySts2_OFF     " -1 "CameraDisplaySts2_Enforcer" ;
VAL_TABLE_ aHmiM_E_TrgStatus_t 3 "TRG_STAT_SNA" 2 "TRG_MANU_PAN" 1 "TRG_AUTO_PAN" 0 "TRG_INACTIVE" ;
VAL_TABLE_ aFailM_E_View_Error_t 1 "View_NoError" 0 "View_ForceDEFAULT" ;
VAL_TABLE_ aFailM_E_SoftBtn_Error_t 1 "SoftBtns_Functional" 0 "SoftBtns_NotFunctional" ;
VAL_TABLE_ aFailM_E_ImageDefeat_Error_t 2 "ImageDefeat_NoError " 1 "ImageDefeat_ForceON " 0 "ImageDefeat_ForceOFF" ;
VAL_TABLE_ aFailM_E_DynOvl_Error_t 1 "DynOvl_NoError" 0 "DynOvl_ForceOFF" ;
VAL_TABLE_ lineRmStyle_e 7 "LaneTypeAll_Other" 6 "LaneTypeAll_Barrier" 5 "LaneTypeAll_BottDots" 4 "LaneTypeAll_RoadEdge" 3 "LaneTypeAll_Double" 2 "LaneTypeAll_Dashed" 1 "LaneTypeAll_Solid" 0 "LaneTypeAll_None" ;
VAL_TABLE_ lineLmStyle_e 7 "LaneTypeAll_Other" 6 "LaneTypeAll_Barrier" 5 "LaneTypeAll_BottDots" 4 "LaneTypeAll_RoadEdge" 3 "LaneTypeAll_Double" 2 "LaneTypeAll_Dashed" 1 "LaneTypeAll_Solid" 0 "LaneTypeAll_None" ;
VAL_TABLE_ lineRmHeadingConf_e 3 "Conf_High" 2 "Conf_Med" 1 "Conf_Low" 0 "Conf_None" ;
VAL_TABLE_ lineLmHeadingConf_e 3 "Description for the value '0x3'" 2 "Conf_Med" 1 "Conf_Low" 0 "Conf_None" ;
VAL_TABLE_ lineRmDistanceConf_e 3 "Conf_High" 2 "Conf_Med" 1 "Conf_Low" 0 "Conf_None" ;
VAL_TABLE_ lineLmDistanceConf_e 3 "Conf_High" 2 "Conf_Med" 1 "Conf_Low" 0 "Conf_None" ;
VAL_TABLE_ laneDectionHealth_e 3 "SNA" 2 "Not_Active_failure" 1 "Not_Active_blocked" 0 "Active" ;
VAL_TABLE_ TeAutoPark_e_ParkStyle 2 "Front_In" 1 "Rear_In" 0 "None" ;
VAL_TABLE_ TeHMI_e_UsrParkOutSide 2 "Right" 1 "Left" 0 "None" ;
VAL_TABLE_ SlotSide_t 2 "SLOT_RIGHT" 1 "SLOT_LEFT" 0 "SLOT_NULL" ;
VAL_TABLE_ ParkingDirection_t 2 "REAR_IN_OUT" 1 "FRONT_IN_OUT" 0 "CAR_NULL" ;
VAL_TABLE_ ParkingSlotType_t 7 "PW_DIAGONAL_LINE" 6 "PW_PARALLEL_LINE" 5 "PW_PERPENDICULAR_LINE" 4 "PW_FISHBONE" 3 "PW_DIAGONAL" 2 "PW_PARALLEL" 1 "PW_PERPENDICULAR" 0 "PW_NODIR" ;
VAL_TABLE_ TeAP_e_AlgoState 4 "Handshake" 3 "Park_Out" 2 "Park_In" 1 "Scanning" 0 "Idle" ;
VAL_TABLE_ TeAutoPark_e_AutoParkStatus 6 "Complete" 5 "Abort" 4 "Fault" 3 "Active" 2 "Standby" 1 "Initialize" 0 "Off" ;
VAL_TABLE_ TeAP_e_ParkAssistStatus 4 "Sensor_Fault" 3 "Active" 2 "Standby" 1 "Initialize" 0 "Off" ;
VAL_TABLE_ TrailerCalFailInfo 2 "Gear_IN_Reverse" 1 "Camera_Blocked" 0 "No_Failure" ;
VAL_TABLE_ Presentinfo 2 "TRAILERPRESENT" 1 "NO_TRAILER" 0 "UNKNOWN" ;
VAL_TABLE_ RecognitionInfo 1 "Known" 0 "Unknown" ;
VAL_TABLE_ Trailercalinfo 2 "Undefined" 1 "Calibrated" 0 "NotCalibrated" ;
VAL_TABLE_ turnaroundSubState 2 "Wait" 1 "TurnLeftOrRight" 0 "DriveStraight" ;
VAL_TABLE_ calibrationSubState 2 "Wait" 1 "TurnLeftOrRight" 0 "DriveStraight" ;
VAL_TABLE_ curState 7 "Trackinglost" 6 "AngleDetection" 5 "Turnaround" 4 "ScanningForTrailer" 3 "Calibration" 2 "TrailerRecognition" 1 "TrailerDetection" 0 "Idle" ;
VAL_TABLE_ CurrentTrailer_ID 6 "Trailer_MAX" 5 "Trailer_Absent" 4 "Trailer_ID5" 3 "Trailer_ID4" 2 "Trailer_ID3" 1 "Trailer_ID2" 0 "Trailer_ID1" ;
VAL_TABLE_ TrailerAngleSign 2 "None" 1 "Anticlockwise" 0 "Clockwise" ;
VAL_TABLE_ MeTRSC_e_TrlrPrsntInfoCAN 2 "TRLR_PRSNT" 1 "NO_TRLR" 0 "UNKNOWN" ;
VAL_TABLE_ MeSVS_e_DispView2Info 15 "VIEW_15" 14 "VIEW_14" 13 "VIEW_13" 12 "VIEW_12" 11 "VIEW_11" 10 "VIEW_10" 9 "VIEW_9" 8 "VIEW_8" 7 "VIEW_7" 6 "VIEW_6" 5 "VIEW_5" 4 "VIEW_4" 3 "VIEW_3" 2 "VIEW_2" 1 "VIEW_1" 0 "OFF" ;
VAL_TABLE_ MeTRSC_e_TRSCStat 6 "Fault" 5 "ActiveHoldOvr" 4 "Active" 3 "PreActive" 2 "Calibrating" 1 "Standby" 0 "Off" ;
VAL_TABLE_ IeTRSC_e_TrlrAngGrapOverSts 2 "SNA" 1 "Active" 0 "Inactive" ;
VAL_TABLE_ IeTRSC_e_TRSCAbortReas 21 "SNA" 20 "Fail Not Present" 19 "Invalid PROXI/veh configmismatch" 18 "Veh speed > spped req by CVADAS" 17 "Trailer angle too steep" 16 "ECU Voltage too low/high" 15 "No/Invalid response from TRSKM" 14 "TRSC butt pressed on TRSKM/Radio" 13 "No user feedback for 600s" 12 "Driver steering override" 11 "trlr image Cameraview lost inFOV" 10 "Forward direction speed > 25mph" 9 "Driver Door Open" 8 "Engine Status signal = OFF" 7 "Rear Tailgate Open" 6 "Ignition not in RUN" 5 "No/invalid response from Radio" 4 "No/invalid response ORC" 3 "No/invalid response Trans Cont." 2 "No/invalid response EPSM" 1 "No/invalid response BSM" 0 "No/Invalid rspnsEngineController" ;
VAL_TABLE_ IeTRSC_e_TRSCUnavailReas 20 "SNA" 19 "Fail Not Present" 18 "Invalid PROXI/Veh Conf. Mismatch" 17 "ECU in Plant Mode" 16 "ECU Voltage too low/high" 15 "No/invalid response TRSKM" 14 "Trailer Calibration Failure" 13 "trailer angle too steep" 12 "Trailer not detected by system" 11 "Camera calibration is unknown" 10 "Vehicle not in 'P'" 9 "Driver door open" 8 "Engine status signal = OFF" 7 "Rear tailgate open" 6 "Ignition not in RUN" 5 "No/invalid response Radio" 4 "No/invalid response ORC" 3 "No/invalid response TC" 2 "No/invalid response EPSM" 1 "No/invalid response BSM" 0 "No/invalid rspnsEngineController" ;
VAL_TABLE_ IeTRSC_e_CamBlockSts 3 "SNA" 2 "Low light" 1 "Camera clear" 0 "Camera blocked" ;
VAL_TABLE_ IeTRSC_e_TrlrRecogInfo 3 "SNA" 2 "No trailer detected" 1 "Unknown Trailer" 0 "Known Trailer" ;
VAL_TABLE_ IeTRSC_e_TrailerID 5 "Trailer_Absent" 4 "Trailer_ID5" 3 "Trailer_ID4" 2 "Trailer_ID3" 1 "Trailer_ID2" 0 "Trailer_ID1" ;
VAL_TABLE_ IeTRSC_e_GearShiftSts 7 "SNA" 6 "S" 5 "M" 4 "L" 3 "D" 2 "N" 1 "R" 0 "P" ;
VAL_TABLE_ IeTRSC_e_TRSKMSts 2 "SNA" 1 "Not Enabled" 0 "Enabled" ;
VAL_TABLE_ IeTRSC_e_TRSKMCenBtnSts 3 "SNA" 2 "Struck" 1 "Not Pressed" 0 "Pressed" ;
VAL_TABLE_ IeTRSC_e_TRSKMBtnSts 3 "SNA" 2 "Stuck" 1 "Not Pressed" 0 "Pressed" ;
VAL_TABLE_ IeTRSC_e_TrlrPrsntFailReas 2 "SNA" 1 "None" 0 "Camera Occlusion/Lowlight Status" ;
VAL_TABLE_ IeTRSC_e_TrlrPrsntSts 2 "SNA" 1 "Detected" 0 "Not Detected" ;
VAL_TABLE_ IeTRSC_e_TrlrCalibFailReas 4 "SNA" 3 "None" 2 "Camera Occlusion/Lowlight Status" 1 "Require more straight driving" 0 "Need more turn radius/arc length" ;
VAL_TABLE_ IeTRSC_e_TrlrCalibSts 2 "SNA" 1 "Not Calibrated" 0 "Calibrated" ;
VAL_TABLE_ IeTRSC_e_TrlrCalibManState 3 "SNA" 2 "None" 1 "Intersection turn left or right" 0 "Drive straight" ;
VAL_TABLE_ MeTRSC_e_TrlrAngSign 2 "None" 1 "Anticlockwise" 0 "Clockwise" ;
VAL_TABLE_ MeTRSC_e_TrlrPrsntInfo 2 "TRLR_PRSNT" 1 "NO_TRLR" 0 "UNKNOWN" ;
VAL_TABLE_ MeTRSC_e_TrlrRecogInfo 1 "Known" 0 "Unknown" ;
VAL_TABLE_ MeTRSC_e_TrlrCalInfo 2 "Undefined" 1 "Calibrated" 0 "Not Calibrated" ;
VAL_TABLE_ MeTRSC_e_TrailerID 6 "Trailer_MAX" 5 "Trailer_Absent" 4 "Trailer_ID5" 3 "Trailer_ID4" 2 "Trailer_ID3" 1 "Trailer_ID2" 0 "Trailer_ID1" ;
VAL_TABLE_ MeTRSC_e_CalFail 2 "More Turn Needed" 1 "Camera Blocked" 0 "No Failure" ;
VAL_TABLE_ MeTRSC_e_TADCalibrationSubstate 2 "Wait" 1 "TurnLeftOrRight" 0 "DriveStraight" ;
VAL_TABLE_ MeTRSC_e_TurnAroundSubState 2 "Wait" 1 "TurnLeftOrRight" 0 "DriveStraight" ;
VAL_TABLE_ MeTRSC_e_TADState 7 "Trackinglost" 6 "AngleDetection" 5 "Turnaround" 4 "ScanningForTrailer" 3 "Calibration" 2 "TrailerRecognition" 1 "TrailerDetection" 0 "Idle" ;

BO_ 3221225472 VECTOR__INDEPENDENT_SIG_MSG: 0 Vector__XXX
 SG_ laneDectionHealth_e : 0|2@1+ (1,0) [0|3] "" Vector__XXX
 SG_ Front_Sensor_Det_Health : 0|1@1+ (1,0) [0|1] "" Vector__XXX
 SG_ cntrCvpamFdData2_u16 : 0|16@1+ (1,0) [0|65535] "" Vector__XXX
 SG_ crcCvpamFdData2_u8 : 0|8@1+ (1,0) [0|255] "" Vector__XXX
 SG_ msgcntrCvpamFdData2_u8 : 0|8@1+ (1,0) [0|255] "" Vector__XXX
 SG_ macCvpamFdData2_u64 : 0|64@1+ (1,0) [0|1.84467440737096E+019] "" Vector__XXX

BO_ 2654814256 Log_PackedDiagFlagData2_v: 64 CVADAS

BO_ 2654814248 Log_PackedDiagFlagData1_v: 64 CVADAS

BO_ 2654814249 Log_PackedNoiseMeasData: 64 CVADAS

BO_ 2654556161 ME_SystemDebugData_1: 64 CVADAS
 SG_ FD14_1_Hook_PresentPtr_MCU1_0 : 0|32@1+ (1,0) [0|0] ""  CANOE
 SG_ FD14_1_ErrFaultInfo_MCU2_0 : 32|16@1+ (1,0) [0|0] ""  CANOE
 SG_ FD14_1_Err_FaultInfo_MCU2_1 : 48|16@1+ (1,0) [0|0] ""  CANOE
 SG_ FD14_1_Err_FaultInfo_MPU1_0 : 64|16@1+ (1,0) [0|0] ""  CANOE
 SG_ FD14_1_Err_FaultInfo_MCU1_0 : 80|16@1+ (1,0) [0|0] ""  CANOE
 SG_ FD14_1_WDG_Error_ID_MCU1_0 : 96|16@1+ (1,0) [0|0] ""  CANOE
 SG_ FD14_1_SDL_Fault_MCU1_0 : 112|16@1+ (1,0) [0|0] ""  CANOE
 SG_ FD14_1_Hook_Service_MCU1_0 : 128|16@1+ (1,0) [0|0] ""  CANOE
 SG_ FD14_1_Hook_DtErr_MCU1_0 : 144|16@1+ (1,0) [0|0] ""  CANOE
 SG_ FD14_1_Hook_Reserved_MCU1_0 : 160|16@1+ (1,0) [0|0] ""  CANOE
 SG_ FD14_1_Hook_fatalErr_MCU1_0 : 176|8@1+ (1,0) [0|0] ""  CANOE
 SG_ FD14_1_Hook_actTsk_MCU1_0 : 184|8@1+ (1,0) [0|0] ""  CANOE
 SG_ FD14_1_Hook_Error_MCU1_0 : 192|8@1+ (1,0) [0|0] ""  CANOE
 SG_ FD14_1_Hook_Type_MCU1_0 : 200|8@1+ (1,0) [0|0] ""  CANOE
 SG_ FD14_1_SSM_FltData1_MCU1_0 : 208|8@1+ (1,0) [0|0] ""  CANOE
 SG_ FD14_1_SSM_FltData2_MCU1_0 : 216|8@1+ (1,0) [0|0] ""  CANOE
 SG_ FD14_1_SSM_FltData3_MCU1_0 : 224|8@1+ (1,0) [0|0] ""  CANOE
 SG_ FD14_1_SSM_FltData4_MCU1_0 : 232|8@1+ (1,0) [0|0] ""  CANOE
 SG_ FD14_1_SSM_FltData5_MCU1_0 : 240|8@1+ (1,0) [0|0] ""  CANOE
 SG_ FD14_1_SSM_FltData6_MCU1_0 : 248|8@1+ (1,0) [0|0] ""  CANOE
 SG_ FD14_1_SSM_FltData7_MCU1_0 : 256|8@1+ (1,0) [0|0] ""  CANOE
 SG_ FD14_1_SSM_FltData8_MCU1_0 : 264|8@1+ (1,0) [0|0] ""  CANOE
 SG_ FD14_1_SSM_FltData9_MCU1_0 : 272|8@1+ (1,0) [0|0] ""  CANOE
 SG_ FD14_1_SSM_FltData10_MCU1_0 : 280|8@1+ (1,0) [0|0] ""  CANOE
 SG_ FD14_1_SSM_FltData11_MCU1_0 : 288|8@1+ (1,0) [0|0] ""  CANOE
 SG_ FD14_1_SSM_FltData12_MCU1_0 : 296|8@1+ (1,0) [0|0] ""  CANOE
 SG_ FD14_1_SSM_FltData13_MCU1_0 : 304|8@1+ (1,0) [0|0] ""  CANOE
 SG_ FD14_1_SSM_FltData14_MCU1_0 : 312|8@1+ (1,0) [0|0] ""  CANOE
 SG_ FD14_1_SSM_FltData15_MCU1_0 : 320|8@1+ (1,0) [0|0] ""  CANOE
 SG_ FD14_1_SSM_FltData16_MCU1_0 : 328|8@1+ (1,0) [0|0] ""  CANOE
 SG_ FD14_1_SSM_FltData17_MCU1_0 : 336|8@1+ (1,0) [0|0] ""  CANOE
 SG_ FD14_1_SSM_FltData18_MCU1_0 : 344|8@1+ (1,0) [0|0] ""  CANOE
 SG_ FD14_1_Err_FaultNum_MCU2_0 : 352|8@1+ (1,0) [0|0] ""  CANOE
 SG_ FD14_1_Err_FaultNum_MCU2_1 : 360|8@1+ (1,0) [0|0] ""  CANOE
 SG_ FD14_1_Err_FaultNum_MPU1_0 : 368|8@1+ (1,0) [0|0] ""  CANOE
 SG_ FD14_1_Err_FaultNum_MCU1_0 : 376|8@1+ (1,0) [0|0] ""  CANOE
 SG_ FD14_1_Reserved_MCU2_0 : 384|8@1+ (1,0) [0|0] ""  CANOE
 SG_ FD14_1_Reserved_MCU2_1 : 392|8@1+ (1,0) [0|0] ""  CANOE
 SG_ FD14_1_Reserved_MPU1_0 : 400|8@1+ (1,0) [0|0] ""  CANOE
 SG_ FD14_1_Reserved_MCU1_0 : 408|8@1+ (1,0) [0|0] ""  CANOE

BO_ 2654552336 FPADebugInfo1: 64 CVADAS
 SG_ stFPAInfoToVCLockedSlotRearRghtY : 176|32@1- (1,0) [0|640] ""  CANOE
 SG_ stFPAInfoToVCLockedSlotFrntLeftY : 144|32@1- (1,0) [0|640] ""  CANOE
 SG_ stFPAInfoToVCLockedSlotRearRghtX : 112|32@1- (1,0) [0|400] ""  CANOE
 SG_ stFPAInfoToVCLockedSlotFrntLeftX : 72|32@1- (1,0) [0|400] ""  CANOE
 SG_ stFPAInfoToVCLockedSlotType : 64|8@1+ (1,0) [0|3] ""  CANOE
 SG_ m_FPAToNVMParkInStyle : 56|8@1+ (1,0) [0|2] ""  CANOE
 SG_ stFPAInfoToVCLockedSlotSide : 48|8@1+ (1,0) [0|2] ""  CANOE
 SG_ m_FpaInfoToVCParkOutStyle : 40|8@1+ (1,0) [0|2] ""  CANOE
 SG_ stFPAInfoToVCLockedSlotID : 32|8@1+ (1,0) [0|6] ""  CANOE
 SG_ m_FPAInfoToUSSOMSlotID : 24|8@1+ (1,0) [0|6] ""  CANOE
 SG_ m_FPAInfoToPLDSlotID : 10|8@1+ (1,0) [0|6] ""  CANOE
 SG_ stFPAInfoToHMISlot6Valid : 9|1@1+ (1,0) [0|1] ""  CANOE
 SG_ stFPAInfoToHMISlot5Valid : 8|1@1+ (1,0) [0|1] ""  CANOE
 SG_ stFPAInfoToHMISlot4Valid : 7|1@1+ (1,0) [0|1] ""  CANOE
 SG_ stFPAInfoToHMISlot3Valid : 6|1@1+ (1,0) [0|1] ""  CANOE
 SG_ stFPAInfoToHMISlot2Valid : 5|1@1+ (1,0) [0|1] ""  CANOE
 SG_ stFPAInfoToHMISlot1Valid : 4|1@1+ (1,0) [0|1] ""  CANOE
 SG_ m_FPAToNVMWriteNVMParam_b : 3|1@1+ (1,0) [0|1] ""  CANOE
 SG_ m_FPAToNVMReadNVMParam_b : 2|1@1+ (1,0) [0|1] ""  CANOE
 SG_ stFPAInfoToVCLockedSlotValid : 1|1@1+ (1,0) [0|1] ""  CANOE
 SG_ AutoParkInitializedStatus_b : 0|1@1+ (1,0) [0|1] ""  CANOE

BO_ 2654552329 USSDebugInfo2: 64 CVADAS
 SG_ stnumPointsR : 192|16@1+ (1,0) [0|400] ""  CANOE
 SG_ stnumPointsL : 161|16@1+ (1,0) [0|400] ""  CANOE
 SG_ stRightObjectList4Valid : 160|1@1+ (1,0) [0|1] ""  CANOE
 SG_ stRightObjectList3Valid : 159|1@1+ (1,0) [0|1] ""  CANOE
 SG_ stRightObjectList2Valid : 158|1@1+ (1,0) [0|1] ""  CANOE
 SG_ stRightObjectList1Valid : 157|1@1+ (1,0) [0|1] ""  CANOE
 SG_ stLeftObjectList4Valid : 156|1@1+ (1,0) [0|1] ""  CANOE
 SG_ stLeftObjectList3Valid : 155|1@1+ (1,0) [0|1] ""  CANOE
 SG_ stLeftObjectList2Valid : 154|1@1+ (1,0) [0|1] ""  CANOE
 SG_ stLeftObjectList1Valid : 153|1@1+ (1,0) [0|1] ""  CANOE
 SG_ stUSSLockedSlotDataSlotValid : 152|1@1+ (1,0) [0|1] ""  CANOE
 SG_ stUSSLockedSlotDataSlotID : 144|8@1+ (1,0) [0|6] ""  CANOE
 SG_ stUSSLockedSlotDataSlotSide : 136|8@1+ (1,0) [0|2] ""  CANOE
 SG_ stUSSLockedSlotDataSlotType : 128|8@1+ (1,0) [0|3] ""  CANOE
 SG_ stUSSLockedSlotDataRearRightY : 96|32@1- (1,0) [0|640] ""  CANOE
 SG_ stUSSLockedSlotDataFrontLeftY : 64|32@1- (1,0) [0|640] ""  CANOE
 SG_ stUSSLockedSlotDataRearRightX : 32|32@1- (1,0) [0|400] ""  CANOE
 SG_ stUSSLockedSlotDataFrontLeftX : 0|32@1- (1,0) [0|400] ""  CANOE

BO_ 2654552328 USSDebugInfo1: 64 CVADAS
 SG_ stUSSParkingSlot1DataSlotID : 296|8@1+ (1,0) [0|6] ""  CANOE
 SG_ stUSSParkingSlot4DataSlotSide : 288|8@1+ (1,0) [0|2] ""  CANOE
 SG_ stUSSParkingSlot1DataSlotSide : 280|8@1+ (1,0) [0|2] ""  CANOE
 SG_ stUSSParkingSlot4SlotType : 40|8@1+ (1,0) [0|3] ""  CANOE
 SG_ stUSSParkingSlot1SlotType : 272|8@1+ (1,0) [0|3] ""  CANOE
 SG_ stUSSParkingSlot4RearRightY : 240|32@1- (1,0) [0|640] ""  CANOE
 SG_ stUSSParkingSlot4FrontLeftY : 208|32@1- (1,0) [0|640] ""  CANOE
 SG_ stUSSParkingSlot1RearRightY : 176|32@1- (1,0) [0|640] ""  CANOE
 SG_ stUSSParkingSlot1FrontLeftY : 144|32@1- (1,0) [0|640] ""  CANOE
 SG_ stUSSParkingSlot4RearRightX : 112|32@1- (1,0) [0|400] ""  CANOE
 SG_ stUSSParkingSlot4FrontLeftX : 80|32@1- (1,0) [0|400] ""  CANOE
 SG_ stUSSParkingSlot1RearRightX : 48|32@1- (1,0) [0|400] ""  CANOE
 SG_ stUSSParkingSlot1FrontLeftX : 7|32@1- (1,0) [0|400] ""  CANOE
 SG_ stUSSParkingSlot6SlotValid : 6|1@1+ (1,0) [0|1] ""  CANOE
 SG_ stUSSParkingSlot5SlotValid : 5|1@1+ (1,0) [0|1] ""  CANOE
 SG_ stUSSParkingSlot4SlotValid : 4|1@1+ (1,0) [0|1] ""  CANOE
 SG_ stUSSParkingSlot3SlotValid : 3|1@1+ (1,0) [0|1] ""  CANOE
 SG_ stUSSParkingSlot2SlotValid : 2|1@1+ (1,0) [0|1] ""  CANOE
 SG_ stUSSParkingSlot1SlotValid : 1|1@1+ (1,0) [0|1] ""  CANOE
 SG_ isUSSInitSuccess_b : 0|1@1+ (1,0) [0|1] ""  CANOE

BO_ 2654552327 PLDDebugInfo2: 20 CVADAS
 SG_ stPLDLockedSlotDataSlotValid : 152|1@1+ (1,0) [0|1] ""  CANOE
 SG_ stPLDLockedSlotDataSlotID : 144|8@1+ (1,0) [0|6] ""  CANOE
 SG_ stPLDLockedSlotDataSlotSide : 136|8@1+ (1,0) [0|2] ""  CANOE
 SG_ stPLDLockedSlotDataSlotType : 128|8@1+ (1,0) [0|3] ""  CANOE
 SG_ stPLDLockedSlotDataRearRightY : 96|32@1- (1,0) [0|640] ""  CANOE
 SG_ stPLDLockedSlotDataRearRightX : 64|32@1- (1,0) [0|400] ""  CANOE
 SG_ stPLDLockedSlotDataFrontLeftY : 32|32@1- (1,0) [0|640] ""  CANOE
 SG_ stPLDLockedSlotDataFrontLeftX : 0|32@1- (1,0) [0|400] ""  CANOE

BO_ 2654552326 PLDDebugInfo1: 64 CVADAS
 SG_ stPLDParkingSlot4SlotType : 304|8@1+ (1,0) [0|3] ""  CANOE
 SG_ stPLDParkingSlot4DataSlotSide : 296|8@1+ (1,0) [0|2] ""  CANOE
 SG_ stPLDParkingSlot4DataSlotID : 288|8@1+ (1,0) [0|6] ""  CANOE
 SG_ stPLDParkingSlot4RearRightX : 256|32@1- (1,0) [0|400] ""  CANOE
 SG_ stPLDParkingSlot4RearRightY : 224|32@1- (1,0) [0|640] ""  CANOE
 SG_ stPLDParkingSlot4FrontLeftY : 192|32@1- (1,0) [0|640] ""  CANOE
 SG_ stPLDParkingSlot4FrontLeftX : 160|32@1- (1,0) [0|400] ""  CANOE
 SG_ stPLDParkingSlot1DataSlotID : 152|8@1+ (1,0) [0|6] ""  CANOE
 SG_ stPLDParkingSlot1DataSlotSide : 144|8@1+ (1,0) [0|2] ""  CANOE
 SG_ stPLDParkingSlot1SlotType : 39|8@1+ (1,0) [0|3] ""  CANOE
 SG_ stPLDParkingSlot1RearRightY : 112|32@1- (1,0) [0|640] ""  CANOE
 SG_ stPLDParkingSlot1RearRightX : 80|32@1- (1,0) [0|400] ""  CANOE
 SG_ stPLDParkingSlot1FrontLeftY : 48|32@1- (1,0) [0|640] ""  CANOE
 SG_ stPLDParkingSlot1FrontLeftX : 7|32@1- (1,0) [0|400] ""  CANOE
 SG_ stPLDParkingSlot6SlotValid : 6|1@1+ (1,0) [0|1] ""  CANOE
 SG_ stPLDParkingSlot5SlotValid : 5|1@1+ (1,0) [0|1] ""  CANOE
 SG_ stPLDParkingSlot3SlotValid : 4|1@1+ (1,0) [0|1] ""  CANOE
 SG_ stPLDParkingSlot2SlotValid : 3|1@1+ (1,0) [0|1] ""  CANOE
 SG_ stPLDParkingSlot4SlotValid : 2|1@1+ (1,0) [0|1] ""  CANOE
 SG_ stPLDParkingSlot1SlotValid : 1|1@1+ (1,0) [0|1] ""  CANOE
 SG_ isPLDInitSuccess_b : 0|1@1+ (1,0) [0|1] ""  CANOE

BO_ 2654552325 LMD_SegmentDebug_2_2: 48 CVADAS
 SG_ leLMD_e_HealthStatus : 304|8@1+ (1,0) [0|3] ""  CANOE
 SG_ IeLMD_e_CameraStatus : 296|8@1+ (1,0) [0|15] ""  CANOE
 SG_ Total_lines_count : 288|8@1+ (1,0) [0|100] ""  CANOE
 SG_ Frame_Index_Lanes_1 : 256|32@1+ (1,0) [0|2500] ""  CANOE
 SG_ LMD_pct_Segment_7_Confidence : 224|32@1- (0.1,0) [0|1.5] ""  CANOE
 SG_ LMD_pct_Segment_8_Confidence : 192|32@1- (0.1,0) [0|1.5] ""  CANOE
 SG_ LMD_pct_Segment_5_Confidence : 160|32@1- (0.1,0) [0|1.5] ""  CANOE
 SG_ LMD_pct_Segment_6_Confidence : 128|32@1- (0.1,0) [0|1.5] ""  CANOE
 SG_ LMD_pct_Segment_3_Confidence : 96|32@1- (0.1,0) [0|1.5] ""  CANOE
 SG_ LMD_pct_Segment_4_Confidence : 64|32@1- (0.1,0) [0|1.5] ""  CANOE
 SG_ LMD_pct_Segment_1_Confidence : 32|32@1- (0.1,0) [0|1.5] ""  CANOE
 SG_ LMD_pct_Segment_2_Confidence : 0|32@1- (0.1,0) [0|1.5] ""  CANOE

BO_ 2654552324 LMD_SegmentDebug_2_1: 64 CVADAS
 SG_ LMD_m_Segment_8_Y2 : 480|32@1- (0.01,0) [-5|5.23] ""  CANOE
 SG_ LMD_m_Segment_7_Y2 : 448|32@1- (0.01,0) [-5|5.23] ""  CANOE
 SG_ LMD_m_Segment_6_Y2 : 416|32@1- (0.01,0) [-5|5.23] ""  CANOE
 SG_ LMD_m_Segment_5_Y2 : 384|32@1- (0.01,0) [-5|5.23] ""  CANOE
 SG_ LMD_m_Segment_4_Y2 : 352|32@1- (0.01,0) [-5|5.23] ""  CANOE
 SG_ LMD_m_Segment_3_Y2 : 320|32@1- (0.01,0) [-5|5.23] ""  CANOE
 SG_ LMD_m_Segment_2_Y2 : 288|32@1- (0.01,0) [-5|5.23] ""  CANOE
 SG_ LMD_m_Segment_1_Y2 : 256|32@1- (0.01,0) [-5|5.23] ""  CANOE
 SG_ LMD_m_Segment_8_X2 : 224|32@1- (0.03,0) [-21|40.41] ""  CANOE
 SG_ LMD_m_Segment_7_X2 : 192|32@1- (0.03,0) [-21|40.41] ""  CANOE
 SG_ LMD_m_Segment_6_X2 : 160|32@1- (0.03,0) [-21|40.41] ""  CANOE
 SG_ LMD_m_Segment_5_X2 : 128|32@1- (0.03,0) [-21|40.41] ""  CANOE
 SG_ LMD_m_Segment_4_X2 : 96|32@1- (0.03,0) [-21|40.41] ""  CANOE
 SG_ LMD_m_Segment_3_X2 : 64|32@1- (0.03,0) [-21|40.41] ""  CANOE
 SG_ LMD_m_Segment_2_X2 : 32|32@1- (0.03,0) [-21|40.41] ""  CANOE
 SG_ LMD_m_Segment_1_X2 : 0|32@1- (0.03,0) [-21|40.41] ""  CANOE

BO_ 2654552323 LMD_SegmentDebug_1_2: 12 CVADAS
 SG_ LMD_m_Segment_8_Y1 : 32|32@1- (0.01,0) [-5|5.23] ""  CANOE
 SG_ LMD_m_Segment_7_Y1 : 64|32@1- (0.01,0) [-5|5.23] ""  CANOE
 SG_ LMD_m_Segment_6_Y1 : 0|32@1- (0.01,0) [-5|5.23] ""  CANOE

BO_ 2654552322 LMD_SegmentDebug_1: 64 CVADAS
 SG_ LMD_m_Segment_5_Y1 : 448|32@1- (0.01,0) [-5|5.23] ""  CANOE
 SG_ LMD_m_Segment_4_Y1 : 416|32@1- (0.01,0) [-5|5.23] ""  CANOE
 SG_ LMD_m_Segment_3_Y1 : 384|32@1- (0.01,0) [-5|5.23] ""  CANOE
 SG_ LMD_m_Segment_2_Y1 : 352|32@1- (0.01,0) [-5|5.23] ""  CANOE
 SG_ LMD_m_Segment_1_Y1 : 320|32@1- (0.01,0) [-5|5.23] ""  CANOE
 SG_ LMD_m_Segment_8_X1 : 288|32@1- (0.03,0) [-21|40.41] ""  CANOE
 SG_ LMD_m_Segment_6_X1 : 256|32@1- (0.03,0) [-21|40.41] ""  CANOE
 SG_ LMD_m_Segment_7_X1 : 224|32@1- (0.03,0) [-21|40.41] ""  CANOE
 SG_ LMD_m_Segment_5_X1 : 192|32@1- (0.03,0) [-21|40.41] ""  CANOE
 SG_ LMD_m_Segment_4_X1 : 160|32@1- (0.03,0) [-21|40.41] ""  CANOE
 SG_ LMD_m_Segment_3_X1 : 128|32@1- (0.03,0) [-21|40.41] ""  CANOE
 SG_ LMD_m_Segment_2_X1 : 96|32@1- (0.03,0) [-21|40.41] ""  CANOE
 SG_ LMD_m_Segment_1_X1 : 64|32@1- (0.03,0) [-21|40.41] ""  CANOE
 SG_ LMD_e_Segment_7_ID : 56|8@1+ (1,0) [0|15] ""  CANOE
 SG_ LMD_e_Segment_8_ID : 48|8@1+ (1,0) [0|15] ""  CANOE
 SG_ LMD_e_Segment_5_ID : 40|8@1+ (1,0) [0|15] ""  CANOE
 SG_ LMD_e_Segment_6_ID : 32|8@1+ (1,0) [0|15] ""  CANOE
 SG_ LMD_e_Segment_3_ID : 24|8@1+ (1,0) [0|15] ""  CANOE
 SG_ LMD_e_Segment_4_ID : 16|8@1+ (1,0) [0|15] ""  CANOE
 SG_ LMD_e_Segment_1_ID : 8|8@1+ (1,0) [0|15] ""  CANOE
 SG_ LMD_e_Segment_2_ID : 0|8@1+ (1,0) [0|15] ""  CANOE

BO_ 2654552321 LMD_LaneLinesDebug_2: 64 CVADAS
 SG_ LMD_e_Line_4_Type : 392|8@1+ (1,0) [0|15] ""  CANOE
 SG_ LMD_e_Line_3_Type : 384|8@1+ (1,0) [0|15] ""  CANOE
 SG_ LMD_pct_Line_3_Confidence : 352|32@1- (0.1,0) [0|1.5] ""  CANOE
 SG_ LMD_px_Line_3_Curvature : 320|32@1- (9.77E-007,0) [-0.032|0.032027695] ""  CANOE
 SG_ LMD_m_Line_4_End_Range : 288|32@1- (0.5,0) [-25|38.5] ""  CANOE
 SG_ LMD_m_Line_4_Start_Range : 256|32@1- (0.5,0) [-25|38.5] ""  CANOE
 SG_ LMD_rad_Line_4_Heading : 224|32@1- (0.000976562,0) [-0.357|0.6420234375] ""  CANOE
 SG_ LMD_m_Line_4_Offset : 192|32@1- (0.01,0) [-5|5.23] ""  CANOE
 SG_ LMD_pct_Line_4_Confidence : 160|32@1- (0.1,0) [0|1.5] ""  CANOE
 SG_ LMD_px_Line_4_Curvature : 128|32@1- (9.77E-007,0) [-0.032|0.032027695] ""  CANOE
 SG_ LMD_m_Line_3_End_Range : 96|32@1- (0.5,0) [-25|38.5] ""  CANOE
 SG_ LMD_m_Line_3_Start_Range : 64|32@1- (0.5,0) [-25|38.5] ""  CANOE
 SG_ LMD_rad_Line_3_Heading : 32|32@1- (0.000976562,0) [-0.357|0.6420234375] ""  CANOE
 SG_ LMD_m_Line_3_Offset : 0|32@1- (0.01,0) [-5|5.23] ""  CANOE

BO_ 2654552320 Debug_ModuleState: 64 CVADAS
 SG_ OC_ModuleState_STM_Right : 88|8@1+ (1,0) [0|11] ""  CANOE
 SG_ OC_ModuleState_STM_Rear : 80|8@1+ (1,0) [0|11] ""  CANOE
 SG_ OC_ModuleState_STM_Left : 72|8@1+ (1,0) [0|11] ""  CANOE
 SG_ OC_ModuleState_STM_Front : 64|8@1+ (1,0) [0|11] ""  CANOE
 SG_ SC_ModuleState_STM_Right : 56|8@1+ (1,0) [0|12] ""  CANOE
 SG_ SC_ModuleState_STM_Rear : 48|8@1+ (1,0) [0|12] ""  CANOE
 SG_ SC_ModuleState_STM_Left : 40|8@1+ (1,0) [0|12] ""  CANOE
 SG_ SC_ModuleState_STM_Front : 32|8@1+ (1,0) [0|12] ""  CANOE
 SG_ EOL_ModuleState_STM_Right : 24|8@1+ (1,0) [0|8] ""  CANOE
 SG_ EOL_ModuleState_STM_Rear : 16|8@1+ (1,0) [0|8] ""  CANOE
 SG_ EOL_ModuleState_STM_Left : 8|8@1+ (1,0) [0|8] ""  CANOE
 SG_ EOL_ModuleState_STM_Front : 0|8@1+ (1,0) [0|8] ""  CANOE

BO_ 2654552217 Debug_CalibSts: 64 CVADAS
 SG_ CalibStatus_STM_Current_Right : 120|8@1+ (1,0) [0|4] ""  CANOE
 SG_ CalibStatus_STM_Current_Rear : 112|8@1+ (1,0) [0|4] ""  CANOE
 SG_ CalibStatus_STM_Current_Left : 104|8@1+ (1,0) [0|4] ""  CANOE
 SG_ CalibStatus_STM_Current_Front : 96|8@1+ (1,0) [0|4] ""  CANOE
 SG_ CalibStatus_STM_OC_Right : 88|8@1+ (1,0) [0|4] ""  CANOE
 SG_ CalibStatus_STM_OC_Rear : 80|8@1+ (1,0) [0|4] ""  CANOE
 SG_ CalibStatus_STM_OC_Left : 72|8@1+ (1,0) [0|4] ""  CANOE
 SG_ CalibStatus_STM_OC_Front : 64|8@1+ (1,0) [0|4] ""  CANOE
 SG_ CalibStatus_STM_SC_Right : 56|8@1+ (1,0) [0|4] ""  CANOE
 SG_ CalibStatus_STM_SC_Rear : 48|8@1+ (1,0) [0|4] ""  CANOE
 SG_ CalibStatus_STM_SC_Left : 40|8@1+ (1,0) [0|4] ""  CANOE
 SG_ CalibStatus_STM_SC_Front : 32|8@1+ (1,0) [0|4] ""  CANOE
 SG_ CalibStatus_STM_EOL_Right : 24|8@1+ (1,0) [0|4] ""  CANOE
 SG_ CalibStatus_STM_EOL_Rear : 16|8@1+ (1,0) [0|4] ""  CANOE
 SG_ CalibStatus_STM_EOL_Left : 8|8@1+ (1,0) [0|4] ""  CANOE
 SG_ CalibStatus_STM_EOL_Front : 0|8@1+ (1,0) [0|4] ""  CANOE

BO_ 2654552216 Debug_ErrCodeAlgo: 64 CVADAS
 SG_ Err_Code_OC_Right : 88|8@1+ (1,0) [0|7] ""  CANOE
 SG_ Err_Code_OC_Rear : 80|8@1+ (1,0) [0|7] ""  CANOE
 SG_ Err_Code_OC_Left : 72|8@1+ (1,0) [0|7] ""  CANOE
 SG_ Err_Code_OC_Front : 64|8@1+ (1,0) [0|7] ""  CANOE
 SG_ Err_Code_SC_Right : 56|8@1+ (1,0) [0|7] ""  CANOE
 SG_ Err_Code_SC_Rear : 48|8@1+ (1,0) [0|7] ""  CANOE
 SG_ Err_Code_SC_Left : 40|8@1+ (1,0) [0|7] ""  CANOE
 SG_ Err_Code_SC_Front : 32|8@1+ (1,0) [0|7] ""  CANOE
 SG_ Err_Code_EOL_Rear_Copy_1 : 24|8@1+ (1,0) [0|19] ""  CANOE
 SG_ Err_Code_EOL_Rear : 16|8@1+ (1,0) [0|19] ""  CANOE
 SG_ Err_Code_EOL_Left : 8|8@1+ (1,0) [0|19] ""  CANOE
 SG_ Err_Code_EOL_Front : 0|8@1+ (1,0) [0|19] ""  CANOE

BO_ 2654552215 Firing_Sequence: 8 CVADAS
 SG_ Current_Firing_Sequence : 0|2@1+ (1,0) [0|3] ""  CANOE

BO_ 2654814236 Log_SnrMeasData_07: 64 CVADAS
 SG_ SnrMeasDataChecksum : 344|32@1+ (1,0) [0|0] ""  CANOE

BO_ 2654814235 Log_SnrMeasData_06: 64 CVADAS

BO_ 2654814234 Log_SnrMeasData_05: 64 CVADAS

BO_ 2654814233 Log_SnrMeasData_04: 64 CVADAS

BO_ 2654814247 Log_SnrMeasData_03: 64 CVADAS

BO_ 2654814231 Log_SnrMeasData_02: 64 CVADAS

BO_ 2654814230 Log_SnrMeasData_01: 64 CVADAS

BO_ 2654814237 Log_SnrTemperature: 64 CVADAS
 SG_ Log_Sensor_Temperature : 0|64@1+ (1,0) [0|1.84467440737096E+019] ""  CANOE

BO_ 2654552337 ME_Debug_SensorTestData_1: 64 CVADAS
 SG_ Tstr_SD_FSR_DrvFreq : 0|16@1+ (572,0) [0|145860] "hz"  CANOE
 SG_ Tstr_SD_FSR_RingFreq : 16|16@1+ (572,0) [0|145860] "hz"  CANOE
 SG_ Tstr_SD_FSR_Ringtime_us : 32|12@1+ (1,0) [0|4095] ""  CANOE
 SG_ Tstr_SD_FSR_Unfiltered_DirDist1_ : 44|10@1+ (1,0) [0|1023] "cm"  CANOE
 SG_ Tstr_SD_FSR_Unfiltered_DirDist2_ : 54|10@1+ (1,0) [0|1023] "cm"  CANOE
 SG_ Tstr_SD_FSR_EchoHeight_adc : 64|8@1+ (1,0) [0|255] "adc"  CANOE
 SG_ Tstr_SD_FSR_SensorBlkgSetCounter : 72|8@1+ (1,0) [0|255] ""  CANOE
 SG_ Tstr_SD_FSR_SensorBlkgClrCounter : 80|8@1+ (1,0) [0|255] ""  CANOE
 SG_ Tstr_SD_FOR_DrvFreq : 88|16@1+ (572,0) [0|145860] "hz"  CANOE
 SG_ Tstr_SD_FOR_RingFreq : 104|16@1+ (572,0) [0|145860] "hz"  CANOE
 SG_ Tstr_SD_FOR_Ringtime_us : 120|12@1+ (1,0) [0|4095] ""  CANOE
 SG_ Tstr_SD_FOR_Unfiltered_DirDist1_ : 132|10@1+ (1,0) [0|1023] "cm"  CANOE
 SG_ Tstr_SD_FOR_Unfiltered_DirDist2_ : 142|10@1+ (1,0) [0|1023] "cm"  CANOE
 SG_ Tstr_SD_FOR_EchoHeight_adc : 152|8@1+ (1,0) [0|255] "adc"  CANOE
 SG_ Tstr_SD_FOR_SensorBlkgSetCounter : 160|8@1+ (1,0) [0|255] ""  CANOE
 SG_ Tstr_SD_FOR_SensorBlkgClrCounter : 168|8@1+ (1,0) [0|255] ""  CANOE
 SG_ Tstr_SD_FIR_DrvFreq : 176|16@1+ (572,0) [0|145860] "hz"  CANOE
 SG_ Tstr_SD_FIR_RingFreq : 192|16@1+ (572,0) [0|145860] "hz"  CANOE
 SG_ Tstr_SD_FIR_Ringtime_us : 208|12@1+ (1,0) [0|4095] ""  CANOE
 SG_ Tstr_SD_FIR_Unfiltered_DirDist1_ : 220|10@1+ (1,0) [0|1023] "cm"  CANOE
 SG_ Tstr_SD_FIR_Unfiltered_DirDist2_ : 230|10@1+ (1,0) [0|1023] "cm"  CANOE
 SG_ Tstr_SD_FIR_EchoHeight_adc : 240|8@1+ (1,0) [0|255] "adc"  CANOE
 SG_ Tstr_SD_FIR_SensorBlkgSetCounter : 248|8@1+ (1,0) [0|255] ""  CANOE
 SG_ Tstr_SD_FIR_SensorBlkgClrCounter : 256|8@1+ (1,0) [0|255] ""  CANOE
 SG_ Tstr_SD_FIL_DrvFreq : 264|16@1+ (572,0) [0|145860] "hz"  CANOE
 SG_ Tstr_SD_FIL_RingFreq : 280|16@1+ (572,0) [0|145860] "hz"  CANOE
 SG_ Tstr_SD_FIL_Ringtime_us : 296|12@1+ (1,0) [0|4095] ""  CANOE
 SG_ Tstr_SD_FIL_Unfiltered_DirDist1_ : 308|10@1+ (1,0) [0|1023] "cm"  CANOE
 SG_ Tstr_SD_FIL_Unfiltered_DirDist2_ : 318|10@1+ (1,0) [0|1023] "cm"  CANOE
 SG_ Tstr_SD_FIL_EchoHeight_adc : 328|8@1+ (1,0) [0|255] "adc"  CANOE
 SG_ Tstr_SD_FIL_SensorBlkgSetCounter : 336|8@1+ (1,0) [0|255] ""  CANOE
 SG_ Tstr_SD_FIL_SensorBlkgClrCounter : 344|8@1+ (1,0) [0|255] ""  CANOE

BO_ 2654552338 ME_Debug_SensorTestData_2: 64 CVADAS
 SG_ Tstr_SD_FOL_DrvFreq : 0|16@1+ (572,0) [0|145860] "hz"  CANOE
 SG_ Tstr_SD_FOL_RingFreq : 16|16@1+ (572,0) [0|145860] "hz"  CANOE
 SG_ Tstr_SD_FOL_Ringtime_us : 32|12@1+ (1,0) [0|4095] ""  CANOE
 SG_ Tstr_SD_FOL_Unfiltered_DirDist1_ : 44|10@1+ (1,0) [0|1023] "cm"  CANOE
 SG_ Tstr_SD_FOL_Unfiltered_DirDist2_ : 54|10@1+ (1,0) [0|1023] "cm"  CANOE
 SG_ Tstr_SD_FOL_EchoHeight_adc : 64|8@1+ (1,0) [0|255] "adc"  CANOE
 SG_ Tstr_SD_FOL_SensorBlkgSetCounter : 72|8@1+ (1,0) [0|255] ""  CANOE
 SG_ Tstr_SD_FOL_SensorBlkgClrCounter : 80|8@1+ (1,0) [0|255] ""  CANOE
 SG_ Tstr_SD_FSL_DrvFreq : 88|16@1+ (572,0) [0|145860] "hz"  CANOE
 SG_ Tstr_SD_FSL_RingFreq : 104|16@1+ (572,0) [0|145860] "hz"  CANOE
 SG_ Tstr_SD_FSL_Ringtime_us : 120|12@1+ (1,0) [0|4095] ""  CANOE
 SG_ Tstr_SD_FSL_Unfiltered_DirDist1_ : 132|10@1+ (1,0) [0|1023] "cm"  CANOE
 SG_ Tstr_SD_FSL_Unfiltered_DirDist2_ : 142|10@1+ (1,0) [0|1023] "cm"  CANOE
 SG_ Tstr_SD_FSL_EchoHeight_adc : 152|8@1+ (1,0) [0|255] "adc"  CANOE
 SG_ Tstr_SD_FSL_SensorBlkgSetCounter : 160|8@1+ (1,0) [0|255] ""  CANOE
 SG_ Tstr_SD_FSL_SensorBlkgClrCounter : 168|8@1+ (1,0) [0|255] ""  CANOE
 SG_ Tstr_SD_RSR_DrvFreq : 176|16@1+ (572,0) [0|145860] "hz"  CANOE
 SG_ Tstr_SD_RSR_RingFreq : 192|16@1+ (572,0) [0|145860] "hz"  CANOE
 SG_ Tstr_SD_RSR_Ringtime_us : 208|12@1+ (1,0) [0|4095] ""  CANOE
 SG_ Tstr_SD_RSR_Unfiltered_DirDist1_ : 220|10@1+ (1,0) [0|1023] "cm"  CANOE
 SG_ Tstr_SD_RSR_Unfiltered_DirDist2_ : 230|10@1+ (1,0) [0|1023] "cm"  CANOE
 SG_ Tstr_SD_RSR_EchoHeight_adc : 240|8@1+ (1,0) [0|255] "adc"  CANOE
 SG_ Tstr_SD_RSR_SensorBlkgSetCounter : 248|8@1+ (1,0) [0|255] ""  CANOE
 SG_ Tstr_SD_RSR_SensorBlkgClrCounter : 256|8@1+ (1,0) [0|255] ""  CANOE
 SG_ Tstr_SD_ROR_DrvFreq : 264|16@1+ (572,0) [0|145860] "hz"  CANOE
 SG_ Tstr_SD_ROR_RingFreq : 280|16@1+ (572,0) [0|145860] "hz"  CANOE
 SG_ Tstr_SD_ROR_Ringtime_us : 296|12@1+ (1,0) [0|4095] ""  CANOE
 SG_ Tstr_SD_ROR_Unfiltered_DirDist1_ : 308|10@1+ (1,0) [0|1023] "cm"  CANOE
 SG_ Tstr_SD_ROR_Unfiltered_DirDist2_ : 318|10@1+ (1,0) [0|1023] "cm"  CANOE
 SG_ Tstr_SD_ROR_EchoHeight_adc : 328|8@1+ (1,0) [0|255] "adc"  CANOE
 SG_ Tstr_SD_ROR_SensorBlkgSetCounter : 336|8@1+ (1,0) [0|255] ""  CANOE
 SG_ Tstr_SD_ROR_SensorBlkgClrCounter : 344|8@1+ (1,0) [0|255] ""  CANOE

BO_ 2654552339 ME_Debug_SensorTestData_3: 64 CVADAS
 SG_ Tstr_SD_RIR_DrvFreq : 0|16@1+ (572,0) [0|145860] "hz"  CANOE
 SG_ Tstr_SD_RIR_RingFreq : 16|16@1+ (572,0) [0|145860] "hz"  CANOE
 SG_ Tstr_SD_RIR_Ringtime_us : 32|12@1+ (1,0) [0|4095] ""  CANOE
 SG_ Tstr_SD_RIR_Unfiltered_DirDist1_ : 44|10@1+ (1,0) [0|1023] "cm"  CANOE
 SG_ Tstr_SD_RIR_Unfiltered_DirDist2_ : 54|10@1+ (1,0) [0|1023] "cm"  CANOE
 SG_ Tstr_SD_RIR_EchoHeight_adc : 64|8@1+ (1,0) [0|255] "adc"  CANOE
 SG_ Tstr_SD_RIR_SensorBlkgSetCounter : 72|8@1+ (1,0) [0|255] ""  CANOE
 SG_ Tstr_SD_RIR_SensorBlkgClrCounter : 80|8@1+ (1,0) [0|255] ""  CANOE
 SG_ Tstr_SD_RIL_DrvFreq : 88|16@1+ (572,0) [0|145860] "hz"  CANOE
 SG_ Tstr_SD_RIL_RingFreq : 104|16@1+ (572,0) [0|145860] "hz"  CANOE
 SG_ Tstr_SD_RIL_Ringtime_us : 120|12@1+ (1,0) [0|4095] ""  CANOE
 SG_ Tstr_SD_RIL_Unfiltered_DirDist1_ : 132|10@1+ (1,0) [0|1023] "cm"  CANOE
 SG_ Tstr_SD_RIL_Unfiltered_DirDist2_ : 142|10@1+ (1,0) [0|1023] "cm"  CANOE
 SG_ Tstr_SD_RIL_EchoHeight_adc : 152|8@1+ (1,0) [0|255] "adc"  CANOE
 SG_ Tstr_SD_RIL_SensorBlkgSetCounter : 160|8@1+ (1,0) [0|255] ""  CANOE
 SG_ Tstr_SD_RIL_SensorBlkgClrCounter : 168|8@1+ (1,0) [0|255] ""  CANOE
 SG_ Tstr_SD_ROL_DrvFreq : 176|16@1+ (572,0) [0|145860] "hz"  CANOE
 SG_ Tstr_SD_ROL_RingFreq : 192|16@1+ (572,0) [0|145860] "hz"  CANOE
 SG_ Tstr_SD_ROL_Ringtime_us : 208|12@1+ (1,0) [0|4095] ""  CANOE
 SG_ Tstr_SD_ROL_Unfiltered_DirDist1_ : 220|10@1+ (1,0) [0|1023] "cm"  CANOE
 SG_ Tstr_SD_ROL_Unfiltered_DirDist2_ : 230|10@1+ (1,0) [0|1023] "cm"  CANOE
 SG_ Tstr_SD_ROL_EchoHeight_adc : 240|8@1+ (1,0) [0|255] "adc"  CANOE
 SG_ Tstr_SD_ROL_SensorBlkgSetCounter : 248|8@1+ (1,0) [0|255] ""  CANOE
 SG_ Tstr_SD_ROL_SensorBlkgClrCounter : 256|8@1+ (1,0) [0|255] ""  CANOE
 SG_ Tstr_SD_RSL_DrvFreq : 264|16@1+ (572,0) [0|145860] "hz"  CANOE
 SG_ Tstr_SD_RSL_RingFreq : 280|16@1+ (572,0) [0|145860] "hz"  CANOE
 SG_ Tstr_SD_RSL_Ringtime_us : 296|12@1+ (1,0) [0|4095] ""  CANOE
 SG_ Tstr_SD_RSL_Unfiltered_DirDist1_ : 308|10@1+ (1,0) [0|1023] "cm"  CANOE
 SG_ Tstr_SD_RSL_Unfiltered_DirDist2_ : 318|10@1+ (1,0) [0|1023] "cm"  CANOE
 SG_ Tstr_SD_RSL_EchoHeight_adc : 328|8@1+ (1,0) [0|255] "adc"  CANOE
 SG_ Tstr_SD_RSL_SensorBlkgSetCounter : 336|8@1+ (1,0) [0|255] ""  CANOE
 SG_ Tstr_SD_RSL_SensorBlkgClrCounter : 344|8@1+ (1,0) [0|255] ""  CANOE

BO_ 2654552214 Firing_Sensors: 6 CVADAS
 SG_ FiringSnr_TimeStamp : 16|32@1+ (1,0) [0|0] "ms"  CANOE
 SG_ Firing_Sensor : 0|16@1+ (1,0) [0|0] ""  CANOE

BO_ 2654552213 Firing_Mode: 5 CVADAS
 SG_ FiringMode_TimeStamp : 8|32@1+ (1,0) [0|0] "ms"  CANOE
 SG_ Firing_Mode_Seq : 0|8@1+ (1,0) [0|0] ""  CANOE

BO_ 2654814209 Diagnostics_Flags: 8 CVADAS
 SG_ BOR_CommUnknown : 63|1@1+ (1,0) [0|1] ""  CANOE
 SG_ AOR_CommUnknown : 62|1@1+ (1,0) [0|1] ""  CANOE
 SG_ BOL_CommUnknown : 61|1@1+ (1,0) [0|1] ""  CANOE
 SG_ AOL_CommUnknown : 60|1@1+ (1,0) [0|1] ""  CANOE
 SG_ RSL_CommUnknown : 59|1@1+ (1,0) [0|1] ""  CANOE
 SG_ ROL_CommUnknown : 58|1@1+ (1,0) [0|1] ""  CANOE
 SG_ RIL_CommUnknown : 57|1@1+ (1,0) [0|1] ""  CANOE
 SG_ RIR_CommUnknown : 56|1@1+ (1,0) [0|1] ""  CANOE
 SG_ ROR_CommUnknown : 55|1@1+ (1,0) [0|1] ""  CANOE
 SG_ RSR_CommUnknown : 54|1@1+ (1,0) [0|1] ""  CANOE
 SG_ FSL_CommUnknown : 53|1@1+ (1,0) [0|1] ""  CANOE
 SG_ FOL_CommUnknown : 52|1@1+ (1,0) [0|1] ""  CANOE
 SG_ FIL_CommUnknown : 51|1@1+ (1,0) [0|1] ""  CANOE
 SG_ FIR_CommUnknown : 50|1@1+ (1,0) [0|1] ""  CANOE
 SG_ FOR_CommUnknown : 49|1@1+ (1,0) [0|1] ""  CANOE
 SG_ FSR_CommUnknown : 48|1@1+ (1,0) [0|1] ""  CANOE
 SG_ BOR_hardware_Fault : 47|1@1+ (1,0) [0|1] ""  CANOE
 SG_ AOR_hardware_Fault : 46|1@1+ (1,0) [0|1] ""  CANOE
 SG_ BOL_hardware_Fault : 45|1@1+ (1,0) [0|1] ""  CANOE
 SG_ AOL_hardware_Fault : 44|1@1+ (1,0) [0|1] ""  CANOE
 SG_ RSL_hardware_Fault : 43|1@1+ (1,0) [0|1] ""  CANOE
 SG_ ROL_hardware_Fault : 42|1@1+ (1,0) [0|1] ""  CANOE
 SG_ RIL_hardware_Fault : 41|1@1+ (1,0) [0|1] ""  CANOE
 SG_ RIR_hardware_Fault : 40|1@1+ (1,0) [0|1] ""  CANOE
 SG_ ROR_hardware_Fault : 39|1@1+ (1,0) [0|1] ""  CANOE
 SG_ RSR_hardware_Fault : 38|1@1+ (1,0) [0|1] ""  CANOE
 SG_ FSL_hardware_Fault : 37|1@1+ (1,0) [0|1] ""  CANOE
 SG_ FOL_hardware_Fault : 36|1@1+ (1,0) [0|1] ""  CANOE
 SG_ FIL_hardware_Fault : 35|1@1+ (1,0) [0|1] ""  CANOE
 SG_ FIR_hardware_Fault : 34|1@1+ (1,0) [0|1] ""  CANOE
 SG_ FOR_hardware_Fault : 33|1@1+ (1,0) [0|1] ""  CANOE
 SG_ FSR_hardware_Fault : 32|1@1+ (1,0) [0|1] ""  CANOE
 SG_ FIR_comm_Fault : 18|1@1+ (1,0) [0|1] ""  CANOE
 SG_ BOR_comm_Fault : 31|1@1+ (1,0) [0|1] ""  CANOE
 SG_ AOR_comm_Fault : 30|1@1+ (1,0) [0|1] ""  CANOE
 SG_ BOL_comm_Fault : 29|1@1+ (1,0) [0|1] ""  CANOE
 SG_ AOL_comm_Fault : 28|1@1+ (1,0) [0|1] ""  CANOE
 SG_ RSL_comm_Fault : 27|1@1+ (1,0) [0|1] ""  CANOE
 SG_ ROL_comm_Fault : 26|1@1+ (1,0) [0|1] ""  CANOE
 SG_ RIL_comm_Fault : 25|1@1+ (1,0) [0|1] ""  CANOE
 SG_ RIR_comm_Fault : 24|1@1+ (1,0) [0|1] ""  CANOE
 SG_ ROR_comm_Fault : 23|1@1+ (1,0) [0|1] ""  CANOE
 SG_ RSR_comm_Fault : 22|1@1+ (1,0) [0|1] ""  CANOE
 SG_ FSL_comm_Fault : 21|1@1+ (1,0) [0|1] ""  CANOE
 SG_ FOL_comm_Fault : 20|1@1+ (1,0) [0|1] ""  CANOE
 SG_ FIL_comm_Fault : 19|1@1+ (1,0) [0|1] ""  CANOE
 SG_ FOR_comm_Fault : 17|1@1+ (1,0) [0|1] ""  CANOE
 SG_ FSR_comm_Fault : 16|1@1+ (1,0) [0|1] ""  CANOE
 SG_ RSR_overTemp_Fault : 6|1@1+ (1,0) [0|1] ""  CANOE
 SG_ RSL_overTemp_Fault : 11|1@1+ (1,0) [0|1] ""  CANOE
 SG_ ROR_overTemp_Fault : 7|1@1+ (1,0) [0|1] ""  CANOE
 SG_ ROL_overTemp_Fault : 10|1@1+ (1,0) [0|1] ""  CANOE
 SG_ RIR_overTemp_Fault : 8|1@1+ (1,0) [0|1] ""  CANOE
 SG_ RIL_overTemp_Fault : 9|1@1+ (1,0) [0|1] ""  CANOE
 SG_ FSL_overTemp_Fault : 5|1@1+ (1,0) [0|1] ""  CANOE
 SG_ FOL_overTemp_Fault : 4|1@1+ (1,0) [0|1] ""  CANOE
 SG_ FIR_overTemp_Fault : 2|1@1+ (1,0) [0|1] ""  CANOE
 SG_ FIL_overTemp_Fault : 3|1@1+ (1,0) [0|1] ""  CANOE
 SG_ BOR_overTemp_Fault : 15|1@1+ (1,0) [0|1] ""  CANOE
 SG_ BOL_overTemp_Fault : 13|1@1+ (1,0) [0|1] ""  CANOE
 SG_ AOR_overTemp_Fault : 14|1@1+ (1,0) [0|1] ""  CANOE
 SG_ AOL_overTemp_Fault : 12|1@1+ (1,0) [0|1] ""  CANOE
 SG_ FOR_overTemp_Fault : 1|1@1+ (1,0) [0|1] ""  CANOE
 SG_ FSR_overTemp_Fault : 0|1@1+ (1,0) [0|1] ""  CANOE

BO_ 2654552212 Distance_Point_Map_11: 64 CVADAS
 SG_ Point_Map_Cruising_Age_94 : 418|6@1+ (1,0) [0|63] ""  CANOE
 SG_ Point_Map_Cruising_Age_93 : 354|6@1+ (1,0) [0|63] ""  CANOE
 SG_ Point_Map_Cruising_Age_95 : 482|6@1+ (1,0) [0|63] ""  CANOE
 SG_ Point_Map_Cruising_Age_92 : 290|6@1+ (1,0) [0|63] ""  CANOE
 SG_ Point_Map_Cruising_Age_91 : 226|6@1+ (1,0) [0|63] ""  CANOE
 SG_ Point_Map_Cruising_Age_90 : 162|6@1+ (1,0) [0|63] ""  CANOE
 SG_ Point_Map_Cruising_Age_89 : 98|6@1+ (1,0) [0|63] ""  CANOE
 SG_ Point_Map_Cruising_Age_88 : 34|6@1+ (1,0) [0|63] ""  CANOE
 SG_ Point_Map_Reserved_94 : 440|8@1+ (1,0) [0|255] ""  CANOE
 SG_ Point_Map_Age_94 : 432|8@1+ (1,0) [0|255] ""  CANOE
 SG_ Point_Map_Confidence_94 : 424|8@1+ (1,0) [0|255] ""  CANOE
 SG_ Point_Map_Height_94 : 416|2@1+ (1,0) [0|3] ""  CANOE
 SG_ Point_Map_Y_94 : 400|16@1- (1,0) [-32768|32767] ""  CANOE
 SG_ Point_Map_X_94 : 384|16@1- (1,0) [-32768|32767] ""  CANOE
 SG_ Point_Map_Reserved_93 : 376|8@1+ (1,0) [0|255] ""  CANOE
 SG_ Point_Map_Age_93 : 368|8@1+ (1,0) [0|255] ""  CANOE
 SG_ Point_Map_Confidence_93 : 360|8@1+ (1,0) [0|255] ""  CANOE
 SG_ Point_Map_Height_93 : 352|2@1+ (1,0) [0|3] ""  CANOE
 SG_ Point_Map_Y_93 : 336|16@1- (1,0) [-32768|32767] ""  CANOE
 SG_ Point_Map_X_93 : 320|16@1- (1,0) [-32768|32767] ""  CANOE
 SG_ Point_Map_Reserved_92 : 312|8@1+ (1,0) [0|255] ""  CANOE
 SG_ Point_Map_Age_92 : 304|8@1+ (1,0) [0|255] ""  CANOE
 SG_ Point_Map_Confidence_92 : 296|8@1+ (1,0) [0|255] ""  CANOE
 SG_ Point_Map_Height_92 : 288|2@1+ (1,0) [0|3] ""  CANOE
 SG_ Point_Map_Y_92 : 272|16@1- (1,0) [-32768|32767] ""  CANOE
 SG_ Point_Map_X_92 : 256|16@1- (1,0) [-32768|32767] ""  CANOE
 SG_ Point_Map_Reserved_91 : 248|8@1+ (1,0) [0|255] ""  CANOE
 SG_ Point_Map_Age_91 : 240|8@1+ (1,0) [0|255] ""  CANOE
 SG_ Point_Map_Confidence_91 : 232|8@1+ (1,0) [0|255] ""  CANOE
 SG_ Point_Map_Height_91 : 224|2@1+ (1,0) [0|3] ""  CANOE
 SG_ Point_Map_Y_91 : 208|16@1- (1,0) [-32768|32767] ""  CANOE
 SG_ Point_Map_X_91 : 192|16@1- (1,0) [-32768|32767] ""  CANOE
 SG_ Point_Map_Reserved_90 : 184|8@1+ (1,0) [0|255] ""  CANOE
 SG_ Point_Map_Age_90 : 176|8@1+ (1,0) [0|255] ""  CANOE
 SG_ Point_Map_Confidence_90 : 168|8@1+ (1,0) [0|255] ""  CANOE
 SG_ Point_Map_Height_90 : 160|2@1+ (1,0) [0|3] ""  CANOE
 SG_ Point_Map_Y_90 : 144|16@1- (1,0) [-32768|32767] ""  CANOE
 SG_ Point_Map_X_90 : 128|16@1- (1,0) [-32768|32767] ""  CANOE
 SG_ Point_Map_Reserved_89 : 120|8@1+ (1,0) [0|255] ""  CANOE
 SG_ Point_Map_Age_89 : 112|8@1+ (1,0) [0|255] ""  CANOE
 SG_ Point_Map_Confidence_89 : 104|8@1+ (1,0) [0|255] ""  CANOE
 SG_ Point_Map_Height_89 : 96|2@1+ (1,0) [0|3] ""  CANOE
 SG_ Point_Map_Y_89 : 80|16@1- (1,0) [-32768|32767] ""  CANOE
 SG_ Point_Map_X_89 : 64|16@1- (1,0) [-32768|32767] ""  CANOE
 SG_ Point_Map_Reserved_88 : 56|8@1+ (1,0) [0|255] ""  CANOE
 SG_ Point_Map_Age_88 : 48|8@1+ (1,0) [0|255] ""  CANOE
 SG_ Point_Map_Confidence_88 : 40|8@1+ (1,0) [0|255] ""  CANOE
 SG_ Point_Map_Height_88 : 32|2@1+ (1,0) [0|3] ""  CANOE
 SG_ Point_Map_Y_88 : 16|16@1- (1,0) [-32768|32767] ""  CANOE
 SG_ Point_Map_X_88 : 0|16@1- (1,0) [-32768|32767] ""  CANOE
 SG_ Point_Map_Reserved_95 : 504|8@1+ (1,0) [0|255] ""  CANOE
 SG_ Point_Map_Age_95 : 496|8@1+ (1,0) [0|255] ""  CANOE
 SG_ Point_Map_Confidence_95 : 488|8@1+ (1,0) [0|255] ""  CANOE
 SG_ Point_Map_Y_95 : 464|16@1- (1,0) [-32768|32767] ""  CANOE
 SG_ Point_Map_Height_95 : 480|2@1+ (1,0) [0|3] ""  CANOE
 SG_ Point_Map_X_95 : 448|16@1- (1,0) [-32768|32767] ""  CANOE

BO_ 2654552211 Distance_Point_Map_10: 64 CVADAS
 SG_ Point_Map_Cruising_Age_87 : 482|6@1+ (1,0) [0|63] ""  CANOE
 SG_ Point_Map_Cruising_Age_86 : 418|6@1+ (1,0) [0|63] ""  CANOE
 SG_ Point_Map_Cruising_Age_85 : 354|6@1+ (1,0) [0|63] ""  CANOE
 SG_ Point_Map_Cruising_Age_84 : 290|6@1+ (1,0) [0|63] ""  CANOE
 SG_ Point_Map_Cruising_Age_83 : 226|6@1+ (1,0) [0|63] ""  CANOE
 SG_ Point_Map_Cruising_Age_82 : 162|6@1+ (1,0) [0|63] ""  CANOE
 SG_ Point_Map_Cruising_Age_81 : 98|6@1+ (1,0) [0|63] ""  CANOE
 SG_ Point_Map_Cruising_Age_80 : 34|6@1+ (1,0) [0|63] ""  CANOE
 SG_ Point_Map_Reserved_87 : 504|8@1+ (1,0) [0|255] ""  CANOE
 SG_ Point_Map_Age_87 : 496|8@1+ (1,0) [0|255] ""  CANOE
 SG_ Point_Map_Confidence_87 : 488|8@1+ (1,0) [0|255] ""  CANOE
 SG_ Point_Map_Height_87 : 480|2@1+ (1,0) [0|3] ""  CANOE
 SG_ Point_Map_Y_87 : 464|16@1- (1,0) [-32768|32767] ""  CANOE
 SG_ Point_Map_X_87 : 448|16@1- (1,0) [-32768|32767] ""  CANOE
 SG_ Point_Map_Reserved_86 : 440|8@1+ (1,0) [0|255] ""  CANOE
 SG_ Point_Map_Age_86 : 432|8@1+ (1,0) [0|255] ""  CANOE
 SG_ Point_Map_Confidence_86 : 424|8@1+ (1,0) [0|255] ""  CANOE
 SG_ Point_Map_Height_86 : 416|2@1+ (1,0) [0|3] ""  CANOE
 SG_ Point_Map_Y_86 : 400|16@1- (1,0) [-32768|32767] ""  CANOE
 SG_ Point_Map_X_86 : 384|16@1- (1,0) [-32768|32767] ""  CANOE
 SG_ Point_Map_Reserved_85 : 376|8@1+ (1,0) [0|255] ""  CANOE
 SG_ Point_Map_Age_85 : 368|8@1+ (1,0) [0|255] ""  CANOE
 SG_ Point_Map_Confidence_85 : 360|8@1+ (1,0) [0|255] ""  CANOE
 SG_ Point_Map_Height_85 : 352|2@1+ (1,0) [0|3] ""  CANOE
 SG_ Point_Map_Y_85 : 336|16@1- (1,0) [-32768|32767] ""  CANOE
 SG_ Point_Map_X_85 : 320|16@1- (1,0) [-32768|32767] ""  CANOE
 SG_ Point_Map_Reserved_84 : 312|8@1+ (1,0) [0|255] ""  CANOE
 SG_ Point_Map_Age_84 : 304|8@1+ (1,0) [0|255] ""  CANOE
 SG_ Point_Map_Confidence_84 : 296|8@1+ (1,0) [0|255] ""  CANOE
 SG_ Point_Map_Height_84 : 288|2@1+ (1,0) [0|3] ""  CANOE
 SG_ Point_Map_Y_84 : 272|16@1- (1,0) [-32768|32767] ""  CANOE
 SG_ Point_Map_X_84 : 256|16@1- (1,0) [-32768|32767] ""  CANOE
 SG_ Point_Map_Reserved_83 : 248|8@1+ (1,0) [0|255] ""  CANOE
 SG_ Point_Map_Age_83 : 240|8@1+ (1,0) [0|255] ""  CANOE
 SG_ Point_Map_Confidence_83 : 232|8@1+ (1,0) [0|255] ""  CANOE
 SG_ Point_Map_Height_83 : 224|2@1+ (1,0) [0|3] ""  CANOE
 SG_ Point_Map_Y_83 : 208|16@1- (1,0) [-32768|32767] ""  CANOE
 SG_ Point_Map_X_83 : 192|16@1- (1,0) [-32768|32767] ""  CANOE
 SG_ Point_Map_Reserved_82 : 184|8@1+ (1,0) [0|255] ""  CANOE
 SG_ Point_Map_Age_82 : 176|8@1+ (1,0) [0|255] ""  CANOE
 SG_ Point_Map_Confidence_82 : 168|8@1+ (1,0) [0|255] ""  CANOE
 SG_ Point_Map_Height_82 : 160|2@1+ (1,0) [0|3] ""  CANOE
 SG_ Point_Map_Y_82 : 144|16@1- (1,0) [-32768|32767] ""  CANOE
 SG_ Point_Map_X_82 : 128|16@1- (1,0) [-32768|32767] ""  CANOE
 SG_ Point_Map_Reserved_81 : 120|8@1+ (1,0) [0|255] ""  CANOE
 SG_ Point_Map_Age_81 : 112|8@1+ (1,0) [0|255] ""  CANOE
 SG_ Point_Map_Confidence_81 : 104|8@1+ (1,0) [0|255] ""  CANOE
 SG_ Point_Map_Height_81 : 96|2@1+ (1,0) [0|3] ""  CANOE
 SG_ Point_Map_Y_81 : 80|16@1- (1,0) [-32768|32767] ""  CANOE
 SG_ Point_Map_X_81 : 64|16@1- (1,0) [-32768|32767] ""  CANOE
 SG_ Point_Map_Reserved_80 : 56|8@1+ (1,0) [0|255] ""  CANOE
 SG_ Point_Map_Age_80 : 48|8@1+ (1,0) [0|255] ""  CANOE
 SG_ Point_Map_Confidence_80 : 40|8@1+ (1,0) [0|255] ""  CANOE
 SG_ Point_Map_Height_80 : 32|2@1+ (1,0) [0|3] ""  CANOE
 SG_ Point_Map_Y_80 : 16|16@1- (1,0) [-32768|32767] ""  CANOE
 SG_ Point_Map_X_80 : 0|16@1- (1,0) [-32768|32767] ""  CANOE

BO_ 2654552210 Distance_Point_Map_9: 64 CVADAS
 SG_ Point_Map_Cruising_Age_79 : 482|6@1+ (1,0) [0|63] ""  CANOE
 SG_ Point_Map_Cruising_Age_78 : 418|6@1+ (1,0) [0|63] ""  CANOE
 SG_ Point_Map_Cruising_Age_77 : 354|6@1+ (1,0) [0|63] ""  CANOE
 SG_ Point_Map_Cruising_Age_76 : 290|6@1+ (1,0) [0|63] ""  CANOE
 SG_ Point_Map_Cruising_Age_75 : 226|6@1+ (1,0) [0|63] ""  CANOE
 SG_ Point_Map_Cruising_Age_74 : 162|6@1+ (1,0) [0|63] ""  CANOE
 SG_ Point_Map_Cruising_Age_73 : 98|6@1+ (1,0) [0|63] ""  CANOE
 SG_ Point_Map_Cruising_Age_72 : 34|6@1+ (1,0) [0|63] ""  CANOE
 SG_ Point_Map_Reserved_79 : 504|8@1+ (1,0) [0|255] ""  CANOE
 SG_ Point_Map_Age_79 : 496|8@1+ (1,0) [0|255] ""  CANOE
 SG_ Point_Map_Confidence_79 : 488|8@1+ (1,0) [0|255] ""  CANOE
 SG_ Point_Map_Height_79 : 480|2@1+ (1,0) [0|3] ""  CANOE
 SG_ Point_Map_Y_79 : 464|16@1- (1,0) [-32768|32767] ""  CANOE
 SG_ Point_Map_X_79 : 448|16@1- (1,0) [-32768|32767] ""  CANOE
 SG_ Point_Map_Reserved_78 : 440|8@1+ (1,0) [0|255] ""  CANOE
 SG_ Point_Map_Age_78 : 432|8@1+ (1,0) [0|255] ""  CANOE
 SG_ Point_Map_Confidence_78 : 424|8@1+ (1,0) [0|255] ""  CANOE
 SG_ Point_Map_Height_78 : 416|2@1+ (1,0) [0|3] ""  CANOE
 SG_ Point_Map_Y_78 : 400|16@1- (1,0) [-32768|32767] ""  CANOE
 SG_ Point_Map_X_78 : 384|16@1- (1,0) [-32768|32767] ""  CANOE
 SG_ Point_Map_Reserved_77 : 376|8@1+ (1,0) [0|255] ""  CANOE
 SG_ Point_Map_Age_77 : 368|8@1+ (1,0) [0|255] ""  CANOE
 SG_ Point_Map_Confidence_77 : 360|8@1+ (1,0) [0|255] ""  CANOE
 SG_ Point_Map_Height_77 : 352|2@1+ (1,0) [0|3] ""  CANOE
 SG_ Point_Map_Y_77 : 336|16@1- (1,0) [-32768|32767] ""  CANOE
 SG_ Point_Map_X_77 : 320|16@1- (1,0) [-32768|32767] ""  CANOE
 SG_ Point_Map_Reserved_76 : 312|8@1+ (1,0) [0|255] ""  CANOE
 SG_ Point_Map_Age_76 : 304|8@1+ (1,0) [0|255] ""  CANOE
 SG_ Point_Map_Confidence_76 : 296|8@1+ (1,0) [0|255] ""  CANOE
 SG_ Point_Map_Height_76 : 288|2@1+ (1,0) [0|3] ""  CANOE
 SG_ Point_Map_Y_76 : 272|16@1- (1,0) [-32768|32767] ""  CANOE
 SG_ Point_Map_X_76 : 256|16@1- (1,0) [-32768|32767] ""  CANOE
 SG_ Point_Map_Reserved_75 : 248|8@1+ (1,0) [0|255] ""  CANOE
 SG_ Point_Map_Age_75 : 240|8@1+ (1,0) [0|255] ""  CANOE
 SG_ Point_Map_Confidence_75 : 232|8@1+ (1,0) [0|255] ""  CANOE
 SG_ Point_Map_Height_75 : 224|2@1+ (1,0) [0|3] ""  CANOE
 SG_ Point_Map_Y_75 : 208|16@1- (1,0) [-32768|32767] ""  CANOE
 SG_ Point_Map_X_75 : 192|16@1- (1,0) [-32768|32767] ""  CANOE
 SG_ Point_Map_Reserved_74 : 184|8@1+ (1,0) [0|255] ""  CANOE
 SG_ Point_Map_Age_74 : 176|8@1+ (1,0) [0|255] ""  CANOE
 SG_ Point_Map_Confidence_74 : 168|8@1+ (1,0) [0|255] ""  CANOE
 SG_ Point_Map_Height_74 : 160|2@1+ (1,0) [0|3] ""  CANOE
 SG_ Point_Map_Y_74 : 144|16@1- (1,0) [-32768|32767] ""  CANOE
 SG_ Point_Map_X_74 : 128|16@1- (1,0) [-32768|32767] ""  CANOE
 SG_ Point_Map_Reserved_73 : 120|8@1+ (1,0) [0|255] ""  CANOE
 SG_ Point_Map_Age_73 : 112|8@1+ (1,0) [0|255] ""  CANOE
 SG_ Point_Map_Confidence_73 : 104|8@1+ (1,0) [0|255] ""  CANOE
 SG_ Point_Map_Height_73 : 96|2@1+ (1,0) [0|3] ""  CANOE
 SG_ Point_Map_Y_73 : 80|16@1- (1,0) [-32768|32767] ""  CANOE
 SG_ Point_Map_X_73 : 64|16@1- (1,0) [-32768|32767] ""  CANOE
 SG_ Point_Map_Reserved_72 : 56|8@1+ (1,0) [0|255] ""  CANOE
 SG_ Point_Map_Age_72 : 48|8@1+ (1,0) [0|255] ""  CANOE
 SG_ Point_Map_Confidence_72 : 40|8@1+ (1,0) [0|255] ""  CANOE
 SG_ Point_Map_Height_72 : 32|2@1+ (1,0) [0|3] ""  CANOE
 SG_ Point_Map_Y_72 : 16|16@1- (1,0) [-32768|32767] ""  CANOE
 SG_ Point_Map_X_72 : 0|16@1- (1,0) [-32768|32767] ""  CANOE

BO_ 2654552209 Distance_Point_Map_8: 64 CVADAS
 SG_ Point_Map_Cruising_Age_70 : 418|6@1+ (1,0) [0|63] ""  CANOE
 SG_ Point_Map_Cruising_Age_71 : 482|6@1+ (1,0) [0|63] ""  CANOE
 SG_ Point_Map_Cruising_Age_69 : 354|6@1+ (1,0) [0|63] ""  CANOE
 SG_ Point_Map_Cruising_Age_68 : 290|6@1+ (1,0) [0|63] ""  CANOE
 SG_ Point_Map_Cruising_Age_67 : 226|6@1+ (1,0) [0|63] ""  CANOE
 SG_ Point_Map_Cruising_Age_66 : 162|6@1+ (1,0) [0|63] ""  CANOE
 SG_ Point_Map_Cruising_Age_65 : 98|6@1+ (1,0) [0|63] ""  CANOE
 SG_ Point_Map_Cruising_Age_64 : 34|6@1+ (1,0) [0|63] ""  CANOE
 SG_ Point_Map_Reserved_71 : 504|8@1+ (1,0) [0|255] ""  CANOE
 SG_ Point_Map_Height_71 : 480|2@1+ (1,0) [0|3] ""  CANOE
 SG_ Point_Map_Age_71 : 496|8@1+ (1,0) [0|255] ""  CANOE
 SG_ Point_Map_Confidence_71 : 488|8@1+ (1,0) [0|255] ""  CANOE
 SG_ Point_Map_Y_71 : 464|16@1- (1,0) [-32768|32767] ""  CANOE
 SG_ Point_Map_X_71 : 448|16@1- (1,0) [-32768|32767] ""  CANOE
 SG_ Point_Map_Reserved_70 : 440|8@1+ (1,0) [0|255] ""  CANOE
 SG_ Point_Map_Age_70 : 432|8@1+ (1,0) [0|255] ""  CANOE
 SG_ Point_Map_Confidence_70 : 424|8@1+ (1,0) [0|255] ""  CANOE
 SG_ Point_Map_Height_70 : 416|2@1+ (1,0) [0|3] ""  CANOE
 SG_ Point_Map_Y_70 : 400|16@1- (1,0) [-32768|32767] ""  CANOE
 SG_ Point_Map_X_70 : 384|16@1- (1,0) [-32768|32767] ""  CANOE
 SG_ Point_Map_Reserved_69 : 376|8@1+ (1,0) [0|255] ""  CANOE
 SG_ Point_Map_Age_69 : 368|8@1+ (1,0) [0|255] ""  CANOE
 SG_ Point_Map_Confidence_69 : 360|8@1+ (1,0) [0|255] ""  CANOE
 SG_ Point_Map_Height_69 : 352|2@1+ (1,0) [0|3] ""  CANOE
 SG_ Point_Map_Y_69 : 336|16@1- (1,0) [-32768|32767] ""  CANOE
 SG_ Point_Map_X_69 : 320|16@1- (1,0) [-32768|32767] ""  CANOE
 SG_ Point_Map_Reserved_68 : 312|8@1+ (1,0) [0|255] ""  CANOE
 SG_ Point_Map_Age_68 : 304|8@1+ (1,0) [0|255] ""  CANOE
 SG_ Point_Map_Confidence_68 : 296|8@1+ (1,0) [0|255] ""  CANOE
 SG_ Point_Map_Height_68 : 288|2@1+ (1,0) [0|3] ""  CANOE
 SG_ Point_Map_Y_68 : 272|16@1- (1,0) [-32768|32767] ""  CANOE
 SG_ Point_Map_X_68 : 256|16@1- (1,0) [-32768|32767] ""  CANOE
 SG_ Point_Map_Reserved_67 : 248|8@1+ (1,0) [0|255] ""  CANOE
 SG_ Point_Map_Age_67 : 240|8@1+ (1,0) [0|255] ""  CANOE
 SG_ Point_Map_Confidence_67 : 232|8@1+ (1,0) [0|255] ""  CANOE
 SG_ Point_Map_Height_67 : 224|2@1+ (1,0) [0|3] ""  CANOE
 SG_ Point_Map_Y_67 : 208|16@1- (1,0) [-32768|32767] ""  CANOE
 SG_ Point_Map_X_67 : 192|16@1- (1,0) [-32768|32767] ""  CANOE
 SG_ Point_Map_Reserved_66 : 184|8@1+ (1,0) [0|255] ""  CANOE
 SG_ Point_Map_Age_66 : 176|8@1+ (1,0) [0|255] ""  CANOE
 SG_ Point_Map_Confidence_66 : 168|8@1+ (1,0) [0|255] ""  CANOE
 SG_ Point_Map_Height_66 : 160|2@1+ (1,0) [0|3] ""  CANOE
 SG_ Point_Map_Y_66 : 144|16@1- (1,0) [-32768|32767] ""  CANOE
 SG_ Point_Map_X_66 : 128|16@1- (1,0) [-32768|32767] ""  CANOE
 SG_ Point_Map_Reserved_65 : 120|8@1+ (1,0) [0|255] ""  CANOE
 SG_ Point_Map_Age_65 : 112|8@1+ (1,0) [0|255] ""  CANOE
 SG_ Point_Map_Confidence_65 : 104|8@1+ (1,0) [0|255] ""  CANOE
 SG_ Point_Map_Height_65 : 96|2@1+ (1,0) [0|3] ""  CANOE
 SG_ Point_Map_Y_65 : 80|16@1- (1,0) [-32768|32767] ""  CANOE
 SG_ Point_Map_X_65 : 64|16@1- (1,0) [-32768|32767] ""  CANOE
 SG_ Point_Map_Reserved_64 : 56|8@1+ (1,0) [0|255] ""  CANOE
 SG_ Point_Map_Age_64 : 48|8@1+ (1,0) [0|255] ""  CANOE
 SG_ Point_Map_Confidence_64 : 40|8@1+ (1,0) [0|255] ""  CANOE
 SG_ Point_Map_Height_64 : 32|2@1+ (1,0) [0|3] ""  CANOE
 SG_ Point_Map_Y_64 : 16|16@1- (1,0) [-32768|32767] ""  CANOE
 SG_ Point_Map_X_64 : 0|16@1- (1,0) [-32768|32767] ""  CANOE

BO_ 2654552208 Distance_Point_Map_7: 64 CVADAS
 SG_ Point_Map_Cruising_Age_63 : 482|6@1+ (1,0) [0|63] ""  CANOE
 SG_ Point_Map_Cruising_Age_62 : 418|6@1+ (1,0) [0|63] ""  CANOE
 SG_ Point_Map_Cruising_Age_61 : 354|6@1+ (1,0) [0|63] ""  CANOE
 SG_ Point_Map_Cruising_Age_60 : 290|6@1+ (1,0) [0|63] ""  CANOE
 SG_ Point_Map_Cruising_Age_59 : 226|6@1+ (1,0) [0|63] ""  CANOE
 SG_ Point_Map_Cruising_Age_58 : 162|6@1+ (1,0) [0|63] ""  CANOE
 SG_ Point_Map_Cruising_Age_57 : 98|6@1+ (1,0) [0|63] ""  CANOE
 SG_ Point_Map_Cruising_Age_56 : 34|6@1+ (1,0) [0|63] ""  CANOE
 SG_ Point_Map_Reserved_62 : 440|8@1+ (1,0) [0|255] ""  CANOE
 SG_ Point_Map_Age_62 : 432|8@1+ (1,0) [0|255] ""  CANOE
 SG_ Point_Map_Confidence_62 : 424|8@1+ (1,0) [0|255] ""  CANOE
 SG_ Point_Map_Height_62 : 416|2@1+ (1,0) [0|3] ""  CANOE
 SG_ Point_Map_Y_62 : 400|16@1- (1,0) [-32768|32767] ""  CANOE
 SG_ Point_Map_X_62 : 384|16@1- (1,0) [-32768|32767] ""  CANOE
 SG_ Point_Map_Reserved_61 : 376|8@1+ (1,0) [0|255] ""  CANOE
 SG_ Point_Map_Age_61 : 368|8@1+ (1,0) [0|255] ""  CANOE
 SG_ Point_Map_Confidence_61 : 360|8@1+ (1,0) [0|255] ""  CANOE
 SG_ Point_Map_Height_61 : 352|2@1+ (1,0) [0|3] ""  CANOE
 SG_ Point_Map_Y_61 : 336|16@1- (1,0) [-32768|32767] ""  CANOE
 SG_ Point_Map_X_61 : 320|16@1- (1,0) [-32768|32767] ""  CANOE
 SG_ Point_Map_Reserved_60 : 312|8@1+ (1,0) [0|255] ""  CANOE
 SG_ Point_Map_Confidence_60 : 296|8@1+ (1,0) [0|255] ""  CANOE
 SG_ Point_Map_Height_60 : 288|2@1+ (1,0) [0|3] ""  CANOE
 SG_ Point_Map_Age_60 : 304|8@1+ (1,0) [0|255] ""  CANOE
 SG_ Point_Map_Y_60 : 272|16@1- (1,0) [-32768|32767] ""  CANOE
 SG_ Point_Map_X_60 : 256|16@1- (1,0) [-32768|32767] ""  CANOE
 SG_ Point_Map_Reserved_59 : 248|8@1+ (1,0) [0|255] ""  CANOE
 SG_ Point_Map_Age_59 : 240|8@1+ (1,0) [0|255] ""  CANOE
 SG_ Point_Map_Confidence_59 : 232|8@1+ (1,0) [0|255] ""  CANOE
 SG_ Point_Map_Height_59 : 224|2@1+ (1,0) [0|3] ""  CANOE
 SG_ Point_Map_Y_59 : 208|16@1- (1,0) [-32768|32767] ""  CANOE
 SG_ Point_Map_X_59 : 192|16@1- (1,0) [-32768|32767] ""  CANOE
 SG_ Point_Map_Reserved_58 : 184|8@1+ (1,0) [0|255] ""  CANOE
 SG_ Point_Map_Age_58 : 176|8@1+ (1,0) [0|255] ""  CANOE
 SG_ Point_Map_Confidence_58 : 168|8@1+ (1,0) [0|255] ""  CANOE
 SG_ Point_Map_Height_58 : 160|2@1+ (1,0) [0|3] ""  CANOE
 SG_ Point_Map_Y_58 : 144|16@1- (1,0) [-32768|32767] ""  CANOE
 SG_ Point_Map_X_58 : 128|16@1- (1,0) [-32768|32767] ""  CANOE
 SG_ Point_Map_Reserved_57 : 120|8@1+ (1,0) [0|255] ""  CANOE
 SG_ Point_Map_Age_57 : 112|8@1+ (1,0) [0|255] ""  CANOE
 SG_ Point_Map_Confidence_57 : 104|8@1+ (1,0) [0|255] ""  CANOE
 SG_ Point_Map_Height_57 : 96|2@1+ (1,0) [0|3] ""  CANOE
 SG_ Point_Map_Y_57 : 80|16@1- (1,0) [-32768|32767] ""  CANOE
 SG_ Point_Map_X_57 : 64|16@1- (1,0) [-32768|32767] ""  CANOE
 SG_ Point_Map_Reserved_56 : 56|8@1+ (1,0) [0|255] ""  CANOE
 SG_ Point_Map_Age_56 : 48|8@1+ (1,0) [0|255] ""  CANOE
 SG_ Point_Map_Confidence_56 : 40|8@1+ (1,0) [0|255] ""  CANOE
 SG_ Point_Map_Height_56 : 32|2@1+ (1,0) [0|3] ""  CANOE
 SG_ Point_Map_Y_56 : 16|16@1- (1,0) [-32768|32767] ""  CANOE
 SG_ Point_Map_X_56 : 0|16@1- (1,0) [-32768|32767] ""  CANOE
 SG_ Point_Map_Reserved_63 : 504|8@1+ (1,0) [0|255] ""  CANOE
 SG_ Point_Map_Age_63 : 496|8@1+ (1,0) [0|255] ""  CANOE
 SG_ Point_Map_Confidence_63 : 488|8@1+ (1,0) [0|255] ""  CANOE
 SG_ Point_Map_Height_63 : 480|2@1+ (1,0) [0|3] ""  CANOE
 SG_ Point_Map_Y_63 : 464|16@1- (1,0) [-32768|32767] ""  CANOE
 SG_ Point_Map_X_63 : 448|16@1- (1,0) [-32768|32767] ""  CANOE

BO_ 2654552201 Distance_Point_Map_6: 64 CVADAS
 SG_ Point_Map_Cruising_Age_54 : 418|6@1+ (1,0) [0|63] ""  CANOE
 SG_ Point_Map_Cruising_Age_55 : 482|6@1+ (1,0) [0|63] ""  CANOE
 SG_ Point_Map_Cruising_Age_53 : 354|6@1+ (1,0) [0|63] ""  CANOE
 SG_ Point_Map_Cruising_Age_52 : 290|6@1+ (1,0) [0|63] ""  CANOE
 SG_ Point_Map_Cruising_Age_51 : 226|6@1+ (1,0) [0|63] ""  CANOE
 SG_ Point_Map_Cruising_Age_50 : 162|6@1+ (1,0) [0|63] ""  CANOE
 SG_ Point_Map_Cruising_Age_49 : 98|6@1+ (1,0) [0|63] ""  CANOE
 SG_ Point_Map_Cruising_Age_48 : 34|6@1+ (1,0) [0|63] ""  CANOE
 SG_ Point_Map_Reserved_53 : 376|8@1+ (1,0) [0|255] ""  CANOE
 SG_ Point_Map_Age_53 : 368|8@1+ (1,0) [0|255] ""  CANOE
 SG_ Point_Map_Confidence_53 : 360|8@1+ (1,0) [0|255] ""  CANOE
 SG_ Point_Map_Height_53 : 352|2@1+ (1,0) [0|3] ""  CANOE
 SG_ Point_Map_Y_53 : 336|16@1- (1,0) [-32768|32767] ""  CANOE
 SG_ Point_Map_X_53 : 320|16@1- (1,0) [-32768|32767] ""  CANOE
 SG_ Point_Map_Reserved_52 : 312|8@1+ (1,0) [0|255] ""  CANOE
 SG_ Point_Map_Age_52 : 304|8@1+ (1,0) [0|255] ""  CANOE
 SG_ Point_Map_Confidence_52 : 296|8@1+ (1,0) [0|255] ""  CANOE
 SG_ Point_Map_Height_52 : 288|2@1+ (1,0) [0|3] ""  CANOE
 SG_ Point_Map_Y_52 : 272|16@1- (1,0) [-32768|32767] ""  CANOE
 SG_ Point_Map_X_52 : 256|16@1- (1,0) [-32768|32767] ""  CANOE
 SG_ Point_Map_Reserved_51 : 248|8@1+ (1,0) [0|255] ""  CANOE
 SG_ Point_Map_Age_51 : 240|8@1+ (1,0) [0|255] ""  CANOE
 SG_ Point_Map_Confidence_51 : 232|8@1+ (1,0) [0|255] ""  CANOE
 SG_ Point_Map_Height_51 : 224|2@1+ (1,0) [0|3] ""  CANOE
 SG_ Point_Map_Y_51 : 208|16@1- (1,0) [-32768|32767] ""  CANOE
 SG_ Point_Map_X_51 : 192|16@1- (1,0) [-32768|32767] ""  CANOE
 SG_ Point_Map_Reserved_50 : 184|8@1+ (1,0) [0|255] ""  CANOE
 SG_ Point_Map_Age_50 : 176|8@1+ (1,0) [0|255] ""  CANOE
 SG_ Point_Map_Confidence_50 : 168|8@1+ (1,0) [0|255] ""  CANOE
 SG_ Point_Map_Height_50 : 160|2@1+ (1,0) [0|3] ""  CANOE
 SG_ Point_Map_Y_50 : 144|16@1- (1,0) [-32768|32767] ""  CANOE
 SG_ Point_Map_X_50 : 128|16@1- (1,0) [-32768|32767] ""  CANOE
 SG_ Point_Map_Reserved_49 : 120|8@1+ (1,0) [0|255] ""  CANOE
 SG_ Point_Map_Age_49 : 112|8@1+ (1,0) [0|255] ""  CANOE
 SG_ Point_Map_Confidence_49 : 104|8@1+ (1,0) [0|255] ""  CANOE
 SG_ Point_Map_Height_49 : 96|2@1+ (1,0) [0|3] ""  CANOE
 SG_ Point_Map_Y_49 : 80|16@1- (1,0) [-32768|32767] ""  CANOE
 SG_ Point_Map_X_49 : 64|16@1- (1,0) [-32768|32767] ""  CANOE
 SG_ Point_Map_Reserved_48 : 56|8@1+ (1,0) [0|255] ""  CANOE
 SG_ Point_Map_Age_48 : 48|8@1+ (1,0) [0|255] ""  CANOE
 SG_ Point_Map_Confidence_48 : 40|8@1+ (1,0) [0|255] ""  CANOE
 SG_ Point_Map_Height_48 : 32|2@1+ (1,0) [0|3] ""  CANOE
 SG_ Point_Map_Y_48 : 16|16@1- (1,0) [-32768|32767] ""  CANOE
 SG_ Point_Map_X_48 : 0|16@1- (1,0) [-32768|32767] ""  CANOE
 SG_ Point_Map_Reserved_54 : 440|8@1+ (1,0) [0|255] ""  CANOE
 SG_ Point_Map_Reserved_55 : 504|8@1+ (1,0) [0|255] ""  CANOE
 SG_ Point_Map_Confidence_55 : 488|8@1+ (1,0) [0|255] ""  CANOE
 SG_ Point_Map_Age_55 : 496|8@1+ (1,0) [0|255] ""  CANOE
 SG_ Point_Map_Height_55 : 480|2@1+ (1,0) [0|3] ""  CANOE
 SG_ Point_Map_Y_55 : 464|16@1- (1,0) [-32768|32767] ""  CANOE
 SG_ Point_Map_X_55 : 448|16@1- (1,0) [-32768|32767] ""  CANOE
 SG_ Point_Map_Age_54 : 432|8@1+ (1,0) [0|255] ""  CANOE
 SG_ Point_Map_Confidence_54 : 424|8@1+ (1,0) [0|255] ""  CANOE
 SG_ Point_Map_Height_54 : 416|2@1+ (1,0) [0|3] ""  CANOE
 SG_ Point_Map_Y_54 : 400|16@1- (1,0) [-32768|32767] ""  CANOE
 SG_ Point_Map_X_54 : 384|16@1- (1,0) [-32768|32767] ""  CANOE

BO_ 2654552200 Distance_Point_Map_5: 64 CVADAS
 SG_ Point_Map_Cruising_Age_47 : 482|6@1+ (1,0) [0|63] ""  CANOE
 SG_ Point_Map_Cruising_Age_46 : 418|6@1+ (1,0) [0|63] ""  CANOE
 SG_ Point_Map_Cruising_Age_45 : 354|6@1+ (1,0) [0|63] ""  CANOE
 SG_ Point_Map_Cruising_Age_44 : 290|6@1+ (1,0) [0|63] ""  CANOE
 SG_ Point_Map_Cruising_Age_43 : 226|6@1+ (1,0) [0|63] ""  CANOE
 SG_ Point_Map_Cruising_Age_42 : 162|6@1+ (1,0) [0|63] ""  CANOE
 SG_ Point_Map_Cruising_Age_41 : 98|6@1+ (1,0) [0|63] ""  CANOE
 SG_ Point_Map_Cruising_Age_40 : 34|6@1+ (1,0) [0|63] ""  CANOE
 SG_ Point_Map_Reserved_44 : 312|8@1+ (1,0) [0|255] ""  CANOE
 SG_ Point_Map_Age_44 : 304|8@1+ (1,0) [0|255] ""  CANOE
 SG_ Point_Map_Confidence_44 : 296|8@1+ (1,0) [0|255] ""  CANOE
 SG_ Point_Map_Height_44 : 288|2@1+ (1,0) [0|3] ""  CANOE
 SG_ Point_Map_Y_44 : 272|16@1- (1,0) [-32768|32767] ""  CANOE
 SG_ Point_Map_X_44 : 256|16@1- (1,0) [-32768|32767] ""  CANOE
 SG_ Point_Map_Reserved_43 : 248|8@1+ (1,0) [0|255] ""  CANOE
 SG_ Point_Map_Age_43 : 240|8@1+ (1,0) [0|255] ""  CANOE
 SG_ Point_Map_Confidence_43 : 232|8@1+ (1,0) [0|255] ""  CANOE
 SG_ Point_Map_Height_43 : 224|2@1+ (1,0) [0|3] ""  CANOE
 SG_ Point_Map_Y_43 : 208|16@1- (1,0) [-32768|32767] ""  CANOE
 SG_ Point_Map_X_43 : 192|16@1- (1,0) [-32768|32767] ""  CANOE
 SG_ Point_Map_Reserved_42 : 184|8@1+ (1,0) [0|255] ""  CANOE
 SG_ Point_Map_Age_42 : 176|8@1+ (1,0) [0|255] ""  CANOE
 SG_ Point_Map_Confidence_42 : 168|8@1+ (1,0) [0|255] ""  CANOE
 SG_ Point_Map_Height_42 : 160|2@1+ (1,0) [0|3] ""  CANOE
 SG_ Point_Map_Y_42 : 144|16@1- (1,0) [-32768|32767] ""  CANOE
 SG_ Point_Map_X_42 : 128|16@1- (1,0) [-32768|32767] ""  CANOE
 SG_ Point_Map_Reserved_41 : 120|8@1+ (1,0) [0|255] ""  CANOE
 SG_ Point_Map_Age_41 : 112|8@1+ (1,0) [0|255] ""  CANOE
 SG_ Point_Map_Confidence_41 : 104|8@1+ (1,0) [0|255] ""  CANOE
 SG_ Point_Map_Height_41 : 96|2@1+ (1,0) [0|3] ""  CANOE
 SG_ Point_Map_Y_41 : 80|16@1- (1,0) [-32768|32767] ""  CANOE
 SG_ Point_Map_X_41 : 64|16@1- (1,0) [-32768|32767] ""  CANOE
 SG_ Point_Map_Reserved_40 : 56|8@1+ (1,0) [0|255] ""  CANOE
 SG_ Point_Map_Age_40 : 48|8@1+ (1,0) [0|255] ""  CANOE
 SG_ Point_Map_Confidence_40 : 40|8@1+ (1,0) [0|255] ""  CANOE
 SG_ Point_Map_Height_40 : 32|2@1+ (1,0) [0|3] ""  CANOE
 SG_ Point_Map_Y_40 : 16|16@1- (1,0) [-32768|32767] ""  CANOE
 SG_ Point_Map_X_40 : 0|16@1- (1,0) [-32768|32767] ""  CANOE
 SG_ Point_Map_Reserved_47 : 504|8@1+ (1,0) [0|255] ""  CANOE
 SG_ Point_Map_Reserved_46 : 440|8@1+ (1,0) [0|255] ""  CANOE
 SG_ Point_Map_Reserved_45 : 376|8@1+ (1,0) [0|255] ""  CANOE
 SG_ Point_Map_Age_47 : 496|8@1+ (1,0) [0|255] ""  CANOE
 SG_ Point_Map_Confidence_47 : 488|8@1+ (1,0) [0|255] ""  CANOE
 SG_ Point_Map_Height_47 : 480|2@1+ (1,0) [0|3] ""  CANOE
 SG_ Point_Map_Y_47 : 464|16@1- (1,0) [-32768|32767] ""  CANOE
 SG_ Point_Map_X_47 : 448|16@1- (1,0) [-32768|32767] ""  CANOE
 SG_ Point_Map_Age_46 : 432|8@1+ (1,0) [0|255] ""  CANOE
 SG_ Point_Map_Confidence_46 : 424|8@1+ (1,0) [0|255] ""  CANOE
 SG_ Point_Map_Height_46 : 416|2@1+ (1,0) [0|3] ""  CANOE
 SG_ Point_Map_Y_46 : 400|16@1- (1,0) [-32768|32767] ""  CANOE
 SG_ Point_Map_X_46 : 384|16@1- (1,0) [-32768|32767] ""  CANOE
 SG_ Point_Map_Age_45 : 368|8@1+ (1,0) [0|255] ""  CANOE
 SG_ Point_Map_Confidence_45 : 360|8@1+ (1,0) [0|255] ""  CANOE
 SG_ Point_Map_Height_45 : 352|2@1+ (1,0) [0|3] ""  CANOE
 SG_ Point_Map_Y_45 : 336|16@1- (1,0) [-32768|32767] ""  CANOE
 SG_ Point_Map_X_45 : 320|16@1- (1,0) [-32768|32767] ""  CANOE

BO_ 2654552199 Distance_Point_Map_4: 64 CVADAS
 SG_ Point_Map_Cruising_Age_38 : 418|6@1+ (1,0) [0|63] ""  CANOE
 SG_ Point_Map_Cruising_Age_39 : 482|6@1+ (1,0) [0|63] ""  CANOE
 SG_ Point_Map_Cruising_Age_37 : 354|6@1+ (1,0) [0|63] ""  CANOE
 SG_ Point_Map_Cruising_Age_36 : 290|6@1+ (1,0) [0|63] ""  CANOE
 SG_ Point_Map_Cruising_Age_35 : 226|6@1+ (1,0) [0|63] ""  CANOE
 SG_ Point_Map_Cruising_Age_34 : 162|6@1+ (1,0) [0|63] ""  CANOE
 SG_ Point_Map_Cruising_Age_33 : 98|6@1+ (1,0) [0|63] ""  CANOE
 SG_ Point_Map_Cruising_Age_32 : 34|6@1+ (1,0) [0|63] ""  CANOE
 SG_ Point_Map_Reserved_35 : 248|8@1+ (1,0) [0|255] ""  CANOE
 SG_ Point_Map_Age_35 : 240|8@1+ (1,0) [0|255] ""  CANOE
 SG_ Point_Map_Confidence_35 : 232|8@1+ (1,0) [0|255] ""  CANOE
 SG_ Point_Map_Height_35 : 224|2@1+ (1,0) [0|3] ""  CANOE
 SG_ Point_Map_Y_35 : 208|16@1- (1,0) [-32768|32767] ""  CANOE
 SG_ Point_Map_X_35 : 192|16@1- (1,0) [-32768|32767] ""  CANOE
 SG_ Point_Map_Reserved_34 : 184|8@1+ (1,0) [0|255] ""  CANOE
 SG_ Point_Map_Age_34 : 176|8@1+ (1,0) [0|255] ""  CANOE
 SG_ Point_Map_Confidence_34 : 168|8@1+ (1,0) [0|255] ""  CANOE
 SG_ Point_Map_Height_34 : 160|2@1+ (1,0) [0|3] ""  CANOE
 SG_ Point_Map_Y_34 : 144|16@1- (1,0) [-32768|32767] ""  CANOE
 SG_ Point_Map_X_34 : 128|16@1- (1,0) [-32768|32767] ""  CANOE
 SG_ Point_Map_Reserved_33 : 120|8@1+ (1,0) [0|255] ""  CANOE
 SG_ Point_Map_Age_33 : 112|8@1+ (1,0) [0|255] ""  CANOE
 SG_ Point_Map_Confidence_33 : 104|8@1+ (1,0) [0|255] ""  CANOE
 SG_ Point_Map_Height_33 : 96|2@1+ (1,0) [0|3] ""  CANOE
 SG_ Point_Map_Y_33 : 80|16@1- (1,0) [-32768|32767] ""  CANOE
 SG_ Point_Map_X_33 : 64|16@1- (1,0) [-32768|32767] ""  CANOE
 SG_ Point_Map_Reserved_32 : 56|8@1+ (1,0) [0|255] ""  CANOE
 SG_ Point_Map_Age_32 : 48|8@1+ (1,0) [0|255] ""  CANOE
 SG_ Point_Map_Confidence_32 : 40|8@1+ (1,0) [0|255] ""  CANOE
 SG_ Point_Map_Height_32 : 32|2@1+ (1,0) [0|3] ""  CANOE
 SG_ Point_Map_Y_32 : 16|16@1- (1,0) [-32768|32767] ""  CANOE
 SG_ Point_Map_X_32 : 0|16@1- (1,0) [-32768|32767] ""  CANOE
 SG_ Point_Map_Reserved_39 : 504|8@1+ (1,0) [0|255] ""  CANOE
 SG_ Point_Map_Reserved_38 : 440|8@1+ (1,0) [0|255] ""  CANOE
 SG_ Point_Map_Reserved_37 : 376|8@1+ (1,0) [0|255] ""  CANOE
 SG_ Point_Map_Reserved_36 : 312|8@1+ (1,0) [0|255] ""  CANOE
 SG_ Point_Map_Age_39 : 496|8@1+ (1,0) [0|255] ""  CANOE
 SG_ Point_Map_Confidence_39 : 488|8@1+ (1,0) [0|255] ""  CANOE
 SG_ Point_Map_Height_39 : 480|2@1+ (1,0) [0|3] ""  CANOE
 SG_ Point_Map_Y_39 : 464|16@1- (1,0) [-32768|32767] ""  CANOE
 SG_ Point_Map_X_39 : 448|16@1- (1,0) [-32768|32767] ""  CANOE
 SG_ Point_Map_Age_38 : 432|8@1+ (1,0) [0|255] ""  CANOE
 SG_ Point_Map_Confidence_38 : 424|8@1+ (1,0) [0|255] ""  CANOE
 SG_ Point_Map_Height_38 : 416|2@1+ (1,0) [0|3] ""  CANOE
 SG_ Point_Map_Y_38 : 400|16@1- (1,0) [-32768|32767] ""  CANOE
 SG_ Point_Map_X_38 : 384|16@1- (1,0) [-32768|32767] ""  CANOE
 SG_ Point_Map_Age_37 : 368|8@1+ (1,0) [0|255] ""  CANOE
 SG_ Point_Map_Confidence_37 : 360|8@1+ (1,0) [0|255] ""  CANOE
 SG_ Point_Map_Height_37 : 352|2@1+ (1,0) [0|3] ""  CANOE
 SG_ Point_Map_Y_37 : 336|16@1- (1,0) [-32768|32767] ""  CANOE
 SG_ Point_Map_X_37 : 320|16@1- (1,0) [-32768|32767] ""  CANOE
 SG_ Point_Map_Age_36 : 304|8@1+ (1,0) [0|255] ""  CANOE
 SG_ Point_Map_Confidence_36 : 296|8@1+ (1,0) [0|255] ""  CANOE
 SG_ Point_Map_Height_36 : 288|2@1+ (1,0) [0|3] ""  CANOE
 SG_ Point_Map_Y_36 : 272|16@1- (1,0) [-32768|32767] ""  CANOE
 SG_ Point_Map_X_36 : 256|16@1- (1,0) [-32768|32767] ""  CANOE

BO_ 2654552198 Distance_Point_Map_3: 64 CVADAS
 SG_ Point_Map_Cruising_Age_31 : 482|6@1+ (1,0) [0|63] ""  CANOE
 SG_ Point_Map_Cruising_Age_30 : 418|6@1+ (1,0) [0|63] ""  CANOE
 SG_ Point_Map_Cruising_Age_29 : 354|6@1+ (1,0) [0|63] ""  CANOE
 SG_ Point_Map_Cruising_Age_28 : 290|6@1+ (1,0) [0|63] ""  CANOE
 SG_ Point_Map_Cruising_Age_27 : 226|6@1+ (1,0) [0|63] ""  CANOE
 SG_ Point_Map_Cruising_Age_26 : 162|6@1+ (1,0) [0|63] ""  CANOE
 SG_ Point_Map_Cruising_Age_25 : 98|6@1+ (1,0) [0|63] ""  CANOE
 SG_ Point_Map_Cruising_Age_24 : 34|6@1+ (1,0) [0|63] ""  CANOE
 SG_ Point_Map_Reserved_26 : 184|8@1+ (1,0) [0|255] ""  CANOE
 SG_ Point_Map_Age_26 : 176|8@1+ (1,0) [0|255] ""  CANOE
 SG_ Point_Map_Confidence_26 : 168|8@1+ (1,0) [0|255] ""  CANOE
 SG_ Point_Map_Height_26 : 160|2@1+ (1,0) [0|3] ""  CANOE
 SG_ Point_Map_Y_26 : 144|16@1- (1,0) [-32768|32767] ""  CANOE
 SG_ Point_Map_X_26 : 128|16@1- (1,0) [-32768|32767] ""  CANOE
 SG_ Point_Map_Reserved_25 : 120|8@1+ (1,0) [0|255] ""  CANOE
 SG_ Point_Map_Age_25 : 112|8@1+ (1,0) [0|255] ""  CANOE
 SG_ Point_Map_Confidence_25 : 104|8@1+ (1,0) [0|255] ""  CANOE
 SG_ Point_Map_Height_25 : 96|2@1+ (1,0) [0|3] ""  CANOE
 SG_ Point_Map_Y_25 : 80|16@1- (1,0) [-32768|32767] ""  CANOE
 SG_ Point_Map_X_25 : 64|16@1- (1,0) [-32768|32767] ""  CANOE
 SG_ Point_Map_Reserved_24 : 56|8@1+ (1,0) [0|255] ""  CANOE
 SG_ Point_Map_Age_24 : 48|8@1+ (1,0) [0|255] ""  CANOE
 SG_ Point_Map_Confidence_24 : 40|8@1+ (1,0) [0|255] ""  CANOE
 SG_ Point_Map_Height_24 : 32|2@1+ (1,0) [0|3] ""  CANOE
 SG_ Point_Map_Y_24 : 16|16@1- (1,0) [-32768|32767] ""  CANOE
 SG_ Point_Map_X_24 : 0|16@1- (1,0) [-32768|32767] ""  CANOE
 SG_ Point_Map_Reserved_31 : 504|8@1+ (1,0) [0|255] ""  CANOE
 SG_ Point_Map_Reserved_30 : 440|8@1+ (1,0) [0|255] ""  CANOE
 SG_ Point_Map_Reserved_29 : 376|8@1+ (1,0) [0|255] ""  CANOE
 SG_ Point_Map_Reserved_28 : 312|8@1+ (1,0) [0|255] ""  CANOE
 SG_ Point_Map_Reserved_27 : 248|8@1+ (1,0) [0|255] ""  CANOE
 SG_ Point_Map_Age_31 : 496|8@1+ (1,0) [0|255] ""  CANOE
 SG_ Point_Map_Confidence_31 : 488|8@1+ (1,0) [0|255] ""  CANOE
 SG_ Point_Map_Height_31 : 480|2@1+ (1,0) [0|3] ""  CANOE
 SG_ Point_Map_Y_31 : 464|16@1- (1,0) [-32768|32767] ""  CANOE
 SG_ Point_Map_X_31 : 448|16@1- (1,0) [-32768|32767] ""  CANOE
 SG_ Point_Map_Age_30 : 432|8@1+ (1,0) [0|255] ""  CANOE
 SG_ Point_Map_Confidence_30 : 424|8@1+ (1,0) [0|255] ""  CANOE
 SG_ Point_Map_Height_30 : 416|2@1+ (1,0) [0|3] ""  CANOE
 SG_ Point_Map_Y_30 : 400|16@1- (1,0) [-32768|32767] ""  CANOE
 SG_ Point_Map_X_30 : 384|16@1- (1,0) [-32768|32767] ""  CANOE
 SG_ Point_Map_Age_29 : 368|8@1+ (1,0) [0|255] ""  CANOE
 SG_ Point_Map_Confidence_29 : 360|8@1+ (1,0) [0|255] ""  CANOE
 SG_ Point_Map_Height_29 : 352|2@1+ (1,0) [0|3] ""  CANOE
 SG_ Point_Map_Y_29 : 336|16@1- (1,0) [-32768|32767] ""  CANOE
 SG_ Point_Map_X_29 : 320|16@1- (1,0) [-32768|32767] ""  CANOE
 SG_ Point_Map_Age_28 : 304|8@1+ (1,0) [0|255] ""  CANOE
 SG_ Point_Map_Confidence_28 : 296|8@1+ (1,0) [0|255] ""  CANOE
 SG_ Point_Map_Height_28 : 288|2@1+ (1,0) [0|3] ""  CANOE
 SG_ Point_Map_Y_28 : 272|16@1- (1,0) [-32768|32767] ""  CANOE
 SG_ Point_Map_X_27 : 192|16@1- (1,0) [-32768|32767] ""  CANOE
 SG_ Point_Map_Age_27 : 240|8@1+ (1,0) [0|255] ""  CANOE
 SG_ Point_Map_Confidence_27 : 232|8@1+ (1,0) [0|255] ""  CANOE
 SG_ Point_Map_Height_27 : 224|2@1+ (1,0) [0|3] ""  CANOE
 SG_ Point_Map_Y_27 : 208|16@1- (1,0) [-32768|32767] ""  CANOE
 SG_ Point_Map_X_28 : 256|16@1- (1,0) [-32768|32767] ""  CANOE

BO_ 2654552197 Distance_Point_Map_2: 64 CVADAS
 SG_ Point_Map_Cruising_Age_23 : 482|6@1+ (1,0) [0|63] ""  CANOE
 SG_ Point_Map_Cruising_Age_22 : 418|6@1+ (1,0) [0|63] ""  CANOE
 SG_ Point_Map_Cruising_Age_21 : 354|6@1+ (1,0) [0|63] ""  CANOE
 SG_ Point_Map_Cruising_Age_20 : 290|6@1+ (1,0) [0|63] ""  CANOE
 SG_ Point_Map_Cruising_Age_19 : 226|6@1+ (1,0) [0|63] ""  CANOE
 SG_ Point_Map_Cruising_Age_18 : 162|6@1+ (1,0) [0|63] ""  CANOE
 SG_ Point_Map_Cruising_Age_17 : 98|6@1+ (1,0) [0|63] ""  CANOE
 SG_ Point_Map_Cruising_Age_16 : 34|6@1+ (1,0) [0|63] ""  CANOE
 SG_ Point_Map_Reserved_17 : 120|8@1+ (1,0) [0|255] ""  CANOE
 SG_ Point_Map_Height_17 : 96|2@1+ (1,0) [0|3] ""  CANOE
 SG_ Point_Map_Age_17 : 112|8@1+ (1,0) [0|255] ""  CANOE
 SG_ Point_Map_Confidence_17 : 104|8@1+ (1,0) [0|255] ""  CANOE
 SG_ Point_Map_Y_17 : 80|16@1- (1,0) [-32768|32767] ""  CANOE
 SG_ Point_Map_X_17 : 64|16@1- (1,0) [-32768|32767] ""  CANOE
 SG_ Point_Map_Reserved_16 : 56|8@1+ (1,0) [0|255] ""  CANOE
 SG_ Point_Map_Age_16 : 48|8@1+ (1,0) [0|255] ""  CANOE
 SG_ Point_Map_Confidence_16 : 40|8@1+ (1,0) [0|255] ""  CANOE
 SG_ Point_Map_Height_16 : 32|2@1+ (1,0) [0|3] ""  CANOE
 SG_ Point_Map_Y_16 : 16|16@1- (1,0) [-32768|32767] ""  CANOE
 SG_ Point_Map_X_16 : 0|16@1- (1,0) [-32768|32767] ""  CANOE
 SG_ Point_Map_Reserved_23 : 504|8@1+ (1,0) [0|255] ""  CANOE
 SG_ Point_Map_Reserved_22 : 440|8@1+ (1,0) [0|255] ""  CANOE
 SG_ Point_Map_Reserved_21 : 376|8@1+ (1,0) [0|255] ""  CANOE
 SG_ Point_Map_Reserved_20 : 312|8@1+ (1,0) [0|255] ""  CANOE
 SG_ Point_Map_Reserved_19 : 248|8@1+ (1,0) [0|255] ""  CANOE
 SG_ Point_Map_Reserved_18 : 184|8@1+ (1,0) [0|255] ""  CANOE
 SG_ Point_Map_Age_23 : 496|8@1+ (1,0) [0|255] ""  CANOE
 SG_ Point_Map_Confidence_23 : 488|8@1+ (1,0) [0|255] ""  CANOE
 SG_ Point_Map_Height_23 : 480|2@1+ (1,0) [0|3] ""  CANOE
 SG_ Point_Map_Y_23 : 464|16@1- (1,0) [-32768|32767] ""  CANOE
 SG_ Point_Map_X_23 : 448|16@1- (1,0) [-32768|32767] ""  CANOE
 SG_ Point_Map_Age_22 : 432|8@1+ (1,0) [0|255] ""  CANOE
 SG_ Point_Map_Confidence_22 : 424|8@1+ (1,0) [0|255] ""  CANOE
 SG_ Point_Map_Height_22 : 416|2@1+ (1,0) [0|3] ""  CANOE
 SG_ Point_Map_Y_22 : 400|16@1- (1,0) [-32768|32767] ""  CANOE
 SG_ Point_Map_X_22 : 384|16@1- (1,0) [-32768|32767] ""  CANOE
 SG_ Point_Map_Age_21 : 368|8@1+ (1,0) [0|255] ""  CANOE
 SG_ Point_Map_Confidence_21 : 360|8@1+ (1,0) [0|255] ""  CANOE
 SG_ Point_Map_Height_21 : 352|2@1+ (1,0) [0|3] ""  CANOE
 SG_ Point_Map_Y_21 : 336|16@1- (1,0) [-32768|32767] ""  CANOE
 SG_ Point_Map_X_21 : 320|16@1- (1,0) [-32768|32767] ""  CANOE
 SG_ Point_Map_Age_20 : 304|8@1+ (1,0) [0|255] ""  CANOE
 SG_ Point_Map_Confidence_20 : 296|8@1+ (1,0) [0|255] ""  CANOE
 SG_ Point_Map_Height_20 : 288|2@1+ (1,0) [0|3] ""  CANOE
 SG_ Point_Map_Y_20 : 272|16@1- (1,0) [-32768|32767] ""  CANOE
 SG_ Point_Map_X_20 : 256|16@1- (1,0) [-32768|32767] ""  CANOE
 SG_ Point_Map_Age_19 : 240|8@1+ (1,0) [0|255] ""  CANOE
 SG_ Point_Map_Confidence_19 : 232|8@1+ (1,0) [0|255] ""  CANOE
 SG_ Point_Map_Height_19 : 224|2@1+ (1,0) [0|3] ""  CANOE
 SG_ Point_Map_Y_19 : 208|16@1- (1,0) [-32768|32767] ""  CANOE
 SG_ Point_Map_X_19 : 192|16@1- (1,0) [-32768|32767] ""  CANOE
 SG_ Point_Map_Age_18 : 176|8@1+ (1,0) [0|255] ""  CANOE
 SG_ Point_Map_Confidence_18 : 168|8@1+ (1,0) [0|255] ""  CANOE
 SG_ Point_Map_Height_18 : 160|2@1+ (1,0) [0|3] ""  CANOE
 SG_ Point_Map_Y_18 : 144|16@1- (1,0) [-32768|32767] ""  CANOE
 SG_ Point_Map_X_18 : 128|16@1- (1,0) [-32768|32767] ""  CANOE

CM_ "Project_DT24_ProjectStandard_FD-CAN14 [CS00155_FD]";
CM_ BO_ 3221225472 "This is a message for not used signals, created by Vector CANdb++ DBC OLE DB Provider.";
BA_DEF_ SG_  "GenSigStartValue" INT 0 2147483647;
BA_DEF_ SG_  "GenSigInactiveValue" INT 0 2147483647;
BA_DEF_ SG_  "GenSigSendType" ENUM  "NotUsed","OnWrite","OnWriteWithRepetition","OnChange","OnChangeWithRepetition","IfActive","IfActiveWithRepetition","NoSigSendType";
BA_DEF_ SG_  "GenSigTimeoutTime_BSM" INT 0 65535;
BA_DEF_ SG_  "GenSigTimeoutTime_BSM2" INT 0 65535;
BA_DEF_ SG_  "GenSigTimeoutTime_CADM" INT 0 65535;
BA_DEF_ SG_  "GenSigTimeoutTime_CVADAS" INT 0 65535;
BA_DEF_ SG_  "GenSigTimeoutTime_ECM" INT 0 65535;
BA_DEF_ SG_  "GenSigTimeoutTime_EPS" INT 0 65535;
BA_DEF_ SG_  "GenSigTimeoutTime_EVCU2" INT 0 65535;
BA_DEF_ SG_  "GenSigTimeoutTime_ORC" INT 0 65535;
BA_DEF_ BO_  "DiagRequest" ENUM  "No","Yes";
BA_DEF_ BO_  "Type" ENUM  "P","C","PE","COC","PE_Cntrl","E","E_Cntrl","OC","S","BAF","DC","EM","MM","ISO-TP","-";
BA_DEF_ BO_  "DiagResponse" ENUM  "No","Yes";
BA_DEF_ BO_  "NmMessage" ENUM  "No","Yes";
BA_DEF_ BO_  "GenMsgSendType" ENUM  "Cyclic","NotUsed","NotUsed","NotUsed","NotUsed","NotUsed","NotUsed","NotUsed","NoMsgSendType";
BA_DEF_ BO_  "GenMsgNrOfRepetition" INT 0 255;
BA_DEF_ BO_  "GenMsgILSupport" ENUM  "No","Yes";
BA_DEF_ BO_  "GenMsgCycleTimeFast" INT 0 65535;
BA_DEF_ BO_  "GenMsgCycleTime" INT 0 65535;
BA_DEF_ BO_  "GenMsgDelayTime" INT 0 65535;
BA_DEF_ BO_  "NmAsrMessage" ENUM  "No","Yes";
BA_DEF_ BO_  "DiagState" ENUM  "No","Yes";
BA_DEF_ BO_  "DiagConnection" HEX 0 65535;
BA_DEF_ BO_  "VFrameFormat" ENUM  "StandardCAN","ExtendedCAN","reserved","reserved","reserved","reserved","reserved","reserved","reserved","reserved","reserved","reserved","reserved","reserved","StandardCAN_FD","ExtendedCAN_FD";
BA_DEF_ BO_  "CANFD_BRS" INT 0 1;
BA_DEF_  "Manufacturer" STRING ;
BA_DEF_  "NmType" STRING ;
BA_DEF_  "BusType" STRING ;
BA_DEF_  "Baudrate" INT 0 1000000;
BA_DEF_  "DBName" STRING ;
BA_DEF_  "NmAsrTimeoutTime" INT 1 65535;
BA_DEF_  "NmAsrWaitBusSleepTime" INT 1 65535;
BA_DEF_  "NmAsrRepeatMessageTime" INT 1 65535;
BA_DEF_  "NmAsrMessageCount" INT 1 256;
BA_DEF_  "NmAsrBaseAddress" HEX 235487232 2147483647;
BA_DEF_  "NmAsrCanMsgCycleTime" INT 1 65535;
BA_DEF_  "Version" HEX 0 255;
BA_DEF_  "VersionWeek" INT 0 53;
BA_DEF_  "VersionYear" INT 0 99;
BA_DEF_ BU_  "Description" STRING ;
BA_DEF_ BU_  "NmStationAddress" HEX 0 255;
BA_DEF_ BU_  "NmNode" ENUM  "No","Yes";
BA_DEF_ BU_  "NmAsrNode" ENUM  "No","Yes";
BA_DEF_ BU_  "NmAsrNodeIdentifier" HEX 0 255;
BA_DEF_ BU_  "NmAsrCanMsgReducedTime" INT 1 65535;
BA_DEF_ BU_  "NmNodeType" ENUM  "+15_NotWakeable","+30_Wakeable","+30_NotWakeable","kMaster","kSlave15","kSlave30","none";
BA_DEF_ BU_  "NwmNodeType" ENUM  "+15_NotWakeable","+30_Wakeable","+30_NotWakeable","kMaster","kSlave15","kSlave30","none";
BA_DEF_ BU_  "NodeLayerModules" STRING ;
BA_DEF_DEF_  "GenSigStartValue" 0;
BA_DEF_DEF_  "GenSigInactiveValue" 0;
BA_DEF_DEF_  "GenSigSendType" "NoSigSendType";
BA_DEF_DEF_  "GenSigTimeoutTime_BSM" 2500;
BA_DEF_DEF_  "GenSigTimeoutTime_BSM2" 2500;
BA_DEF_DEF_  "GenSigTimeoutTime_CADM" 2500;
BA_DEF_DEF_  "GenSigTimeoutTime_CVADAS" 2500;
BA_DEF_DEF_  "GenSigTimeoutTime_ECM" 2500;
BA_DEF_DEF_  "GenSigTimeoutTime_EPS" 2500;
BA_DEF_DEF_  "GenSigTimeoutTime_EVCU2" 2500;
BA_DEF_DEF_  "GenSigTimeoutTime_ORC" 2500;
BA_DEF_DEF_  "DiagRequest" "No";
BA_DEF_DEF_  "Type" "-";
BA_DEF_DEF_  "DiagResponse" "No";
BA_DEF_DEF_  "NmMessage" "No";
BA_DEF_DEF_  "GenMsgSendType" "NoMsgSendType";
BA_DEF_DEF_  "GenMsgNrOfRepetition" 0;
BA_DEF_DEF_  "GenMsgILSupport" "No";
BA_DEF_DEF_  "GenMsgCycleTimeFast" 0;
BA_DEF_DEF_  "GenMsgCycleTime" 0;
BA_DEF_DEF_  "GenMsgDelayTime" 0;
BA_DEF_DEF_  "NmAsrMessage" "No";
BA_DEF_DEF_  "DiagState" "No";
BA_DEF_DEF_  "DiagConnection" 0;
BA_DEF_DEF_  "VFrameFormat" "StandardCAN_FD";
BA_DEF_DEF_  "CANFD_BRS" 0;
BA_DEF_DEF_  "Manufacturer" "Fiat";
BA_DEF_DEF_  "NmType" "";
BA_DEF_DEF_  "BusType" "CAN";
BA_DEF_DEF_  "Baudrate" 500000;
BA_DEF_DEF_  "DBName" "CAN";
BA_DEF_DEF_  "NmAsrTimeoutTime" 1000;
BA_DEF_DEF_  "NmAsrWaitBusSleepTime" 750;
BA_DEF_DEF_  "NmAsrRepeatMessageTime" 800;
BA_DEF_DEF_  "NmAsrMessageCount" 256;
BA_DEF_DEF_  "NmAsrBaseAddress" 506724352;
BA_DEF_DEF_  "NmAsrCanMsgCycleTime" 200;
BA_DEF_DEF_  "Version" 160;
BA_DEF_DEF_  "VersionWeek" 45;
BA_DEF_DEF_  "VersionYear" 22;
BA_DEF_DEF_  "Description" "";
BA_DEF_DEF_  "NmStationAddress" 0;
BA_DEF_DEF_  "NmNode" "Yes";
BA_DEF_DEF_  "NmAsrNode" "Yes";
BA_DEF_DEF_  "NmAsrNodeIdentifier" 0;
BA_DEF_DEF_  "NmAsrCanMsgReducedTime" 100;
BA_DEF_DEF_  "NmNodeType" "none";
BA_DEF_DEF_  "NwmNodeType" "none";
BA_DEF_DEF_  "NodeLayerModules" "";
BA_ "NmType" "NmAsr";
BA_ "BusType" "CAN FD";
BA_ "NmAsrTimeoutTime" 8000;
BA_ "NmAsrWaitBusSleepTime" 1000;
BA_ "NmAsrRepeatMessageTime" 5000;
BA_ "NmAsrBaseAddress" 507002880;
BA_ "NmAsrCanMsgCycleTime" 1000;
BA_ "DBName" "FDCAN14";
BA_ "NodeLayerModules" BU_ CANOE "CANoeILNLVector.dll,AsrNM33.dll";
BA_ "NodeLayerModules" BU_ BSM "CANoeILNLVector.dll,AsrNM33.dll";
BA_ "Description" BU_ BSM "Braking System Module";
BA_ "NmStationAddress" BU_ BSM 6;
BA_ "NmAsrNodeIdentifier" BU_ BSM 6;
BA_ "NmAsrCanMsgReducedTime" BU_ BSM 525;
BA_ "NmNodeType" BU_ BSM 2;
BA_ "NwmNodeType" BU_ BSM 2;
BA_ "NodeLayerModules" BU_ BSM2 "CANoeILNLVector.dll,AsrNM33.dll";
BA_ "Description" BU_ BSM2 "Brake System Module 2";
BA_ "NmStationAddress" BU_ BSM2 148;
BA_ "NmAsrNodeIdentifier" BU_ BSM2 148;
BA_ "NmAsrCanMsgReducedTime" BU_ BSM2 625;
BA_ "NmNodeType" BU_ BSM2 2;
BA_ "NwmNodeType" BU_ BSM2 2;
BA_ "NodeLayerModules" BU_ CADM "CANoeILNLVector.dll,AsrNM33.dll";
BA_ "Description" BU_ CADM "Central ADAS Decision Module";
BA_ "NmStationAddress" BU_ CADM 141;
BA_ "NmAsrNodeIdentifier" BU_ CADM 141;
BA_ "NmAsrCanMsgReducedTime" BU_ CADM 650;
BA_ "NmNodeType" BU_ CADM 2;
BA_ "NwmNodeType" BU_ CADM 2;
BA_ "NodeLayerModules" BU_ CVADAS "CANoeILNLVector.dll,AsrNM33.dll";
BA_ "Description" BU_ CVADAS "Central Vision ADAS";
BA_ "NmStationAddress" BU_ CVADAS 24;
BA_ "NmAsrNodeIdentifier" BU_ CVADAS 24;
BA_ "NmAsrCanMsgReducedTime" BU_ CVADAS 675;
BA_ "NmNodeType" BU_ CVADAS 2;
BA_ "NwmNodeType" BU_ CVADAS 2;
BA_ "NodeLayerModules" BU_ ECM "CANoeILNLVector.dll,AsrNM33.dll";
BA_ "Description" BU_ ECM "Engine Control Module";
BA_ "NmStationAddress" BU_ ECM 1;
BA_ "NmAsrNodeIdentifier" BU_ ECM 1;
BA_ "NmAsrCanMsgReducedTime" BU_ ECM 575;
BA_ "NmNodeType" BU_ ECM 2;
BA_ "NwmNodeType" BU_ ECM 2;
BA_ "NodeLayerModules" BU_ EPS "CANoeILNLVector.dll,AsrNM33.dll";
BA_ "Description" BU_ EPS "Electric Power Steering";
BA_ "NmStationAddress" BU_ EPS 2;
BA_ "NmAsrNodeIdentifier" BU_ EPS 2;
BA_ "NmAsrCanMsgReducedTime" BU_ EPS 600;
BA_ "NmNodeType" BU_ EPS 2;
BA_ "NwmNodeType" BU_ EPS 2;
BA_ "NodeLayerModules" BU_ ORC "CANoeILNLVector.dll,AsrNM33.dll";
BA_ "Description" BU_ ORC "Occupant Restraint Control";
BA_ "NmStationAddress" BU_ ORC 26;
BA_ "NmAsrNodeIdentifier" BU_ ORC 26;
BA_ "NmAsrCanMsgReducedTime" BU_ ORC 925;
BA_ "NmNodeType" BU_ ORC 2;
BA_ "NwmNodeType" BU_ ORC 2;
BA_ "GenMsgSendType" BO_ 2654814256 0;
BA_ "GenMsgILSupport" BO_ 2654814256 1;
BA_ "GenMsgCycleTime" BO_ 2654814256 40;
BA_ "VFrameFormat" BO_ 2654814256 15;
BA_ "GenMsgSendType" BO_ 2654814248 0;
BA_ "GenMsgILSupport" BO_ 2654814248 1;
BA_ "GenMsgCycleTime" BO_ 2654814248 40;
BA_ "VFrameFormat" BO_ 2654814248 15;
BA_ "GenMsgSendType" BO_ 2654814249 0;
BA_ "GenMsgILSupport" BO_ 2654814249 1;
BA_ "GenMsgCycleTime" BO_ 2654814249 40;
BA_ "VFrameFormat" BO_ 2654814249 15;
BA_ "GenMsgILSupport" BO_ 2654556161 1;
BA_ "CANFD_BRS" BO_ 2654556161 1;
BA_ "VFrameFormat" BO_ 2654556161 15;
BA_ "VFrameFormat" BO_ 2654552336 15;
BA_ "VFrameFormat" BO_ 2654552329 15;
BA_ "VFrameFormat" BO_ 2654552328 15;
BA_ "VFrameFormat" BO_ 2654552327 15;
BA_ "VFrameFormat" BO_ 2654552326 15;
BA_ "VFrameFormat" BO_ 2654552325 15;
BA_ "VFrameFormat" BO_ 2654552324 15;
BA_ "VFrameFormat" BO_ 2654552323 15;
BA_ "VFrameFormat" BO_ 2654552322 15;
BA_ "VFrameFormat" BO_ 2654552321 15;
BA_ "VFrameFormat" BO_ 2654552320 15;
BA_ "VFrameFormat" BO_ 2654552217 15;
BA_ "VFrameFormat" BO_ 2654552216 15;
BA_ "VFrameFormat" BO_ 2654552215 15;
BA_ "GenMsgCycleTime" BO_ 2654814236 40;
BA_ "GenMsgILSupport" BO_ 2654814236 1;
BA_ "GenMsgSendType" BO_ 2654814236 0;
BA_ "VFrameFormat" BO_ 2654814236 15;
BA_ "GenMsgCycleTime" BO_ 2654814235 40;
BA_ "GenMsgILSupport" BO_ 2654814235 1;
BA_ "GenMsgSendType" BO_ 2654814235 0;
BA_ "VFrameFormat" BO_ 2654814235 15;
BA_ "GenMsgCycleTime" BO_ 2654814234 40;
BA_ "GenMsgILSupport" BO_ 2654814234 1;
BA_ "GenMsgSendType" BO_ 2654814234 0;
BA_ "VFrameFormat" BO_ 2654814234 15;
BA_ "GenMsgCycleTime" BO_ 2654814233 40;
BA_ "GenMsgILSupport" BO_ 2654814233 1;
BA_ "GenMsgSendType" BO_ 2654814233 0;
BA_ "VFrameFormat" BO_ 2654814233 15;
BA_ "GenMsgCycleTime" BO_ 2654814247 40;
BA_ "GenMsgILSupport" BO_ 2654814247 1;
BA_ "GenMsgSendType" BO_ 2654814247 0;
BA_ "VFrameFormat" BO_ 2654814247 15;
BA_ "GenMsgCycleTime" BO_ 2654814231 40;
BA_ "GenMsgILSupport" BO_ 2654814231 1;
BA_ "GenMsgSendType" BO_ 2654814231 0;
BA_ "VFrameFormat" BO_ 2654814231 15;
BA_ "GenMsgCycleTime" BO_ 2654814230 40;
BA_ "GenMsgILSupport" BO_ 2654814230 1;
BA_ "GenMsgSendType" BO_ 2654814230 0;
BA_ "VFrameFormat" BO_ 2654814230 15;
BA_ "VFrameFormat" BO_ 2654814237 15;
BA_ "VFrameFormat" BO_ 2654552337 15;
BA_ "VFrameFormat" BO_ 2654552338 15;
BA_ "VFrameFormat" BO_ 2654552339 15;
BA_ "VFrameFormat" BO_ 2654552214 15;
BA_ "VFrameFormat" BO_ 2654552213 15;
BA_ "VFrameFormat" BO_ 2654814209 15;
BA_ "VFrameFormat" BO_ 2654552212 15;
BA_ "VFrameFormat" BO_ 2654552211 15;
BA_ "VFrameFormat" BO_ 2654552210 15;
BA_ "VFrameFormat" BO_ 2654552209 15;
BA_ "VFrameFormat" BO_ 2654552208 15;
BA_ "VFrameFormat" BO_ 2654552201 15;
BA_ "VFrameFormat" BO_ 2654552200 15;
BA_ "VFrameFormat" BO_ 2654552199 15;
BA_ "VFrameFormat" BO_ 2654552198 15;
BA_ "VFrameFormat" BO_ 2654552197 15;
BA_ "GenSigSendType" SG_ 2654556161 FD14_1_Hook_PresentPtr_MCU1_0 1;
BA_ "GenSigSendType" SG_ 2654556161 FD14_1_ErrFaultInfo_MCU2_0 1;
BA_ "GenSigSendType" SG_ 2654556161 FD14_1_Err_FaultInfo_MCU2_1 1;
BA_ "GenSigSendType" SG_ 2654556161 FD14_1_Err_FaultInfo_MPU1_0 1;
BA_ "GenSigSendType" SG_ 2654556161 FD14_1_Err_FaultInfo_MCU1_0 1;
BA_ "GenSigSendType" SG_ 2654556161 FD14_1_WDG_Error_ID_MCU1_0 1;
BA_ "GenSigSendType" SG_ 2654556161 FD14_1_SDL_Fault_MCU1_0 1;
BA_ "GenSigSendType" SG_ 2654556161 FD14_1_Hook_Service_MCU1_0 1;
BA_ "GenSigSendType" SG_ 2654556161 FD14_1_Hook_DtErr_MCU1_0 1;
BA_ "GenSigSendType" SG_ 2654556161 FD14_1_Hook_Reserved_MCU1_0 1;
BA_ "GenSigSendType" SG_ 2654556161 FD14_1_Hook_fatalErr_MCU1_0 1;
BA_ "GenSigSendType" SG_ 2654556161 FD14_1_Hook_actTsk_MCU1_0 1;
BA_ "GenSigSendType" SG_ 2654556161 FD14_1_Hook_Error_MCU1_0 1;
BA_ "GenSigSendType" SG_ 2654556161 FD14_1_Hook_Type_MCU1_0 1;
BA_ "GenSigSendType" SG_ 2654556161 FD14_1_SSM_FltData1_MCU1_0 1;
BA_ "GenSigSendType" SG_ 2654556161 FD14_1_SSM_FltData2_MCU1_0 1;
BA_ "GenSigSendType" SG_ 2654556161 FD14_1_SSM_FltData3_MCU1_0 1;
BA_ "GenSigSendType" SG_ 2654556161 FD14_1_SSM_FltData4_MCU1_0 1;
BA_ "GenSigSendType" SG_ 2654556161 FD14_1_SSM_FltData5_MCU1_0 1;
BA_ "GenSigSendType" SG_ 2654556161 FD14_1_SSM_FltData6_MCU1_0 1;
BA_ "GenSigSendType" SG_ 2654556161 FD14_1_SSM_FltData7_MCU1_0 1;
BA_ "GenSigSendType" SG_ 2654556161 FD14_1_SSM_FltData8_MCU1_0 1;
BA_ "GenSigSendType" SG_ 2654556161 FD14_1_SSM_FltData9_MCU1_0 1;
BA_ "GenSigSendType" SG_ 2654556161 FD14_1_SSM_FltData10_MCU1_0 1;
BA_ "GenSigSendType" SG_ 2654556161 FD14_1_SSM_FltData11_MCU1_0 1;
BA_ "GenSigSendType" SG_ 2654556161 FD14_1_SSM_FltData12_MCU1_0 1;
BA_ "GenSigSendType" SG_ 2654556161 FD14_1_SSM_FltData13_MCU1_0 1;
BA_ "GenSigSendType" SG_ 2654556161 FD14_1_SSM_FltData14_MCU1_0 1;
BA_ "GenSigSendType" SG_ 2654556161 FD14_1_SSM_FltData15_MCU1_0 1;
BA_ "GenSigSendType" SG_ 2654556161 FD14_1_SSM_FltData16_MCU1_0 1;
BA_ "GenSigSendType" SG_ 2654556161 FD14_1_SSM_FltData17_MCU1_0 1;
BA_ "GenSigSendType" SG_ 2654556161 FD14_1_SSM_FltData18_MCU1_0 1;
BA_ "GenSigSendType" SG_ 2654556161 FD14_1_Err_FaultNum_MCU2_0 1;
BA_ "GenSigSendType" SG_ 2654556161 FD14_1_Err_FaultNum_MCU2_1 1;
BA_ "GenSigSendType" SG_ 2654556161 FD14_1_Err_FaultNum_MPU1_0 1;
BA_ "GenSigSendType" SG_ 2654556161 FD14_1_Err_FaultNum_MCU1_0 1;
BA_ "GenSigSendType" SG_ 2654556161 FD14_1_Reserved_MCU2_0 1;
BA_ "GenSigSendType" SG_ 2654556161 FD14_1_Reserved_MCU2_1 1;
BA_ "GenSigSendType" SG_ 2654556161 FD14_1_Reserved_MPU1_0 1;
BA_ "GenSigSendType" SG_ 2654556161 FD14_1_Reserved_MCU1_0 1;
BA_ "GenSigSendType" SG_ 2654552336 stFPAInfoToVCLockedSlotRearRghtY 1;
BA_ "GenSigSendType" SG_ 2654552336 stFPAInfoToVCLockedSlotFrntLeftY 1;
BA_ "GenSigSendType" SG_ 2654552336 stFPAInfoToVCLockedSlotRearRghtX 1;
BA_ "GenSigSendType" SG_ 2654552336 stFPAInfoToVCLockedSlotFrntLeftX 1;
BA_ "GenSigSendType" SG_ 2654552336 stFPAInfoToVCLockedSlotType 1;
BA_ "GenSigSendType" SG_ 2654552336 m_FPAToNVMParkInStyle 1;
BA_ "GenSigSendType" SG_ 2654552336 stFPAInfoToVCLockedSlotSide 1;
BA_ "GenSigSendType" SG_ 2654552336 m_FpaInfoToVCParkOutStyle 1;
BA_ "GenSigSendType" SG_ 2654552336 stFPAInfoToVCLockedSlotID 1;
BA_ "GenSigSendType" SG_ 2654552336 m_FPAInfoToUSSOMSlotID 1;
BA_ "GenSigSendType" SG_ 2654552336 m_FPAInfoToPLDSlotID 1;
BA_ "GenSigSendType" SG_ 2654552336 stFPAInfoToHMISlot6Valid 1;
BA_ "GenSigSendType" SG_ 2654552336 stFPAInfoToHMISlot5Valid 1;
BA_ "GenSigSendType" SG_ 2654552336 stFPAInfoToHMISlot4Valid 1;
BA_ "GenSigSendType" SG_ 2654552336 stFPAInfoToHMISlot3Valid 1;
BA_ "GenSigSendType" SG_ 2654552336 stFPAInfoToHMISlot2Valid 1;
BA_ "GenSigSendType" SG_ 2654552336 stFPAInfoToHMISlot1Valid 1;
BA_ "GenSigSendType" SG_ 2654552336 m_FPAToNVMWriteNVMParam_b 1;
BA_ "GenSigSendType" SG_ 2654552336 m_FPAToNVMReadNVMParam_b 1;
BA_ "GenSigSendType" SG_ 2654552336 stFPAInfoToVCLockedSlotValid 1;
BA_ "GenSigSendType" SG_ 2654552336 AutoParkInitializedStatus_b 1;
BA_ "GenSigSendType" SG_ 2654552329 stnumPointsR 1;
BA_ "GenSigSendType" SG_ 2654552329 stnumPointsL 1;
BA_ "GenSigSendType" SG_ 2654552329 stRightObjectList4Valid 1;
BA_ "GenSigSendType" SG_ 2654552329 stRightObjectList3Valid 1;
BA_ "GenSigSendType" SG_ 2654552329 stRightObjectList2Valid 1;
BA_ "GenSigSendType" SG_ 2654552329 stRightObjectList1Valid 1;
BA_ "GenSigSendType" SG_ 2654552329 stLeftObjectList4Valid 1;
BA_ "GenSigSendType" SG_ 2654552329 stLeftObjectList3Valid 1;
BA_ "GenSigSendType" SG_ 2654552329 stLeftObjectList2Valid 1;
BA_ "GenSigSendType" SG_ 2654552329 stLeftObjectList1Valid 1;
BA_ "GenSigSendType" SG_ 2654552329 stUSSLockedSlotDataSlotValid 1;
BA_ "GenSigSendType" SG_ 2654552329 stUSSLockedSlotDataSlotID 1;
BA_ "GenSigSendType" SG_ 2654552329 stUSSLockedSlotDataSlotSide 1;
BA_ "GenSigSendType" SG_ 2654552329 stUSSLockedSlotDataSlotType 1;
BA_ "GenSigSendType" SG_ 2654552329 stUSSLockedSlotDataRearRightY 1;
BA_ "GenSigSendType" SG_ 2654552329 stUSSLockedSlotDataFrontLeftY 1;
BA_ "GenSigSendType" SG_ 2654552329 stUSSLockedSlotDataRearRightX 1;
BA_ "GenSigSendType" SG_ 2654552329 stUSSLockedSlotDataFrontLeftX 1;
BA_ "GenSigSendType" SG_ 2654552328 stUSSParkingSlot1DataSlotID 1;
BA_ "GenSigSendType" SG_ 2654552328 stUSSParkingSlot4DataSlotSide 1;
BA_ "GenSigSendType" SG_ 2654552328 stUSSParkingSlot1DataSlotSide 1;
BA_ "GenSigSendType" SG_ 2654552328 stUSSParkingSlot4SlotType 1;
BA_ "GenSigSendType" SG_ 2654552328 stUSSParkingSlot1SlotType 1;
BA_ "GenSigSendType" SG_ 2654552328 stUSSParkingSlot4RearRightY 1;
BA_ "GenSigSendType" SG_ 2654552328 stUSSParkingSlot4FrontLeftY 1;
BA_ "GenSigSendType" SG_ 2654552328 stUSSParkingSlot1RearRightY 1;
BA_ "GenSigSendType" SG_ 2654552328 stUSSParkingSlot1FrontLeftY 1;
BA_ "GenSigSendType" SG_ 2654552328 stUSSParkingSlot4RearRightX 1;
BA_ "GenSigSendType" SG_ 2654552328 stUSSParkingSlot4FrontLeftX 1;
BA_ "GenSigSendType" SG_ 2654552328 stUSSParkingSlot1RearRightX 1;
BA_ "GenSigSendType" SG_ 2654552328 stUSSParkingSlot1FrontLeftX 1;
BA_ "GenSigSendType" SG_ 2654552328 stUSSParkingSlot6SlotValid 1;
BA_ "GenSigSendType" SG_ 2654552328 stUSSParkingSlot5SlotValid 1;
BA_ "GenSigSendType" SG_ 2654552328 stUSSParkingSlot4SlotValid 1;
BA_ "GenSigSendType" SG_ 2654552328 stUSSParkingSlot3SlotValid 1;
BA_ "GenSigSendType" SG_ 2654552328 stUSSParkingSlot2SlotValid 1;
BA_ "GenSigSendType" SG_ 2654552328 stUSSParkingSlot1SlotValid 1;
BA_ "GenSigSendType" SG_ 2654552328 isUSSInitSuccess_b 1;
BA_ "GenSigSendType" SG_ 2654552327 stPLDLockedSlotDataSlotValid 1;
BA_ "GenSigSendType" SG_ 2654552327 stPLDLockedSlotDataSlotID 1;
BA_ "GenSigSendType" SG_ 2654552327 stPLDLockedSlotDataSlotSide 1;
BA_ "GenSigSendType" SG_ 2654552327 stPLDLockedSlotDataSlotType 1;
BA_ "GenSigSendType" SG_ 2654552327 stPLDLockedSlotDataRearRightY 1;
BA_ "GenSigSendType" SG_ 2654552327 stPLDLockedSlotDataRearRightX 1;
BA_ "GenSigSendType" SG_ 2654552327 stPLDLockedSlotDataFrontLeftY 1;
BA_ "GenSigSendType" SG_ 2654552327 stPLDLockedSlotDataFrontLeftX 1;
BA_ "GenSigSendType" SG_ 2654552326 stPLDParkingSlot4SlotType 1;
BA_ "GenSigSendType" SG_ 2654552326 stPLDParkingSlot4DataSlotSide 1;
BA_ "GenSigSendType" SG_ 2654552326 stPLDParkingSlot4DataSlotID 1;
BA_ "GenSigSendType" SG_ 2654552326 stPLDParkingSlot4RearRightX 1;
BA_ "GenSigSendType" SG_ 2654552326 stPLDParkingSlot4RearRightY 1;
BA_ "GenSigSendType" SG_ 2654552326 stPLDParkingSlot4FrontLeftY 1;
BA_ "GenSigSendType" SG_ 2654552326 stPLDParkingSlot4FrontLeftX 1;
BA_ "GenSigSendType" SG_ 2654552326 stPLDParkingSlot1DataSlotID 1;
BA_ "GenSigSendType" SG_ 2654552326 stPLDParkingSlot1DataSlotSide 1;
BA_ "GenSigSendType" SG_ 2654552326 stPLDParkingSlot1SlotType 1;
BA_ "GenSigSendType" SG_ 2654552326 stPLDParkingSlot1RearRightY 1;
BA_ "GenSigSendType" SG_ 2654552326 stPLDParkingSlot1RearRightX 1;
BA_ "GenSigSendType" SG_ 2654552326 stPLDParkingSlot1FrontLeftY 1;
BA_ "GenSigSendType" SG_ 2654552326 stPLDParkingSlot1FrontLeftX 1;
BA_ "GenSigSendType" SG_ 2654552326 stPLDParkingSlot6SlotValid 1;
BA_ "GenSigSendType" SG_ 2654552326 stPLDParkingSlot5SlotValid 1;
BA_ "GenSigSendType" SG_ 2654552326 stPLDParkingSlot3SlotValid 1;
BA_ "GenSigSendType" SG_ 2654552326 stPLDParkingSlot2SlotValid 1;
BA_ "GenSigSendType" SG_ 2654552326 stPLDParkingSlot4SlotValid 1;
BA_ "GenSigSendType" SG_ 2654552326 stPLDParkingSlot1SlotValid 1;
BA_ "GenSigSendType" SG_ 2654552326 isPLDInitSuccess_b 1;
BA_ "GenSigSendType" SG_ 2654552325 leLMD_e_HealthStatus 1;
BA_ "GenSigSendType" SG_ 2654552325 IeLMD_e_CameraStatus 1;
BA_ "GenSigSendType" SG_ 2654552325 Total_lines_count 1;
BA_ "GenSigSendType" SG_ 2654552325 Frame_Index_Lanes_1 1;
BA_ "GenSigSendType" SG_ 2654552325 LMD_pct_Segment_7_Confidence 1;
BA_ "GenSigSendType" SG_ 2654552325 LMD_pct_Segment_8_Confidence 1;
BA_ "GenSigSendType" SG_ 2654552325 LMD_pct_Segment_5_Confidence 1;
BA_ "GenSigSendType" SG_ 2654552325 LMD_pct_Segment_6_Confidence 1;
BA_ "GenSigSendType" SG_ 2654552325 LMD_pct_Segment_3_Confidence 1;
BA_ "GenSigSendType" SG_ 2654552325 LMD_pct_Segment_4_Confidence 1;
BA_ "GenSigSendType" SG_ 2654552325 LMD_pct_Segment_1_Confidence 1;
BA_ "GenSigSendType" SG_ 2654552325 LMD_pct_Segment_2_Confidence 1;
BA_ "GenSigSendType" SG_ 2654552324 LMD_m_Segment_8_Y2 1;
BA_ "GenSigSendType" SG_ 2654552324 LMD_m_Segment_7_Y2 1;
BA_ "GenSigSendType" SG_ 2654552324 LMD_m_Segment_6_Y2 1;
BA_ "GenSigSendType" SG_ 2654552324 LMD_m_Segment_5_Y2 1;
BA_ "GenSigSendType" SG_ 2654552324 LMD_m_Segment_4_Y2 1;
BA_ "GenSigSendType" SG_ 2654552324 LMD_m_Segment_3_Y2 1;
BA_ "GenSigSendType" SG_ 2654552324 LMD_m_Segment_2_Y2 1;
BA_ "GenSigSendType" SG_ 2654552324 LMD_m_Segment_1_Y2 1;
BA_ "GenSigSendType" SG_ 2654552324 LMD_m_Segment_8_X2 1;
BA_ "GenSigSendType" SG_ 2654552324 LMD_m_Segment_7_X2 1;
BA_ "GenSigSendType" SG_ 2654552324 LMD_m_Segment_6_X2 1;
BA_ "GenSigSendType" SG_ 2654552324 LMD_m_Segment_5_X2 1;
BA_ "GenSigSendType" SG_ 2654552324 LMD_m_Segment_4_X2 1;
BA_ "GenSigSendType" SG_ 2654552324 LMD_m_Segment_3_X2 1;
BA_ "GenSigSendType" SG_ 2654552324 LMD_m_Segment_2_X2 1;
BA_ "GenSigSendType" SG_ 2654552324 LMD_m_Segment_1_X2 1;
BA_ "GenSigSendType" SG_ 2654552323 LMD_m_Segment_8_Y1 1;
BA_ "GenSigSendType" SG_ 2654552323 LMD_m_Segment_7_Y1 1;
BA_ "GenSigSendType" SG_ 2654552323 LMD_m_Segment_6_Y1 1;
BA_ "GenSigSendType" SG_ 2654552322 LMD_m_Segment_5_Y1 1;
BA_ "GenSigSendType" SG_ 2654552322 LMD_m_Segment_4_Y1 1;
BA_ "GenSigSendType" SG_ 2654552322 LMD_m_Segment_3_Y1 1;
BA_ "GenSigSendType" SG_ 2654552322 LMD_m_Segment_2_Y1 1;
BA_ "GenSigSendType" SG_ 2654552322 LMD_m_Segment_1_Y1 1;
BA_ "GenSigSendType" SG_ 2654552322 LMD_m_Segment_8_X1 1;
BA_ "GenSigSendType" SG_ 2654552322 LMD_m_Segment_6_X1 1;
BA_ "GenSigSendType" SG_ 2654552322 LMD_m_Segment_7_X1 1;
BA_ "GenSigSendType" SG_ 2654552322 LMD_m_Segment_5_X1 1;
BA_ "GenSigSendType" SG_ 2654552322 LMD_m_Segment_4_X1 1;
BA_ "GenSigSendType" SG_ 2654552322 LMD_m_Segment_3_X1 1;
BA_ "GenSigSendType" SG_ 2654552322 LMD_m_Segment_2_X1 1;
BA_ "GenSigSendType" SG_ 2654552322 LMD_m_Segment_1_X1 1;
BA_ "GenSigSendType" SG_ 2654552322 LMD_e_Segment_7_ID 1;
BA_ "GenSigSendType" SG_ 2654552322 LMD_e_Segment_8_ID 1;
BA_ "GenSigSendType" SG_ 2654552322 LMD_e_Segment_5_ID 1;
BA_ "GenSigSendType" SG_ 2654552322 LMD_e_Segment_6_ID 1;
BA_ "GenSigSendType" SG_ 2654552322 LMD_e_Segment_3_ID 1;
BA_ "GenSigSendType" SG_ 2654552322 LMD_e_Segment_4_ID 1;
BA_ "GenSigSendType" SG_ 2654552322 LMD_e_Segment_1_ID 1;
BA_ "GenSigSendType" SG_ 2654552322 LMD_e_Segment_2_ID 1;
BA_ "GenSigSendType" SG_ 2654552321 LMD_e_Line_4_Type 1;
BA_ "GenSigSendType" SG_ 2654552321 LMD_e_Line_3_Type 1;
BA_ "GenSigSendType" SG_ 2654552321 LMD_pct_Line_3_Confidence 1;
BA_ "GenSigSendType" SG_ 2654552321 LMD_px_Line_3_Curvature 1;
BA_ "GenSigSendType" SG_ 2654552321 LMD_m_Line_4_End_Range 1;
BA_ "GenSigSendType" SG_ 2654552321 LMD_m_Line_4_Start_Range 1;
BA_ "GenSigSendType" SG_ 2654552321 LMD_rad_Line_4_Heading 1;
BA_ "GenSigSendType" SG_ 2654552321 LMD_m_Line_4_Offset 1;
BA_ "GenSigSendType" SG_ 2654552321 LMD_pct_Line_4_Confidence 1;
BA_ "GenSigSendType" SG_ 2654552321 LMD_px_Line_4_Curvature 1;
BA_ "GenSigSendType" SG_ 2654552321 LMD_m_Line_3_End_Range 1;
BA_ "GenSigSendType" SG_ 2654552321 LMD_m_Line_3_Start_Range 1;
BA_ "GenSigSendType" SG_ 2654552321 LMD_rad_Line_3_Heading 1;
BA_ "GenSigSendType" SG_ 2654552321 LMD_m_Line_3_Offset 1;
BA_ "GenSigSendType" SG_ 2654552320 OC_ModuleState_STM_Right 1;
BA_ "GenSigSendType" SG_ 2654552320 OC_ModuleState_STM_Rear 1;
BA_ "GenSigSendType" SG_ 2654552320 OC_ModuleState_STM_Left 1;
BA_ "GenSigSendType" SG_ 2654552320 OC_ModuleState_STM_Front 1;
BA_ "GenSigSendType" SG_ 2654552320 SC_ModuleState_STM_Right 1;
BA_ "GenSigSendType" SG_ 2654552320 SC_ModuleState_STM_Rear 1;
BA_ "GenSigSendType" SG_ 2654552320 SC_ModuleState_STM_Left 1;
BA_ "GenSigSendType" SG_ 2654552320 SC_ModuleState_STM_Front 1;
BA_ "GenSigSendType" SG_ 2654552320 EOL_ModuleState_STM_Right 1;
BA_ "GenSigSendType" SG_ 2654552320 EOL_ModuleState_STM_Rear 1;
BA_ "GenSigSendType" SG_ 2654552320 EOL_ModuleState_STM_Left 1;
BA_ "GenSigSendType" SG_ 2654552320 EOL_ModuleState_STM_Front 1;
BA_ "GenSigSendType" SG_ 2654552217 CalibStatus_STM_Current_Right 1;
BA_ "GenSigSendType" SG_ 2654552217 CalibStatus_STM_Current_Rear 1;
BA_ "GenSigSendType" SG_ 2654552217 CalibStatus_STM_Current_Left 1;
BA_ "GenSigSendType" SG_ 2654552217 CalibStatus_STM_Current_Front 1;
BA_ "GenSigSendType" SG_ 2654552217 CalibStatus_STM_OC_Right 1;
BA_ "GenSigSendType" SG_ 2654552217 CalibStatus_STM_OC_Rear 1;
BA_ "GenSigSendType" SG_ 2654552217 CalibStatus_STM_OC_Left 1;
BA_ "GenSigSendType" SG_ 2654552217 CalibStatus_STM_OC_Front 1;
BA_ "GenSigSendType" SG_ 2654552217 CalibStatus_STM_SC_Right 1;
BA_ "GenSigSendType" SG_ 2654552217 CalibStatus_STM_SC_Rear 1;
BA_ "GenSigSendType" SG_ 2654552217 CalibStatus_STM_SC_Left 1;
BA_ "GenSigSendType" SG_ 2654552217 CalibStatus_STM_SC_Front 1;
BA_ "GenSigSendType" SG_ 2654552217 CalibStatus_STM_EOL_Right 1;
BA_ "GenSigSendType" SG_ 2654552217 CalibStatus_STM_EOL_Rear 1;
BA_ "GenSigSendType" SG_ 2654552217 CalibStatus_STM_EOL_Left 1;
BA_ "GenSigSendType" SG_ 2654552217 CalibStatus_STM_EOL_Front 1;
BA_ "GenSigSendType" SG_ 2654552216 Err_Code_OC_Right 1;
BA_ "GenSigSendType" SG_ 2654552216 Err_Code_OC_Rear 1;
BA_ "GenSigSendType" SG_ 2654552216 Err_Code_OC_Left 1;
BA_ "GenSigSendType" SG_ 2654552216 Err_Code_OC_Front 1;
BA_ "GenSigSendType" SG_ 2654552216 Err_Code_SC_Right 1;
BA_ "GenSigSendType" SG_ 2654552216 Err_Code_SC_Rear 1;
BA_ "GenSigSendType" SG_ 2654552216 Err_Code_SC_Left 1;
BA_ "GenSigSendType" SG_ 2654552216 Err_Code_SC_Front 1;
BA_ "GenSigSendType" SG_ 2654552216 Err_Code_EOL_Rear_Copy_1 1;
BA_ "GenSigSendType" SG_ 2654552216 Err_Code_EOL_Rear 1;
BA_ "GenSigSendType" SG_ 2654552216 Err_Code_EOL_Left 1;
BA_ "GenSigSendType" SG_ 2654552216 Err_Code_EOL_Front 1;
BA_ "GenSigSendType" SG_ 2654552215 Current_Firing_Sequence 1;
BA_ "GenSigSendType" SG_ 2654814236 SnrMeasDataChecksum 1;
BA_ "GenSigSendType" SG_ 2654814237 Log_Sensor_Temperature 1;
BA_ "GenSigSendType" SG_ 2654552337 Tstr_SD_FSR_DrvFreq 1;
BA_ "GenSigSendType" SG_ 2654552337 Tstr_SD_FSR_RingFreq 1;
BA_ "GenSigSendType" SG_ 2654552337 Tstr_SD_FSR_Ringtime_us 1;
BA_ "GenSigSendType" SG_ 2654552337 Tstr_SD_FSR_Unfiltered_DirDist1_ 1;
BA_ "GenSigSendType" SG_ 2654552337 Tstr_SD_FSR_Unfiltered_DirDist2_ 1;
BA_ "GenSigSendType" SG_ 2654552337 Tstr_SD_FSR_EchoHeight_adc 1;
BA_ "GenSigSendType" SG_ 2654552337 Tstr_SD_FSR_SensorBlkgSetCounter 1;
BA_ "GenSigSendType" SG_ 2654552337 Tstr_SD_FSR_SensorBlkgClrCounter 1;
BA_ "GenSigSendType" SG_ 2654552337 Tstr_SD_FOR_DrvFreq 1;
BA_ "GenSigSendType" SG_ 2654552337 Tstr_SD_FOR_RingFreq 1;
BA_ "GenSigSendType" SG_ 2654552337 Tstr_SD_FOR_Ringtime_us 1;
BA_ "GenSigSendType" SG_ 2654552337 Tstr_SD_FOR_Unfiltered_DirDist1_ 1;
BA_ "GenSigSendType" SG_ 2654552337 Tstr_SD_FOR_Unfiltered_DirDist2_ 1;
BA_ "GenSigSendType" SG_ 2654552337 Tstr_SD_FOR_EchoHeight_adc 1;
BA_ "GenSigSendType" SG_ 2654552337 Tstr_SD_FOR_SensorBlkgSetCounter 1;
BA_ "GenSigSendType" SG_ 2654552337 Tstr_SD_FOR_SensorBlkgClrCounter 1;
BA_ "GenSigSendType" SG_ 2654552337 Tstr_SD_FIR_DrvFreq 1;
BA_ "GenSigSendType" SG_ 2654552337 Tstr_SD_FIR_RingFreq 1;
BA_ "GenSigSendType" SG_ 2654552337 Tstr_SD_FIR_Ringtime_us 1;
BA_ "GenSigSendType" SG_ 2654552337 Tstr_SD_FIR_Unfiltered_DirDist1_ 1;
BA_ "GenSigSendType" SG_ 2654552337 Tstr_SD_FIR_Unfiltered_DirDist2_ 1;
BA_ "GenSigSendType" SG_ 2654552337 Tstr_SD_FIR_EchoHeight_adc 1;
BA_ "GenSigSendType" SG_ 2654552337 Tstr_SD_FIR_SensorBlkgSetCounter 1;
BA_ "GenSigSendType" SG_ 2654552337 Tstr_SD_FIR_SensorBlkgClrCounter 1;
BA_ "GenSigSendType" SG_ 2654552337 Tstr_SD_FIL_DrvFreq 1;
BA_ "GenSigSendType" SG_ 2654552337 Tstr_SD_FIL_RingFreq 1;
BA_ "GenSigSendType" SG_ 2654552337 Tstr_SD_FIL_Ringtime_us 1;
BA_ "GenSigSendType" SG_ 2654552337 Tstr_SD_FIL_Unfiltered_DirDist1_ 1;
BA_ "GenSigSendType" SG_ 2654552337 Tstr_SD_FIL_Unfiltered_DirDist2_ 1;
BA_ "GenSigSendType" SG_ 2654552337 Tstr_SD_FIL_EchoHeight_adc 1;
BA_ "GenSigSendType" SG_ 2654552337 Tstr_SD_FIL_SensorBlkgSetCounter 1;
BA_ "GenSigSendType" SG_ 2654552337 Tstr_SD_FIL_SensorBlkgClrCounter 1;
BA_ "GenSigSendType" SG_ 2654552338 Tstr_SD_FOL_DrvFreq 1;
BA_ "GenSigSendType" SG_ 2654552338 Tstr_SD_FOL_RingFreq 1;
BA_ "GenSigSendType" SG_ 2654552338 Tstr_SD_FOL_Ringtime_us 1;
BA_ "GenSigSendType" SG_ 2654552338 Tstr_SD_FOL_Unfiltered_DirDist1_ 1;
BA_ "GenSigSendType" SG_ 2654552338 Tstr_SD_FOL_Unfiltered_DirDist2_ 1;
BA_ "GenSigSendType" SG_ 2654552338 Tstr_SD_FOL_EchoHeight_adc 1;
BA_ "GenSigSendType" SG_ 2654552338 Tstr_SD_FOL_SensorBlkgSetCounter 1;
BA_ "GenSigSendType" SG_ 2654552338 Tstr_SD_FOL_SensorBlkgClrCounter 1;
BA_ "GenSigSendType" SG_ 2654552338 Tstr_SD_FSL_DrvFreq 1;
BA_ "GenSigSendType" SG_ 2654552338 Tstr_SD_FSL_RingFreq 1;
BA_ "GenSigSendType" SG_ 2654552338 Tstr_SD_FSL_Ringtime_us 1;
BA_ "GenSigSendType" SG_ 2654552338 Tstr_SD_FSL_Unfiltered_DirDist1_ 1;
BA_ "GenSigSendType" SG_ 2654552338 Tstr_SD_FSL_Unfiltered_DirDist2_ 1;
BA_ "GenSigSendType" SG_ 2654552338 Tstr_SD_FSL_EchoHeight_adc 1;
BA_ "GenSigSendType" SG_ 2654552338 Tstr_SD_FSL_SensorBlkgSetCounter 1;
BA_ "GenSigSendType" SG_ 2654552338 Tstr_SD_FSL_SensorBlkgClrCounter 1;
BA_ "GenSigSendType" SG_ 2654552338 Tstr_SD_RSR_DrvFreq 1;
BA_ "GenSigSendType" SG_ 2654552338 Tstr_SD_RSR_RingFreq 1;
BA_ "GenSigSendType" SG_ 2654552338 Tstr_SD_RSR_Ringtime_us 1;
BA_ "GenSigSendType" SG_ 2654552338 Tstr_SD_RSR_Unfiltered_DirDist1_ 1;
BA_ "GenSigSendType" SG_ 2654552338 Tstr_SD_RSR_Unfiltered_DirDist2_ 1;
BA_ "GenSigSendType" SG_ 2654552338 Tstr_SD_RSR_EchoHeight_adc 1;
BA_ "GenSigSendType" SG_ 2654552338 Tstr_SD_RSR_SensorBlkgSetCounter 1;
BA_ "GenSigSendType" SG_ 2654552338 Tstr_SD_RSR_SensorBlkgClrCounter 1;
BA_ "GenSigSendType" SG_ 2654552338 Tstr_SD_ROR_DrvFreq 1;
BA_ "GenSigSendType" SG_ 2654552338 Tstr_SD_ROR_RingFreq 1;
BA_ "GenSigSendType" SG_ 2654552338 Tstr_SD_ROR_Ringtime_us 1;
BA_ "GenSigSendType" SG_ 2654552338 Tstr_SD_ROR_Unfiltered_DirDist1_ 1;
BA_ "GenSigSendType" SG_ 2654552338 Tstr_SD_ROR_Unfiltered_DirDist2_ 1;
BA_ "GenSigSendType" SG_ 2654552338 Tstr_SD_ROR_EchoHeight_adc 1;
BA_ "GenSigSendType" SG_ 2654552338 Tstr_SD_ROR_SensorBlkgSetCounter 1;
BA_ "GenSigSendType" SG_ 2654552338 Tstr_SD_ROR_SensorBlkgClrCounter 1;
BA_ "GenSigSendType" SG_ 2654552339 Tstr_SD_RIR_DrvFreq 1;
BA_ "GenSigSendType" SG_ 2654552339 Tstr_SD_RIR_RingFreq 1;
BA_ "GenSigSendType" SG_ 2654552339 Tstr_SD_RIR_Ringtime_us 1;
BA_ "GenSigSendType" SG_ 2654552339 Tstr_SD_RIR_Unfiltered_DirDist1_ 1;
BA_ "GenSigSendType" SG_ 2654552339 Tstr_SD_RIR_Unfiltered_DirDist2_ 1;
BA_ "GenSigSendType" SG_ 2654552339 Tstr_SD_RIR_EchoHeight_adc 1;
BA_ "GenSigSendType" SG_ 2654552339 Tstr_SD_RIR_SensorBlkgSetCounter 1;
BA_ "GenSigSendType" SG_ 2654552339 Tstr_SD_RIR_SensorBlkgClrCounter 1;
BA_ "GenSigSendType" SG_ 2654552339 Tstr_SD_RIL_DrvFreq 1;
BA_ "GenSigSendType" SG_ 2654552339 Tstr_SD_RIL_RingFreq 1;
BA_ "GenSigSendType" SG_ 2654552339 Tstr_SD_RIL_Ringtime_us 1;
BA_ "GenSigSendType" SG_ 2654552339 Tstr_SD_RIL_Unfiltered_DirDist1_ 1;
BA_ "GenSigSendType" SG_ 2654552339 Tstr_SD_RIL_Unfiltered_DirDist2_ 1;
BA_ "GenSigSendType" SG_ 2654552339 Tstr_SD_RIL_EchoHeight_adc 1;
BA_ "GenSigSendType" SG_ 2654552339 Tstr_SD_RIL_SensorBlkgSetCounter 1;
BA_ "GenSigSendType" SG_ 2654552339 Tstr_SD_RIL_SensorBlkgClrCounter 1;
BA_ "GenSigSendType" SG_ 2654552339 Tstr_SD_ROL_DrvFreq 1;
BA_ "GenSigSendType" SG_ 2654552339 Tstr_SD_ROL_RingFreq 1;
BA_ "GenSigSendType" SG_ 2654552339 Tstr_SD_ROL_Ringtime_us 1;
BA_ "GenSigSendType" SG_ 2654552339 Tstr_SD_ROL_Unfiltered_DirDist1_ 1;
BA_ "GenSigSendType" SG_ 2654552339 Tstr_SD_ROL_Unfiltered_DirDist2_ 1;
BA_ "GenSigSendType" SG_ 2654552339 Tstr_SD_ROL_EchoHeight_adc 1;
BA_ "GenSigSendType" SG_ 2654552339 Tstr_SD_ROL_SensorBlkgSetCounter 1;
BA_ "GenSigSendType" SG_ 2654552339 Tstr_SD_ROL_SensorBlkgClrCounter 1;
BA_ "GenSigSendType" SG_ 2654552339 Tstr_SD_RSL_DrvFreq 1;
BA_ "GenSigSendType" SG_ 2654552339 Tstr_SD_RSL_RingFreq 1;
BA_ "GenSigSendType" SG_ 2654552339 Tstr_SD_RSL_Ringtime_us 1;
BA_ "GenSigSendType" SG_ 2654552339 Tstr_SD_RSL_Unfiltered_DirDist1_ 1;
BA_ "GenSigSendType" SG_ 2654552339 Tstr_SD_RSL_Unfiltered_DirDist2_ 1;
BA_ "GenSigSendType" SG_ 2654552339 Tstr_SD_RSL_EchoHeight_adc 1;
BA_ "GenSigSendType" SG_ 2654552339 Tstr_SD_RSL_SensorBlkgSetCounter 1;
BA_ "GenSigSendType" SG_ 2654552339 Tstr_SD_RSL_SensorBlkgClrCounter 1;
BA_ "GenSigSendType" SG_ 2654552214 FiringSnr_TimeStamp 1;
BA_ "GenSigSendType" SG_ 2654552214 Firing_Sensor 1;
BA_ "GenSigSendType" SG_ 2654552213 FiringMode_TimeStamp 1;
BA_ "GenSigSendType" SG_ 2654552213 Firing_Mode_Seq 1;
BA_ "GenSigSendType" SG_ 2654814209 BOR_CommUnknown 1;
BA_ "GenSigSendType" SG_ 2654814209 AOR_CommUnknown 1;
BA_ "GenSigSendType" SG_ 2654814209 BOL_CommUnknown 1;
BA_ "GenSigSendType" SG_ 2654814209 AOL_CommUnknown 1;
BA_ "GenSigSendType" SG_ 2654814209 RSL_CommUnknown 1;
BA_ "GenSigSendType" SG_ 2654814209 ROL_CommUnknown 1;
BA_ "GenSigSendType" SG_ 2654814209 RIL_CommUnknown 1;
BA_ "GenSigSendType" SG_ 2654814209 RIR_CommUnknown 1;
BA_ "GenSigSendType" SG_ 2654814209 ROR_CommUnknown 1;
BA_ "GenSigSendType" SG_ 2654814209 RSR_CommUnknown 1;
BA_ "GenSigSendType" SG_ 2654814209 FSL_CommUnknown 1;
BA_ "GenSigSendType" SG_ 2654814209 FOL_CommUnknown 1;
BA_ "GenSigSendType" SG_ 2654814209 FIL_CommUnknown 1;
BA_ "GenSigSendType" SG_ 2654814209 FIR_CommUnknown 1;
BA_ "GenSigSendType" SG_ 2654814209 FOR_CommUnknown 1;
BA_ "GenSigSendType" SG_ 2654814209 FSR_CommUnknown 1;
BA_ "GenSigSendType" SG_ 2654814209 BOR_hardware_Fault 1;
BA_ "GenSigSendType" SG_ 2654814209 AOR_hardware_Fault 1;
BA_ "GenSigSendType" SG_ 2654814209 BOL_hardware_Fault 1;
BA_ "GenSigSendType" SG_ 2654814209 AOL_hardware_Fault 1;
BA_ "GenSigSendType" SG_ 2654814209 RSL_hardware_Fault 1;
BA_ "GenSigSendType" SG_ 2654814209 ROL_hardware_Fault 1;
BA_ "GenSigSendType" SG_ 2654814209 RIL_hardware_Fault 1;
BA_ "GenSigSendType" SG_ 2654814209 RIR_hardware_Fault 1;
BA_ "GenSigSendType" SG_ 2654814209 ROR_hardware_Fault 1;
BA_ "GenSigSendType" SG_ 2654814209 RSR_hardware_Fault 1;
BA_ "GenSigSendType" SG_ 2654814209 FSL_hardware_Fault 1;
BA_ "GenSigSendType" SG_ 2654814209 FOL_hardware_Fault 1;
BA_ "GenSigSendType" SG_ 2654814209 FIL_hardware_Fault 1;
BA_ "GenSigSendType" SG_ 2654814209 FIR_hardware_Fault 1;
BA_ "GenSigSendType" SG_ 2654814209 FOR_hardware_Fault 1;
BA_ "GenSigSendType" SG_ 2654814209 FSR_hardware_Fault 1;
BA_ "GenSigSendType" SG_ 2654814209 FIR_comm_Fault 1;
BA_ "GenSigSendType" SG_ 2654814209 BOR_comm_Fault 1;
BA_ "GenSigSendType" SG_ 2654814209 AOR_comm_Fault 1;
BA_ "GenSigSendType" SG_ 2654814209 BOL_comm_Fault 1;
BA_ "GenSigSendType" SG_ 2654814209 AOL_comm_Fault 1;
BA_ "GenSigSendType" SG_ 2654814209 RSL_comm_Fault 1;
BA_ "GenSigSendType" SG_ 2654814209 ROL_comm_Fault 1;
BA_ "GenSigSendType" SG_ 2654814209 RIL_comm_Fault 1;
BA_ "GenSigSendType" SG_ 2654814209 RIR_comm_Fault 1;
BA_ "GenSigSendType" SG_ 2654814209 ROR_comm_Fault 1;
BA_ "GenSigSendType" SG_ 2654814209 RSR_comm_Fault 1;
BA_ "GenSigSendType" SG_ 2654814209 FSL_comm_Fault 1;
BA_ "GenSigSendType" SG_ 2654814209 FOL_comm_Fault 1;
BA_ "GenSigSendType" SG_ 2654814209 FIL_comm_Fault 1;
BA_ "GenSigSendType" SG_ 2654814209 FOR_comm_Fault 1;
BA_ "GenSigSendType" SG_ 2654814209 FSR_comm_Fault 1;
BA_ "GenSigSendType" SG_ 2654814209 RSR_overTemp_Fault 1;
BA_ "GenSigSendType" SG_ 2654814209 RSL_overTemp_Fault 1;
BA_ "GenSigSendType" SG_ 2654814209 ROR_overTemp_Fault 1;
BA_ "GenSigSendType" SG_ 2654814209 ROL_overTemp_Fault 1;
BA_ "GenSigSendType" SG_ 2654814209 RIR_overTemp_Fault 1;
BA_ "GenSigSendType" SG_ 2654814209 RIL_overTemp_Fault 1;
BA_ "GenSigSendType" SG_ 2654814209 FSL_overTemp_Fault 1;
BA_ "GenSigSendType" SG_ 2654814209 FOL_overTemp_Fault 1;
BA_ "GenSigSendType" SG_ 2654814209 FIR_overTemp_Fault 1;
BA_ "GenSigSendType" SG_ 2654814209 FIL_overTemp_Fault 1;
BA_ "GenSigSendType" SG_ 2654814209 BOR_overTemp_Fault 1;
BA_ "GenSigSendType" SG_ 2654814209 BOL_overTemp_Fault 1;
BA_ "GenSigSendType" SG_ 2654814209 AOR_overTemp_Fault 1;
BA_ "GenSigSendType" SG_ 2654814209 AOL_overTemp_Fault 1;
BA_ "GenSigSendType" SG_ 2654814209 FOR_overTemp_Fault 1;
BA_ "GenSigSendType" SG_ 2654814209 FSR_overTemp_Fault 1;
BA_ "GenSigSendType" SG_ 2654552212 Point_Map_Cruising_Age_94 1;
BA_ "GenSigSendType" SG_ 2654552212 Point_Map_Cruising_Age_93 1;
BA_ "GenSigSendType" SG_ 2654552212 Point_Map_Cruising_Age_95 1;
BA_ "GenSigSendType" SG_ 2654552212 Point_Map_Cruising_Age_92 1;
BA_ "GenSigSendType" SG_ 2654552212 Point_Map_Cruising_Age_91 1;
BA_ "GenSigSendType" SG_ 2654552212 Point_Map_Cruising_Age_90 1;
BA_ "GenSigSendType" SG_ 2654552212 Point_Map_Cruising_Age_89 1;
BA_ "GenSigSendType" SG_ 2654552212 Point_Map_Cruising_Age_88 1;
BA_ "GenSigSendType" SG_ 2654552212 Point_Map_Reserved_94 1;
BA_ "GenSigSendType" SG_ 2654552212 Point_Map_Age_94 1;
BA_ "GenSigSendType" SG_ 2654552212 Point_Map_Confidence_94 1;
BA_ "GenSigSendType" SG_ 2654552212 Point_Map_Height_94 1;
BA_ "GenSigSendType" SG_ 2654552212 Point_Map_Y_94 1;
BA_ "GenSigSendType" SG_ 2654552212 Point_Map_X_94 1;
BA_ "GenSigSendType" SG_ 2654552212 Point_Map_Reserved_93 1;
BA_ "GenSigSendType" SG_ 2654552212 Point_Map_Age_93 1;
BA_ "GenSigSendType" SG_ 2654552212 Point_Map_Confidence_93 1;
BA_ "GenSigSendType" SG_ 2654552212 Point_Map_Height_93 1;
BA_ "GenSigSendType" SG_ 2654552212 Point_Map_Y_93 1;
BA_ "GenSigSendType" SG_ 2654552212 Point_Map_X_93 1;
BA_ "GenSigSendType" SG_ 2654552212 Point_Map_Reserved_92 1;
BA_ "GenSigSendType" SG_ 2654552212 Point_Map_Age_92 1;
BA_ "GenSigSendType" SG_ 2654552212 Point_Map_Confidence_92 1;
BA_ "GenSigSendType" SG_ 2654552212 Point_Map_Height_92 1;
BA_ "GenSigSendType" SG_ 2654552212 Point_Map_Y_92 1;
BA_ "GenSigSendType" SG_ 2654552212 Point_Map_X_92 1;
BA_ "GenSigSendType" SG_ 2654552212 Point_Map_Reserved_91 1;
BA_ "GenSigSendType" SG_ 2654552212 Point_Map_Age_91 1;
BA_ "GenSigSendType" SG_ 2654552212 Point_Map_Confidence_91 1;
BA_ "GenSigSendType" SG_ 2654552212 Point_Map_Height_91 1;
BA_ "GenSigSendType" SG_ 2654552212 Point_Map_Y_91 1;
BA_ "GenSigSendType" SG_ 2654552212 Point_Map_X_91 1;
BA_ "GenSigSendType" SG_ 2654552212 Point_Map_Reserved_90 1;
BA_ "GenSigSendType" SG_ 2654552212 Point_Map_Age_90 1;
BA_ "GenSigSendType" SG_ 2654552212 Point_Map_Confidence_90 1;
BA_ "GenSigSendType" SG_ 2654552212 Point_Map_Height_90 1;
BA_ "GenSigSendType" SG_ 2654552212 Point_Map_Y_90 1;
BA_ "GenSigSendType" SG_ 2654552212 Point_Map_X_90 1;
BA_ "GenSigSendType" SG_ 2654552212 Point_Map_Reserved_89 1;
BA_ "GenSigSendType" SG_ 2654552212 Point_Map_Age_89 1;
BA_ "GenSigSendType" SG_ 2654552212 Point_Map_Confidence_89 1;
BA_ "GenSigSendType" SG_ 2654552212 Point_Map_Height_89 1;
BA_ "GenSigSendType" SG_ 2654552212 Point_Map_Y_89 1;
BA_ "GenSigSendType" SG_ 2654552212 Point_Map_X_89 1;
BA_ "GenSigSendType" SG_ 2654552212 Point_Map_Reserved_88 1;
BA_ "GenSigSendType" SG_ 2654552212 Point_Map_Age_88 1;
BA_ "GenSigSendType" SG_ 2654552212 Point_Map_Confidence_88 1;
BA_ "GenSigSendType" SG_ 2654552212 Point_Map_Height_88 1;
BA_ "GenSigSendType" SG_ 2654552212 Point_Map_Y_88 1;
BA_ "GenSigSendType" SG_ 2654552212 Point_Map_X_88 1;
BA_ "GenSigSendType" SG_ 2654552212 Point_Map_Reserved_95 1;
BA_ "GenSigSendType" SG_ 2654552212 Point_Map_Age_95 1;
BA_ "GenSigSendType" SG_ 2654552212 Point_Map_Confidence_95 1;
BA_ "GenSigSendType" SG_ 2654552212 Point_Map_Y_95 1;
BA_ "GenSigSendType" SG_ 2654552212 Point_Map_Height_95 1;
BA_ "GenSigSendType" SG_ 2654552212 Point_Map_X_95 1;
BA_ "GenSigSendType" SG_ 2654552211 Point_Map_Cruising_Age_87 1;
BA_ "GenSigSendType" SG_ 2654552211 Point_Map_Cruising_Age_86 1;
BA_ "GenSigSendType" SG_ 2654552211 Point_Map_Cruising_Age_85 1;
BA_ "GenSigSendType" SG_ 2654552211 Point_Map_Cruising_Age_84 1;
BA_ "GenSigSendType" SG_ 2654552211 Point_Map_Cruising_Age_83 1;
BA_ "GenSigSendType" SG_ 2654552211 Point_Map_Cruising_Age_82 1;
BA_ "GenSigSendType" SG_ 2654552211 Point_Map_Cruising_Age_81 1;
BA_ "GenSigSendType" SG_ 2654552211 Point_Map_Cruising_Age_80 1;
BA_ "GenSigSendType" SG_ 2654552211 Point_Map_Reserved_87 1;
BA_ "GenSigSendType" SG_ 2654552211 Point_Map_Age_87 1;
BA_ "GenSigSendType" SG_ 2654552211 Point_Map_Confidence_87 1;
BA_ "GenSigSendType" SG_ 2654552211 Point_Map_Height_87 1;
BA_ "GenSigSendType" SG_ 2654552211 Point_Map_Y_87 1;
BA_ "GenSigSendType" SG_ 2654552211 Point_Map_X_87 1;
BA_ "GenSigSendType" SG_ 2654552211 Point_Map_Reserved_86 1;
BA_ "GenSigSendType" SG_ 2654552211 Point_Map_Age_86 1;
BA_ "GenSigSendType" SG_ 2654552211 Point_Map_Confidence_86 1;
BA_ "GenSigSendType" SG_ 2654552211 Point_Map_Height_86 1;
BA_ "GenSigSendType" SG_ 2654552211 Point_Map_Y_86 1;
BA_ "GenSigSendType" SG_ 2654552211 Point_Map_X_86 1;
BA_ "GenSigSendType" SG_ 2654552211 Point_Map_Reserved_85 1;
BA_ "GenSigSendType" SG_ 2654552211 Point_Map_Age_85 1;
BA_ "GenSigSendType" SG_ 2654552211 Point_Map_Confidence_85 1;
BA_ "GenSigSendType" SG_ 2654552211 Point_Map_Height_85 1;
BA_ "GenSigSendType" SG_ 2654552211 Point_Map_Y_85 1;
BA_ "GenSigSendType" SG_ 2654552211 Point_Map_X_85 1;
BA_ "GenSigSendType" SG_ 2654552211 Point_Map_Reserved_84 1;
BA_ "GenSigSendType" SG_ 2654552211 Point_Map_Age_84 1;
BA_ "GenSigSendType" SG_ 2654552211 Point_Map_Confidence_84 1;
BA_ "GenSigSendType" SG_ 2654552211 Point_Map_Height_84 1;
BA_ "GenSigSendType" SG_ 2654552211 Point_Map_Y_84 1;
BA_ "GenSigSendType" SG_ 2654552211 Point_Map_X_84 1;
BA_ "GenSigSendType" SG_ 2654552211 Point_Map_Reserved_83 1;
BA_ "GenSigSendType" SG_ 2654552211 Point_Map_Age_83 1;
BA_ "GenSigSendType" SG_ 2654552211 Point_Map_Confidence_83 1;
BA_ "GenSigSendType" SG_ 2654552211 Point_Map_Height_83 1;
BA_ "GenSigSendType" SG_ 2654552211 Point_Map_Y_83 1;
BA_ "GenSigSendType" SG_ 2654552211 Point_Map_X_83 1;
BA_ "GenSigSendType" SG_ 2654552211 Point_Map_Reserved_82 1;
BA_ "GenSigSendType" SG_ 2654552211 Point_Map_Age_82 1;
BA_ "GenSigSendType" SG_ 2654552211 Point_Map_Confidence_82 1;
BA_ "GenSigSendType" SG_ 2654552211 Point_Map_Height_82 1;
BA_ "GenSigSendType" SG_ 2654552211 Point_Map_Y_82 1;
BA_ "GenSigSendType" SG_ 2654552211 Point_Map_X_82 1;
BA_ "GenSigSendType" SG_ 2654552211 Point_Map_Reserved_81 1;
BA_ "GenSigSendType" SG_ 2654552211 Point_Map_Age_81 1;
BA_ "GenSigSendType" SG_ 2654552211 Point_Map_Confidence_81 1;
BA_ "GenSigSendType" SG_ 2654552211 Point_Map_Height_81 1;
BA_ "GenSigSendType" SG_ 2654552211 Point_Map_Y_81 1;
BA_ "GenSigSendType" SG_ 2654552211 Point_Map_X_81 1;
BA_ "GenSigSendType" SG_ 2654552211 Point_Map_Reserved_80 1;
BA_ "GenSigSendType" SG_ 2654552211 Point_Map_Age_80 1;
BA_ "GenSigSendType" SG_ 2654552211 Point_Map_Confidence_80 1;
BA_ "GenSigSendType" SG_ 2654552211 Point_Map_Height_80 1;
BA_ "GenSigSendType" SG_ 2654552211 Point_Map_Y_80 1;
BA_ "GenSigSendType" SG_ 2654552211 Point_Map_X_80 1;
BA_ "GenSigSendType" SG_ 2654552210 Point_Map_Cruising_Age_79 1;
BA_ "GenSigSendType" SG_ 2654552210 Point_Map_Cruising_Age_78 1;
BA_ "GenSigSendType" SG_ 2654552210 Point_Map_Cruising_Age_77 1;
BA_ "GenSigSendType" SG_ 2654552210 Point_Map_Cruising_Age_76 1;
BA_ "GenSigSendType" SG_ 2654552210 Point_Map_Cruising_Age_75 1;
BA_ "GenSigSendType" SG_ 2654552210 Point_Map_Cruising_Age_74 1;
BA_ "GenSigSendType" SG_ 2654552210 Point_Map_Cruising_Age_73 1;
BA_ "GenSigSendType" SG_ 2654552210 Point_Map_Cruising_Age_72 1;
BA_ "GenSigSendType" SG_ 2654552210 Point_Map_Reserved_79 1;
BA_ "GenSigSendType" SG_ 2654552210 Point_Map_Age_79 1;
BA_ "GenSigSendType" SG_ 2654552210 Point_Map_Confidence_79 1;
BA_ "GenSigSendType" SG_ 2654552210 Point_Map_Height_79 1;
BA_ "GenSigSendType" SG_ 2654552210 Point_Map_Y_79 1;
BA_ "GenSigSendType" SG_ 2654552210 Point_Map_X_79 1;
BA_ "GenSigSendType" SG_ 2654552210 Point_Map_Reserved_78 1;
BA_ "GenSigSendType" SG_ 2654552210 Point_Map_Age_78 1;
BA_ "GenSigSendType" SG_ 2654552210 Point_Map_Confidence_78 1;
BA_ "GenSigSendType" SG_ 2654552210 Point_Map_Height_78 1;
BA_ "GenSigSendType" SG_ 2654552210 Point_Map_Y_78 1;
BA_ "GenSigSendType" SG_ 2654552210 Point_Map_X_78 1;
BA_ "GenSigSendType" SG_ 2654552210 Point_Map_Reserved_77 1;
BA_ "GenSigSendType" SG_ 2654552210 Point_Map_Age_77 1;
BA_ "GenSigSendType" SG_ 2654552210 Point_Map_Confidence_77 1;
BA_ "GenSigSendType" SG_ 2654552210 Point_Map_Height_77 1;
BA_ "GenSigSendType" SG_ 2654552210 Point_Map_Y_77 1;
BA_ "GenSigSendType" SG_ 2654552210 Point_Map_X_77 1;
BA_ "GenSigSendType" SG_ 2654552210 Point_Map_Reserved_76 1;
BA_ "GenSigSendType" SG_ 2654552210 Point_Map_Age_76 1;
BA_ "GenSigSendType" SG_ 2654552210 Point_Map_Confidence_76 1;
BA_ "GenSigSendType" SG_ 2654552210 Point_Map_Height_76 1;
BA_ "GenSigSendType" SG_ 2654552210 Point_Map_Y_76 1;
BA_ "GenSigSendType" SG_ 2654552210 Point_Map_X_76 1;
BA_ "GenSigSendType" SG_ 2654552210 Point_Map_Reserved_75 1;
BA_ "GenSigSendType" SG_ 2654552210 Point_Map_Age_75 1;
BA_ "GenSigSendType" SG_ 2654552210 Point_Map_Confidence_75 1;
BA_ "GenSigSendType" SG_ 2654552210 Point_Map_Height_75 1;
BA_ "GenSigSendType" SG_ 2654552210 Point_Map_Y_75 1;
BA_ "GenSigSendType" SG_ 2654552210 Point_Map_X_75 1;
BA_ "GenSigSendType" SG_ 2654552210 Point_Map_Reserved_74 1;
BA_ "GenSigSendType" SG_ 2654552210 Point_Map_Age_74 1;
BA_ "GenSigSendType" SG_ 2654552210 Point_Map_Confidence_74 1;
BA_ "GenSigSendType" SG_ 2654552210 Point_Map_Height_74 1;
BA_ "GenSigSendType" SG_ 2654552210 Point_Map_Y_74 1;
BA_ "GenSigSendType" SG_ 2654552210 Point_Map_X_74 1;
BA_ "GenSigSendType" SG_ 2654552210 Point_Map_Reserved_73 1;
BA_ "GenSigSendType" SG_ 2654552210 Point_Map_Age_73 1;
BA_ "GenSigSendType" SG_ 2654552210 Point_Map_Confidence_73 1;
BA_ "GenSigSendType" SG_ 2654552210 Point_Map_Height_73 1;
BA_ "GenSigSendType" SG_ 2654552210 Point_Map_Y_73 1;
BA_ "GenSigSendType" SG_ 2654552210 Point_Map_X_73 1;
BA_ "GenSigSendType" SG_ 2654552210 Point_Map_Reserved_72 1;
BA_ "GenSigSendType" SG_ 2654552210 Point_Map_Age_72 1;
BA_ "GenSigSendType" SG_ 2654552210 Point_Map_Confidence_72 1;
BA_ "GenSigSendType" SG_ 2654552210 Point_Map_Height_72 1;
BA_ "GenSigSendType" SG_ 2654552210 Point_Map_Y_72 1;
BA_ "GenSigSendType" SG_ 2654552210 Point_Map_X_72 1;
BA_ "GenSigSendType" SG_ 2654552209 Point_Map_Cruising_Age_70 1;
BA_ "GenSigSendType" SG_ 2654552209 Point_Map_Cruising_Age_71 1;
BA_ "GenSigSendType" SG_ 2654552209 Point_Map_Cruising_Age_69 1;
BA_ "GenSigSendType" SG_ 2654552209 Point_Map_Cruising_Age_68 1;
BA_ "GenSigSendType" SG_ 2654552209 Point_Map_Cruising_Age_67 1;
BA_ "GenSigSendType" SG_ 2654552209 Point_Map_Cruising_Age_66 1;
BA_ "GenSigSendType" SG_ 2654552209 Point_Map_Cruising_Age_65 1;
BA_ "GenSigSendType" SG_ 2654552209 Point_Map_Cruising_Age_64 1;
BA_ "GenSigSendType" SG_ 2654552209 Point_Map_Reserved_71 1;
BA_ "GenSigSendType" SG_ 2654552209 Point_Map_Height_71 1;
BA_ "GenSigSendType" SG_ 2654552209 Point_Map_Age_71 1;
BA_ "GenSigSendType" SG_ 2654552209 Point_Map_Confidence_71 1;
BA_ "GenSigSendType" SG_ 2654552209 Point_Map_Y_71 1;
BA_ "GenSigSendType" SG_ 2654552209 Point_Map_X_71 1;
BA_ "GenSigSendType" SG_ 2654552209 Point_Map_Reserved_70 1;
BA_ "GenSigSendType" SG_ 2654552209 Point_Map_Age_70 1;
BA_ "GenSigSendType" SG_ 2654552209 Point_Map_Confidence_70 1;
BA_ "GenSigSendType" SG_ 2654552209 Point_Map_Height_70 1;
BA_ "GenSigSendType" SG_ 2654552209 Point_Map_Y_70 1;
BA_ "GenSigSendType" SG_ 2654552209 Point_Map_X_70 1;
BA_ "GenSigSendType" SG_ 2654552209 Point_Map_Reserved_69 1;
BA_ "GenSigSendType" SG_ 2654552209 Point_Map_Age_69 1;
BA_ "GenSigSendType" SG_ 2654552209 Point_Map_Confidence_69 1;
BA_ "GenSigSendType" SG_ 2654552209 Point_Map_Height_69 1;
BA_ "GenSigSendType" SG_ 2654552209 Point_Map_Y_69 1;
BA_ "GenSigSendType" SG_ 2654552209 Point_Map_X_69 1;
BA_ "GenSigSendType" SG_ 2654552209 Point_Map_Reserved_68 1;
BA_ "GenSigSendType" SG_ 2654552209 Point_Map_Age_68 1;
BA_ "GenSigSendType" SG_ 2654552209 Point_Map_Confidence_68 1;
BA_ "GenSigSendType" SG_ 2654552209 Point_Map_Height_68 1;
BA_ "GenSigSendType" SG_ 2654552209 Point_Map_Y_68 1;
BA_ "GenSigSendType" SG_ 2654552209 Point_Map_X_68 1;
BA_ "GenSigSendType" SG_ 2654552209 Point_Map_Reserved_67 1;
BA_ "GenSigSendType" SG_ 2654552209 Point_Map_Age_67 1;
BA_ "GenSigSendType" SG_ 2654552209 Point_Map_Confidence_67 1;
BA_ "GenSigSendType" SG_ 2654552209 Point_Map_Height_67 1;
BA_ "GenSigSendType" SG_ 2654552209 Point_Map_Y_67 1;
BA_ "GenSigSendType" SG_ 2654552209 Point_Map_X_67 1;
BA_ "GenSigSendType" SG_ 2654552209 Point_Map_Reserved_66 1;
BA_ "GenSigSendType" SG_ 2654552209 Point_Map_Age_66 1;
BA_ "GenSigSendType" SG_ 2654552209 Point_Map_Confidence_66 1;
BA_ "GenSigSendType" SG_ 2654552209 Point_Map_Height_66 1;
BA_ "GenSigSendType" SG_ 2654552209 Point_Map_Y_66 1;
BA_ "GenSigSendType" SG_ 2654552209 Point_Map_X_66 1;
BA_ "GenSigSendType" SG_ 2654552209 Point_Map_Reserved_65 1;
BA_ "GenSigSendType" SG_ 2654552209 Point_Map_Age_65 1;
BA_ "GenSigSendType" SG_ 2654552209 Point_Map_Confidence_65 1;
BA_ "GenSigSendType" SG_ 2654552209 Point_Map_Height_65 1;
BA_ "GenSigSendType" SG_ 2654552209 Point_Map_Y_65 1;
BA_ "GenSigSendType" SG_ 2654552209 Point_Map_X_65 1;
BA_ "GenSigSendType" SG_ 2654552209 Point_Map_Reserved_64 1;
BA_ "GenSigSendType" SG_ 2654552209 Point_Map_Age_64 1;
BA_ "GenSigSendType" SG_ 2654552209 Point_Map_Confidence_64 1;
BA_ "GenSigSendType" SG_ 2654552209 Point_Map_Height_64 1;
BA_ "GenSigSendType" SG_ 2654552209 Point_Map_Y_64 1;
BA_ "GenSigSendType" SG_ 2654552209 Point_Map_X_64 1;
BA_ "GenSigSendType" SG_ 2654552208 Point_Map_Cruising_Age_63 1;
BA_ "GenSigSendType" SG_ 2654552208 Point_Map_Cruising_Age_62 1;
BA_ "GenSigSendType" SG_ 2654552208 Point_Map_Cruising_Age_61 1;
BA_ "GenSigSendType" SG_ 2654552208 Point_Map_Cruising_Age_60 1;
BA_ "GenSigSendType" SG_ 2654552208 Point_Map_Cruising_Age_59 1;
BA_ "GenSigSendType" SG_ 2654552208 Point_Map_Cruising_Age_58 1;
BA_ "GenSigSendType" SG_ 2654552208 Point_Map_Cruising_Age_57 1;
BA_ "GenSigSendType" SG_ 2654552208 Point_Map_Cruising_Age_56 1;
BA_ "GenSigSendType" SG_ 2654552208 Point_Map_Reserved_62 1;
BA_ "GenSigSendType" SG_ 2654552208 Point_Map_Age_62 1;
BA_ "GenSigSendType" SG_ 2654552208 Point_Map_Confidence_62 1;
BA_ "GenSigSendType" SG_ 2654552208 Point_Map_Height_62 1;
BA_ "GenSigSendType" SG_ 2654552208 Point_Map_Y_62 1;
BA_ "GenSigSendType" SG_ 2654552208 Point_Map_X_62 1;
BA_ "GenSigSendType" SG_ 2654552208 Point_Map_Reserved_61 1;
BA_ "GenSigSendType" SG_ 2654552208 Point_Map_Age_61 1;
BA_ "GenSigSendType" SG_ 2654552208 Point_Map_Confidence_61 1;
BA_ "GenSigSendType" SG_ 2654552208 Point_Map_Height_61 1;
BA_ "GenSigSendType" SG_ 2654552208 Point_Map_Y_61 1;
BA_ "GenSigSendType" SG_ 2654552208 Point_Map_X_61 1;
BA_ "GenSigSendType" SG_ 2654552208 Point_Map_Reserved_60 1;
BA_ "GenSigSendType" SG_ 2654552208 Point_Map_Confidence_60 1;
BA_ "GenSigSendType" SG_ 2654552208 Point_Map_Height_60 1;
BA_ "GenSigSendType" SG_ 2654552208 Point_Map_Age_60 1;
BA_ "GenSigSendType" SG_ 2654552208 Point_Map_Y_60 1;
BA_ "GenSigSendType" SG_ 2654552208 Point_Map_X_60 1;
BA_ "GenSigSendType" SG_ 2654552208 Point_Map_Reserved_59 1;
BA_ "GenSigSendType" SG_ 2654552208 Point_Map_Age_59 1;
BA_ "GenSigSendType" SG_ 2654552208 Point_Map_Confidence_59 1;
BA_ "GenSigSendType" SG_ 2654552208 Point_Map_Height_59 1;
BA_ "GenSigSendType" SG_ 2654552208 Point_Map_Y_59 1;
BA_ "GenSigSendType" SG_ 2654552208 Point_Map_X_59 1;
BA_ "GenSigSendType" SG_ 2654552208 Point_Map_Reserved_58 1;
BA_ "GenSigSendType" SG_ 2654552208 Point_Map_Age_58 1;
BA_ "GenSigSendType" SG_ 2654552208 Point_Map_Confidence_58 1;
BA_ "GenSigSendType" SG_ 2654552208 Point_Map_Height_58 1;
BA_ "GenSigSendType" SG_ 2654552208 Point_Map_Y_58 1;
BA_ "GenSigSendType" SG_ 2654552208 Point_Map_X_58 1;
BA_ "GenSigSendType" SG_ 2654552208 Point_Map_Reserved_57 1;
BA_ "GenSigSendType" SG_ 2654552208 Point_Map_Age_57 1;
BA_ "GenSigSendType" SG_ 2654552208 Point_Map_Confidence_57 1;
BA_ "GenSigSendType" SG_ 2654552208 Point_Map_Height_57 1;
BA_ "GenSigSendType" SG_ 2654552208 Point_Map_Y_57 1;
BA_ "GenSigSendType" SG_ 2654552208 Point_Map_X_57 1;
BA_ "GenSigSendType" SG_ 2654552208 Point_Map_Reserved_56 1;
BA_ "GenSigSendType" SG_ 2654552208 Point_Map_Age_56 1;
BA_ "GenSigSendType" SG_ 2654552208 Point_Map_Confidence_56 1;
BA_ "GenSigSendType" SG_ 2654552208 Point_Map_Height_56 1;
BA_ "GenSigSendType" SG_ 2654552208 Point_Map_Y_56 1;
BA_ "GenSigSendType" SG_ 2654552208 Point_Map_X_56 1;
BA_ "GenSigSendType" SG_ 2654552208 Point_Map_Reserved_63 1;
BA_ "GenSigSendType" SG_ 2654552208 Point_Map_Age_63 1;
BA_ "GenSigSendType" SG_ 2654552208 Point_Map_Confidence_63 1;
BA_ "GenSigSendType" SG_ 2654552208 Point_Map_Height_63 1;
BA_ "GenSigSendType" SG_ 2654552208 Point_Map_Y_63 1;
BA_ "GenSigSendType" SG_ 2654552208 Point_Map_X_63 1;
BA_ "GenSigSendType" SG_ 2654552201 Point_Map_Cruising_Age_54 1;
BA_ "GenSigSendType" SG_ 2654552201 Point_Map_Cruising_Age_55 1;
BA_ "GenSigSendType" SG_ 2654552201 Point_Map_Cruising_Age_53 1;
BA_ "GenSigSendType" SG_ 2654552201 Point_Map_Cruising_Age_52 1;
BA_ "GenSigSendType" SG_ 2654552201 Point_Map_Cruising_Age_51 1;
BA_ "GenSigSendType" SG_ 2654552201 Point_Map_Cruising_Age_50 1;
BA_ "GenSigSendType" SG_ 2654552201 Point_Map_Cruising_Age_49 1;
BA_ "GenSigSendType" SG_ 2654552201 Point_Map_Cruising_Age_48 1;
BA_ "GenSigSendType" SG_ 2654552201 Point_Map_Reserved_53 1;
BA_ "GenSigSendType" SG_ 2654552201 Point_Map_Age_53 1;
BA_ "GenSigSendType" SG_ 2654552201 Point_Map_Confidence_53 1;
BA_ "GenSigSendType" SG_ 2654552201 Point_Map_Height_53 1;
BA_ "GenSigSendType" SG_ 2654552201 Point_Map_Y_53 1;
BA_ "GenSigSendType" SG_ 2654552201 Point_Map_X_53 1;
BA_ "GenSigSendType" SG_ 2654552201 Point_Map_Reserved_52 1;
BA_ "GenSigSendType" SG_ 2654552201 Point_Map_Age_52 1;
BA_ "GenSigSendType" SG_ 2654552201 Point_Map_Confidence_52 1;
BA_ "GenSigSendType" SG_ 2654552201 Point_Map_Height_52 1;
BA_ "GenSigSendType" SG_ 2654552201 Point_Map_Y_52 1;
BA_ "GenSigSendType" SG_ 2654552201 Point_Map_X_52 1;
BA_ "GenSigSendType" SG_ 2654552201 Point_Map_Reserved_51 1;
BA_ "GenSigSendType" SG_ 2654552201 Point_Map_Age_51 1;
BA_ "GenSigSendType" SG_ 2654552201 Point_Map_Confidence_51 1;
BA_ "GenSigSendType" SG_ 2654552201 Point_Map_Height_51 1;
BA_ "GenSigSendType" SG_ 2654552201 Point_Map_Y_51 1;
BA_ "GenSigSendType" SG_ 2654552201 Point_Map_X_51 1;
BA_ "GenSigSendType" SG_ 2654552201 Point_Map_Reserved_50 1;
BA_ "GenSigSendType" SG_ 2654552201 Point_Map_Age_50 1;
BA_ "GenSigSendType" SG_ 2654552201 Point_Map_Confidence_50 1;
BA_ "GenSigSendType" SG_ 2654552201 Point_Map_Height_50 1;
BA_ "GenSigSendType" SG_ 2654552201 Point_Map_Y_50 1;
BA_ "GenSigSendType" SG_ 2654552201 Point_Map_X_50 1;
BA_ "GenSigSendType" SG_ 2654552201 Point_Map_Reserved_49 1;
BA_ "GenSigSendType" SG_ 2654552201 Point_Map_Age_49 1;
BA_ "GenSigSendType" SG_ 2654552201 Point_Map_Confidence_49 1;
BA_ "GenSigSendType" SG_ 2654552201 Point_Map_Height_49 1;
BA_ "GenSigSendType" SG_ 2654552201 Point_Map_Y_49 1;
BA_ "GenSigSendType" SG_ 2654552201 Point_Map_X_49 1;
BA_ "GenSigSendType" SG_ 2654552201 Point_Map_Reserved_48 1;
BA_ "GenSigSendType" SG_ 2654552201 Point_Map_Age_48 1;
BA_ "GenSigSendType" SG_ 2654552201 Point_Map_Confidence_48 1;
BA_ "GenSigSendType" SG_ 2654552201 Point_Map_Height_48 1;
BA_ "GenSigSendType" SG_ 2654552201 Point_Map_Y_48 1;
BA_ "GenSigSendType" SG_ 2654552201 Point_Map_X_48 1;
BA_ "GenSigSendType" SG_ 2654552201 Point_Map_Reserved_54 1;
BA_ "GenSigSendType" SG_ 2654552201 Point_Map_Reserved_55 1;
BA_ "GenSigSendType" SG_ 2654552201 Point_Map_Confidence_55 1;
BA_ "GenSigSendType" SG_ 2654552201 Point_Map_Age_55 1;
BA_ "GenSigSendType" SG_ 2654552201 Point_Map_Height_55 1;
BA_ "GenSigSendType" SG_ 2654552201 Point_Map_Y_55 1;
BA_ "GenSigSendType" SG_ 2654552201 Point_Map_X_55 1;
BA_ "GenSigSendType" SG_ 2654552201 Point_Map_Age_54 1;
BA_ "GenSigSendType" SG_ 2654552201 Point_Map_Confidence_54 1;
BA_ "GenSigSendType" SG_ 2654552201 Point_Map_Height_54 1;
BA_ "GenSigSendType" SG_ 2654552201 Point_Map_Y_54 1;
BA_ "GenSigSendType" SG_ 2654552201 Point_Map_X_54 1;
BA_ "GenSigSendType" SG_ 2654552200 Point_Map_Cruising_Age_47 1;
BA_ "GenSigSendType" SG_ 2654552200 Point_Map_Cruising_Age_46 1;
BA_ "GenSigSendType" SG_ 2654552200 Point_Map_Cruising_Age_45 1;
BA_ "GenSigSendType" SG_ 2654552200 Point_Map_Cruising_Age_44 1;
BA_ "GenSigSendType" SG_ 2654552200 Point_Map_Cruising_Age_43 1;
BA_ "GenSigSendType" SG_ 2654552200 Point_Map_Cruising_Age_42 1;
BA_ "GenSigSendType" SG_ 2654552200 Point_Map_Cruising_Age_41 1;
BA_ "GenSigSendType" SG_ 2654552200 Point_Map_Cruising_Age_40 1;
BA_ "GenSigSendType" SG_ 2654552200 Point_Map_Reserved_44 1;
BA_ "GenSigSendType" SG_ 2654552200 Point_Map_Age_44 1;
BA_ "GenSigSendType" SG_ 2654552200 Point_Map_Confidence_44 1;
BA_ "GenSigSendType" SG_ 2654552200 Point_Map_Height_44 1;
BA_ "GenSigSendType" SG_ 2654552200 Point_Map_Y_44 1;
BA_ "GenSigSendType" SG_ 2654552200 Point_Map_X_44 1;
BA_ "GenSigSendType" SG_ 2654552200 Point_Map_Reserved_43 1;
BA_ "GenSigSendType" SG_ 2654552200 Point_Map_Age_43 1;
BA_ "GenSigSendType" SG_ 2654552200 Point_Map_Confidence_43 1;
BA_ "GenSigSendType" SG_ 2654552200 Point_Map_Height_43 1;
BA_ "GenSigSendType" SG_ 2654552200 Point_Map_Y_43 1;
BA_ "GenSigSendType" SG_ 2654552200 Point_Map_X_43 1;
BA_ "GenSigSendType" SG_ 2654552200 Point_Map_Reserved_42 1;
BA_ "GenSigSendType" SG_ 2654552200 Point_Map_Age_42 1;
BA_ "GenSigSendType" SG_ 2654552200 Point_Map_Confidence_42 1;
BA_ "GenSigSendType" SG_ 2654552200 Point_Map_Height_42 1;
BA_ "GenSigSendType" SG_ 2654552200 Point_Map_Y_42 1;
BA_ "GenSigSendType" SG_ 2654552200 Point_Map_X_42 1;
BA_ "GenSigSendType" SG_ 2654552200 Point_Map_Reserved_41 1;
BA_ "GenSigSendType" SG_ 2654552200 Point_Map_Age_41 1;
BA_ "GenSigSendType" SG_ 2654552200 Point_Map_Confidence_41 1;
BA_ "GenSigSendType" SG_ 2654552200 Point_Map_Height_41 1;
BA_ "GenSigSendType" SG_ 2654552200 Point_Map_Y_41 1;
BA_ "GenSigSendType" SG_ 2654552200 Point_Map_X_41 1;
BA_ "GenSigSendType" SG_ 2654552200 Point_Map_Reserved_40 1;
BA_ "GenSigSendType" SG_ 2654552200 Point_Map_Age_40 1;
BA_ "GenSigSendType" SG_ 2654552200 Point_Map_Confidence_40 1;
BA_ "GenSigSendType" SG_ 2654552200 Point_Map_Height_40 1;
BA_ "GenSigSendType" SG_ 2654552200 Point_Map_Y_40 1;
BA_ "GenSigSendType" SG_ 2654552200 Point_Map_X_40 1;
BA_ "GenSigSendType" SG_ 2654552200 Point_Map_Reserved_47 1;
BA_ "GenSigSendType" SG_ 2654552200 Point_Map_Reserved_46 1;
BA_ "GenSigSendType" SG_ 2654552200 Point_Map_Reserved_45 1;
BA_ "GenSigSendType" SG_ 2654552200 Point_Map_Age_47 1;
BA_ "GenSigSendType" SG_ 2654552200 Point_Map_Confidence_47 1;
BA_ "GenSigSendType" SG_ 2654552200 Point_Map_Height_47 1;
BA_ "GenSigSendType" SG_ 2654552200 Point_Map_Y_47 1;
BA_ "GenSigSendType" SG_ 2654552200 Point_Map_X_47 1;
BA_ "GenSigSendType" SG_ 2654552200 Point_Map_Age_46 1;
BA_ "GenSigSendType" SG_ 2654552200 Point_Map_Confidence_46 1;
BA_ "GenSigSendType" SG_ 2654552200 Point_Map_Height_46 1;
BA_ "GenSigSendType" SG_ 2654552200 Point_Map_Y_46 1;
BA_ "GenSigSendType" SG_ 2654552200 Point_Map_X_46 1;
BA_ "GenSigSendType" SG_ 2654552200 Point_Map_Age_45 1;
BA_ "GenSigSendType" SG_ 2654552200 Point_Map_Confidence_45 1;
BA_ "GenSigSendType" SG_ 2654552200 Point_Map_Height_45 1;
BA_ "GenSigSendType" SG_ 2654552200 Point_Map_Y_45 1;
BA_ "GenSigSendType" SG_ 2654552200 Point_Map_X_45 1;
BA_ "GenSigSendType" SG_ 2654552199 Point_Map_Cruising_Age_38 1;
BA_ "GenSigSendType" SG_ 2654552199 Point_Map_Cruising_Age_39 1;
BA_ "GenSigSendType" SG_ 2654552199 Point_Map_Cruising_Age_37 1;
BA_ "GenSigSendType" SG_ 2654552199 Point_Map_Cruising_Age_36 1;
BA_ "GenSigSendType" SG_ 2654552199 Point_Map_Cruising_Age_35 1;
BA_ "GenSigSendType" SG_ 2654552199 Point_Map_Cruising_Age_34 1;
BA_ "GenSigSendType" SG_ 2654552199 Point_Map_Cruising_Age_33 1;
BA_ "GenSigSendType" SG_ 2654552199 Point_Map_Cruising_Age_32 1;
BA_ "GenSigSendType" SG_ 2654552199 Point_Map_Reserved_35 1;
BA_ "GenSigSendType" SG_ 2654552199 Point_Map_Age_35 1;
BA_ "GenSigSendType" SG_ 2654552199 Point_Map_Confidence_35 1;
BA_ "GenSigSendType" SG_ 2654552199 Point_Map_Height_35 1;
BA_ "GenSigSendType" SG_ 2654552199 Point_Map_Y_35 1;
BA_ "GenSigSendType" SG_ 2654552199 Point_Map_X_35 1;
BA_ "GenSigSendType" SG_ 2654552199 Point_Map_Reserved_34 1;
BA_ "GenSigSendType" SG_ 2654552199 Point_Map_Age_34 1;
BA_ "GenSigSendType" SG_ 2654552199 Point_Map_Confidence_34 1;
BA_ "GenSigSendType" SG_ 2654552199 Point_Map_Height_34 1;
BA_ "GenSigSendType" SG_ 2654552199 Point_Map_Y_34 1;
BA_ "GenSigSendType" SG_ 2654552199 Point_Map_X_34 1;
BA_ "GenSigSendType" SG_ 2654552199 Point_Map_Reserved_33 1;
BA_ "GenSigSendType" SG_ 2654552199 Point_Map_Age_33 1;
BA_ "GenSigSendType" SG_ 2654552199 Point_Map_Confidence_33 1;
BA_ "GenSigSendType" SG_ 2654552199 Point_Map_Height_33 1;
BA_ "GenSigSendType" SG_ 2654552199 Point_Map_Y_33 1;
BA_ "GenSigSendType" SG_ 2654552199 Point_Map_X_33 1;
BA_ "GenSigSendType" SG_ 2654552199 Point_Map_Reserved_32 1;
BA_ "GenSigSendType" SG_ 2654552199 Point_Map_Age_32 1;
BA_ "GenSigSendType" SG_ 2654552199 Point_Map_Confidence_32 1;
BA_ "GenSigSendType" SG_ 2654552199 Point_Map_Height_32 1;
BA_ "GenSigSendType" SG_ 2654552199 Point_Map_Y_32 1;
BA_ "GenSigSendType" SG_ 2654552199 Point_Map_X_32 1;
BA_ "GenSigSendType" SG_ 2654552199 Point_Map_Reserved_39 1;
BA_ "GenSigSendType" SG_ 2654552199 Point_Map_Reserved_38 1;
BA_ "GenSigSendType" SG_ 2654552199 Point_Map_Reserved_37 1;
BA_ "GenSigSendType" SG_ 2654552199 Point_Map_Reserved_36 1;
BA_ "GenSigSendType" SG_ 2654552199 Point_Map_Age_39 1;
BA_ "GenSigSendType" SG_ 2654552199 Point_Map_Confidence_39 1;
BA_ "GenSigSendType" SG_ 2654552199 Point_Map_Height_39 1;
BA_ "GenSigSendType" SG_ 2654552199 Point_Map_Y_39 1;
BA_ "GenSigSendType" SG_ 2654552199 Point_Map_X_39 1;
BA_ "GenSigSendType" SG_ 2654552199 Point_Map_Age_38 1;
BA_ "GenSigSendType" SG_ 2654552199 Point_Map_Confidence_38 1;
BA_ "GenSigSendType" SG_ 2654552199 Point_Map_Height_38 1;
BA_ "GenSigSendType" SG_ 2654552199 Point_Map_Y_38 1;
BA_ "GenSigSendType" SG_ 2654552199 Point_Map_X_38 1;
BA_ "GenSigSendType" SG_ 2654552199 Point_Map_Age_37 1;
BA_ "GenSigSendType" SG_ 2654552199 Point_Map_Confidence_37 1;
BA_ "GenSigSendType" SG_ 2654552199 Point_Map_Height_37 1;
BA_ "GenSigSendType" SG_ 2654552199 Point_Map_Y_37 1;
BA_ "GenSigSendType" SG_ 2654552199 Point_Map_X_37 1;
BA_ "GenSigSendType" SG_ 2654552199 Point_Map_Age_36 1;
BA_ "GenSigSendType" SG_ 2654552199 Point_Map_Confidence_36 1;
BA_ "GenSigSendType" SG_ 2654552199 Point_Map_Height_36 1;
BA_ "GenSigSendType" SG_ 2654552199 Point_Map_Y_36 1;
BA_ "GenSigSendType" SG_ 2654552199 Point_Map_X_36 1;
BA_ "GenSigSendType" SG_ 2654552198 Point_Map_Cruising_Age_31 1;
BA_ "GenSigSendType" SG_ 2654552198 Point_Map_Cruising_Age_30 1;
BA_ "GenSigSendType" SG_ 2654552198 Point_Map_Cruising_Age_29 1;
BA_ "GenSigSendType" SG_ 2654552198 Point_Map_Cruising_Age_28 1;
BA_ "GenSigSendType" SG_ 2654552198 Point_Map_Cruising_Age_27 1;
BA_ "GenSigSendType" SG_ 2654552198 Point_Map_Cruising_Age_26 1;
BA_ "GenSigSendType" SG_ 2654552198 Point_Map_Cruising_Age_25 1;
BA_ "GenSigSendType" SG_ 2654552198 Point_Map_Cruising_Age_24 1;
BA_ "GenSigSendType" SG_ 2654552198 Point_Map_Reserved_26 1;
BA_ "GenSigSendType" SG_ 2654552198 Point_Map_Age_26 1;
BA_ "GenSigSendType" SG_ 2654552198 Point_Map_Confidence_26 1;
BA_ "GenSigSendType" SG_ 2654552198 Point_Map_Height_26 1;
BA_ "GenSigSendType" SG_ 2654552198 Point_Map_Y_26 1;
BA_ "GenSigSendType" SG_ 2654552198 Point_Map_X_26 1;
BA_ "GenSigSendType" SG_ 2654552198 Point_Map_Reserved_25 1;
BA_ "GenSigSendType" SG_ 2654552198 Point_Map_Age_25 1;
BA_ "GenSigSendType" SG_ 2654552198 Point_Map_Confidence_25 1;
BA_ "GenSigSendType" SG_ 2654552198 Point_Map_Height_25 1;
BA_ "GenSigSendType" SG_ 2654552198 Point_Map_Y_25 1;
BA_ "GenSigSendType" SG_ 2654552198 Point_Map_X_25 1;
BA_ "GenSigSendType" SG_ 2654552198 Point_Map_Reserved_24 1;
BA_ "GenSigSendType" SG_ 2654552198 Point_Map_Age_24 1;
BA_ "GenSigSendType" SG_ 2654552198 Point_Map_Confidence_24 1;
BA_ "GenSigSendType" SG_ 2654552198 Point_Map_Height_24 1;
BA_ "GenSigSendType" SG_ 2654552198 Point_Map_Y_24 1;
BA_ "GenSigSendType" SG_ 2654552198 Point_Map_X_24 1;
BA_ "GenSigSendType" SG_ 2654552198 Point_Map_Reserved_31 1;
BA_ "GenSigSendType" SG_ 2654552198 Point_Map_Reserved_30 1;
BA_ "GenSigSendType" SG_ 2654552198 Point_Map_Reserved_29 1;
BA_ "GenSigSendType" SG_ 2654552198 Point_Map_Reserved_28 1;
BA_ "GenSigSendType" SG_ 2654552198 Point_Map_Reserved_27 1;
BA_ "GenSigSendType" SG_ 2654552198 Point_Map_Age_31 1;
BA_ "GenSigSendType" SG_ 2654552198 Point_Map_Confidence_31 1;
BA_ "GenSigSendType" SG_ 2654552198 Point_Map_Height_31 1;
BA_ "GenSigSendType" SG_ 2654552198 Point_Map_Y_31 1;
BA_ "GenSigSendType" SG_ 2654552198 Point_Map_X_31 1;
BA_ "GenSigSendType" SG_ 2654552198 Point_Map_Age_30 1;
BA_ "GenSigSendType" SG_ 2654552198 Point_Map_Confidence_30 1;
BA_ "GenSigSendType" SG_ 2654552198 Point_Map_Height_30 1;
BA_ "GenSigSendType" SG_ 2654552198 Point_Map_Y_30 1;
BA_ "GenSigSendType" SG_ 2654552198 Point_Map_X_30 1;
BA_ "GenSigSendType" SG_ 2654552198 Point_Map_Age_29 1;
BA_ "GenSigSendType" SG_ 2654552198 Point_Map_Confidence_29 1;
BA_ "GenSigSendType" SG_ 2654552198 Point_Map_Height_29 1;
BA_ "GenSigSendType" SG_ 2654552198 Point_Map_Y_29 1;
BA_ "GenSigSendType" SG_ 2654552198 Point_Map_X_29 1;
BA_ "GenSigSendType" SG_ 2654552198 Point_Map_Age_28 1;
BA_ "GenSigSendType" SG_ 2654552198 Point_Map_Confidence_28 1;
BA_ "GenSigSendType" SG_ 2654552198 Point_Map_Height_28 1;
BA_ "GenSigSendType" SG_ 2654552198 Point_Map_Y_28 1;
BA_ "GenSigSendType" SG_ 2654552198 Point_Map_X_27 1;
BA_ "GenSigSendType" SG_ 2654552198 Point_Map_Age_27 1;
BA_ "GenSigSendType" SG_ 2654552198 Point_Map_Confidence_27 1;
BA_ "GenSigSendType" SG_ 2654552198 Point_Map_Height_27 1;
BA_ "GenSigSendType" SG_ 2654552198 Point_Map_Y_27 1;
BA_ "GenSigSendType" SG_ 2654552198 Point_Map_X_28 1;
BA_ "GenSigSendType" SG_ 2654552197 Point_Map_Cruising_Age_23 1;
BA_ "GenSigSendType" SG_ 2654552197 Point_Map_Cruising_Age_22 1;
BA_ "GenSigSendType" SG_ 2654552197 Point_Map_Cruising_Age_21 1;
BA_ "GenSigSendType" SG_ 2654552197 Point_Map_Cruising_Age_20 1;
BA_ "GenSigSendType" SG_ 2654552197 Point_Map_Cruising_Age_19 1;
BA_ "GenSigSendType" SG_ 2654552197 Point_Map_Cruising_Age_18 1;
BA_ "GenSigSendType" SG_ 2654552197 Point_Map_Cruising_Age_17 1;
BA_ "GenSigSendType" SG_ 2654552197 Point_Map_Cruising_Age_16 1;
BA_ "GenSigSendType" SG_ 2654552197 Point_Map_Reserved_17 1;
BA_ "GenSigSendType" SG_ 2654552197 Point_Map_Height_17 1;
BA_ "GenSigSendType" SG_ 2654552197 Point_Map_Age_17 1;
BA_ "GenSigSendType" SG_ 2654552197 Point_Map_Confidence_17 1;
BA_ "GenSigSendType" SG_ 2654552197 Point_Map_Y_17 1;
BA_ "GenSigSendType" SG_ 2654552197 Point_Map_X_17 1;
BA_ "GenSigSendType" SG_ 2654552197 Point_Map_Reserved_16 1;
BA_ "GenSigSendType" SG_ 2654552197 Point_Map_Age_16 1;
BA_ "GenSigSendType" SG_ 2654552197 Point_Map_Confidence_16 1;
BA_ "GenSigSendType" SG_ 2654552197 Point_Map_Height_16 1;
BA_ "GenSigSendType" SG_ 2654552197 Point_Map_Y_16 1;
BA_ "GenSigSendType" SG_ 2654552197 Point_Map_X_16 1;
BA_ "GenSigSendType" SG_ 2654552197 Point_Map_Reserved_23 1;
BA_ "GenSigSendType" SG_ 2654552197 Point_Map_Reserved_22 1;
BA_ "GenSigSendType" SG_ 2654552197 Point_Map_Reserved_21 1;
BA_ "GenSigSendType" SG_ 2654552197 Point_Map_Reserved_20 1;
BA_ "GenSigSendType" SG_ 2654552197 Point_Map_Reserved_19 1;
BA_ "GenSigSendType" SG_ 2654552197 Point_Map_Reserved_18 1;
BA_ "GenSigSendType" SG_ 2654552197 Point_Map_Age_23 1;
BA_ "GenSigSendType" SG_ 2654552197 Point_Map_Confidence_23 1;
BA_ "GenSigSendType" SG_ 2654552197 Point_Map_Height_23 1;
BA_ "GenSigSendType" SG_ 2654552197 Point_Map_Y_23 1;
BA_ "GenSigSendType" SG_ 2654552197 Point_Map_X_23 1;
BA_ "GenSigSendType" SG_ 2654552197 Point_Map_Age_22 1;
BA_ "GenSigSendType" SG_ 2654552197 Point_Map_Confidence_22 1;
BA_ "GenSigSendType" SG_ 2654552197 Point_Map_Height_22 1;
BA_ "GenSigSendType" SG_ 2654552197 Point_Map_Y_22 1;
BA_ "GenSigSendType" SG_ 2654552197 Point_Map_X_22 1;
BA_ "GenSigSendType" SG_ 2654552197 Point_Map_Age_21 1;
BA_ "GenSigSendType" SG_ 2654552197 Point_Map_Confidence_21 1;
BA_ "GenSigSendType" SG_ 2654552197 Point_Map_Height_21 1;
BA_ "GenSigSendType" SG_ 2654552197 Point_Map_Y_21 1;
BA_ "GenSigSendType" SG_ 2654552197 Point_Map_X_21 1;
BA_ "GenSigSendType" SG_ 2654552197 Point_Map_Age_20 1;
BA_ "GenSigSendType" SG_ 2654552197 Point_Map_Confidence_20 1;
BA_ "GenSigSendType" SG_ 2654552197 Point_Map_Height_20 1;
BA_ "GenSigSendType" SG_ 2654552197 Point_Map_Y_20 1;
BA_ "GenSigSendType" SG_ 2654552197 Point_Map_X_20 1;
BA_ "GenSigSendType" SG_ 2654552197 Point_Map_Age_19 1;
BA_ "GenSigSendType" SG_ 2654552197 Point_Map_Confidence_19 1;
BA_ "GenSigSendType" SG_ 2654552197 Point_Map_Height_19 1;
BA_ "GenSigSendType" SG_ 2654552197 Point_Map_Y_19 1;
BA_ "GenSigSendType" SG_ 2654552197 Point_Map_X_19 1;
BA_ "GenSigSendType" SG_ 2654552197 Point_Map_Age_18 1;
BA_ "GenSigSendType" SG_ 2654552197 Point_Map_Confidence_18 1;
BA_ "GenSigSendType" SG_ 2654552197 Point_Map_Height_18 1;
BA_ "GenSigSendType" SG_ 2654552197 Point_Map_Y_18 1;
BA_ "GenSigSendType" SG_ 2654552197 Point_Map_X_18 1;
BA_ "NodeLayerModules" BU_ EVCU2 "CANoeILNLVector.dll,AsrNM33.dll";
VAL_ 3221225472 laneDectionHealth_e 3 "SNA" 2 "Not_Active_failure" 1 "Not_Active_blocked" 0 "Active" ;
VAL_ 2654552320 OC_ModuleState_STM_Right -1 "aZynqM_E_OC_STM_Size_Enforcer0xF" 18 "aZynqM_E_OC_STM_NumStates" 17 "aZynqM_E_OC_STM_End" 16 "aZynqM_E_OC_STM_Error" 9 "aZynqM_E_OC_STM_Stop" 8 "aZynqM_E_OC_STM_Resume" 7 "aZynqM_E_OC_STM_Paused" 6 "aZynqM_E_OC_STM_Pause" 5 " aZynqM_E_OC_STM_CheckStatus" 4 "aZynqM_E_OC_STM_StartCamCalib" 3 "aZynqM_E_OC_STM_SelectCurrCam" 2 "aZynqM_E_OC_STM_Idle" 1 "aZynqM_E_OC_STM_Init" 0 "aZynqM_E_OC_STM_NotInit " ;
VAL_ 2654552320 OC_ModuleState_STM_Rear -1 "aZynqM_E_OC_STM_Size_Enforcer0xF" 18 "aZynqM_E_OC_STM_NumStates" 17 "aZynqM_E_OC_STM_End" 16 "aZynqM_E_OC_STM_Error" 9 "aZynqM_E_OC_STM_Stop" 8 "aZynqM_E_OC_STM_Resume" 7 "aZynqM_E_OC_STM_Paused" 6 "aZynqM_E_OC_STM_Pause" 5 " aZynqM_E_OC_STM_CheckStatus" 4 "aZynqM_E_OC_STM_StartCamCalib" 3 "aZynqM_E_OC_STM_SelectCurrCam" 2 "aZynqM_E_OC_STM_Idle" 1 "aZynqM_E_OC_STM_Init" 0 "aZynqM_E_OC_STM_NotInit " ;
VAL_ 2654552320 OC_ModuleState_STM_Left -1 "aZynqM_E_OC_STM_Size_Enforcer0xF" 18 "aZynqM_E_OC_STM_NumStates" 17 "aZynqM_E_OC_STM_End" 16 "aZynqM_E_OC_STM_Error" 9 "aZynqM_E_OC_STM_Stop" 8 "aZynqM_E_OC_STM_Resume" 7 "aZynqM_E_OC_STM_Paused" 6 "aZynqM_E_OC_STM_Pause" 5 " aZynqM_E_OC_STM_CheckStatus" 4 "aZynqM_E_OC_STM_StartCamCalib" 3 "aZynqM_E_OC_STM_SelectCurrCam" 2 "aZynqM_E_OC_STM_Idle" 1 "aZynqM_E_OC_STM_Init" 0 "aZynqM_E_OC_STM_NotInit " ;
VAL_ 2654552320 OC_ModuleState_STM_Front -1 "aZynqM_E_OC_STM_Size_Enforcer0xF" 18 "aZynqM_E_OC_STM_NumStates" 17 "aZynqM_E_OC_STM_End" 16 "aZynqM_E_OC_STM_Error" 9 "aZynqM_E_OC_STM_Stop" 8 "aZynqM_E_OC_STM_Resume" 7 "aZynqM_E_OC_STM_Paused" 6 "aZynqM_E_OC_STM_Pause" 5 " aZynqM_E_OC_STM_CheckStatus" 4 "aZynqM_E_OC_STM_StartCamCalib" 3 "aZynqM_E_OC_STM_SelectCurrCam" 2 "aZynqM_E_OC_STM_Idle" 1 "aZynqM_E_OC_STM_Init" 0 "aZynqM_E_OC_STM_NotInit " ;
VAL_ 2654552320 SC_ModuleState_STM_Right 19 "  aZynqM_E_SC_STM_NumStates" 18 "aZynqM_E_SC_STM_E_End" 17 "aZynqM_E_SC_STM_E_Error" 16 "aZynqM_E_SC_STM_E_Stop" 9 "aZynqM_E_SC_STM_E_Resume" 8 "aZynqM_E_SC_STM_E_Paused" 7 "aZynqM_E_SC_STM_E_Pause" 6 "aZynqM_E_SC_STM_E_CheckStatus" 5 "aZynqM_E_SC_STM_E_StartCamCalib" 4 "aZynqM_E_SC_STM_E_SelectCurrCam" 3 "aZynqM_E_SC_STM_E_WaitEEPROMRead" 2 "  aZynqM_E_SC_STM_E_Idle" 1 "aZynqM_E_SC_STM_E_Init" 0 "aZynqM_E_SC_STM_E_NotInit " -1 "  aZynqM_E_SC_STM_Size_Enforcer " ;
VAL_ 2654552320 SC_ModuleState_STM_Rear 19 "  aZynqM_E_SC_STM_NumStates" 18 "aZynqM_E_SC_STM_E_End" 17 "aZynqM_E_SC_STM_E_Error" 16 "aZynqM_E_SC_STM_E_Stop" 9 "aZynqM_E_SC_STM_E_Resume" 8 "aZynqM_E_SC_STM_E_Paused" 7 "aZynqM_E_SC_STM_E_Pause" 6 "aZynqM_E_SC_STM_E_CheckStatus" 5 "aZynqM_E_SC_STM_E_StartCamCalib" 4 "aZynqM_E_SC_STM_E_SelectCurrCam" 3 "aZynqM_E_SC_STM_E_WaitEEPROMRead" 2 "  aZynqM_E_SC_STM_E_Idle" 1 "aZynqM_E_SC_STM_E_Init" 0 "aZynqM_E_SC_STM_E_NotInit " -1 "  aZynqM_E_SC_STM_Size_Enforcer " ;
VAL_ 2654552320 SC_ModuleState_STM_Left 19 "  aZynqM_E_SC_STM_NumStates" 18 "aZynqM_E_SC_STM_E_End" 17 "aZynqM_E_SC_STM_E_Error" 16 "aZynqM_E_SC_STM_E_Stop" 9 "aZynqM_E_SC_STM_E_Resume" 8 "aZynqM_E_SC_STM_E_Paused" 7 "aZynqM_E_SC_STM_E_Pause" 6 "aZynqM_E_SC_STM_E_CheckStatus" 5 "aZynqM_E_SC_STM_E_StartCamCalib" 4 "aZynqM_E_SC_STM_E_SelectCurrCam" 3 "aZynqM_E_SC_STM_E_WaitEEPROMRead" 2 "  aZynqM_E_SC_STM_E_Idle" 1 "aZynqM_E_SC_STM_E_Init" 0 "aZynqM_E_SC_STM_E_NotInit " -1 "  aZynqM_E_SC_STM_Size_Enforcer " ;
VAL_ 2654552320 SC_ModuleState_STM_Front 19 "  aZynqM_E_SC_STM_NumStates" 18 "aZynqM_E_SC_STM_E_End" 17 "aZynqM_E_SC_STM_E_Error" 16 "aZynqM_E_SC_STM_E_Stop" 9 "aZynqM_E_SC_STM_E_Resume" 8 "aZynqM_E_SC_STM_E_Paused" 7 "aZynqM_E_SC_STM_E_Pause" 6 "aZynqM_E_SC_STM_E_CheckStatus" 5 "aZynqM_E_SC_STM_E_StartCamCalib" 4 "aZynqM_E_SC_STM_E_SelectCurrCam" 3 "aZynqM_E_SC_STM_E_WaitEEPROMRead" 2 "  aZynqM_E_SC_STM_E_Idle" 1 "aZynqM_E_SC_STM_E_Init" 0 "aZynqM_E_SC_STM_E_NotInit " -1 "  aZynqM_E_SC_STM_Size_Enforcer " ;
VAL_ 2654552320 EOL_ModuleState_STM_Right 9 "aZynqM_E_EOL_STM_NumStates" 8 "aZynqM_E_EOL_STM_E_End" 7 "aZynqM_E_EOL_STM_E_Error" 6 " aZynqM_E_EOL_STM_E_Stop" 5 "aZynqM_E_EOL_STM_E_CheckStatus" 4 "aZynqM_E_EOL_STM_E_StartCamCalib" 3 "aZynqM_E_EOL_STM_E_SelectCurrCam" 2 "aZynqM_E_EOL_STM_E_Idle" 1 "aZynqM_E_EOL_STM_E_Init" 0 "aZynqM_E_EOL_STM_E_NotInit" -1 "aZynqM_E_EOL_STM_Size_Enforcer" ;
VAL_ 2654552320 EOL_ModuleState_STM_Rear 9 "aZynqM_E_EOL_STM_NumStates" 8 "aZynqM_E_EOL_STM_E_End" 7 "aZynqM_E_EOL_STM_E_Error" 6 " aZynqM_E_EOL_STM_E_Stop" 5 "aZynqM_E_EOL_STM_E_CheckStatus" 4 "aZynqM_E_EOL_STM_E_StartCamCalib" 3 "aZynqM_E_EOL_STM_E_SelectCurrCam" 2 "aZynqM_E_EOL_STM_E_Idle" 1 "aZynqM_E_EOL_STM_E_Init" 0 "aZynqM_E_EOL_STM_E_NotInit" -1 "aZynqM_E_EOL_STM_Size_Enforcer" ;
VAL_ 2654552320 EOL_ModuleState_STM_Left 9 "aZynqM_E_EOL_STM_NumStates" 8 "aZynqM_E_EOL_STM_E_End" 7 "aZynqM_E_EOL_STM_E_Error" 6 " aZynqM_E_EOL_STM_E_Stop" 5 "aZynqM_E_EOL_STM_E_CheckStatus" 4 "aZynqM_E_EOL_STM_E_StartCamCalib" 3 "aZynqM_E_EOL_STM_E_SelectCurrCam" 2 "aZynqM_E_EOL_STM_E_Idle" 1 "aZynqM_E_EOL_STM_E_Init" 0 "aZynqM_E_EOL_STM_E_NotInit" -1 "aZynqM_E_EOL_STM_Size_Enforcer" ;
VAL_ 2654552320 EOL_ModuleState_STM_Front 9 "aZynqM_E_EOL_STM_NumStates" 8 "aZynqM_E_EOL_STM_E_End" 7 "aZynqM_E_EOL_STM_E_Error" 6 " aZynqM_E_EOL_STM_E_Stop" 5 "aZynqM_E_EOL_STM_E_CheckStatus" 4 "aZynqM_E_EOL_STM_E_StartCamCalib" 3 "aZynqM_E_EOL_STM_E_SelectCurrCam" 2 "aZynqM_E_EOL_STM_E_Idle" 1 "aZynqM_E_EOL_STM_E_Init" 0 "aZynqM_E_EOL_STM_E_NotInit" -1 "aZynqM_E_EOL_STM_Size_Enforcer" ;
VAL_ 2654552217 CalibStatus_STM_Current_Right 4 "ME_Hydra3defs_E_CalibAbortFailed" 3 "ME_Hydra3defs_E_CalibCompSuccess" 2 "ME_Hydra3defs_E_CalibRunning" 1 "ME_Hydra3defs_E_CalibPending" 0 "ME_Hydra3defs_E_CalibNotStarted" -1 "ME_Hydra3defs_E_CalStatSzeEnforc" ;
VAL_ 2654552217 CalibStatus_STM_Current_Rear 4 "ME_Hydra3defs_E_CalibAbortFailed" 3 "ME_Hydra3defs_E_CalibCompSuccess" 2 "ME_Hydra3defs_E_CalibRunning" 1 "ME_Hydra3defs_E_CalibPending" 0 "ME_Hydra3defs_E_CalibNotStarted" -1 "ME_Hydra3defs_E_CalStatSzeEnforc" ;
VAL_ 2654552217 CalibStatus_STM_Current_Left 4 "ME_Hydra3defs_E_CalibAbortFailed" 3 "ME_Hydra3defs_E_CalibCompSuccess" 2 "ME_Hydra3defs_E_CalibRunning" 1 "ME_Hydra3defs_E_CalibPending" 0 "ME_Hydra3defs_E_CalibNotStarted" -1 "ME_Hydra3defs_E_CalStatSzeEnforc" ;
VAL_ 2654552217 CalibStatus_STM_Current_Front 4 "ME_Hydra3defs_E_CalibAbortFailed" 3 "ME_Hydra3defs_E_CalibCompSuccess" 2 "ME_Hydra3defs_E_CalibRunning" 1 "ME_Hydra3defs_E_CalibPending" 0 "ME_Hydra3defs_E_CalibNotStarted" -1 "ME_Hydra3defs_E_CalStatSzeEnforc" ;
VAL_ 2654552217 CalibStatus_STM_OC_Right 4 "ME_Hydra3defs_E_CalibAbortFailed" 3 "ME_Hydra3defs_E_CalibCompSuccess" 2 "ME_Hydra3defs_E_CalibRunning" 1 "ME_Hydra3defs_E_CalibPending" 0 "ME_Hydra3defs_E_CalibNotStarted" -1 "ME_Hydra3defs_E_CalStatSzeEnforc" ;
VAL_ 2654552217 CalibStatus_STM_OC_Rear 4 "ME_Hydra3defs_E_CalibAbortFailed" 3 "ME_Hydra3defs_E_CalibCompSuccess" 2 "ME_Hydra3defs_E_CalibRunning" 1 "ME_Hydra3defs_E_CalibPending" 0 "ME_Hydra3defs_E_CalibNotStarted" -1 "ME_Hydra3defs_E_CalStatSzeEnforc" ;
VAL_ 2654552217 CalibStatus_STM_OC_Left 4 "ME_Hydra3defs_E_CalibAbortFailed" 3 "ME_Hydra3defs_E_CalibCompSuccess" 2 "ME_Hydra3defs_E_CalibRunning" 1 "ME_Hydra3defs_E_CalibPending" 0 "ME_Hydra3defs_E_CalibNotStarted" -1 "ME_Hydra3defs_E_CalStatSzeEnforc" ;
VAL_ 2654552217 CalibStatus_STM_OC_Front 4 "ME_Hydra3defs_E_CalibAbortFailed" 3 "ME_Hydra3defs_E_CalibCompSuccess" 2 "ME_Hydra3defs_E_CalibRunning" 1 "ME_Hydra3defs_E_CalibPending" 0 "ME_Hydra3defs_E_CalibNotStarted" -1 "ME_Hydra3defs_E_CalStatSzeEnforc" ;
VAL_ 2654552217 CalibStatus_STM_SC_Right 4 "ME_Hydra3defs_E_CalibAbortFailed" 3 "ME_Hydra3defs_E_CalibCompSuccess" 2 "ME_Hydra3defs_E_CalibRunning" 1 "ME_Hydra3defs_E_CalibPending" 0 "ME_Hydra3defs_E_CalibNotStarted" -1 "ME_Hydra3defs_E_CalStatSzeEnforc" ;
VAL_ 2654552217 CalibStatus_STM_SC_Rear 4 "ME_Hydra3defs_E_CalibAbortFailed" 3 "ME_Hydra3defs_E_CalibCompSuccess" 2 "ME_Hydra3defs_E_CalibRunning" 1 "ME_Hydra3defs_E_CalibPending" 0 "ME_Hydra3defs_E_CalibNotStarted" -1 "ME_Hydra3defs_E_CalStatSzeEnforc" ;
VAL_ 2654552217 CalibStatus_STM_SC_Left 4 "ME_Hydra3defs_E_CalibAbortFailed" 3 "ME_Hydra3defs_E_CalibCompSuccess" 2 "ME_Hydra3defs_E_CalibRunning" 1 "ME_Hydra3defs_E_CalibPending" 0 "ME_Hydra3defs_E_CalibNotStarted" -1 "ME_Hydra3defs_E_CalStatSzeEnforc" ;
VAL_ 2654552217 CalibStatus_STM_SC_Front 4 "ME_Hydra3defs_E_CalibAbortFailed" 3 "ME_Hydra3defs_E_CalibCompSuccess" 2 "ME_Hydra3defs_E_CalibRunning" 1 "ME_Hydra3defs_E_CalibPending" 0 "ME_Hydra3defs_E_CalibNotStarted" -1 "ME_Hydra3defs_E_CalStatSzeEnforc" ;
VAL_ 2654552217 CalibStatus_STM_EOL_Right 4 "ME_Hydra3defs_E_CalibAbortFailed" 3 "ME_Hydra3defs_E_CalibCompSuccess" 2 "ME_Hydra3defs_E_CalibRunning" 1 "ME_Hydra3defs_E_CalibPending" 0 "ME_Hydra3defs_E_CalibNotStarted" -1 "ME_Hydra3defs_E_CalStatSzeEnforc" ;
VAL_ 2654552217 CalibStatus_STM_EOL_Rear 4 "ME_Hydra3defs_E_CalibAbortFailed" 3 "ME_Hydra3defs_E_CalibCompSuccess" 2 "ME_Hydra3defs_E_CalibRunning" 1 "ME_Hydra3defs_E_CalibPending" 0 "ME_Hydra3defs_E_CalibNotStarted" -1 "ME_Hydra3defs_E_CalStatSzeEnforc" ;
VAL_ 2654552217 CalibStatus_STM_EOL_Left 4 "ME_Hydra3defs_E_CalibAbortFailed" 3 "ME_Hydra3defs_E_CalibCompSuccess" 2 "ME_Hydra3defs_E_CalibRunning" 1 "ME_Hydra3defs_E_CalibPending" 0 "ME_Hydra3defs_E_CalibNotStarted" -1 "ME_Hydra3defs_E_CalStatSzeEnforc" ;
VAL_ 2654552217 CalibStatus_STM_EOL_Front 4 "ME_Hydra3defs_E_CalibAbortFailed" 3 "ME_Hydra3defs_E_CalibCompSuccess" 2 "ME_Hydra3defs_E_CalibRunning" 1 "ME_Hydra3defs_E_CalibPending" 0 "ME_Hydra3defs_E_CalibNotStarted" -1 "ME_Hydra3defs_E_CalStatSzeEnforc" ;
VAL_ 2654552216 Err_Code_OC_Right 8 "e_OC_Num" 7 "e_OC_UnexpectedRequest" 6 "e_OC_InvalidSavedData" 5 "e_OC_InvalidConfiguration" 4 "e_OC_CalibrationError" 3 "e_OC_FeatureCollectionError" 2 "e_OC_StartFail" 1 "e_OC_InitFail" 0 "  e_OC_NoError " -1 "e_OCErrorCode_Size_Enforcer " ;
VAL_ 2654552216 Err_Code_OC_Rear 8 "e_OC_Num" 7 "e_OC_UnexpectedRequest" 6 "e_OC_InvalidSavedData" 5 "e_OC_InvalidConfiguration" 4 "e_OC_CalibrationError" 3 "e_OC_FeatureCollectionError" 2 "e_OC_StartFail" 1 "e_OC_InitFail" 0 "  e_OC_NoError " -1 "e_OCErrorCode_Size_Enforcer " ;
VAL_ 2654552216 Err_Code_OC_Left 8 "e_OC_Num" 7 "e_OC_UnexpectedRequest" 6 "e_OC_InvalidSavedData" 5 "e_OC_InvalidConfiguration" 4 "e_OC_CalibrationError" 3 "e_OC_FeatureCollectionError" 2 "e_OC_StartFail" 1 "e_OC_InitFail" 0 "  e_OC_NoError " -1 "e_OCErrorCode_Size_Enforcer " ;
VAL_ 2654552216 Err_Code_OC_Front 8 "e_OC_Num" 7 "e_OC_UnexpectedRequest" 6 "e_OC_InvalidSavedData" 5 "e_OC_InvalidConfiguration" 4 "e_OC_CalibrationError" 3 "e_OC_FeatureCollectionError" 2 "e_OC_StartFail" 1 "e_OC_InitFail" 0 "  e_OC_NoError " -1 "e_OCErrorCode_Size_Enforcer " ;
VAL_ 2654552216 Err_Code_SC_Right 8 "e_OC_Num" 7 "e_OC_UnexpectedRequest" 6 "e_OC_InvalidSavedData" 5 "e_OC_InvalidConfiguration" 4 "e_OC_CalibrationError" 3 "e_OC_FeatureCollectionError" 2 "e_OC_StartFail" 1 "e_OC_InitFail" 0 "  e_OC_NoError " -1 "e_OCErrorCode_Size_Enforcer " ;
VAL_ 2654552216 Err_Code_SC_Rear 8 "e_OC_Num" 7 "e_OC_UnexpectedRequest" 6 "e_OC_InvalidSavedData" 5 "e_OC_InvalidConfiguration" 4 "e_OC_CalibrationError" 3 "e_OC_FeatureCollectionError" 2 "e_OC_StartFail" 1 "e_OC_InitFail" 0 "  e_OC_NoError " -1 "e_OCErrorCode_Size_Enforcer " ;
VAL_ 2654552216 Err_Code_SC_Left 8 "e_OC_Num" 7 "e_OC_UnexpectedRequest" 6 "e_OC_InvalidSavedData" 5 "e_OC_InvalidConfiguration" 4 "e_OC_CalibrationError" 3 "e_OC_FeatureCollectionError" 2 "e_OC_StartFail" 1 "e_OC_InitFail" 0 "  e_OC_NoError " -1 "e_OCErrorCode_Size_Enforcer " ;
VAL_ 2654552216 Err_Code_SC_Front 8 "e_OC_Num" 7 "e_OC_UnexpectedRequest" 6 "e_OC_InvalidSavedData" 5 "e_OC_InvalidConfiguration" 4 "e_OC_CalibrationError" 3 "e_OC_FeatureCollectionError" 2 "e_OC_StartFail" 1 "e_OC_InitFail" 0 "  e_OC_NoError " -1 "e_OCErrorCode_Size_Enforcer " ;
VAL_ 2654552216 Err_Code_EOL_Rear_Copy_1 25 "e_EOL_PRECONDITION_NOT_CORRECT" 24 " e_EOL_WRONG_CAMERA_SOFTWARE" 23 "e_EOL_PRECOND_NOT_CORRECT_DOORS" 22 "e_EOL_PRECOND_NOT_CORRECT_VELOC" 21 "e_EOL_HMOGRAPHY_ESTIMATION_ERROR" 20 "e_EOL_ABORTED" 19 "e_EOL_NOT_CALIBRATED" 18 "e_EOL_RESULT_EXCEED_QUAL_LIM" 17 "e_EOL_TARGET_IDENTIF_ERROR_RIGHT" 16 "e_EOL_TARGET_IDENTIF_ERROR_LEFT" 9 "e_EOL_TARGET_NOT_FOUND_RIGHT" 8 "e_EOL_TARGET_NOT_FOUND_LEFT" 7 "e_EOL_TARGET_NOT_FOUND_INIT" 6 "e_EOL_VARIANT_CODING_ISSUE" 5 "e_EOL_MISSING_INTERNAL_LINK" 4 "e_EOL_PRECON_NOT_CORRECT_NUMCAMS" 3 "e_EOL_PRECOND_NOT_CORRECT_VRANGE" 2 "e_EOL_MISSING_SOFTWARE" 1 "e_EOL_CALIBRATION_SUCCESS" 0 "e_EOL_CALIBRATION_IN_PROCESS " -1 "e_EOLErrorCode_Size_Enforcer " ;
VAL_ 2654552216 Err_Code_EOL_Rear 25 "e_EOL_PRECONDITION_NOT_CORRECT" 24 " e_EOL_WRONG_CAMERA_SOFTWARE" 23 "e_EOL_PRECOND_NOT_CORRECT_DOORS" 22 "e_EOL_PRECOND_NOT_CORRECT_VELOC" 21 "e_EOL_HMOGRAPHY_ESTIMATION_ERROR" 20 "e_EOL_ABORTED" 19 "e_EOL_NOT_CALIBRATED" 18 "e_EOL_RESULT_EXCEED_QUAL_LIM" 17 "e_EOL_TARGET_IDENTIF_ERROR_RIGHT" 16 "e_EOL_TARGET_IDENTIF_ERROR_LEFT" 9 "e_EOL_TARGET_NOT_FOUND_RIGHT" 8 "e_EOL_TARGET_NOT_FOUND_LEFT" 7 "e_EOL_TARGET_NOT_FOUND_INIT" 6 "e_EOL_VARIANT_CODING_ISSUE" 5 "e_EOL_MISSING_INTERNAL_LINK" 4 "e_EOL_PRECON_NOT_CORRECT_NUMCAMS" 3 "e_EOL_PRECOND_NOT_CORRECT_VRANGE" 2 "e_EOL_MISSING_SOFTWARE" 1 "e_EOL_CALIBRATION_SUCCESS" 0 "e_EOL_CALIBRATION_IN_PROCESS " -1 "e_EOLErrorCode_Size_Enforcer " ;
VAL_ 2654552216 Err_Code_EOL_Left 25 "e_EOL_PRECONDITION_NOT_CORRECT" 24 " e_EOL_WRONG_CAMERA_SOFTWARE" 23 "e_EOL_PRECOND_NOT_CORRECT_DOORS" 22 "e_EOL_PRECOND_NOT_CORRECT_VELOC" 21 "e_EOL_HMOGRAPHY_ESTIMATION_ERROR" 20 "e_EOL_ABORTED" 19 "e_EOL_NOT_CALIBRATED" 18 "e_EOL_RESULT_EXCEED_QUAL_LIM" 17 "e_EOL_TARGET_IDENTIF_ERROR_RIGHT" 16 "e_EOL_TARGET_IDENTIF_ERROR_LEFT" 9 "e_EOL_TARGET_NOT_FOUND_RIGHT" 8 "e_EOL_TARGET_NOT_FOUND_LEFT" 7 "e_EOL_TARGET_NOT_FOUND_INIT" 6 "e_EOL_VARIANT_CODING_ISSUE" 5 "e_EOL_MISSING_INTERNAL_LINK" 4 "e_EOL_PRECON_NOT_CORRECT_NUMCAMS" 3 "e_EOL_PRECOND_NOT_CORRECT_VRANGE" 2 "e_EOL_MISSING_SOFTWARE" 1 "e_EOL_CALIBRATION_SUCCESS" 0 "e_EOL_CALIBRATION_IN_PROCESS " -1 "e_EOLErrorCode_Size_Enforcer " ;
VAL_ 2654552216 Err_Code_EOL_Front 25 "e_EOL_PRECONDITION_NOT_CORRECT" 24 " e_EOL_WRONG_CAMERA_SOFTWARE" 23 "e_EOL_PRECOND_NOT_CORRECT_DOORS" 22 "e_EOL_PRECOND_NOT_CORRECT_VELOC" 21 "e_EOL_HMOGRAPHY_ESTIMATION_ERROR" 20 "e_EOL_ABORTED" 19 "e_EOL_NOT_CALIBRATED" 18 "e_EOL_RESULT_EXCEED_QUAL_LIM" 17 "e_EOL_TARGET_IDENTIF_ERROR_RIGHT" 16 "e_EOL_TARGET_IDENTIF_ERROR_LEFT" 9 "e_EOL_TARGET_NOT_FOUND_RIGHT" 8 "e_EOL_TARGET_NOT_FOUND_LEFT" 7 "e_EOL_TARGET_NOT_FOUND_INIT" 6 "e_EOL_VARIANT_CODING_ISSUE" 5 "e_EOL_MISSING_INTERNAL_LINK" 4 "e_EOL_PRECON_NOT_CORRECT_NUMCAMS" 3 "e_EOL_PRECOND_NOT_CORRECT_VRANGE" 2 "e_EOL_MISSING_SOFTWARE" 1 "e_EOL_CALIBRATION_SUCCESS" 0 "e_EOL_CALIBRATION_IN_PROCESS " -1 "e_EOLErrorCode_Size_Enforcer " ;
SIG_VALTYPE_ 2654552336 stFPAInfoToVCLockedSlotRearRghtY : 1;
SIG_VALTYPE_ 2654552336 stFPAInfoToVCLockedSlotFrntLeftY : 1;
SIG_VALTYPE_ 2654552336 stFPAInfoToVCLockedSlotRearRghtX : 1;
SIG_VALTYPE_ 2654552336 stFPAInfoToVCLockedSlotFrntLeftX : 1;
SIG_VALTYPE_ 2654552329 stUSSLockedSlotDataRearRightY : 1;
SIG_VALTYPE_ 2654552329 stUSSLockedSlotDataFrontLeftY : 1;
SIG_VALTYPE_ 2654552329 stUSSLockedSlotDataRearRightX : 1;
SIG_VALTYPE_ 2654552329 stUSSLockedSlotDataFrontLeftX : 1;
SIG_VALTYPE_ 2654552328 stUSSParkingSlot4RearRightY : 1;
SIG_VALTYPE_ 2654552328 stUSSParkingSlot4FrontLeftY : 1;
SIG_VALTYPE_ 2654552328 stUSSParkingSlot1RearRightY : 1;
SIG_VALTYPE_ 2654552328 stUSSParkingSlot1FrontLeftY : 1;
SIG_VALTYPE_ 2654552328 stUSSParkingSlot4RearRightX : 1;
SIG_VALTYPE_ 2654552328 stUSSParkingSlot4FrontLeftX : 1;
SIG_VALTYPE_ 2654552328 stUSSParkingSlot1RearRightX : 1;
SIG_VALTYPE_ 2654552328 stUSSParkingSlot1FrontLeftX : 1;
SIG_VALTYPE_ 2654552327 stPLDLockedSlotDataRearRightY : 1;
SIG_VALTYPE_ 2654552327 stPLDLockedSlotDataRearRightX : 1;
SIG_VALTYPE_ 2654552327 stPLDLockedSlotDataFrontLeftY : 1;
SIG_VALTYPE_ 2654552327 stPLDLockedSlotDataFrontLeftX : 1;
SIG_VALTYPE_ 2654552326 stPLDParkingSlot4RearRightX : 1;
SIG_VALTYPE_ 2654552326 stPLDParkingSlot4RearRightY : 1;
SIG_VALTYPE_ 2654552326 stPLDParkingSlot4FrontLeftY : 1;
SIG_VALTYPE_ 2654552326 stPLDParkingSlot4FrontLeftX : 1;
SIG_VALTYPE_ 2654552326 stPLDParkingSlot1RearRightY : 1;
SIG_VALTYPE_ 2654552326 stPLDParkingSlot1RearRightX : 1;
SIG_VALTYPE_ 2654552326 stPLDParkingSlot1FrontLeftY : 1;
SIG_VALTYPE_ 2654552326 stPLDParkingSlot1FrontLeftX : 1;
SIG_VALTYPE_ 2654552325 LMD_pct_Segment_7_Confidence : 1;
SIG_VALTYPE_ 2654552325 LMD_pct_Segment_8_Confidence : 1;
SIG_VALTYPE_ 2654552325 LMD_pct_Segment_5_Confidence : 1;
SIG_VALTYPE_ 2654552325 LMD_pct_Segment_6_Confidence : 1;
SIG_VALTYPE_ 2654552325 LMD_pct_Segment_3_Confidence : 1;
SIG_VALTYPE_ 2654552325 LMD_pct_Segment_4_Confidence : 1;
SIG_VALTYPE_ 2654552325 LMD_pct_Segment_1_Confidence : 1;
SIG_VALTYPE_ 2654552325 LMD_pct_Segment_2_Confidence : 1;
SIG_VALTYPE_ 2654552324 LMD_m_Segment_8_Y2 : 1;
SIG_VALTYPE_ 2654552324 LMD_m_Segment_7_Y2 : 1;
SIG_VALTYPE_ 2654552324 LMD_m_Segment_6_Y2 : 1;
SIG_VALTYPE_ 2654552324 LMD_m_Segment_5_Y2 : 1;
SIG_VALTYPE_ 2654552324 LMD_m_Segment_4_Y2 : 1;
SIG_VALTYPE_ 2654552324 LMD_m_Segment_3_Y2 : 1;
SIG_VALTYPE_ 2654552324 LMD_m_Segment_2_Y2 : 1;
SIG_VALTYPE_ 2654552324 LMD_m_Segment_1_Y2 : 1;
SIG_VALTYPE_ 2654552324 LMD_m_Segment_8_X2 : 1;
SIG_VALTYPE_ 2654552324 LMD_m_Segment_7_X2 : 1;
SIG_VALTYPE_ 2654552324 LMD_m_Segment_6_X2 : 1;
SIG_VALTYPE_ 2654552324 LMD_m_Segment_5_X2 : 1;
SIG_VALTYPE_ 2654552324 LMD_m_Segment_4_X2 : 1;
SIG_VALTYPE_ 2654552324 LMD_m_Segment_3_X2 : 1;
SIG_VALTYPE_ 2654552324 LMD_m_Segment_2_X2 : 1;
SIG_VALTYPE_ 2654552324 LMD_m_Segment_1_X2 : 1;
SIG_VALTYPE_ 2654552323 LMD_m_Segment_8_Y1 : 1;
SIG_VALTYPE_ 2654552323 LMD_m_Segment_7_Y1 : 1;
SIG_VALTYPE_ 2654552323 LMD_m_Segment_6_Y1 : 1;
SIG_VALTYPE_ 2654552322 LMD_m_Segment_5_Y1 : 1;
SIG_VALTYPE_ 2654552322 LMD_m_Segment_4_Y1 : 1;
SIG_VALTYPE_ 2654552322 LMD_m_Segment_3_Y1 : 1;
SIG_VALTYPE_ 2654552322 LMD_m_Segment_2_Y1 : 1;
SIG_VALTYPE_ 2654552322 LMD_m_Segment_1_Y1 : 1;
SIG_VALTYPE_ 2654552322 LMD_m_Segment_8_X1 : 1;
SIG_VALTYPE_ 2654552322 LMD_m_Segment_6_X1 : 1;
SIG_VALTYPE_ 2654552322 LMD_m_Segment_7_X1 : 1;
SIG_VALTYPE_ 2654552322 LMD_m_Segment_5_X1 : 1;
SIG_VALTYPE_ 2654552322 LMD_m_Segment_4_X1 : 1;
SIG_VALTYPE_ 2654552322 LMD_m_Segment_3_X1 : 1;
SIG_VALTYPE_ 2654552322 LMD_m_Segment_2_X1 : 1;
SIG_VALTYPE_ 2654552322 LMD_m_Segment_1_X1 : 1;
SIG_VALTYPE_ 2654552321 LMD_pct_Line_3_Confidence : 1;
SIG_VALTYPE_ 2654552321 LMD_px_Line_3_Curvature : 1;
SIG_VALTYPE_ 2654552321 LMD_m_Line_4_End_Range : 1;
SIG_VALTYPE_ 2654552321 LMD_m_Line_4_Start_Range : 1;
SIG_VALTYPE_ 2654552321 LMD_rad_Line_4_Heading : 1;
SIG_VALTYPE_ 2654552321 LMD_m_Line_4_Offset : 1;
SIG_VALTYPE_ 2654552321 LMD_pct_Line_4_Confidence : 1;
SIG_VALTYPE_ 2654552321 LMD_px_Line_4_Curvature : 1;
SIG_VALTYPE_ 2654552321 LMD_m_Line_3_End_Range : 1;
SIG_VALTYPE_ 2654552321 LMD_m_Line_3_Start_Range : 1;
SIG_VALTYPE_ 2654552321 LMD_rad_Line_3_Heading : 1;
SIG_VALTYPE_ 2654552321 LMD_m_Line_3_Offset : 1;
