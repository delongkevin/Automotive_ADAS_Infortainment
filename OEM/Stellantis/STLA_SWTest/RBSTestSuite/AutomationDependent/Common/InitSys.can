/*@!Encoding:1252*/
includes
{
  
}

variables
{
  
}

on start
{
 @MEnv_Default_SET_BOL_1=1;
 setSignal (KST_KL_15_XIX_ClampControl_01_XIX_HCP1_CANFD04, 1);
}