/*@!Encoding:1252*/
includes
{
  
}

 

variables
{
  msTimer defaultMode;
}

on start 
{
  setTimer(defaultMode, 1000);
}

on timer defaultMode 
{
  @MEnv_Default_SET_BOL_1 = 1;
}
 

on ethernetPacket *
{
  // it should never be used that way, but it is the quickest way to send data over without MAC bypass
  
  if(this.dir == rx)
  {    
    if(this.msgChannel == 1)  // ECU network
    {
      this.msgChannel = 2;  // change channel to PC network
      output(this);
    }    
    else if(this.msgChannel == 2) // PC network
    {
      this.msgChannel = 1;  // change channel to ECU network
      output(this);
    }
  }
}