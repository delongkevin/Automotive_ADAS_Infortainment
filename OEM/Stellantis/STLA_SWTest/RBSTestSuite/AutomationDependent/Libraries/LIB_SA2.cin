/*@!Encoding:1252*/
includes
{
  #include "LIB_Diagnostic.cin"
}

variables
{  
  const long SA2_MAX_COMMAND_AMOUNT_RAW = 10;
  
  enum Sa2Operation
  {
    SA2_RSL = 0x81,
    SA2_RSR = 0x82,
    SA2_ADD = 0x93,
    SA2_SUB = 0x84,
    SA2_EOR = 0x87,
    SA2_FOR = 0x68,
    SA2_NEXT = 0x49,
    SA2_BCC = 0x4A,
    SA2_BRA = 0x6B,
    SA2_END = 0x4C
  };
  
  struct SA2Command
  {
    enum Sa2Operation operation;
    dword value;
  };
  
  struct SA2Struct
  {
    struct SA2Command rawCommands[SA2_MAX_COMMAND_AMOUNT_RAW];
    long rawCommandsLen;
    dword operand;
    byte carry;
  };
  
  long sa2ForLoopStart, sa2ForLoopEnd, sa2ForLoopIdx;
}



void _sa2FindCommands(struct SA2Struct sa2, byte arr[], long arrLen)
{
  long idx;
  
  sa2.rawCommandsLen = 0;
  for(idx=0;idx<arrLen;idx++)
  {
    switch(arr[idx])
    {
      case SA2_RSL:   // commands without param
      case SA2_RSR:
      case SA2_NEXT:
      case SA2_END:
        sa2.rawCommands[sa2.rawCommandsLen].operation = (enum Sa2Operation)arr[idx];
        sa2.rawCommandsLen++;
        break;
      
      case SA2_ADD:   // commands with 4 byte param
      case SA2_SUB:
      case SA2_EOR:
        sa2.rawCommands[sa2.rawCommandsLen].operation = (enum Sa2Operation)arr[idx];
        sa2.rawCommands[sa2.rawCommandsLen].value = (arr[idx+1] << 24) + (arr[idx+2] << 16) + (arr[idx+3] << 8) + (arr[idx+4] << 0);
        idx += 4;
        sa2.rawCommandsLen++;
        break;
        
      case SA2_FOR:   // commands with 1 byte param
      case SA2_BCC:
      case SA2_BRA:
        sa2.rawCommands[sa2.rawCommandsLen].operation = (enum Sa2Operation)arr[idx];
        sa2.rawCommands[sa2.rawCommandsLen].value = arr[idx+1];
        idx += 1;
        sa2.rawCommandsLen++;
        break;
    }
    
    if(sa2.rawCommandsLen >= SA2_MAX_COMMAND_AMOUNT_RAW)
    {
      write("SA2 - parameter have to many operations!");
      break;
    }
  }
}

void _sa2ExecuteCommands(struct SA2Struct sa2, long startPos, long endPos)
{
  long mainIdx, endForIdx;
  
  for(mainIdx=startPos;mainIdx<endPos;mainIdx++)
  {
    switch(sa2.rawCommands[mainIdx].operation)
    {
      case SA2_FOR:
      {
        for(endForIdx=endPos; endForIdx>=startPos; endForIdx--)
        {
          if(sa2.rawCommands[endForIdx].operation == SA2_NEXT)
          {
            break;
          }
        }
        sa2ForLoopStart = mainIdx+1; 
        sa2ForLoopEnd = endForIdx; 
        sa2ForLoopIdx = sa2.rawCommands[mainIdx].value;
        
        while(sa2ForLoopIdx)
        {
          _sa2ExecuteCommands(sa2, sa2ForLoopStart, sa2ForLoopEnd);
          sa2ForLoopIdx--;
        }
        break;
      }
      
      case SA2_RSL:
      {
        sa2.carry = (sa2.operand & 0x80000000) ? 1 : 0;  // move 31 bit to carry
        sa2.operand = (sa2.operand << 1) + sa2.carry;
        break;
      }
      
      case SA2_RSR:
      {
        sa2.carry = (sa2.operand & 0x00000001) ? 1 : 0;  // move 0 bit to carry
        sa2.operand = (sa2.operand >> 1) + (sa2.carry << 31);
        break;
      }
      
      case SA2_ADD:
      {
        sa2.carry = ((sa2.operand + sa2.rawCommands[mainIdx].value) > 0xFFFFFFFF) ? 1 : 0;  // if number is greater than 0xFFFFFFFF
        sa2.operand += sa2.rawCommands[mainIdx].value;
        break;
      }
      
      case SA2_SUB:
      {
        sa2.carry = (sa2.rawCommands[mainIdx].value > sa2.operand) ? 1 : 0;  // if value is greater than operand
        sa2.operand -= sa2.rawCommands[mainIdx].value;
        break;
      }
      
      case SA2_EOR:
      {
        sa2.carry = 0;
        sa2.operand = sa2.operand ^ sa2.rawCommands[mainIdx].value;
        break;
      }
      
      case SA2_BCC:
      {
        if(sa2.carry == 0)
        {
          mainIdx = startPos + sa2.rawCommands[mainIdx].value;
        }
        break;
      }
      
      case SA2_BRA:
      {
        mainIdx = startPos + sa2.rawCommands[mainIdx].value;
        break;
      }
      
      case SA2_END:
      {
        mainIdx = endPos; // finish algorithm
        break;
      }
      
      default:
        write("Error - 0x%02X (%s), value: 0x%08X", sa2.rawCommands[mainIdx].operation, sa2.rawCommands[mainIdx].operation.name(), sa2.rawCommands[mainIdx].value);
        break;
    }
    //write("Current operation: 0x%02X (%s), value: 0x%08X", sa2.rawCommands[mainIdx].operation, sa2.rawCommands[mainIdx].operation.name(), sa2.rawCommands[mainIdx].value);
    //write("carry: %d, operand: 0x%08X", sa2.carry, sa2.operand);
  }
  
}

long SA2CalculateKey(char sa2[], dword inSeed, dword &outKey)
{
  byte sa2ByteArr[128];
  long sa2ByteArrLen;
  struct SA2Struct parsedSa2;
  
  sa2ByteArrLen = ParseHexStringToByteArray(sa2, sa2ByteArr);
  
  if(sa2ByteArr[sa2ByteArrLen-1] != SA2_END)
  {
    write("SA2 - isn't properly ended!");
    return 0;
  }
  else
  {
    parsedSa2.operand = inSeed;
    parsedSa2.carry = 0;
    _sa2FindCommands(parsedSa2, sa2ByteArr, sa2ByteArrLen);
    _sa2ExecuteCommands(parsedSa2, 0, parsedSa2.rawCommandsLen);
    outKey = parsedSa2.operand;
    return 1;
  }
}

