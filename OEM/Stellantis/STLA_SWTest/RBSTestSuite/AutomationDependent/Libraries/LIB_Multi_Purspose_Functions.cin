/*@!Encoding:1252*/
includes
{
}

variables
{ 
}

long GetStringAfterRegex(char s[], char regex[], long offsetFromBeginningOfRegex, char desiredString[])
{
  long res;
  
  for(res=0; res<elCount(desiredString); res++)
  {
    desiredString[res] = 0; //clear string before copy
  }
  
  res = strstr_regex(s, regex);
  if(res != -1)
  {
    memcpy_off(desiredString, 0, s, res+offsetFromBeginningOfRegex, elCount(desiredString));    
    return strlen(desiredString);
  }
      
  return 0;
}

void FindStringMultiplications(char stringIn[], char stringOut[])
{
  /*
  Find multiplication formula, to change it to normal string.
  Formula: ((howManyTimesRepeatPattern)whatToRepeat)
  Examples:
  in: '((3)abc)' -> out: 'abcabcabc'
  in: '((2) FF)' -> out: ' FF FF'
  in: '((5)02 )' -> out: '02 02 02 02 02 '
  */
  
  const long FSM_DEBUG = 0;
  
  long offset, ret, idx, startReplacement, endReplacement;
  char multiplyerString[64], whatToRepeatString[256], toReplace[4096], replacementString[4096];
  
  if(FSM_DEBUG) { write("FindStringMultiplications in: '%s'", stringIn); }
  snprintf(stringOut, elCount(stringOut), "%s", stringIn);
  
  offset = 0;
  do
  {
    ret = strstr_regex_off(stringOut, offset, "\\(\\([0-9]*\\)(.*)\\)");
    if(ret >= 0)
    {
      snprintf(multiplyerString, elCount(multiplyerString), "");
      startReplacement = ret;
      idx = ret + 2;      
      while(stringOut[idx] != ')')
      {
        snprintf(multiplyerString, elCount(multiplyerString), "%s%c", multiplyerString, stringOut[idx]);
        idx++;
      }
      idx++;
      
      snprintf(whatToRepeatString, elCount(whatToRepeatString), "");
      while(stringOut[idx] != ')')
      {
        snprintf(whatToRepeatString, elCount(whatToRepeatString), "%s%c", whatToRepeatString, stringOut[idx]);
        idx++;
      }
      endReplacement = idx+1;
      
      if(FSM_DEBUG) { write("multiplyerString: '%s', whatToRepeatString: '%s'", multiplyerString, whatToRepeatString); }
      
      memcpy_off(toReplace, 0, stringOut, startReplacement, endReplacement-startReplacement);
      toReplace[endReplacement-startReplacement] = 0;
      snprintf(replacementString, elCount(replacementString), "");
      for(idx=0; idx<atol(multiplyerString); idx++)
      {
        snprintf(replacementString, elCount(replacementString), "%s%s", replacementString, whatToRepeatString);
      }
      
      if(FSM_DEBUG) { write("toReplace: '%s', replacementString: '%s'", toReplace, replacementString); }
      
      str_replace(stringOut, toReplace, replacementString);
      if(FSM_DEBUG) { write("stringOut: '%s'", stringOut); }
      
      offset = offset + ret + 1;
    }
    else
    {
      offset+=1;
    }
  }
  while(offset < strlen(stringOut));
  
  if(FSM_DEBUG) { write("FindStringMultiplications out: '%s'", stringOut); }
}

long ParseHexStringToByteArray(char string[], byte out[])
{
  const long PHSTBA_DEBUG = 0;
  
  char singleHexChar[8];
  long offset, ret, bytePosition;
  
  str_replace(string, "X", "0");   // dont care about X - used just to be more clear in report
  str_replace(string, "x", "0");   // dont care about x - used just to be more clear in report  
  
  offset = 0;
  bytePosition = 0;
  do
  {
    ret = strstr_regex_off(string, offset, "[0-9A-Fa-f]{2}");
    if(ret >= 0)
    {
      snprintf(singleHexChar, elCount(singleHexChar), "0x%c%c", string[ret], string[ret+1]);
      out[bytePosition] = atol(singleHexChar);
      if(PHSTBA_DEBUG) { write("offset: %d, hex string: '%s', hex value: 0x%02X", offset, singleHexChar, out[bytePosition]); }
      offset = ret + 2;
      bytePosition++;
    }
    else
    {
      offset += 1;
    }
  }
  while(offset < strlen(string));
  
  for(offset=bytePosition; (offset < bytePosition + 64) && ( offset<elCount(out) ); offset++)
  {
    out[offset] = 0;
  }
  
  if(PHSTBA_DEBUG) { write("------------------------"); }
  
  return bytePosition;
}

long CompareFloatsWithAccuracy(float first, float second, long firstPercentageAccuracy)
{
  // return 1 if floats are the same (with percentageAccuracyOfA accuracy)
  const float almostZero = 0.000001;
  float epsilon;
  
  if((first >= -almostZero) && (first <= almostZero))   // workaround for near zero values
  {
    first = almostZero;
    firstPercentageAccuracy = 2*100;
  }
  
  epsilon = (firstPercentageAccuracy * first)/100.0;
  return (abs(first-second) < abs(epsilon));
}