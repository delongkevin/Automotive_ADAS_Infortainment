/*@!Encoding:1252*/
/*
   LIB Diagnostic  - collection of simple diagnostic functions (SendDiagRequestTS with 3 different overloads)
   with support for mask response.

   Last modification: 16 Jun 2020
              Author: Radoslaw Karasinski
*/
              
includes
{
  #include "LIB_Report_Utility.cin"  
}

variables
{
  const long LIB_DIAG_DEBUG = 0;
  const long MAX_ECU_QUALIFIER_LEN = 256;
  const long MAX_DIAG_REQ_SIZE = 4096;
  const long MAX_DIAG_REQ_REPORT = 200;
  const long MAX_P2_TIMEOUT_MS = 5*1000; // time to wait in tests for response - when exceed time defined in diagnostic console, 
                                         // step will be FAILED anyway
    
  enum DiagFlags
  {
    DF_IS_FUNCTIONAL = 0x0001,
    DF_ASCII = 0x0002,
    DF_PRINT_REQ_TYPE = 0x0004
  };
  
  enum DiagStatus
  {
    DS_IDLE,
    DS_REQUEST_PREPARED,
    DS_REQUEST_ERROR,
    DS_REQUEST_SENT,
    DS_WAITING_FOR_RESPONSE,
    DS_NO_RESPONSE,
    DS_RESPONSE_UNKNOWN,
    DS_RESPONSE_PENDING,
    DS_RESPONSE_NEGATIVE,
    DS_RESPONSE_POSITIVE
  };
  
  enum DiagNrcCode
  {
    generalReject = 0x10,
    serviceNotSupported = 0x11,
    subFunctionNotSupported = 0x12,
    incorrectMessageLengthOrInvalidFormat = 0x13,
    responseTooLong = 0x14,
    busyRepeatReques = 0x21,
    conditionsNotCorrect = 0x22,
    requestSequenceError = 0x24,
    requestOutOfRange = 0x31,
    securityAccessDenied = 0x33,
    invalidKey = 0x35,
    exceedNumberOfAttempts = 0x36,
    requiredTimeDelayNotExpired = 0x37,
    uploadDownloadNotAccepted = 0x70,
    transferDataSuspended = 0x71,
    generalProgrammingFailure = 0x72,
    wrongBlockSequenceCounter = 0x73,
    responsePending = 0x78,
    subFunctionNotSupportedInActiveSession = 0x7E,
    serviceNotSupportedInActiveSession = 0x7F,
    rpmTooHigh = 0x81,
    rpmTooLow = 0x82,
    engineIsRunning = 0x83, 
    engineIsNotRunning = 0x84,
    engineRunTimeTooLow = 0x85,
    temperatureTooHigh = 0x86,
    temperatureTooLow = 0x87,
    vehicleSpeedTooHigh = 0x88,
    vehicleSpeedTooLow = 0x89,
    throttleOrPedalTooHigh = 0x8A,
    throttleOrPedalTooLow = 0x8B,
    transmissionRangeNotInNeutral = 0x8C,
    transmissionRangeNotInGear = 0x8D,
    brakeSwitchNotClosed = 0x8F,
    shifterLeverNotInPark = 0x90,
    torqueConverterClutchLocked = 0x91,
    voltageTooHigh = 0x92,
    voltageTooLow = 0x93
  };
  
  struct diagEcu
  {
    char ecuQualifier[MAX_ECU_QUALIFIER_LEN];
    char ecuName[MAX_ECU_QUALIFIER_LEN];
    
    byte diagReq[MAX_DIAG_REQ_SIZE];
    long diagReqLen;
    byte diagRespExpected[MAX_DIAG_REQ_SIZE];
    long diagRespExpectedLen;
    byte diagRespMask[MAX_DIAG_REQ_SIZE];
    long diagRespMaskLen;
    byte diagResp[MAX_DIAG_REQ_SIZE];
    long diagRespLen;
    
    dword usedFlags;    
    enum DiagStatus status;
    enum DiagStatus expectedResponse;
    enum ReportObservedType observedResult;
    float sentTimestampMs;
    float receiveTimestampMs;
  };
  
  #pragma warning(disable: 2058)  // disable warning "Struct is only partially initialized."
  struct diagEcu MFK5 = {"BV_FrontSensoDriveAssisSysteUDS_Physical", "MFK5"};
}

void _parseResponse(struct diagEcu ecu, char consoleName[], diagResponse * resp)
{
  if( strncmp(ecu.ecuQualifier, consoleName, elCount(consoleName)) == 0)
  {
    ecu.receiveTimestampMs = timeNowFloat()/100.0;
    ecu.diagRespLen = resp.GetPrimitiveData(ecu.diagResp, elCount(ecu.diagResp));
        
    if(ecu.diagResp[0] == ecu.diagReq[0] + 0x40)
    {
      _setDiagStatus(ecu, DS_RESPONSE_POSITIVE);
    }
    else if(ecu.diagResp[0] == 0x7F)
    {
      _setDiagStatus(ecu, DS_RESPONSE_NEGATIVE);
    }
    else
    {
      _setDiagStatus(ecu, DS_RESPONSE_UNKNOWN);
    }
  }
}

on diagResponse *
{
  char consoleName[MAX_ECU_QUALIFIER_LEN];  
  char str[1024];
  long byteIdx;
  
  snprintf(str, elCount(str), "%f diagResponse:", timeNowFloat()/100000.0);  
  for(byteIdx=0; byteIdx<this.GetPrimitiveSize(); byteIdx++)
  {
    snprintf(str, elCount(str), "%s %02X", str, this.GetPrimitiveByte(byteIdx));
  }  
  if(LIB_DIAG_DEBUG) write(str);
    
  diagGetCurrentEcu( consoleName, elcount(consoleName));
  _parseResponse(MFK5, consoleName, this);  
}

/*
on EthernetPacket *
{
  char reconnectStr[256];
  
  if(this.dir == rx && this.doip.IsAvailable())
  {
    if(swapWord(this.doip.word(2)) == 0x0004) // Vehicle announcement/Identification response
    {
      diagSetTarget(MFK5.ecuQualifier);
      
      snprintf(reconnectStr, elCount(reconnectStr), "Reconnect to %s... ", MFK5.ecuQualifier);
      write(reconnectStr);
      diagDisconnectChannel();
      diagCloseChannel();
      diagConnectChannel();
    }
  }
}
*/

void _setDiagStatus(struct diagEcu ecu, enum DiagStatus status)
{
  ecu.status = status;
  TestSupplyTextEvent(ecu.status.name());
  if(LIB_DIAG_DEBUG) { write("%f _setDiagStatus: ecuName: %s, status: %s", timeNowFloat()/100000.0, ecu.ecuName, status.Name()); }
}

enum DiagStatus _sendPreparedDiagRequest(long isFunctional, struct diagEcu ecu)
{
  diagRequest * req;
  
  diagSetTarget(ecu.ecuQualifier);
  DiagSetP2Extended(-1);
  req.Resize(ecu.diagReqLen);
  req.SetPrimitiveData(ecu.diagReq, ecu.diagReqLen);  
  _setDiagStatus(ecu, DS_REQUEST_PREPARED);
  
  if(isFunctional)
  {
    diagSendFunctional(req);
  }
  else
  {
    diagSendRequest(req);
  }
  
  if(testWaitForDiagRequestSent(req, MAX_P2_TIMEOUT_MS) == 1)
  {
    _setDiagStatus(ecu, DS_REQUEST_SENT);
    return DS_REQUEST_SENT; 
  }
  
  return DS_REQUEST_ERROR;
}

void _verifyReceivedMessage(struct diagEcu ecu)
{
  long idx, errorCounter;
  
  errorCounter = 0;
  
  /* ========== new check added - to be verified ========== */
  if(ecu.diagRespExpectedLen != ecu.diagRespMaskLen)
  {
    snprintf(stepTemporaryString, elCount(stepTemporaryString), "%s, expected response length (%d bytes) is different than given mask (%d bytes)", stepTemporaryString, ecu.diagRespExpectedLen, ecu.diagRespMaskLen);
    errorCounter++;
  }
  
  if(ecu.diagRespLen < ecu.diagRespExpectedLen)
  {
    snprintf(stepTemporaryString, elCount(stepTemporaryString), "%s, wrong size of response (expected response length is %d bytes, received %d bytes)", stepTemporaryString, ecu.diagRespExpectedLen, ecu.diagRespLen);
    errorCounter++;
  }
  else if(ecu.diagRespLen < ecu.diagRespMaskLen)
  {
    snprintf(stepTemporaryString, elCount(stepTemporaryString), "%s, wrong size of response (expected response mask length is %d bytes, received %d bytes)", stepTemporaryString, ecu.diagRespMaskLen, ecu.diagRespLen);
    errorCounter++;
  }
  /* ==================== */
  
  for(idx=0; (idx<ecu.diagRespLen) && (idx<ecu.diagRespMaskLen); idx++)
  {
    if((ecu.diagResp[idx] & ecu.diagRespMask[idx]) != ecu.diagRespExpected[idx] )
    {
      errorCounter++;
      snprintf(stepTemporaryString, elCount(stepTemporaryString), "%s, error on byte %d", stepTemporaryString, idx+1 );
    }
  }
  
  if((errorCounter == 0) && (ecu.expectedResponse == ecu.status) )
  {
    ReportObservedPassed(stepTemporaryString);
    ecu.observedResult = REPORT_PASSED;
  }
  else
  {
    ReportObservedFailed(stepTemporaryString);
    ecu.observedResult = REPORT_FAILED;
  }
}

void _negativeMessageFormatString(struct diagEcu ecu, char str[])
{
  long idx;
  snprintf(str, elCount(str), "Negative response from %s received:", ecu.ecuName);
  for(idx=0; idx<ecu.diagRespLen; idx++)
  {
    snprintf(str, elCount(str), "%s %02X", str, ecu.diagResp[idx] );
  }
  snprintf(str, elCount(str), "%s (%s)", str, ((enum DiagNrcCode)ecu.diagResp[2]).name() );
  
  if(ecu.usedFlags & DF_ASCII)
  {
    snprintf(stepTemporaryString, elCount(stepTemporaryString), "%s (ASCII value: '", stepTemporaryString, ecu.diagResp[idx] );
    for(idx=3; idx<ecu.diagRespLen; idx++)
    {
      snprintf(stepTemporaryString, elCount(stepTemporaryString), "%s%c", stepTemporaryString, ecu.diagResp[idx] );
    }
    snprintf(stepTemporaryString, elCount(stepTemporaryString), "%s')", stepTemporaryString);
  }
}

enum DiagStatus _waitForDiagnosticResponse(struct diagEcu ecu)
{
  long idx;
  
  TestJoinTextEvent(DS_RESPONSE_UNKNOWN.name());
  TestJoinTextEvent(DS_RESPONSE_NEGATIVE.name());
  TestJoinTextEvent(DS_RESPONSE_POSITIVE.name());
  
  if(testWaitForAnyJoinedEvent(MAX_P2_TIMEOUT_MS) > 0)
  {
    if(ecu.status == DS_RESPONSE_NEGATIVE)
    {
      if((ecu.diagResp[1] == ecu.diagReq[0]) && (ecu.diagResp[2] == responsePending) )
      {
        _setDiagStatus(ecu, DS_RESPONSE_PENDING);
        ReportObserved("ResponsePending received!");
        //ReportObservedWarning("ResponsePending received!");
        if(ecu.expectedResponse != DS_RESPONSE_PENDING)
        {
          _waitForDiagnosticResponse(ecu);
        }
        else
        {
          _negativeMessageFormatString(ecu, stepTemporaryString);
          _verifyReceivedMessage(ecu);
        }
      }
      else
      {
        _negativeMessageFormatString(ecu, stepTemporaryString);
        _verifyReceivedMessage(ecu);
      }
    }
    else if(ecu.status == DS_RESPONSE_POSITIVE)
    {
      snprintf(stepTemporaryString, elCount(stepTemporaryString), "Positive response from %s received:", ecu.ecuName);
      for(idx=0; idx<ecu.diagRespLen; idx++)
      {
        snprintf(stepTemporaryString, elCount(stepTemporaryString), "%s %02X", stepTemporaryString, ecu.diagResp[idx] );
      }      
      if(ecu.usedFlags & DF_ASCII)
      {
        snprintf(stepTemporaryString, elCount(stepTemporaryString), "%s (ASCII value: '", stepTemporaryString, ecu.diagResp[idx] );
        for(idx=3; idx<ecu.diagRespLen; idx++)
        {
          snprintf(stepTemporaryString, elCount(stepTemporaryString), "%s%c", stepTemporaryString, ecu.diagResp[idx] );
        }
        snprintf(stepTemporaryString, elCount(stepTemporaryString), "%s')", stepTemporaryString);
      }
      
      _verifyReceivedMessage(ecu);
    } 
  }
  else
  {
    _setDiagStatus(ecu, DS_NO_RESPONSE);
    
    snprintf(stepTemporaryString, elCount(stepTemporaryString), "No response from %s within %d ms.", ecu.ecuName, MAX_P2_TIMEOUT_MS);
    
    if(ecu.expectedResponse == ecu.status)
    {
      ReportObservedPassed(stepTemporaryString);
    }
    else
    {
      ReportObservedFailed(stepTemporaryString);
    }
  }
  
  return ecu.status;  
}

void SendDiagRequestTS(struct diagEcu ecu, dword flags, char descryption[], char request[], char expectedResponse[], char responseMask[])
{
  char requestStr[4*MAX_DIAG_REQ_SIZE], respStr[4*MAX_DIAG_REQ_SIZE], respMaskStr[4*MAX_DIAG_REQ_SIZE];
  long errorCode;
  char errorString[1024];
  diagRequest * req;
  char name[512];
  
  if(LIB_DIAG_DEBUG) { write("\nSendDiagRequestTS data in: ecuName: %s, request: {%s}, expectedResponse: {%s}, responseMask: {%s}", ecu.ecuName, request, expectedResponse, responseMask); }
  
  ecu.usedFlags = flags;
  
  FindStringMultiplications(request, requestStr);
  ecu.diagReqLen = ParseHexStringToByteArray(requestStr, ecu.diagReq);
  FindStringMultiplications(expectedResponse, respStr);
  ecu.diagRespExpectedLen = ParseHexStringToByteArray(respStr, ecu.diagRespExpected);
  FindStringMultiplications(responseMask, respMaskStr);
  ecu.diagRespMaskLen = ParseHexStringToByteArray(respMaskStr, ecu.diagRespMask);
  
  if(ecu.diagReqLen > MAX_DIAG_REQ_REPORT)
  {
    requestStr[MAX_DIAG_REQ_REPORT] = 0;
    snprintf(requestStr ,elCount(requestStr), "%s... (request length: %d)", requestStr, ecu.diagReqLen);
  }
  
  ReportStep();
  if(strlen(descryption) > 0)
  {
    snprintf(stepTemporaryString, elCount(stepTemporaryString), "%s - send diagnostic request", descryption);
  }
  else
  {
    snprintf(stepTemporaryString, elCount(stepTemporaryString), "Send diagnostic request");
  }  
  if(flags & DF_IS_FUNCTIONAL)
  {
    snprintf(stepTemporaryString, elCount(stepTemporaryString), "%s (functional)", stepTemporaryString);
  }
  
  snprintf(stepTemporaryString, elCount(stepTemporaryString), "%s to %s: %s", stepTemporaryString, ecu.ecuName, requestStr);
  
  if(flags & DF_PRINT_REQ_TYPE)
  {
    diagSetTarget(ecu.ecuQualifier);  
    req.Resize(ecu.diagReqLen);
    req.SetPrimitiveData(ecu.diagReq, ecu.diagReqLen);  
    
    DiagGetObjectName(req, name, elcount( name));    
    snprintf(stepTemporaryString, elCount(stepTemporaryString), "%s (%s", stepTemporaryString, name);    
    
    if((ecu.diagReq[0] == 0x22) || (ecu.diagReq[0] == 0x2E))
    {
      diagGetParameter(req, "Param_RecorDataIdent", name, elcount( name));
      snprintf(stepTemporaryString, elCount(stepTemporaryString), "%s - %s)", stepTemporaryString, name); 
    }
    else if(ecu.diagReq[0] == 0x31)
    {
      diagGetParameter(req, "Param_RoutiIdent", name, elcount( name));
      snprintf(stepTemporaryString, elCount(stepTemporaryString), "%s - %s)", stepTemporaryString, name); 
    }
    else
    {
      snprintf(stepTemporaryString, elCount(stepTemporaryString), "%s)", stepTemporaryString);    
    }
  }
  
  ReportAction(stepTemporaryString);
  
  snprintf(stepTemporaryString, elCount(stepTemporaryString), "%s should respond with: %s", ecu.ecuName, respStr);
  if(ecu.diagRespExpected[0] == 0x7F)
  {
    snprintf(stepTemporaryString, elCount(stepTemporaryString), "%s (%s)", stepTemporaryString, ((enum DiagNrcCode)ecu.diagRespExpected[2]).name() );
  }
  snprintf(stepTemporaryString, elCount(stepTemporaryString), "%s - checked with mask: %s", stepTemporaryString, respMaskStr);
  ReportExpected(stepTemporaryString);
  
  if(ecu.diagRespExpected[0] == ecu.diagReq[0] + 0x40)
  {
    ecu.expectedResponse = DS_RESPONSE_POSITIVE;
  }
  else if((ecu.diagRespExpected[0] == 0x7F) && (ecu.diagRespExpected[2] == responsePending) )
  {
    ecu.expectedResponse = DS_RESPONSE_PENDING;
  }
  else if((ecu.diagRespExpected[0] == 0x7F))
  {
    ecu.expectedResponse = DS_RESPONSE_NEGATIVE;
  }
  else if(ecu.diagRespExpected[0] == 0x00)
  {
    ecu.expectedResponse = DS_NO_RESPONSE;
  }
  else
  {
    ecu.expectedResponse = DS_RESPONSE_UNKNOWN;
  }
      
  if(_sendPreparedDiagRequest((flags & DF_IS_FUNCTIONAL), ecu) == DS_REQUEST_SENT)
  {
    _setDiagStatus(ecu, DS_WAITING_FOR_RESPONSE);
    _waitForDiagnosticResponse(ecu);
  }
  else
  {
    errorCode = DiagGetLastCommunicationError();
    DiagGetCommunicationErrorString(errorCode, errorString, elcount(errorString));
    snprintf(errorString, elCount(errorString), "Diagnostic message wasn't send succesfully: %s (errorCode: %d)", errorString, errorCode);    
    if(errorCode == 161)  // DoIP - Connection was closed by the peer	
    {
      // try to reconnect
      ReportObservedFailed(errorString);  // untill will find workaround
    }
    else
    {      
      ReportObservedFailed(errorString);
      write(errorString);
    }
  }
}

void SendDiagRequestTS(struct diagEcu ecu, char descryption[], char request[], char expectedResponse[], char responseMask[])
{
  //SendDiagRequestTS(ecu, 0, descryption, request, expectedResponse, responseMask);
  SendDiagRequestTS(ecu, DF_PRINT_REQ_TYPE, descryption, request, expectedResponse, responseMask);
}

void SendDiagRequestTS(struct diagEcu ecu, char request[], char expectedResponse[], char responseMask[])
{
  SendDiagRequestTS(ecu, 0, "", request, expectedResponse, responseMask);
}

