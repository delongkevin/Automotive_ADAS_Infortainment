/*@!Encoding:1252*/
includes
{
  #include "LIB_Report_Utility.cin"  
}

variables
{
  const float DEFAULT_ECU_KL30_VOLTAGE = 14.8;
  const long PERCENTAGE_ACCURACY = 10;  
}

void CloseAllImagesOnMonitorTS()
{
  sysExec("taskkill", "/IM \"i_view64.exe\" /F");
  testWaitForTimeout(500);
}

void OpenImageOnMonitorTS(char patch[])
{
  /*  This function require IrfanView on desktop
      Remember to select proper option: 
          Options, Settings, Viewing: Remember the last window size 
          Options, Settings, Full Screen / Slideshow: Fit to screen: all images/movies
      After that move IfranView to proper screen and open it in full window mode      
  */
  char command[4096];  
  
  ReportStep();
  snprintf(stepTemporaryString, elCount(stepTemporaryString), "Open image file: %s.", patch);
  ReportAction(stepTemporaryString);
  
  snprintf(command, elCount(command), " \"%s\" /one /fs ", patch);
        
  CloseAllImagesOnMonitorTS();
  sysExec("C:\\Program Files\\IrfanView\\i_view64.exe", command);
  testWaitForTimeout(500);
}

void CloseAllVideosOnMonitorTS()
{
  sysExec("taskkill", "/IM \"vlc.exe\" /F");
  testWaitForTimeout(3000);
}

void OpenVideoOnMonitorTS(char patch[])
{
  /*  This function will open video in VLC - make sure that this program is installed!
  */
  char command[4096];
  
  ReportStep();
  snprintf(stepTemporaryString, elCount(stepTemporaryString), "Open video file: %s.", patch);
  ReportAction(stepTemporaryString);
  
  snprintf(command, elCount(command), "\"%s\" --fullscreen --video-on-top --video-title-timeout=1", patch);
  
  CloseAllVideosOnMonitorTS();
  sysExec("C:\\Program Files\\VideoLAN\\VLC\\vlc.exe", command);
  testWaitForTimeout(1000);
}

void SetKl30Output(long output)
{
  if(output)
  {
    @sysvar::PowerSupply::OutputState = 1;
  }
  else
  {
    @sysvar::PowerSupply::OutputState = 0;
  }
}

void SetKl30OutputTS(long output, long timeoutMs)
{  
  ReportStep();
  if(output)
  {
    ReportAction("Enable KL_30 output.");
    ReportExpected("KL_30 output should be enabled.");
    SetKl30Output(1);
    if(timeoutMs > 0)
    {
      testWaitForTimeout(timeoutMs);
    }
    ReportObservedPassed("KL_30 output was enabled.");
  }
  else
  {
    ReportAction("Disable KL_30 output.");
    ReportExpected("KL_30 output should be disabled.");
    SetKl30Output(0);
    if(timeoutMs > 0)
    {
      testWaitForTimeout(timeoutMs);
    }
    ReportObservedPassed("KL_30 output was disabled.");
  }
}

void SetKl30OutputTS(long output)
{
  SetKl30OutputTS(output, 10*1000);
}

void SetKl15OutputTS(long output, long timeoutMs)
{
  ReportStep();
  if(output)
  {
    ReportAction("Enable KL_15 output.");
    ReportExpected("KL_15 output should be enabled.");    
    @MEnv_Default_SET_BOL_1 = 1;
    if(timeoutMs > 0)
    {
      testWaitForTimeout(timeoutMs);
    }
    ReportObservedPassed("KL_15 output was enabled.");
  }
  else
  {
    ReportAction("Disable KL_15 output.");
    ReportExpected("KL_15 output should be disabled.");
    @MEnv_Default_SET_BOL_1 = 0;
    if(timeoutMs > 0)
    {
      testWaitForTimeout(timeoutMs);
    }
    ReportObservedPassed("KL_15 output was disabled.");
  }
}

void SetKl15OutputTS(long output)
{
  SetKl15OutputTS(output, 1000);
}

void KL30ResetTS()
{
  SetKl30OutputTS(0);
  SetKl30OutputTS(1);
}

void SetKl30VoltageTS(float voltage)
{
  ReportStep();
  snprintf(stepTemporaryString, elCount(stepTemporaryString), "Set KL_30 voltage to %.3f [V].", voltage);
  ReportAction(stepTemporaryString);
  snprintf(stepTemporaryString, elCount(stepTemporaryString), "KL_30 voltage should be set to %.3f [V] (+/- %d%%).", voltage, PERCENTAGE_ACCURACY);
  ReportExpected(stepTemporaryString);
  @sysvar::PowerSupply::SetVoltage = voltage;
  testWaitForTimeout(1000);
  
  snprintf(stepTemporaryString, elCount(stepTemporaryString), "KL_30 voltage is set to %.3f [V].", @sysvar::PowerSupply::ActualOutputVoltage);
      
  if(CompareFloatsWithAccuracy(voltage, @sysvar::PowerSupply::ActualOutputVoltage, PERCENTAGE_ACCURACY))
  {
    ReportObservedPassed(stepTemporaryString);
  }
  else
  {
    ReportObservedFailed(stepTemporaryString);
  }  
}

float GetKL30CurrentConsumption()
{
  return @sysvar::PowerSupply::ActualOutputCurrent;
}
