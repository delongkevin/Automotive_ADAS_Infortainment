/*@!Encoding:1252*/
/*
   LIB Report Utility  - collection of functions which allow to create nice looking report in CANoe.
   Each test at begginging should call ReportInit(); function. After that:
      - call ReportStep(); as indicce of new step
      - call ReportAction("Here put what you want to do");
      - call ReportExpected("Here put what are you expecting")
      - perform actual actions of tests
      - call ReportObserved("if action resuls don't need to make test failed, can be usefull i.e. for debug purposes")  OR
            - call ReportObservedWarning("if something wrong happen during test, but don't affected test itself") OR
            - call ReportObservedFailed("if action have different result, than expected") OR
            - call ReportObservedPassed("if action have expected result")
      - then you can call ReportStep(); again (with following functions) if you want to make more steps in one test.

   Last modification: 16 Jun 2020
              Author: Radoslaw Karasinski
*/
              
includes
{
  #include "LIB_Multi_Purspose_Functions.cin"  
}

variables
{ 
  /* variables for external usage */
  
  char stepTemporaryString[8192];
  
  /* variables for internal library usage */  
  long _reportStepNumber;
  char _reportStepNumberString[32];
  
  enum ReportObservedType
  {
    REPORT_NO_RESULT,
	REPORT_PASSED,
	REPORT_INCONCLUSIVE,
    REPORT_FAILED,
	REPORT_ERROR_IN_TEST_SYSTEM,    
    REPORT_WARNING
  };
  
  enum ReportObservedType TestFinalResult = REPORT_PASSED;
}

void ReportInit(char TestDescription[], char TestRequirements[], char TestParameters[])
{
  _reportStepNumber = 0;
  snprintf(stepTemporaryString, elCount(stepTemporaryString), "Description: %s\n Requirements: %s\n Parameters: %s", TestDescription, TestRequirements, TestParameters);
  TestCaseDescription(stepTemporaryString);
}

void ReportStep(long number)
{
  if(number <= 0 )
  {
    if(_reportStepNumber > 0)
    {
      TestStep("", ""); // just to make empty space beetween steps
    }
    _reportStepNumber++;
  }
  else
  {
    _reportStepNumber = number;
  }
}

void ReportStep()
{
  ReportStep(-1);
}

void ReportAction(char desc[])
{
  snprintf(_reportStepNumberString, elCount(_reportStepNumberString), "%d", _reportStepNumber);
  TestStep(_reportStepNumberString, "......ACTION: %s", desc);
}

void ReportExpected(char desc[])
{
  snprintf(_reportStepNumberString, elCount(_reportStepNumberString), "%d", _reportStepNumber);
  TestStep(_reportStepNumberString, "EXPECTED: %s", desc);
}

void ReportComment(char desc[])
{
  snprintf(_reportStepNumberString, elCount(_reportStepNumberString), "%d", _reportStepNumber);
  TestStep(_reportStepNumberString, ".COMMENT: %s", desc);
}

void _ReportObserved(enum ReportObservedType type, char desc[])
{
  snprintf(_reportStepNumberString, elCount(_reportStepNumberString), "%d", _reportStepNumber);
  switch(type)
  {
    default:
    case REPORT_FAILED:
      TestFinalResult =  REPORT_FAILED;
      TestStepFail(_reportStepNumberString, "OBSERVED: %s", desc);
      break;
      
    case REPORT_NO_RESULT:
      TestStep(_reportStepNumberString, "OBSERVED: %s", desc);
      break;
      
    case REPORT_PASSED:
      TestStepPass(_reportStepNumberString, "OBSERVED: %s", desc);
      break;
      
     case REPORT_WARNING:
      TestFinalResult =  REPORT_FAILED;
      testStepWarning(_reportStepNumberString, "OBSERVED: %s", desc);
      break;
  }
}

void ReportObserved(char desc[])
{
  _ReportObserved(REPORT_NO_RESULT, desc);
}

void ReportObservedFailed(char desc[])
{
  _ReportObserved(REPORT_FAILED, desc);
}

void ReportObservedPassed(char desc[])
{
  _ReportObserved(REPORT_PASSED, desc);
}

void ReportObservedWarning(char desc[])
{
  _ReportObserved(REPORT_WARNING, desc);
}
