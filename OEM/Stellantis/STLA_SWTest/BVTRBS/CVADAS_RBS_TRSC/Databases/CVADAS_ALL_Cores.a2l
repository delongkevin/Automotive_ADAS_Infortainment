/* generated by ASAP2 Updater - ASAP2 Tool-Set Version 16.0.40 */ ASAP2_VERSION 1 71
/begin PROJECT Master "CVADAS A2L template"
/begin MODULE CVADAS ""
/begin MOD_PAR "" /end MOD_PAR
/begin MOD_COMMON "" BYTE_ORDER MSB_LAST ALIGNMENT_BYTE 1 ALIGNMENT_WORD 2 ALIGNMENT_LONG 4 ALIGNMENT_FLOAT16_IEEE 2 ALIGNMENT_FLOAT32_IEEE 4 ALIGNMENT_FLOAT64_IEEE 8 ALIGNMENT_INT64 8 /end MOD_COMMON
/begin IF_DATA XCP
 /begin DAQ DYNAMIC 0x01 0x01 0x00 OPTIMISATION_TYPE_DEFAULT ADDRESS_EXTENSION_FREE IDENTIFICATION_FIELD_TYPE_ABSOLUTE GRANULARITY_ODT_ENTRY_SIZE_DAQ_BYTE 0x07 OVERLOAD_INDICATION_PID PRESCALER_SUPPORTED /begin TIMESTAMP_SUPPORTED 0x01 SIZE_WORD UNIT_100US TIMESTAMP_FIXED /end TIMESTAMP_SUPPORTED
  /begin EVENT "XcpEventChannel_10ms" "XcpEvent" 0x00 DAQ 0x01 0x0A 0x06 0x00 /end EVENT
 /end DAQ
 /begin PAG 0x00 /end PAG
 /begin PGM PGM_MODE_ABSOLUTE 0x00 0x00 /end PGM
 /begin PROTOCOL_LAYER 0x0104 0x07D0 0x2710 0x00 0x00 0x00 0x00 0x00 0x08 0x08 BYTE_ORDER_MSB_LAST ADDRESS_GRANULARITY_BYTE SEED_AND_KEY_EXTERNAL_FUNCTION "" /end PROTOCOL_LAYER
 /begin XCP_ON_CAN 0x0100 CAN_ID_MASTER 0xDE394018 CAN_ID_SLAVE 0xDE3D4018 BAUDRATE 0x07A120 SAMPLE_POINT 0x4B SAMPLE_RATE SINGLE BTL_CYCLES 0x08 SJW 0x02 SYNC_EDGE SINGLE /end XCP_ON_CAN
/end IF_DATA
/begin CHARACTERISTIC CONST_DPS2RPS "conversion parameter from degree/s to rad/s" VALUE 0x950ECC9C Scalar_FLOAT32_IEEE 0 Rear_ObjectDection_CM_single -3.4E+38 3.4E+38 /end CHARACTERISTIC
/begin CHARACTERISTIC CONST_KPH2MPS "conversion parameter from Kph to m/s" VALUE 0x950F58A4 Scalar_FLOAT32_IEEE 0 Rear_ObjectDection_CM_single -3.4E+38 3.4E+38 /end CHARACTERISTIC
/begin CHARACTERISTIC CONST_RPS2DPS "conversion parameter from rad/s to degree/s" VALUE 0x950F86DC Scalar_FLOAT32_IEEE 0 Rear_ObjectDection_CM_single -3.4E+38 3.4E+38 /end CHARACTERISTIC
/begin CHARACTERISTIC CeAP_m_CMtoM "cm to meter conversion" VALUE 0x0 Scalar_FLOAT32_IEEE 0 Rear_ObjectDection_CM_single -3.4E+38 3.4E+38 /end CHARACTERISTIC
/begin CHARACTERISTIC CeConst_k_ConstOne "" VALUE 0x0 Scalar_FLOAT32_IEEE 0 TRSC_VC_CM_single -3.4E+38 3.4E+38 /end CHARACTERISTIC
/begin CHARACTERISTIC CeConst_k_ConstTwo "" VALUE 0x0 Scalar_FLOAT32_IEEE 0 TRSC_VC_CM_single -3.4E+38 3.4E+38 /end CHARACTERISTIC
/begin CHARACTERISTIC CeConst_k_ConstZero "" VALUE 0x0 Scalar_FLOAT32_IEEE 0 TRSC_VC_CM_single -3.4E+38 3.4E+38 /end CHARACTERISTIC
/begin CHARACTERISTIC CeConst_ku_deg2rad "" VALUE 0x0 Scalar_FLOAT32_IEEE 0 TRSC_VC_CM_single -3.4E+38 3.4E+38 /end CHARACTERISTIC
/begin CHARACTERISTIC CeKM_b_False "Relative angle Covariance" VALUE 0x0 Scalar_BOOLEAN 0 TRSC_VC_CM_boolean 0 1 /end CHARACTERISTIC
/begin CHARACTERISTIC CeKM_b_True "array of zeros for initialiation" VALUE 0x0 Scalar_BOOLEAN 0 TRSC_VC_CM_boolean 0 1 /end CHARACTERISTIC
/begin CHARACTERISTIC CeKM_deg_180 "180 degree" VALUE 0x0 Scalar_FLOAT32_IEEE 0 TRSC_VC_CM_single_deg -3.4E+38 3.4E+38 /end CHARACTERISTIC
/begin CHARACTERISTIC CeKM_deg_360 "360 degree" VALUE 0x0 Scalar_FLOAT32_IEEE 0 TRSC_VC_CM_single_deg -3.4E+38 3.4E+38 /end CHARACTERISTIC
/begin CHARACTERISTIC CeKM_k_ArrayZeros "array of zeros for initialiation" VAL_BLK 0x0 Scalar_FLOAT32_IEEE 0 TRSC_VC_CM_single -3.4E+38 3.4E+38 MATRIX_DIM 3 /end CHARACTERISTIC
/begin CHARACTERISTIC CeKM_k_ConstFour "Gear number four" VALUE 0x0 Scalar_UBYTE 0 TRSC_VC_CM_uint8 0 255 /end CHARACTERISTIC
/begin CHARACTERISTIC CeKM_k_pi "Pi Constant" VALUE 0x0 Scalar_FLOAT32_IEEE 0 TRSC_VC_CM_single -3.4E+38 3.4E+38 /end CHARACTERISTIC
/begin CHARACTERISTIC CeTRA_deg_AngleNinety "Angle 90 deg" VALUE 0x0 Scalar_FLOAT32_IEEE 0 TRSC_VC_CM_single_deg -3.4E+38 3.4E+38 /end CHARACTERISTIC
/begin CHARACTERISTIC CeTRA_deg_AngleOneEighty "Angle 180 degree" VALUE 0x0 Scalar_FLOAT32_IEEE 0 TRSC_VC_CM_single_deg -3.4E+38 3.4E+38 /end CHARACTERISTIC
/begin CHARACTERISTIC CeTRA_deg_AngleThreeSixty "Angle 360 degree" VALUE 0x0 Scalar_FLOAT32_IEEE 0 TRSC_VC_CM_single_deg -3.4E+38 3.4E+38 /end CHARACTERISTIC
/begin CHARACTERISTIC CeTRA_k_ConstTen "Constant value Ten" VALUE 0x0 Scalar_FLOAT32_IEEE 0 TRSC_VC_CM_single -3.4E+38 3.4E+38 /end CHARACTERISTIC
/begin CHARACTERISTIC CeTRA_k_OnePerHundred "Constant value 0.01 used to calculate D-gain of PID controller" VALUE 0x0 Scalar_FLOAT32_IEEE 0 TRSC_VC_CM_single -3.4E+38 3.4E+38 /end CHARACTERISTIC
/begin CHARACTERISTIC CeTRA_k_One_Four "Constant value 1.4 used to calculate P-gain of PID controller" VALUE 0x0 Scalar_FLOAT32_IEEE 0 TRSC_VC_CM_single -3.4E+38 3.4E+38 /end CHARACTERISTIC
/begin CHARACTERISTIC CeTRA_k_fifteen "Constant Value Fifteen" VALUE 0x0 Scalar_FLOAT32_IEEE 0 TRSC_VC_CM_single -3.4E+38 3.4E+38 /end CHARACTERISTIC
/begin CHARACTERISTIC CeTRA_sec_SampleTime "sampling time" VALUE 0x0 Scalar_FLOAT32_IEEE 0 TRSC_VC_CM_single_sec -3.4E+38 3.4E+38 /end CHARACTERISTIC
/begin CHARACTERISTIC CurbLim_para "" VAL_BLK 0x0 Scalar_FLOAT32_IEEE 0 SWC_VC_CM_single 0 5 MATRIX_DIM 3 /end CHARACTERISTIC
/begin CHARACTERISTIC ErrorMgr_Satellite_RunningCount_B "AUTO PARK" VALUE 0x9D119260 __UBYTE_Z 0 NO_COMPU_METHOD 0 255 /end CHARACTERISTIC
/begin MEASUREMENT FrontCentreObjNum "" SBYTE SWC_AP_StateMachine_CM_int8 0 0 -128 127 ECU_ADDRESS 0x0 /end MEASUREMENT
/begin MEASUREMENT FrontLeftObjNum "" SBYTE SWC_AP_StateMachine_CM_int8 0 0 -128 127 ECU_ADDRESS 0x0 /end MEASUREMENT
/begin MEASUREMENT FrontRightObjNum "" SBYTE SWC_AP_StateMachine_CM_int8 0 0 -128 127 ECU_ADDRESS 0x0 /end MEASUREMENT
/begin MEASUREMENT IbFID_PA.MeAP_b_FPADisable "" UBYTE DT24_CVADAS_AP_CodGen_CM_boolean 0 0 0 1 ECU_ADDRESS 0x0 /end MEASUREMENT
/begin MEASUREMENT IbFID_PA.MeAP_b_FPAVolDefMed "" UBYTE DT24_CVADAS_AP_CodGen_CM_boolean 0 0 0 1 ECU_ADDRESS 0x0 /end MEASUREMENT
/begin MEASUREMENT IbFID_PA.MeAP_b_PAVolDefMed "" UBYTE DT24_CVADAS_AP_CodGen_CM_boolean 0 0 0 1 ECU_ADDRESS 0x0 /end MEASUREMENT
/begin MEASUREMENT IbFID_PA.MeAP_b_RPAActvTrlr "" UBYTE DT24_CVADAS_AP_CodGen_CM_boolean 0 0 0 1 ECU_ADDRESS 0x0 /end MEASUREMENT
/begin MEASUREMENT IbFID_PA.MeAP_b_RPADisable "" UBYTE DT24_CVADAS_AP_CodGen_CM_boolean 0 0 0 1 ECU_ADDRESS 0x0 /end MEASUREMENT
/begin MEASUREMENT IbFID_PA.MeAP_b_RPAVolDefMed "" UBYTE DT24_CVADAS_AP_CodGen_CM_boolean 0 0 0 1 ECU_ADDRESS 0x0 /end MEASUREMENT
/begin MEASUREMENT IbFID_PARB.MeAP_b_PARBActv4LOW "" UBYTE DT24_CVADAS_AP_CodGen_CM_boolean 0 0 0 1 ECU_ADDRESS 0x0 /end MEASUREMENT
/begin MEASUREMENT IbFID_PARB.MeAP_b_PARBActvTrlr "" UBYTE DT24_CVADAS_AP_CodGen_CM_boolean 0 0 0 1 ECU_ADDRESS 0x0 /end MEASUREMENT
/begin MEASUREMENT IbFID_PARB.MeAP_b_PARBDiable "" UBYTE DT24_CVADAS_AP_CodGen_CM_boolean 0 0 0 1 ECU_ADDRESS 0x0 /end MEASUREMENT
/begin MEASUREMENT IbFID_PPPA.MeAP_b_PPPAActv4LOW "" UBYTE DT24_CVADAS_AP_CodGen_CM_boolean 0 0 0 1 ECU_ADDRESS 0x0 /end MEASUREMENT
/begin MEASUREMENT IbFID_PPPA.MeAP_b_PPPAActvTrlr "" UBYTE DT24_CVADAS_AP_CodGen_CM_boolean 0 0 0 1 ECU_ADDRESS 0x0 /end MEASUREMENT
/begin MEASUREMENT IbFID_PPPA.MeAP_b_PPPADefEng "" UBYTE DT24_CVADAS_AP_CodGen_CM_boolean 0 0 0 1 ECU_ADDRESS 0x0 /end MEASUREMENT
/begin MEASUREMENT IbFID_PPPA.MeAP_b_PPPADisable "" UBYTE DT24_CVADAS_AP_CodGen_CM_boolean 0 0 0 1 ECU_ADDRESS 0x0 /end MEASUREMENT
/begin MEASUREMENT IbTRSC_InpBus.IbTRSC_MEProxiToIpc.IePRX_b_AuxTrlrCam "" UBYTE TRSC_SM_VC_Int_CM_boolean 0 0 0 1 ECU_ADDRESS 0x0 /end MEASUREMENT
/begin MEASUREMENT IbTRSC_InpBus.IbTRSC_MEProxiToIpc.IePRX_b_CanNode27AsmAscm "" UBYTE TRSC_SM_VC_Int_CM_boolean 0 0 0 1 ECU_ADDRESS 0x0 /end MEASUREMENT
/begin MEASUREMENT IbTRSC_InpBus.IbTRSC_MEProxiToIpc.IePRX_b_CanNode63Ttm "" UBYTE TRSC_SM_VC_Int_CM_boolean 0 0 0 1 ECU_ADDRESS 0x0 /end MEASUREMENT
/begin MEASUREMENT IbTRSC_InpBus.IbTRSC_MEProxiToIpc.IePRX_b_CanNode95ItbmItcm "" UBYTE TRSC_SM_VC_Int_CM_boolean 0 0 0 1 ECU_ADDRESS 0x0 /end MEASUREMENT
/begin MEASUREMENT IbTRSC_InpBus.IbTRSC_MEProxiToIpc.IePRX_b_SRT "" UBYTE TRSC_SM_VC_Int_CM_boolean 0 0 0 1 ECU_ADDRESS 0x0 /end MEASUREMENT
/begin MEASUREMENT IbTRSC_InpBus.IbTRSC_MEProxiToIpc.IePRX_b_SVSPresent "" UBYTE TRSC_SM_VC_Int_CM_boolean 0 0 0 1 ECU_ADDRESS 0x0 /end MEASUREMENT
/begin MEASUREMENT IbTRSC_InpBus.IbTRSC_MEProxiToIpc.IePRX_b_TRSCPresent "" UBYTE TRSC_SM_VC_Int_CM_boolean 0 0 0 1 ECU_ADDRESS 0x0 /end MEASUREMENT
/begin MEASUREMENT IbTRSC_InpBus.IbTRSC_MEProxiToIpc.IePRX_b_TrlrSurroundPresence "" UBYTE TRSC_SM_VC_Int_CM_boolean 0 0 0 1 ECU_ADDRESS 0x0 /end MEASUREMENT
/begin MEASUREMENT IbTRSC_InpBus.IbTRSC_MEProxiToIpc.IePRX_e_RadDsplyTyp "" SLONG TRSC_SM_VC_Int_CM_TeTRSC_e_RadDsplyTyp 0 0 0 2147483647 ECU_ADDRESS 0x0 /end MEASUREMENT
/begin MEASUREMENT IbTRSC_InpBus.IbTRSC_MEProxiToIpc.IePRX_e_StrRackPinTyp "" SLONG TRSC_SM_VC_Int_CM_TeTRSC_e_StrRackPinTyp 0 0 0 2147483647 ECU_ADDRESS 0x0 /end MEASUREMENT
/begin MEASUREMENT IbTRSC_InpBus.IbTRSC_MEProxiToIpc.IePRX_e_VehWhlBase "" SLONG TRSC_SM_VC_Int_CM_TeTRSC_e_VehWhlBase 0 0 0 2147483647 ECU_ADDRESS 0x0 /end MEASUREMENT
/begin MEASUREMENT IbTRSC_InpBus.IbTRSC_MEProxiToIpc.IePRX_mm_VehTyreSize "" FLOAT32_IEEE TRSC_SM_VC_Int_CM_single 0 0 -3.4E+38 3.4E+38 ECU_ADDRESS 0x0 /end MEASUREMENT
/begin MEASUREMENT IbTRSC_InpBus.IbTRSC_SVStoTRSC.IeHMI_b_MoreCamReq "" UBYTE TRSC_SM_VC_Int_CM_boolean 0 0 0 1 ECU_ADDRESS 0x0 /end MEASUREMENT
/begin MEASUREMENT IbTRSC_InpBus.IbTRSC_SVStoTRSC.MeSVS_e_DispView2Info "" SLONG TRSC_SM_VC_Int_CM_TeTRSC_e_DispView2 0 0 0 2147483647 ECU_ADDRESS 0x0 /end MEASUREMENT
/begin MEASUREMENT IbTRSC_InpBus.IbTRSC_TrailerDetInp.MeTRSC_b_OBTLRecalibrate "" UBYTE TRSC_SM_VC_Int_CM_boolean 0 0 0 1 ECU_ADDRESS 0x0 /end MEASUREMENT
/begin MEASUREMENT IbTRSC_InpBus.IbTRSC_TrailerDetInp.MeTRSC_cnt_TrlrCalibFailCntInfo "" ULONG TRSC_SM_VC_Int_CM_uint32 0 0 0 4294967295 ECU_ADDRESS 0x0 /end MEASUREMENT
/begin MEASUREMENT IbTRSC_InpBus.IbTRSC_TrailerDetInp.MeTRSC_deg_DetJackKnifeAngle "" FLOAT32_IEEE TRSC_SM_VC_Int_CM_single 0 0 -3.4E+38 3.4E+38 ECU_ADDRESS 0x0 /end MEASUREMENT
/begin MEASUREMENT IbTRSC_InpBus.IbTRSC_TrailerDetInp.MeTRSC_deg_DetJackknifeThrAngle "" FLOAT32_IEEE TRSC_SM_VC_Int_CM_single 0 0 -3.4E+38 3.4E+38 ECU_ADDRESS 0x0 /end MEASUREMENT
/begin MEASUREMENT IbTRSC_InpBus.IbTRSC_TrailerDetInp.MeTRSC_deg_TADAngle "" FLOAT32_IEEE TRSC_SM_VC_Int_CM_single 0 0 -3.4E+38 3.4E+38 ECU_ADDRESS 0x0 /end MEASUREMENT
/begin MEASUREMENT IbTRSC_InpBus.IbTRSC_TrailerDetInp.MeTRSC_deg_TADAngleRate "" FLOAT32_IEEE TRSC_SM_VC_Int_CM_single 0 0 -3.4E+38 3.4E+38 ECU_ADDRESS 0x0 /end MEASUREMENT
/begin MEASUREMENT IbTRSC_InpBus.IbTRSC_TrailerDetInp.MeTRSC_e_TADState "" SLONG TRSC_SM_VC_Int_CM_TeTRSC_e_TADState 0 0 0 2147483647 ECU_ADDRESS 0x0 /end MEASUREMENT
/begin MEASUREMENT IbTRSC_InpBus.IbTRSC_TrailerDetInp.MeTRSC_e_TrlrCalInfo "" SLONG TRSC_SM_VC_Int_CM_TeTRSC_e_TrlrCalInfo 0 0 0 2147483647 ECU_ADDRESS 0x0 /end MEASUREMENT
/begin MEASUREMENT IbTRSC_InpBus.IbTRSC_TrailerDetInp.MeTRSC_e_TrlrPrsntInfo "" SLONG TRSC_SM_VC_Int_CM_TeTRSC_e_TrlrPrsntInfo 0 0 0 2147483647 ECU_ADDRESS 0x0 /end MEASUREMENT
/begin MEASUREMENT IbTRSC_InpBus.IbTRSC_TrailerDetInp.MeTRSC_e_TrlrRecogInfo "" SLONG TRSC_SM_VC_Int_CM_TeTRSC_e_TrlrRecogInfo 0 0 0 2147483647 ECU_ADDRESS 0x0 /end MEASUREMENT
/begin MEASUREMENT IbTRSC_InpBus.IbTRSC_TrailerDetInp.MeTRSC_m_DetTrailerBeamLen "" FLOAT32_IEEE TRSC_SM_VC_Int_CM_single 0 0 -3.4E+38 3.4E+38 ECU_ADDRESS 0x0 /end MEASUREMENT
/begin MEASUREMENT IbTRSC_InpBus.IbTRSC_TrailerDetInp.MeTRSC_m_HitchLength "" FLOAT32_IEEE TRSC_SM_VC_Int_CM_single 0 0 -3.4E+38 3.4E+38 ECU_ADDRESS 0x0 /end MEASUREMENT
/begin MEASUREMENT IbTRSC_InpBus.IbTRSC_VehInpFromCAN14.IeVBII_M_StrWhlTrq "" FLOAT32_IEEE TRSC_SM_VC_Int_CM_single 0 0 -3.4E+38 3.4E+38 ECU_ADDRESS 0x0 /end MEASUREMENT
/begin MEASUREMENT IbTRSC_InpBus.IbTRSC_VehInpFromCAN14.IeVBII_a_VehLatAcc "" FLOAT32_IEEE TRSC_SM_VC_Int_CM_single 0 0 -3.4E+38 3.4E+38 ECU_ADDRESS 0x0 /end MEASUREMENT
/begin MEASUREMENT IbTRSC_InpBus.IbTRSC_VehInpFromCAN14.IeVBII_a_VehLatAccOffset "" FLOAT32_IEEE TRSC_SM_VC_Int_CM_single 0 0 -3.4E+38 3.4E+38 ECU_ADDRESS 0x0 /end MEASUREMENT
/begin MEASUREMENT IbTRSC_InpBus.IbTRSC_VehInpFromCAN14.IeVBII_a_VehLongAcc "" FLOAT32_IEEE TRSC_SM_VC_Int_CM_single 0 0 -3.4E+38 3.4E+38 ECU_ADDRESS 0x0 /end MEASUREMENT
/begin MEASUREMENT IbTRSC_InpBus.IbTRSC_VehInpFromCAN14.IeVBII_a_VehLongAccOffset "" FLOAT32_IEEE TRSC_SM_VC_Int_CM_single 0 0 -3.4E+38 3.4E+38 ECU_ADDRESS 0x0 /end MEASUREMENT
/begin MEASUREMENT IbTRSC_InpBus.IbTRSC_VehInpFromCAN14.IeVBII_b_StrTchSts "" UBYTE TRSC_SM_VC_Int_CM_boolean 0 0 0 1 ECU_ADDRESS 0x0 /end MEASUREMENT
/begin MEASUREMENT IbTRSC_InpBus.IbTRSC_VehInpFromCAN14.IeVBII_cnt_LhfPulseCtr "" UBYTE TRSC_SM_VC_Int_CM_uint8 0 0 0 255 ECU_ADDRESS 0x0 /end MEASUREMENT
/begin MEASUREMENT IbTRSC_InpBus.IbTRSC_VehInpFromCAN14.IeVBII_cnt_LhrPulseCtr "" UBYTE TRSC_SM_VC_Int_CM_uint8 0 0 0 255 ECU_ADDRESS 0x0 /end MEASUREMENT
/begin MEASUREMENT IbTRSC_InpBus.IbTRSC_VehInpFromCAN14.IeVBII_cnt_RhfPulseCtr "" UBYTE TRSC_SM_VC_Int_CM_uint8 0 0 0 255 ECU_ADDRESS 0x0 /end MEASUREMENT
/begin MEASUREMENT IbTRSC_InpBus.IbTRSC_VehInpFromCAN14.IeVBII_cnt_RhrPulseCtr "" UBYTE TRSC_SM_VC_Int_CM_uint8 0 0 0 255 ECU_ADDRESS 0x0 /end MEASUREMENT
/begin MEASUREMENT IbTRSC_InpBus.IbTRSC_VehInpFromCAN14.IeVBII_ddeg_StrWhlSpd "" FLOAT32_IEEE TRSC_SM_VC_Int_CM_single 0 0 -3.4E+38 3.4E+38 ECU_ADDRESS 0x0 /end MEASUREMENT
/begin MEASUREMENT IbTRSC_InpBus.IbTRSC_VehInpFromCAN14.IeVBII_ddeg_VehYawRate "" FLOAT32_IEEE TRSC_SM_VC_Int_CM_single 0 0 -3.4E+38 3.4E+38 ECU_ADDRESS 0x0 /end MEASUREMENT
/begin MEASUREMENT IbTRSC_InpBus.IbTRSC_VehInpFromCAN14.IeVBII_deg_StrWhlAng "" FLOAT32_IEEE TRSC_SM_VC_Int_CM_single 0 0 -3.4E+38 3.4E+38 ECU_ADDRESS 0x0 /end MEASUREMENT
/begin MEASUREMENT IbTRSC_InpBus.IbTRSC_VehInpFromCAN14.IeVBII_e_EcmTrscResp "" SLONG TRSC_SM_VC_Int_CM_TeVBII_e_EcmTrscResp 0 0 0 2147483647 ECU_ADDRESS 0x0 /end MEASUREMENT
/begin MEASUREMENT IbTRSC_InpBus.IbTRSC_VehInpFromCAN14.IeVBII_e_EngineSts "" SLONG TRSC_SM_VC_Int_CM_TeVBII_e_EngineSts 0 0 0 2147483647 ECU_ADDRESS 0x0 /end MEASUREMENT
/begin MEASUREMENT IbTRSC_InpBus.IbTRSC_VehInpFromCAN14.IeVBII_e_EscTrscBrkResp "" SLONG TRSC_SM_VC_Int_CM_TeVBII_e_EscTrscBrkResp 0 0 0 2147483647 ECU_ADDRESS 0x0 /end MEASUREMENT
/begin MEASUREMENT IbTRSC_InpBus.IbTRSC_VehInpFromCAN14.IeVBII_e_LhfWhlSpnSts "" SLONG TRSC_SM_VC_Int_CM_TeVBII_e_WhlSpnSts 0 0 0 2147483647 ECU_ADDRESS 0x0 /end MEASUREMENT
/begin MEASUREMENT IbTRSC_InpBus.IbTRSC_VehInpFromCAN14.IeVBII_e_LhrWhlSpnSts "" SLONG TRSC_SM_VC_Int_CM_TeVBII_e_WhlSpnSts 0 0 0 2147483647 ECU_ADDRESS 0x0 /end MEASUREMENT
/begin MEASUREMENT IbTRSC_InpBus.IbTRSC_VehInpFromCAN14.IeVBII_e_RhfWhlSpnSts "" SLONG TRSC_SM_VC_Int_CM_TeVBII_e_WhlSpnSts 0 0 0 2147483647 ECU_ADDRESS 0x0 /end MEASUREMENT
/begin MEASUREMENT IbTRSC_InpBus.IbTRSC_VehInpFromCAN14.IeVBII_e_RhrWhlSpnSts "" SLONG TRSC_SM_VC_Int_CM_TeVBII_e_WhlSpnSts 0 0 0 2147483647 ECU_ADDRESS 0x0 /end MEASUREMENT
/begin MEASUREMENT IbTRSC_InpBus.IbTRSC_VehInpFromCAN14.IeVBII_e_SPMLatCtrlRespSts "" SLONG TRSC_SM_VC_Int_CM_TeVBII_e_SPMLatCtrlRespSts 0 0 0 2147483647 ECU_ADDRESS 0x0 /end MEASUREMENT
/begin MEASUREMENT IbTRSC_InpBus.IbTRSC_VehInpFromCAN14.IeVBII_e_StrTrqResp "" SLONG TRSC_SM_VC_Int_CM_TeVBII_e_StrTrqResp 0 0 0 2147483647 ECU_ADDRESS 0x0 /end MEASUREMENT
/begin MEASUREMENT IbTRSC_InpBus.IbTRSC_VehInpFromCAN14.IeVBII_e_StrWhlAngleType "" SLONG TRSC_SM_VC_Int_CM_TeVBII_e_StrWhlAngleType 0 0 0 2147483647 ECU_ADDRESS 0x0 /end MEASUREMENT
/begin MEASUREMENT IbTRSC_InpBus.IbTRSC_VehInpFromCAN14.IeVBII_e_VehStandStillSts "" SLONG TRSC_SM_VC_Int_CM_TeVBII_e_VehStandStillSts 0 0 0 2147483647 ECU_ADDRESS 0x0 /end MEASUREMENT
/begin MEASUREMENT IbTRSC_InpBus.IbTRSC_VehInpFromCAN14.IeVBII_kph_LhfWhlSpd "" FLOAT32_IEEE TRSC_SM_VC_Int_CM_single 0 0 -3.4E+38 3.4E+38 ECU_ADDRESS 0x0 /end MEASUREMENT
/begin MEASUREMENT IbTRSC_InpBus.IbTRSC_VehInpFromCAN14.IeVBII_kph_LhrWhlSpd "" FLOAT32_IEEE TRSC_SM_VC_Int_CM_single 0 0 -3.4E+38 3.4E+38 ECU_ADDRESS 0x0 /end MEASUREMENT
/begin MEASUREMENT IbTRSC_InpBus.IbTRSC_VehInpFromCAN14.IeVBII_kph_RefVehSpd "" FLOAT32_IEEE TRSC_SM_VC_Int_CM_single 0 0 -3.4E+38 3.4E+38 ECU_ADDRESS 0x0 /end MEASUREMENT
/begin MEASUREMENT IbTRSC_InpBus.IbTRSC_VehInpFromCAN14.IeVBII_kph_RhfWhlSpd "" FLOAT32_IEEE TRSC_SM_VC_Int_CM_single 0 0 -3.4E+38 3.4E+38 ECU_ADDRESS 0x0 /end MEASUREMENT
/begin MEASUREMENT IbTRSC_InpBus.IbTRSC_VehInpFromCAN14.IeVBII_kph_RhrWhlSpd "" FLOAT32_IEEE TRSC_SM_VC_Int_CM_single 0 0 -3.4E+38 3.4E+38 ECU_ADDRESS 0x0 /end MEASUREMENT
/begin MEASUREMENT IbTRSC_InpBus.IbTRSC_VehInpFromCAN14.IeVBII_kph_VehSpeedVSOSig "" FLOAT32_IEEE TRSC_SM_VC_Int_CM_single 0 0 -3.4E+38 3.4E+38 ECU_ADDRESS 0x0 /end MEASUREMENT
/begin MEASUREMENT IbTRSC_InpBus.IbTRSC_VehInpFromCAN2.IeVBII_b_DriverDoorSts "" UBYTE TRSC_SM_VC_Int_CM_boolean 0 0 0 1 ECU_ADDRESS 0x0 /end MEASUREMENT
/begin MEASUREMENT IbTRSC_InpBus.IbTRSC_VehInpFromCAN2.IeVBII_b_TrnkStatus "" UBYTE TRSC_SM_VC_Int_CM_boolean 0 0 0 1 ECU_ADDRESS 0x0 /end MEASUREMENT
/begin MEASUREMENT IbTRSC_InpBus.IbTRSC_VehInpFromCAN2.IeVBII_b_VehAscmSysFail "" UBYTE TRSC_SM_VC_Int_CM_boolean 0 0 0 1 ECU_ADDRESS 0x0 /end MEASUREMENT
/begin MEASUREMENT IbTRSC_InpBus.IbTRSC_VehInpFromCAN2.IeVBII_e_CamDispSts "" SLONG TRSC_SM_VC_Int_CM_TeVBII_e_CamDispSts 0 0 0 2147483647 ECU_ADDRESS 0x0 /end MEASUREMENT
/begin MEASUREMENT IbTRSC_InpBus.IbTRSC_VehInpFromCAN2.IeVBII_e_CenterBtnSts "" SLONG TRSC_SM_VC_Int_CM_TeVBII_e_CenterBtnSts 0 0 0 2147483647 ECU_ADDRESS 0x0 /end MEASUREMENT
/begin MEASUREMENT IbTRSC_InpBus.IbTRSC_VehInpFromCAN2.IeVBII_e_CmdIgnSts "" SLONG TRSC_SM_VC_Int_CM_TeVBII_e_CmdIgnSts 0 0 0 2147483647 ECU_ADDRESS 0x0 /end MEASUREMENT
/begin MEASUREMENT IbTRSC_InpBus.IbTRSC_VehInpFromCAN2.IeVBII_e_EnblBtnSts "" SLONG TRSC_SM_VC_Int_CM_TeVBII_e_EnblBtnSts 0 0 0 2147483647 ECU_ADDRESS 0x0 /end MEASUREMENT
/begin MEASUREMENT IbTRSC_InpBus.IbTRSC_VehInpFromCAN2.IeVBII_e_GearEngagedForDsply "" SLONG TRSC_SM_VC_Int_CM_TeVBII_e_GearEngagedForDsply 0 0 0 2147483647 ECU_ADDRESS 0x0 /end MEASUREMENT
/begin MEASUREMENT IbTRSC_InpBus.IbTRSC_VehInpFromCAN2.IeVBII_e_GearRptState "" SLONG TRSC_SM_VC_Int_CM_TeVBII_e_GearRptState 0 0 0 2147483647 ECU_ADDRESS 0x0 /end MEASUREMENT
/begin MEASUREMENT IbTRSC_InpBus.IbTRSC_VehInpFromCAN2.IeVBII_e_SBR1RowDriverSeatSts "" SLONG TRSC_SM_VC_Int_CM_TeVBII_e_SBR1RowDriverSeatSts 0 0 0 2147483647 ECU_ADDRESS 0x0 /end MEASUREMENT
/begin MEASUREMENT IbTRSC_InpBus.IbTRSC_VehInpFromCAN2.IeVBII_e_ShiftLvrPos "" SLONG TRSC_SM_VC_Int_CM_TeVBII_e_ShiftLvrPos 0 0 0 2147483647 ECU_ADDRESS 0x0 /end MEASUREMENT
/begin MEASUREMENT IbTRSC_InpBus.IbTRSC_VehInpFromCAN2.IeVBII_e_TGWCamDispSts "" SLONG TRSC_SM_VC_Int_CM_TeVBII_e_TGWCamDispSts 0 0 0 2147483647 ECU_ADDRESS 0x0 /end MEASUREMENT
/begin MEASUREMENT IbTRSC_InpBus.IbTRSC_VehInpFromCAN2.IeVBII_e_TchScrSts "" SLONG TRSC_SM_VC_Int_CM_TeVBII_e_TchScrSts 0 0 0 2147483647 ECU_ADDRESS 0x0 /end MEASUREMENT
/begin MEASUREMENT IbTRSC_InpBus.IbTRSC_VehInpFromCAN2.IeVBII_e_TrailerConnectionSts "" SLONG TRSC_SM_VC_Int_CM_TeVBII_e_TrailerConnectionSts 0 0 0 2147483647 ECU_ADDRESS 0x0 /end MEASUREMENT
/begin MEASUREMENT IbTRSC_InpBus.IbTRSC_VehInpFromCAN2.IeVBII_e_TrlrPrsntSts "" SLONG TRSC_SM_VC_Int_CM_TeVBII_e_TrlrPrsntSts 0 0 0 2147483647 ECU_ADDRESS 0x0 /end MEASUREMENT
/begin MEASUREMENT IbTRSC_InpBus.IbTRSC_VehInpFromCAN2.IeVBII_e_TrscEnblBtnSts "" SLONG TRSC_SM_VC_Int_CM_TeVBII_e_TrscEnblBtnSts 0 0 0 2147483647 ECU_ADDRESS 0x0 /end MEASUREMENT
/begin MEASUREMENT IbTRSC_InpBus.IbTRSC_VehInpFromCAN2.IeVBII_e_VehAscmSts "" SLONG TRSC_SM_VC_Int_CM_TeVBII_e_VehAscmSts 0 0 0 2147483647 ECU_ADDRESS 0x0 /end MEASUREMENT
/begin MEASUREMENT IbTRSC_InpBus.IbTRSC_VehInpFromCAN2.IeVBII_e_VehFlLvlAdj "" UBYTE TRSC_SM_VC_Int_CM_boolean 0 0 0 1 ECU_ADDRESS 0x0 /end MEASUREMENT
/begin MEASUREMENT IbTRSC_InpBus.IbTRSC_VehInpFromCAN2.IeVBII_e_VehFrLvlAdj "" UBYTE TRSC_SM_VC_Int_CM_boolean 0 0 0 1 ECU_ADDRESS 0x0 /end MEASUREMENT
/begin MEASUREMENT IbTRSC_InpBus.IbTRSC_VehInpFromCAN2.IeVBII_e_VehRlLvlAdj "" UBYTE TRSC_SM_VC_Int_CM_boolean 0 0 0 1 ECU_ADDRESS 0x0 /end MEASUREMENT
/begin MEASUREMENT IbTRSC_InpBus.IbTRSC_VehInpFromCAN2.IeVBII_e_VehRrLvlAdj "" UBYTE TRSC_SM_VC_Int_CM_boolean 0 0 0 1 ECU_ADDRESS 0x0 /end MEASUREMENT
/begin MEASUREMENT IbTRSC_InpBus.IbTRSC_VehInpFromCAN2.IeVBII_k_KnobAngl "" UWORD TRSC_SM_VC_Int_CM_uint16 0 0 0 65535 ECU_ADDRESS 0x0 /end MEASUREMENT
/begin MEASUREMENT IbTRSC_InpBus.IbTRSC_VehInpFromCAN2.IeVBII_mm_VehFlLvl "" FLOAT32_IEEE TRSC_SM_VC_Int_CM_single 0 0 -3.4E+38 3.4E+38 ECU_ADDRESS 0x0 /end MEASUREMENT
/begin MEASUREMENT IbTRSC_InpBus.IbTRSC_VehInpFromCAN2.IeVBII_mm_VehFrLvl "" FLOAT32_IEEE TRSC_SM_VC_Int_CM_single 0 0 -3.4E+38 3.4E+38 ECU_ADDRESS 0x0 /end MEASUREMENT
/begin MEASUREMENT IbTRSC_InpBus.IbTRSC_VehInpFromCAN2.IeVBII_mm_VehRlLvl "" FLOAT32_IEEE TRSC_SM_VC_Int_CM_single 0 0 -3.4E+38 3.4E+38 ECU_ADDRESS 0x0 /end MEASUREMENT
/begin MEASUREMENT IbTRSC_InpBus.IbTRSC_VehInpFromCAN2.IeVBII_mm_VehRrLvl "" FLOAT32_IEEE TRSC_SM_VC_Int_CM_single 0 0 -3.4E+38 3.4E+38 ECU_ADDRESS 0x0 /end MEASUREMENT
/begin MEASUREMENT IbTRSC_InpBus.IbTRSC_VehInpFromCAN2.IeVBII_px_TchXCoord "" FLOAT32_IEEE TRSC_SM_VC_Int_CM_single 0 0 -3.4E+38 3.4E+38 ECU_ADDRESS 0x0 /end MEASUREMENT
/begin MEASUREMENT IbTRSC_InpBus.IbTRSC_VehInpFromCAN2.IeVBII_px_TchYCoord "" FLOAT32_IEEE TRSC_SM_VC_Int_CM_single 0 0 -3.4E+38 3.4E+38 ECU_ADDRESS 0x0 /end MEASUREMENT
/begin MEASUREMENT IbTRSC_InpBus.MeTRSC_b_InternalFault "MeTRSC_b_InternalFault" UBYTE NO_COMPU_METHOD 0 0 0 255 ECU_ADDRESS 0x0 /end MEASUREMENT
/begin MEASUREMENT IbTRSC_InpBus.MeTRSC_e_CamBlockSts "" UBYTE TRSC_SM_VC_Int_CM_uint8 0 0 0 255 ECU_ADDRESS 0x0 /end MEASUREMENT
/begin MEASUREMENT IeTRSC_M_TRSCStrTrq "TRSC steering torque overlay request  information" FLOAT32_IEEE TRSC_SM_VC_Int_CM_single_nm 0 0 -3.4E+38 3.4E+38 ECU_ADDRESS 0x0 /end MEASUREMENT
/begin MEASUREMENT IeTRSC_b_MoreCamReqSts "Status of More Camera request Input from HMI SoftButton, ( 0 -> NotPressed, 1 -> Pressed)" UBYTE TRSC_SM_VC_Int_CM_boolean 0 0 0 1 ECU_ADDRESS 0x0 /end MEASUREMENT
/begin MEASUREMENT IeTRSC_cnt_KnobPos "DID Value of TRSKM Knob Position" UBYTE TRSC_SM_VC_Int_CM_uint8_count 0 0 0 255 ECU_ADDRESS 0x0 /end MEASUREMENT
/begin MEASUREMENT IeTRSC_deg_FrntWhlAng "DID Value of Front Road wheel angle" FLOAT32_IEEE TRSC_SM_VC_Int_CM_single 0 0 -3.4E+38 3.4E+38 ECU_ADDRESS 0x0 /end MEASUREMENT
/begin MEASUREMENT IeTRSC_deg_JackknifeThrAngle "DID Value of JackknifeThresholdAngle" FLOAT32_IEEE TRSC_SM_VC_Int_CM_single 0 0 -3.4E+38 3.4E+38 ECU_ADDRESS 0x0 /end MEASUREMENT
/begin MEASUREMENT IeTRSC_deg_TrlrAngKnob "DID Value of Trailer Angle requested by the knob" FLOAT32_IEEE TRSC_SM_VC_Int_CM_single 0 0 -3.4E+38 3.4E+38 ECU_ADDRESS 0x0 /end MEASUREMENT
/begin MEASUREMENT IeTRSC_e_GearShiftSts "DID Value of Shifter Position status read from bus:\r\n      Init(0)\r\n      Gear1(1)\r\n      Gear2(2)\r\n      Gear3(3)\r\n      Gear4(4)\r\n      Gear5(5)\r\n      Gear6(6)\r\n      Gear7(7)\r\n      Gear8(8)\r\n      Gear9(9)\r\n      NotUsed1(10)\r\n      NotUsed2(11)\r\n   " SLONG TRSC_SM_VC_Int_CM_TeVBII_e_GearEngagedForDsply 0 0 0 2147483647 ECU_ADDRESS 0x0 /end MEASUREMENT
/begin MEASUREMENT IeTRSC_e_SpdLmtReq "TRSC ECM Speed limit request" SLONG TRSC_SM_VC_Int_CM_TeTRSC_e_SpdLmtReq 0 0 0 2147483647 ECU_ADDRESS 0x0 /end MEASUREMENT
/begin MEASUREMENT IeTRSC_e_TRSCAbortReas "Decimal value shall be converted to binary to understand bit set or resetted for below values:\r\n      \r\n      DID Value for Abort/Cancellation Reason:\r\n      No response or invalid from Engine Controller,\r\n      No response or invalid from Brake Systems M" ULONG TRSC_SM_VC_Int_CM_uint32 0 0 0 4294967295 ECU_ADDRESS 0x0 /end MEASUREMENT
/begin MEASUREMENT IeTRSC_e_TRSCLedSts "TRSKM LED request" SLONG TRSC_SM_VC_Int_CM_TeTRSC_e_TRSCLedSts 0 0 0 2147483647 ECU_ADDRESS 0x0 /end MEASUREMENT
/begin MEASUREMENT IeTRSC_e_TRSCPopupDispInfo "TRSC Cluster PopUp Request" SLONG TRSC_SM_VC_Int_CM_TeTRSC_e_TRSCPopupDispInfo 0 0 0 2147483647 ECU_ADDRESS 0x0 /end MEASUREMENT
/begin MEASUREMENT IeTRSC_e_TRSCStrTrqActvReq "TRSC steering torque overlay activation request" SLONG TRSC_SM_VC_Int_CM_TeTRSC_e_TRSCStrTrqActvReq 0 0 0 2147483647 ECU_ADDRESS 0x0 /end MEASUREMENT
/begin MEASUREMENT IeTRSC_e_TRSCSts "TRSC Status" SLONG TRSC_SM_VC_Int_CM_TeTRSC_e_TRSCSts 0 0 0 2147483647 ECU_ADDRESS 0x0 /end MEASUREMENT
/begin MEASUREMENT IeTRSC_e_TRSCUnavailReas "Decimal value shall be converted to binary to understand bit set or resetted for below values:\r\n      \r\n      DID Value for TRSC Unavailable/ not able to engage TRSC Reason:\r\n      No response or invalid from Engine Controller,\r\n      No response or inval" ULONG TRSC_SM_VC_Int_CM_uint32 0 0 0 4294967295 ECU_ADDRESS 0x0 /end MEASUREMENT
/begin MEASUREMENT IeTRSC_e_TRSKMBtnSts "DID Value of TRSKM Button Status\r\n      NotPressed(0)\r\n      Pressed(1)\r\n      SNA(2)" SLONG TRSC_SM_VC_Int_CM_TeVBII_e_EnblBtnSts 0 0 0 2147483647 ECU_ADDRESS 0x0 /end MEASUREMENT
/begin MEASUREMENT IeTRSC_e_TRSKMCenBtnSts "DID Value of TRSKM Push to Center Button Status:\r\n      NotPressed(0)\r\n      Pressed(1)\r\n      SNA(2)" SLONG TRSC_SM_VC_Int_CM_TeVBII_e_CenterBtnSts 0 0 0 2147483647 ECU_ADDRESS 0x0 /end MEASUREMENT
/begin MEASUREMENT IeTRSC_e_TRSKMSts "DID Value of TRSKM Module status:\r\n      Enabled,\r\n      Not Enabled,\r\n      SNA - No confirmation received by TRSKM" SLONG TRSC_SM_VC_Int_CM_TeTRSC_e_TRSKMSts 0 0 0 2147483647 ECU_ADDRESS 0x0 /end MEASUREMENT
/begin MEASUREMENT IeTRSC_e_TrlrHitchLightCtrl "Trailer Hitch light Control when trailer is connected" SLONG TRSC_SM_VC_Int_CM_TeTRSC_e_TrlrHitchLightCtrl 0 0 0 2147483647 ECU_ADDRESS 0x0 /end MEASUREMENT
/begin MEASUREMENT IeTRSC_e_VehStpReq "TRSC break activation request" SLONG TRSC_SM_VC_Int_CM_TeTRSC_e_VehStpReq 0 0 0 2147483647 ECU_ADDRESS 0x0 /end MEASUREMENT
/begin MEASUREMENT IeTRSC_kph_VehSpeedVSOSig "It is the average vehicle speed calculated" FLOAT32_IEEE TRSC_SM_VC_Int_CM_single_km_h 0 0 -3.4E+38 3.4E+38 ECU_ADDRESS 0x0 /end MEASUREMENT
/begin MEASUREMENT IeTRSC_m_TrlrWhlBaseEff "DID value of Trailer Wheel Base effective" FLOAT32_IEEE TRSC_SM_VC_Int_CM_single 0 0 -3.4E+38 3.4E+38 ECU_ADDRESS 0x0 /end MEASUREMENT
/begin MEASUREMENT IeTRSC_pct_TRSCStrDmp "TRSC Steering damping percentage" FLOAT32_IEEE TRSC_SM_VC_Int_CM_single_percent 0 0 -3.4E+38 3.4E+38 ECU_ADDRESS 0x0 /end MEASUREMENT
/begin CHARACTERISTIC K_Overlap_Thrsld_RAEB "" VAL_BLK 0x9511371C Scalar_FLOAT32_IEEE 0 Rear_ObjectDection_CM_single -3.4E+38 3.4E+38 MATRIX_DIM 5 /end CHARACTERISTIC
/begin CHARACTERISTIC K_e_RAEB_VehicleWidth "To feed mobileye obj type into AdCam instead of hard coded value" VALUE 0x95113214 Scalar_FLOAT32_IEEE 0 Rear_ObjectDection_CM_single -3.4E+38 3.4E+38 /end CHARACTERISTIC
/begin AXIS_PTS KaTRA_deg_TADLUTBrkPts "Breakpoints for TAD LookUp Table " 0x0 NO_INPUT_QUANTITY Lookup1D_X_FLOAT32_IEEE 0 TRSC_VC_CM_single_deg 3 -3.4E+38 3.4E+38 /end AXIS_PTS
/begin AXIS_PTS KaTRA_deg_TAD_IGainLUTBrkPts "Breakpoints for I-Gain LookUp Table for TAD" 0x0 NO_INPUT_QUANTITY Lookup1D_X_FLOAT32_IEEE 0 TRSC_VC_CM_single_deg 2 -3.4E+38 3.4E+38 /end AXIS_PTS
/begin CHARACTERISTIC KaTRA_k_PGainLUTTblData "Table Data for P-Gain LookUp Table " MAP 0x0 Lookup2D_FLOAT32_IEEE 0 TRSC_VC_CM_single -3.4E+38 3.4E+38
 /begin AXIS_DESCR COM_AXIS NO_INPUT_QUANTITY TRSC_VC_CM_single_m 2 -3.4E+38 3.4E+38 AXIS_PTS_REF KaTRA_m_PGainLUTYBrkPts /end AXIS_DESCR
 /begin AXIS_DESCR COM_AXIS NO_INPUT_QUANTITY TRSC_VC_CM_single_mps 2 -3.4E+38 3.4E+38 AXIS_PTS_REF KaTRA_v_PGainLUTXBrkPts /end AXIS_DESCR
/end CHARACTERISTIC
/begin CHARACTERISTIC KaTRA_k_TADLUTTblData "Table Data for TAD LookUp Table " CURVE 0x0 Lookup1D_FLOAT32_IEEE 0 TRSC_VC_CM_single -3.4E+38 3.4E+38
 /begin AXIS_DESCR COM_AXIS NO_INPUT_QUANTITY TRSC_VC_CM_single_deg 3 -3.4E+38 3.4E+38 AXIS_PTS_REF KaTRA_deg_TADLUTBrkPts /end AXIS_DESCR
/end CHARACTERISTIC
/begin CHARACTERISTIC KaTRA_k_TAD_IGainLUTTblData "Table data for I-Gain LookUp Table for TAD" CURVE 0x0 Lookup1D_FLOAT32_IEEE 0 TRSC_VC_CM_single -3.4E+38 3.4E+38
 /begin AXIS_DESCR COM_AXIS NO_INPUT_QUANTITY TRSC_VC_CM_single_deg 2 -3.4E+38 3.4E+38 AXIS_PTS_REF KaTRA_deg_TAD_IGainLUTBrkPts /end AXIS_DESCR
/end CHARACTERISTIC
/begin CHARACTERISTIC KaTRA_k_TravDistLUTTblData "Table data for Travel Distance LookUp Table" CURVE 0x0 Lookup1D_FLOAT32_IEEE 0 TRSC_VC_CM_single -3.4E+38 3.4E+38
 /begin AXIS_DESCR COM_AXIS NO_INPUT_QUANTITY TRSC_VC_CM_single_m 2 -3.4E+38 3.4E+38 AXIS_PTS_REF KaTRA_m_TravDistLUTBrkPts /end AXIS_DESCR
/end CHARACTERISTIC
/begin CHARACTERISTIC KaTRA_k_VehSpdLUTTblData "Table data for Vehicle Speed LookUp Table " CURVE 0x0 Lookup1D_FLOAT32_IEEE 0 TRSC_VC_CM_single -3.4E+38 3.4E+38
 /begin AXIS_DESCR COM_AXIS NO_INPUT_QUANTITY TRSC_VC_CM_single_mps 2 -3.4E+38 3.4E+38 AXIS_PTS_REF KaTRA_v_VehSpdLUTBrkPts /end AXIS_DESCR
/end CHARACTERISTIC
/begin CHARACTERISTIC KaTRA_k_VehSpd_HdgDeviatLUTTblData "Table data for Heading Deviation LookUp Table " CURVE 0x0 Lookup1D_FLOAT32_IEEE 0 TRSC_VC_CM_single -3.4E+38 3.4E+38
 /begin AXIS_DESCR COM_AXIS NO_INPUT_QUANTITY TRSC_VC_CM_single_mps 3 -3.4E+38 3.4E+38 AXIS_PTS_REF KaTRA_v_VehSpd_HdgDeviatLUTBrkPts /end AXIS_DESCR
/end CHARACTERISTIC
/begin CHARACTERISTIC KaTRA_k_VehSpd_IGainLUTTblData "Table data for I-Gain LookUp Table for vehicle speed" CURVE 0x0 Lookup1D_FLOAT32_IEEE 0 TRSC_VC_CM_single -3.4E+38 3.4E+38
 /begin AXIS_DESCR COM_AXIS NO_INPUT_QUANTITY TRSC_VC_CM_single_mps 2 -3.4E+38 3.4E+38 AXIS_PTS_REF KaTRA_v_VehSpd_IGainLUTBrkPts /end AXIS_DESCR
/end CHARACTERISTIC
/begin AXIS_PTS KaTRA_m_PGainLUTYBrkPts "Y-Breakpoints for P-Gain LookUp Table " 0x0 NO_INPUT_QUANTITY Lookup2D_X_FLOAT32_IEEE 0 TRSC_VC_CM_single_m 2 -3.4E+38 3.4E+38 /end AXIS_PTS
/begin AXIS_PTS KaTRA_m_TravDistLUTBrkPts "Breakpoints for Travel Distance LookUp Table" 0x0 NO_INPUT_QUANTITY Lookup1D_X_FLOAT32_IEEE 0 TRSC_VC_CM_single_m 2 -3.4E+38 3.4E+38 /end AXIS_PTS
/begin AXIS_PTS KaTRA_v_PGainLUTXBrkPts "X-Breakpoints for P-Gain LookUp Table " 0x0 NO_INPUT_QUANTITY Lookup2D_X_FLOAT32_IEEE 0 TRSC_VC_CM_single_mps 2 -3.4E+38 3.4E+38 /end AXIS_PTS
/begin AXIS_PTS KaTRA_v_VehSpdLUTBrkPts "Breakpoints for Vehicle Speed LookUp Table " 0x0 NO_INPUT_QUANTITY Lookup1D_X_FLOAT32_IEEE 0 TRSC_VC_CM_single_mps 2 -3.4E+38 3.4E+38 /end AXIS_PTS
/begin AXIS_PTS KaTRA_v_VehSpd_HdgDeviatLUTBrkPts "Breakpoints for Heading Deviation LookUp Table" 0x0 NO_INPUT_QUANTITY Lookup1D_X_FLOAT32_IEEE 0 TRSC_VC_CM_single_mps 3 -3.4E+38 3.4E+38 /end AXIS_PTS
/begin AXIS_PTS KaTRA_v_VehSpd_IGainLUTBrkPts "Breakpoints for I-Gain LookUp Table " 0x0 NO_INPUT_QUANTITY Lookup1D_X_FLOAT32_IEEE 0 TRSC_VC_CM_single_mps 2 -3.4E+38 3.4E+38 /end AXIS_PTS
/begin CHARACTERISTIC KeAP_Cnt_GearFiltTimeThd "Gear Filtering time threshold 400ms" VALUE 0x951131D0 Scalar_UWORD 0 SWC_AP_StateMachine_CM_uint16_ms 0 65535 /end CHARACTERISTIC
/begin CHARACTERISTIC KeAP_Cnt_GearOverrideTimeThd "Gear override time threshold" VALUE 0x951131D2 Scalar_UWORD 0 SWC_AP_StateMachine_CM_uint16_ms 0 65535 /end CHARACTERISTIC
/begin CHARACTERISTIC KeAP_b_AutoParkEn "Ego vehicle shall be equipped with Auto Park Assist feature" VALUE 0x951131C4 Scalar_BOOLEAN 0 SWC_AP_StateMachine_CM_boolean 0 1 /end CHARACTERISTIC
/begin CHARACTERISTIC KeAP_b_FPAEn "Ego vehicle shall be equipped with Front Park Assist feature" VALUE 0x951131C5 Scalar_BOOLEAN 0 SWC_AP_StateMachine_CM_boolean 0 1 /end CHARACTERISTIC
/begin CHARACTERISTIC KeAP_b_FullAutoPark "Ego vehicle shall be equipped with Fully Auto Park Assist feature" VALUE 0x951131C6 Scalar_BOOLEAN 0 SWC_AP_StateMachine_CM_boolean 0 1 /end CHARACTERISTIC
/begin CHARACTERISTIC KeAP_b_HookConnected "Hook Connected 0= Not Connected 1=Connected" VALUE 0x951131C7 Scalar_BOOLEAN 0 SWC_AP_StateMachine_CM_boolean 0 1 /end CHARACTERISTIC
/begin CHARACTERISTIC KeAP_b_RPAwithBrk "Ego vehicle shall be equipped with Rear Park Assist with Brake" VALUE 0x951131C8 Scalar_BOOLEAN 0 SWC_AP_StateMachine_CM_boolean 0 1 /end CHARACTERISTIC
/begin CHARACTERISTIC KeAP_b_RPAwithSurroundView "Ego vehicle shall be equipped with Rear Park Assist with Brake and Surround View Interaction" VALUE 0x951131C9 Scalar_BOOLEAN 0 SWC_AP_StateMachine_CM_boolean 0 1 /end CHARACTERISTIC
/begin CHARACTERISTIC KeAP_b_SteerOnlyAutoPark "Ego vehicle shall be equipped with Steer only Auto Park Assist feature" VALUE 0x951131CA Scalar_BOOLEAN 0 SWC_AP_StateMachine_CM_boolean 0 1 /end CHARACTERISTIC
/begin CHARACTERISTIC KeAP_cm_DistZone1 "Warning Zone 1 Dist" VALUE 0x951131D4 Scalar_SWORD 0 SWC_APA_CM_int16_cm 0 32767 /end CHARACTERISTIC
/begin CHARACTERISTIC KeAP_cm_DistZone2 "Warning Zone 2 Dist" VALUE 0x951131D6 Scalar_SWORD 0 SWC_APA_CM_int16_cm 0 32767 /end CHARACTERISTIC
/begin CHARACTERISTIC KeAP_cm_DistZone3 "Warning Zone 3 Dist" VALUE 0x951131D8 Scalar_SWORD 0 SWC_APA_CM_int16_cm 0 32767 /end CHARACTERISTIC
/begin CHARACTERISTIC KeAP_cm_DistZone4 "Warning Zone 4 Dist" VALUE 0x951131DA Scalar_SWORD 0 SWC_APA_CM_int16_cm 0 32767 /end CHARACTERISTIC
/begin CHARACTERISTIC KeAP_cm_DistZone5 "Warning Zone 5 Dist" VALUE 0x951131DC Scalar_SWORD 0 SWC_APA_CM_int16_cm 0 32767 /end CHARACTERISTIC
/begin CHARACTERISTIC KeAP_cm_DistZone6 "Warning Zone 6 Dist" VALUE 0x951131DE Scalar_SWORD 0 SWC_APA_CM_int16_cm 0 32767 /end CHARACTERISTIC
/begin CHARACTERISTIC KeAP_cm_FrntLongDistAdj "Longitudanl Distance from Rear Axle to Front edge of vehicle" VALUE 0x951131E0 Scalar_SWORD 0 SWC_AP_StateMachine_CM_int16_cm -32768 32767 /end CHARACTERISTIC
/begin CHARACTERISTIC KeAP_cm_HalfVehicleWidth "Ego Vehicle Car Half Width" VALUE 0x951131E2 Scalar_SWORD 0 SWC_AP_StateMachine_CM_int16_sec -32768 32767 /end CHARACTERISTIC
/begin CHARACTERISTIC KeAP_cm_HookDistOffset "Length of Permanant Hook attached at back side of Ego" VALUE 0x951131E4 Scalar_SWORD 0 SWC_AP_StateMachine_CM_int16_cm -32768 32767 /end CHARACTERISTIC
/begin CHARACTERISTIC KeAP_cm_MaxNoObjDetctDist "Max distance when no object detected" VALUE 0x951131E6 Scalar_SWORD 0 SWC_AP_StateMachine_CM_int16_cm -32768 32767 /end CHARACTERISTIC
/begin CHARACTERISTIC KeAP_cm_ObjPrestFCDistThd "Distance threshold to detect object in Front Centre" VALUE 0x951131E8 Scalar_UWORD 0 SWC_AP_StateMachine_CM_uint16_cm 0 65535 /end CHARACTERISTIC
/begin CHARACTERISTIC KeAP_cm_ObjPrestRCDistThd "Distance threshold to detect object in Rear Centre" VALUE 0x951131EA Scalar_UWORD 0 SWC_AP_StateMachine_CM_uint16_cm 0 65535 /end CHARACTERISTIC
/begin CHARACTERISTIC KeAP_cm_RearLongDistAdj "Longitudanl Distance from Rear Axle to Rear edge of vehicle" VALUE 0x951131EC Scalar_SWORD 0 SWC_AP_StateMachine_CM_int16_cm -32768 32767 /end CHARACTERISTIC
/begin CHARACTERISTIC KeAP_cm_VehicleWidth "Ego Vehicle Car Width" VALUE 0x951131EE Scalar_UWORD 0 SWC_AP_StateMachine_CM_uint16_sec 0 65535 /end CHARACTERISTIC
/begin CHARACTERISTIC KeAP_cm_WarnOffset "Warn Offset Distance " VALUE 0x951131F0 Scalar_SWORD 0 SWC_AP_StateMachine_CM_int16_sec -32768 32767 /end CHARACTERISTIC
/begin CHARACTERISTIC KeAP_cnt_ChimeVolChgAlert "Chime Volume Change Alert time threshold - Half sec chime" VALUE 0x951131F2 Scalar_UWORD 0 SWC_APA_CM_uint16_cnt 0 65535 /end CHARACTERISTIC
/begin CHARACTERISTIC KeAP_cnt_DebounceTimeThd "Debounce time threshold" VALUE 0x951131F4 Scalar_SWORD 0 SWC_APA_CM_int16_cnt 0 32767 /end CHARACTERISTIC
/begin CHARACTERISTIC KeAP_cnt_FrntChimeDisTimeThd "Front Chime Disable time threshold when Vehicle Standstill condition is true " VALUE 0x951131F6 Scalar_UWORD 0 SWC_APA_CM_uint16_cnt 0 65535 /end CHARACTERISTIC
/begin CHARACTERISTIC KeAP_cnt_HalfSecChimeAlert "Half Sec Chime Alert Time Threshold" VALUE 0x951131F8 Scalar_UWORD 0 SWC_APA_CM_uint16_cnt 0 65535 /end CHARACTERISTIC
/begin CHARACTERISTIC KeAP_cnt_LEDBlinkTimeThd "Time Step for LED blinking " VALUE 0x951131FA Scalar_UWORD 0 SWC_APA_CM_uint16_cnt 0 65535 /end CHARACTERISTIC
/begin CHARACTERISTIC KeAP_cnt_SwtStuckTimeThd "Maximum time threshold for Switch to be presssed condition 60sec" VALUE 0x951131FE Scalar_UWORD 0 SWC_AP_StateMachine_CM_uint16_sec 0 65535 /end CHARACTERISTIC
/begin CHARACTERISTIC KeAP_cnt_TimeStep "Time Step for Counter " VALUE 0x95113200 Scalar_UWORD 0 SWC_AP_StateMachine_CM_uint16_sec 0 65535 /end CHARACTERISTIC
/begin CHARACTERISTIC KeAP_cnt_VehKeyOnTimeThd "Vehicle Key On Time Threshold" VALUE 0x95113202 Scalar_UWORD 0 SWC_APA_CM_uint16_cnt 0 65535 /end CHARACTERISTIC
/begin CHARACTERISTIC KeAP_degC_OperatingTempThd "Maximum operating Temprature threshold " VALUE 0x95113218 Scalar_FLOAT32_IEEE 0 SWC_AP_StateMachine_CM_single_degC -3.4E+38 3.4E+38 /end CHARACTERISTIC
/begin CHARACTERISTIC KeAP_e_GbTypAT "ATX Gear_Box_Type" VALUE 0x951131CB Scalar_UBYTE 0 SWC_APA_CM_uint8 0 255 /end CHARACTERISTIC
/begin CHARACTERISTIC KeAP_kph_EnblHysThd "Hystere sis threshold to apply for all vehicle speed related threshold parameters" VALUE 0x9511318C Scalar_FLOAT32_IEEE 0 SWC_AP_StateMachine_CM_single_kph 0 2 /end CHARACTERISTIC
/begin CHARACTERISTIC KeAP_kph_FrntWarnMaxSpdThd "Vehicle speed threshold during Front Park Assist feature" VALUE 0x95113190 Scalar_FLOAT32_IEEE 0 SWC_AP_StateMachine_CM_single_kph 0 11 /end CHARACTERISTIC
/begin CHARACTERISTIC KeAP_kph_PSDOffThd "Vehicle speed threshold during detection the parking slot" VALUE 0x95113194 Scalar_FLOAT32_IEEE 0 SWC_AP_StateMachine_CM_single_kph 0 45 /end CHARACTERISTIC
/begin CHARACTERISTIC KeAP_kph_PSDOnThd "Vehicle speed threshold to warn driver about hight speed during parking slot detection" VALUE 0x95113198 Scalar_FLOAT32_IEEE 0 SWC_AP_StateMachine_CM_single_kph 0 3.4E+38 /end CHARACTERISTIC
/begin CHARACTERISTIC KeAP_kph_ParkMnvThd "Ego Vehicle speed limit to continue parking maneuvering" VALUE 0x9511319C Scalar_FLOAT32_IEEE 0 SWC_AP_StateMachine_CM_single_kph 0 10 /end CHARACTERISTIC
/begin CHARACTERISTIC KeAP_kph_RearWarnMaxSpdThd "Vehicle speed threshold during Rear Park Assist feature" VALUE 0x951131A0 Scalar_FLOAT32_IEEE 0 SWC_AP_StateMachine_CM_single_kph 0 11 /end CHARACTERISTIC
/begin CHARACTERISTIC KeAP_pct_ObjConfidenceThd "Detected Object Confidence threshold" VALUE 0x951131CC Scalar_UBYTE 0 SWC_AP_StateMachine_CM_uint8_pct 0 255 /end CHARACTERISTIC
/begin CHARACTERISTIC KeAP_s_BSMInterfaceCntTimeout "BSM Interface timeout threshold" VALUE 0x95113204 Scalar_UWORD 0 SWC_AP_StateMachine_CM_uint16_ms 0 65535 /end CHARACTERISTIC
/begin CHARACTERISTIC KeAP_s_CamHandshakeDur "Cam HMI Interface timeout threshold 100ms" VALUE 0x95113206 Scalar_UWORD 0 SWC_AP_StateMachine_CM_uint16_ms 0 65535 /end CHARACTERISTIC
/begin CHARACTERISTIC KeAP_s_EPSInterfaceCntTimeout "EPS Interface timeout threshold" VALUE 0x95113208 Scalar_UWORD 0 SWC_AP_StateMachine_CM_uint16_ms 0 65535 /end CHARACTERISTIC
/begin CHARACTERISTIC KeAP_s_GearShiftWaitCntTimeout "Gear Change/Shift request timeout threshold" VALUE 0x9511320A Scalar_UWORD 0 SWC_AP_StateMachine_CM_uint16_ms 0 65535 /end CHARACTERISTIC
/begin CHARACTERISTIC KeAP_s_MaxStandstillTimeThd "Maximum time threshold for vehicle to be in stand still position" VALUE 0x9511320C Scalar_UWORD 0 SWC_AP_StateMachine_CM_uint16_sec 0 65535 /end CHARACTERISTIC
/begin CHARACTERISTIC KeAP_s_ObjInPathTimeoutDur "EPS Interface timeout threshold" VALUE 0x9511320E Scalar_UWORD 0 SWC_AP_StateMachine_CM_uint16_ms 0 65535 /end CHARACTERISTIC
/begin CHARACTERISTIC KeAP_s_PausedPressBtnTimeoutDur "EPS Interface timeout threshold" VALUE 0x95113210 Scalar_UWORD 0 SWC_AP_StateMachine_CM_uint16_ms 0 65535 /end CHARACTERISTIC
/begin CHARACTERISTIC KeCMbB_b_EnblOncObjDbnc "" VALUE 0x951131CD Scalar_BOOLEAN 0 Rear_ObjectDection_CM_boolean 0 1 /end CHARACTERISTIC
/begin CHARACTERISTIC KeKM_deg_AngTh "steering wheel threshold value to compare steering wheel angle." VALUE 0x0 Scalar_FLOAT32_IEEE 0 TRSC_VC_CM_single_deg -3.4E+38 3.4E+38 /end CHARACTERISTIC
/begin CHARACTERISTIC KeKM_k_GyroYawCov "Gyro Yaw Covariance  " VALUE 0x0 Scalar_FLOAT32_IEEE 0 TRSC_VC_CM_single -3.4E+38 3.4E+38 /end CHARACTERISTIC
/begin CHARACTERISTIC KeKM_k_KM_SF_RelAngCov "Relative angle Covariance" VALUE 0x0 Scalar_FLOAT32_IEEE 0 TRSC_VC_CM_single -3.4E+38 3.4E+38 /end CHARACTERISTIC
/begin CHARACTERISTIC KeKM_k_KM_SF_RelAngRateCov "Relative angle rate covariance  " VALUE 0x0 Scalar_FLOAT32_IEEE 0 TRSC_VC_CM_single -3.4E+38 3.4E+38 /end CHARACTERISTIC
/begin CHARACTERISTIC KeKM_k_KM_SF_YawRateCov "Yaw Rate Covariance" VALUE 0x0 Scalar_FLOAT32_IEEE 0 TRSC_VC_CM_single -3.4E+38 3.4E+38 /end CHARACTERISTIC
/begin CHARACTERISTIC KeKM_k_KM_YawRateGyroBiasInit "Yaw rate Gyro bias initialization" VALUE 0x0 Scalar_FLOAT32_IEEE 0 TRSC_VC_CM_single -3.4E+38 3.4E+38 /end CHARACTERISTIC
/begin CHARACTERISTIC KeKM_k_NumWheelPulses "Number of wheel pulses" VALUE 0x0 Scalar_FLOAT32_IEEE 0 TRSC_VC_CM_single -3.4E+38 3.4E+38 /end CHARACTERISTIC
/begin CHARACTERISTIC KeKM_k_SWA_Res "Steering Wheel Angle Resolution" VALUE 0x0 Scalar_FLOAT32_IEEE 0 TRSC_VC_CM_single -3.4E+38 3.4E+38 /end CHARACTERISTIC
/begin CHARACTERISTIC KeKM_k_TADCov "Trailer Angle Detection Covariance  " VALUE 0x0 Scalar_FLOAT32_IEEE 0 TRSC_VC_CM_single -3.4E+38 3.4E+38 /end CHARACTERISTIC
/begin CHARACTERISTIC KeKM_k_UpdateIMU_H "Update IMU measurement matrix" VAL_BLK 0x0 Scalar_FLOAT32_IEEE 0 TRSC_VC_CM_single -3.4E+38 3.4E+38 MATRIX_DIM 3 /end CHARACTERISTIC
/begin CHARACTERISTIC KeKM_k_UpdateRPM_H "Update RPM measurement matrix" VAL_BLK 0x0 Scalar_FLOAT32_IEEE 0 TRSC_VC_CM_single -3.4E+38 3.4E+38 MATRIX_DIM 3 /end CHARACTERISTIC
/begin CHARACTERISTIC KeKM_k_UpdateTAD_H "Update TAD measurement matrix" VAL_BLK 0x0 Scalar_FLOAT32_IEEE 0 TRSC_VC_CM_single -3.4E+38 3.4E+38 MATRIX_DIM 3 /end CHARACTERISTIC
/begin CHARACTERISTIC KeKM_k_WhlPlsCnt_high_lim "Wheel Pulse count high limit" VALUE 0x0 Scalar_FLOAT32_IEEE 0 TRSC_VC_CM_single -3.4E+38 3.4E+38 /end CHARACTERISTIC
/begin CHARACTERISTIC KeKM_k_WhlPlsCnt_low_lim "Wheel Pulse count low limit" VALUE 0x0 Scalar_FLOAT32_IEEE 0 TRSC_VC_CM_single -3.4E+38 3.4E+38 /end CHARACTERISTIC
/begin CHARACTERISTIC KeKM_k_WhlRPMYawCov "Wheel RPM Yaw Covariance  " VALUE 0x0 Scalar_FLOAT32_IEEE 0 TRSC_VC_CM_single -3.4E+38 3.4E+38 /end CHARACTERISTIC
/begin CHARACTERISTIC KeKM_m_TrackWidth "Track Width" VALUE 0x0 Scalar_FLOAT32_IEEE 0 TRSC_VC_CM_single_m -3.4E+38 3.4E+38 /end CHARACTERISTIC
/begin CHARACTERISTIC KeKM_m_WheelCircumference "Wheel circumference" VALUE 0x0 Scalar_FLOAT32_IEEE 0 TRSC_VC_CM_single_m -3.4E+38 3.4E+38 /end CHARACTERISTIC
/begin CHARACTERISTIC KeKM_s_SampleTime "sampling time" VALUE 0x0 Scalar_FLOAT32_IEEE 0 TRSC_VC_CM_single_sec -3.4E+38 3.4E+38 /end CHARACTERISTIC
/begin CHARACTERISTIC KeTHA_M_AbortStrTrq "Steering torque for maneuver abort." VALUE 0x9510F42C Scalar_FLOAT32_IEEE 0 THA_VC_Ref_CM_single_nm 0 2.5 /end CHARACTERISTIC
/begin CHARACTERISTIC KeTHA_M_SteerTweakTrq "Steering tweak torque." VALUE 0x95113848 Scalar_FLOAT32_IEEE 0 THA_VC_Ref_CM_single_Nm 0 5 /end CHARACTERISTIC
/begin CHARACTERISTIC KeTHA_cnt_WhlPlsCntHighLim "Upper limit for wheel pulse counter." VALUE 0x95113838 Scalar_UWORD 0 THA_VC_Ref_CM_uint16 0 32768 /end CHARACTERISTIC
/begin CHARACTERISTIC KeTHA_cnt_WhlPlsCntLowLim "Lower limit for wheel pulse counter." VALUE 0x9511383A Scalar_SWORD 0 THA_VC_Ref_CM_int16 -32768 0 /end CHARACTERISTIC
/begin CHARACTERISTIC KeTHA_ddeg_StrRateLimFinal "Steering rate limit during maneuver." VALUE 0x9511383C Scalar_UWORD 0 THA_VC_Ref_CM_uint16_deg_s 0 500 /end CHARACTERISTIC
/begin CHARACTERISTIC KeTHA_ddeg_StrRateLimInit "Initial steering rate limit to avoid sudden jerk." VALUE 0x9511383E Scalar_UWORD 0 THA_VC_Ref_CM_uint16_deg_s 0 45 /end CHARACTERISTIC
/begin CHARACTERISTIC KeTHA_deg_VehTrlrInitAngMax "Maximum initial host vehicle angle from trailer ball to trailer coupler to initiate THA maneuver." VALUE 0x95110904 Scalar_FLOAT32_IEEE 0 THA_SM_Ref_CM_single_deg 0 360 /end CHARACTERISTIC
/begin CHARACTERISTIC KeTHA_kph_ActvSpdThd "Vehicle speed to active feature." VALUE 0x95111394 Scalar_FLOAT32_IEEE 0 THA_SM_Ref_CM_single_km_hr 0 100 /end CHARACTERISTIC
/begin CHARACTERISTIC KeTHA_m_WhlBase "Vehicle wheelbase distance" VALUE 0x951122B4 Scalar_FLOAT32_IEEE 0 THA_VC_Ref_CM_single_m 0 4 /end CHARACTERISTIC
/begin CHARACTERISTIC KeTHA_m_WhlCircumference "Wheel circumference." VALUE 0x95113880 Scalar_FLOAT32_IEEE 0 THA_VC_Ref_CM_single_m 0 4 /end CHARACTERISTIC
/begin CHARACTERISTIC KeTHA_px_HitchCplrDeltaThd1 "Coupler distance threshold for transiting to Engaged Delta state in pixels. (Equivalent to 4 Feet)" VALUE 0x95113840 Scalar_UWORD 0 THA_SM_Ref_CM_uint16_pixel 0 1080 /end CHARACTERISTIC
/begin CHARACTERISTIC KeTHA_px_HitchCplrDeltaThd2 "Coupler distance threshold for transiting to Engaged Inquiry state in pixels. (Equivalent to 2 Feet)" VALUE 0x95113842 Scalar_UWORD 0 THA_SM_Ref_CM_uint16_pixel 0 1080 /end CHARACTERISTIC
/begin CHARACTERISTIC KeTHA_px_RearBrkSuppDist "Distance from target trailer coupler that autonomous braking will be suppressed. " VALUE 0x95113844 Scalar_UWORD 0 THA_SM_Ref_CM_uint16_pixel 0 1080 /end CHARACTERISTIC
/begin CHARACTERISTIC KeTHA_s_BsmHandshake "BSM handshake duration." VALUE 0x951128E4 Scalar_FLOAT32_IEEE 0 THA_SM_Ref_CM_single_s 0 2 /end CHARACTERISTIC
/begin CHARACTERISTIC KeTHA_s_ChimeActvTime "THA completion chime activation duration." VALUE 0x95112A8C Scalar_FLOAT32_IEEE 0 THA_SM_Ref_CM_single_s 0 5 /end CHARACTERISTIC
/begin CHARACTERISTIC KeTHA_s_EcmHandshake "ECM handshake duration.\n      " VALUE 0x95113334 Scalar_FLOAT32_IEEE 0 THA_SM_Ref_CM_single_s 0 2 /end CHARACTERISTIC
/begin CHARACTERISTIC KeTHA_s_EpsHandshake "EPS handshake duration." VALUE 0x95113604 Scalar_FLOAT32_IEEE 0 THA_SM_Ref_CM_single_s 0 2 /end CHARACTERISTIC
/begin CHARACTERISTIC KeTHA_s_MnvTimeout "THA Maneuver Timeout." VALUE 0x95113BA4 Scalar_FLOAT32_IEEE 0 THA_SM_Ref_CM_single_s 100 1000 /end CHARACTERISTIC
/begin CHARACTERISTIC KeTHA_s_Standstill "Vehicle standstill time." VALUE 0x95113F44 Scalar_FLOAT32_IEEE 0 THA_SM_Ref_CM_single_s 0 10 /end CHARACTERISTIC
/begin CHARACTERISTIC KeTHA_s_SteerTweakTime "Steering tweak time.\n      " VALUE 0x95113884 Scalar_FLOAT32_IEEE 0 THA_VC_Ref_CM_single_s 0 2 /end CHARACTERISTIC
/begin CHARACTERISTIC KeTHA_s_ThaSampleTime "Sample time of THA feature for counter/timer operations within logic." VALUE 0x95114F4C Scalar_FLOAT32_IEEE 0 THA_SM_Ref_CM_single_s -3.4E+38 3.4E+38 /end CHARACTERISTIC
/begin CHARACTERISTIC KeTOS_s_InTurnDbncTm "" VALUE 0x951131A4 Scalar_FLOAT32_IEEE 0 Rear_ObjectDection_CM_single -3.4E+38 3.4E+38 /end CHARACTERISTIC
/begin CHARACTERISTIC KeTOS_s_StrDrvDbncTm "" VALUE 0x951131A8 Scalar_FLOAT32_IEEE 0 Rear_ObjectDection_CM_single -3.4E+38 3.4E+38 /end CHARACTERISTIC
/begin CHARACTERISTIC KeTOS_s_TurnExitDbncTm "" VALUE 0x951131AC Scalar_FLOAT32_IEEE 0 Rear_ObjectDection_CM_single -3.4E+38 3.4E+38 /end CHARACTERISTIC
/begin CHARACTERISTIC KeTOS_x_InTurnThd "" VALUE 0x951131B0 Scalar_FLOAT32_IEEE 0 Rear_ObjectDection_CM_single -3.4E+38 3.4E+38 /end CHARACTERISTIC
/begin CHARACTERISTIC KeTOS_x_TurnExitThd "" VALUE 0x951131B4 Scalar_FLOAT32_IEEE 0 Rear_ObjectDection_CM_single -3.4E+38 3.4E+38 /end CHARACTERISTIC
/begin CHARACTERISTIC KeTRA_deg_TrailerBeamLenYBrkPts "Y-Breakpoints for Trailer Beam Length" VAL_BLK 0x0 Scalar_FLOAT32_IEEE 0 TRSC_VC_CM_single_deg -3.4E+38 3.4E+38 MATRIX_DIM 3 /end CHARACTERISTIC
/begin CHARACTERISTIC KeTRA_k_Kp "Kp value(5) used to calculate P-gain of PID controller" VALUE 0x0 Scalar_FLOAT32_IEEE 0 TRSC_VC_CM_single -3.4E+38 3.4E+38 /end CHARACTERISTIC
/begin CHARACTERISTIC KeTRA_m_K_beta "Calibration Value Beta used for P-Gain in PID" VALUE 0x0 Scalar_FLOAT32_IEEE 0 TRSC_VC_CM_single_m -3.4E+38 3.4E+38 /end CHARACTERISTIC
/begin CHARACTERISTIC KeTRA_m_TrailerBeamLenXBrkPts "X-Breakpoints for Trailer Beam Length" VAL_BLK 0x0 Scalar_FLOAT32_IEEE 0 TRSC_VC_CM_single_m -3.4E+38 3.4E+38 MATRIX_DIM 3 /end CHARACTERISTIC
/begin CHARACTERISTIC KeTRSC_Cnt_FailedCnt "MCU2_0" VALUE 0x0 __UBYTE_Z 0 NO_COMPU_METHOD 0 255 /end CHARACTERISTIC
/begin CHARACTERISTIC KeTRSC_e_CamBlockAcceptLvl "acceptance value" VALUE 0x0 Scalar_UBYTE 0 TRSC_StateMachine_CM_uint8 0 255 /end CHARACTERISTIC
/begin CHARACTERISTIC KeTRSC_kph_DeactivationSpd "DEACTIVATION_SPD" VALUE 0x0 Scalar_FLOAT32_IEEE 0 TRSC_StateMachine_CM_single_km_h 4 15 /end CHARACTERISTIC
/begin CHARACTERISTIC KeTRSC_pct_TrlrJackKnifePerc "TRAILER_JACKNIFE_PERCENT" VALUE 0x0 Scalar_FLOAT32_IEEE 0 TRSC_StateMachine_CM_single__ 0 100 /end CHARACTERISTIC
/begin CHARACTERISTIC KeTRSC_s_ActTransRevDbnc2 "ACTUAL_TRANS_REVERSE_DEBOUNCE_2" VALUE 0x0 Scalar_FLOAT32_IEEE 0 TRSC_StateMachine_CM_single_sec 0.5 2 /end CHARACTERISTIC
/begin CHARACTERISTIC KeTRSC_s_CalibDlyTh "Calibration Delay (1000 ms)" VALUE 0x0 Scalar_FLOAT32_IEEE 0 TRSC_StateMachine_CM_single_sec -3.4E+38 3.4E+38 /end CHARACTERISTIC
/begin CHARACTERISTIC KeTRSC_s_EpsRespTmOut "EPS_RESPONSE_TIME_OUT" VALUE 0x0 Scalar_FLOAT32_IEEE 0 TRSC_StateMachine_CM_single_sec 1 5 /end CHARACTERISTIC
/begin CHARACTERISTIC KeTRSC_s_FifteenSecTh "15 sec" VALUE 0x0 Scalar_FLOAT32_IEEE 0 TRSC_StateMachine_CM_single_sec -3.4E+38 3.4E+38 /end CHARACTERISTIC
/begin CHARACTERISTIC KeTRSC_s_FiveSecTh "LED timer threshold (5 Sec) used for blinking" VALUE 0x0 Scalar_FLOAT32_IEEE 0 TRSC_StateMachine_CM_single_sec -3.4E+38 3.4E+38 /end CHARACTERISTIC
/begin CHARACTERISTIC KeTRSC_s_GearDbncTh "Gear Debounce timer threshold = 350 msec" VALUE 0x0 Scalar_FLOAT32_IEEE 0 TRSC_StateMachine_CM_single_sec -3.4E+38 3.4E+38 /end CHARACTERISTIC
/begin CHARACTERISTIC KeTRSC_s_LEDTmrTh "LED timer threshold (5 Sec) used for blinking" VALUE 0x0 Scalar_FLOAT32_IEEE 0 TRSC_StateMachine_CM_single_sec -3.4E+38 3.4E+38 /end CHARACTERISTIC
/begin CHARACTERISTIC KeTRSC_s_RespNotRcvdTmOut "RESPONSE_NOT_RECEIVED_TIME_OUT (300 msec)" VALUE 0x0 Scalar_FLOAT32_IEEE 0 TRSC_StateMachine_CM_single_sec 0.1 0.8 /end CHARACTERISTIC
/begin CHARACTERISTIC KeTRSC_s_TenMinTh "10 Min = 600 seconds timer threshold" VALUE 0x0 Scalar_FLOAT32_IEEE 0 TRSC_StateMachine_CM_single_sec -3.4E+38 3.4E+38 /end CHARACTERISTIC
/begin CHARACTERISTIC KeTRSC_s_ThirtySecTh "30 sec" VALUE 0x0 Scalar_FLOAT32_IEEE 0 TRSC_StateMachine_CM_single_sec -3.4E+38 3.4E+38 /end CHARACTERISTIC
/begin CHARACTERISTIC KeTRSC_s_TrlrUnkwnSet "TRAILER_UNKNOWN_SET = 10 sec" VALUE 0x0 Scalar_FLOAT32_IEEE 0 TRSC_StateMachine_CM_single_sec 5 120 /end CHARACTERISTIC
/begin CHARACTERISTIC KeTRSC_s_TwoSecTh "LED timer threshold (2 Sec) used for blinking" VALUE 0x0 Scalar_FLOAT32_IEEE 0 TRSC_StateMachine_CM_single_sec -3.4E+38 3.4E+38 /end CHARACTERISTIC
/begin MEASUREMENT MbNVM_ProxyParam.KeAP_b_CVPAMPres "" UBYTE DT24_CVADAS_AP_CodGen_CM_boolean 0 0 0 1 ECU_ADDRESS 0x0 /end MEASUREMENT
/begin MEASUREMENT MbNVM_ProxyParam.KeAP_b_CanNode24PAMCVADAS "" UBYTE DT24_CVADAS_AP_CodGen_CM_boolean 0 0 0 1 ECU_ADDRESS 0x0 /end MEASUREMENT
/begin MEASUREMENT MbNVM_ProxyParam.KeAP_b_CanNode63TTM "" UBYTE DT24_CVADAS_AP_CodGen_CM_boolean 0 0 0 1 ECU_ADDRESS 0x95113791 /end MEASUREMENT
/begin MEASUREMENT MbNVM_ProxyParam.KeAP_b_CanNode67DTCM "" UBYTE DT24_CVADAS_AP_CodGen_CM_boolean 0 0 0 1 ECU_ADDRESS 0x95113790 /end MEASUREMENT
/begin MEASUREMENT MbNVM_ProxyParam.KeAP_b_CanNode95ITBMTCM "" UBYTE DT24_CVADAS_AP_CodGen_CM_boolean 0 0 0 1 ECU_ADDRESS 0x951137A1 /end MEASUREMENT
/begin MEASUREMENT MbNVM_ProxyParam.KeAP_b_DrvSide "" UBYTE DT24_CVADAS_AP_CodGen_CM_boolean 0 0 0 1 ECU_ADDRESS 0x951137A2 /end MEASUREMENT
/begin MEASUREMENT MbNVM_ProxyParam.KeAP_b_FullAutoPrkgSys "" UBYTE DT24_CVADAS_AP_CodGen_CM_boolean 0 0 0 1 ECU_ADDRESS 0x951137A7 /end MEASUREMENT
/begin MEASUREMENT MbNVM_ProxyParam.KeAP_b_PAMCfg "" UBYTE DT24_CVADAS_AP_CodGen_CM_boolean 0 0 0 1 ECU_ADDRESS 0x9511379F /end MEASUREMENT
/begin MEASUREMENT MbNVM_ProxyParam.KeAP_b_ParkWithStop "" UBYTE DT24_CVADAS_AP_CodGen_CM_boolean 0 0 0 1 ECU_ADDRESS 0x9511379E /end MEASUREMENT
/begin MEASUREMENT MbNVM_ProxyParam.KeAP_b_PullOutCtrlPres "" UBYTE DT24_CVADAS_AP_CodGen_CM_boolean 0 0 0 1 ECU_ADDRESS 0x951137A6 /end MEASUREMENT
/begin MEASUREMENT MbNVM_ProxyParam.KeAP_b_SemiAutoPrkgSys "" UBYTE DT24_CVADAS_AP_CodGen_CM_boolean 0 0 0 1 ECU_ADDRESS 0x951137A3 /end MEASUREMENT
/begin MEASUREMENT MbNVM_ProxyParam.KeAP_b_StopAndStrt "" UBYTE DT24_CVADAS_AP_CodGen_CM_boolean 0 0 0 1 ECU_ADDRESS 0x95113792 /end MEASUREMENT
/begin MEASUREMENT MbNVM_ProxyParam.KeAP_b_TrlrHitchAsstPres "" UBYTE DT24_CVADAS_AP_CodGen_CM_boolean 0 0 0 1 ECU_ADDRESS 0x951137A8 /end MEASUREMENT
/begin MEASUREMENT MbNVM_ProxyParam.KeAP_b_TrlrRvsSteerPres "" UBYTE DT24_CVADAS_AP_CodGen_CM_boolean 0 0 0 1 ECU_ADDRESS 0x951137A9 /end MEASUREMENT
/begin MEASUREMENT MbNVM_ProxyParam.KeAP_e_CtryCod "" SLONG DT24_CVADAS_AP_CodGen_CM_TeAP_e_CtryCod 0 0 0 215 ECU_ADDRESS 0x9511379B /end MEASUREMENT
/begin MEASUREMENT MbNVM_ProxyParam.KeAP_e_DrvTypVrnt "" SLONG DT24_CVADAS_AP_CodGen_CM_TeAP_e_DrvTypVrnt 0 0 0 4 ECU_ADDRESS 0x95113797 /end MEASUREMENT
/begin MEASUREMENT MbNVM_ProxyParam.KeAP_e_GbTyp "" SLONG DT24_CVADAS_AP_CodGen_CM_TeAP_e_GbTyp 0 0 0 4 ECU_ADDRESS 0x95113798 /end MEASUREMENT
/begin MEASUREMENT MbNVM_ProxyParam.KeAP_e_HybTyp "" SLONG DT24_CVADAS_AP_CodGen_CM_TeAP_e_HybTyp 0 0 0 5 ECU_ADDRESS 0x9511379C /end MEASUREMENT
/begin MEASUREMENT MbNVM_ProxyParam.KeAP_e_MdlYr "" UWORD DT24_CVADAS_AP_CodGen_CM_uint16 0 0 0 65535 ECU_ADDRESS 0x951137A4 /end MEASUREMENT
/begin MEASUREMENT MbNVM_ProxyParam.KeAP_e_PAMTunSet "" SLONG DT24_CVADAS_AP_CodGen_CM_TeAP_e_PAMTunSet 0 0 0 4 ECU_ADDRESS 0x95113799 /end MEASUREMENT
/begin MEASUREMENT MbNVM_ProxyParam.KeAP_e_RadioDispTyp "" SLONG DT24_CVADAS_AP_CodGen_CM_TeAP_e_RadioDispTyp 0 0 0 9 ECU_ADDRESS 0x951137A0 /end MEASUREMENT
/begin MEASUREMENT MbNVM_ProxyParam.KeAP_e_SteerRatRackPinionTyp "" SLONG DT24_CVADAS_AP_CodGen_CM_TeAP_e_SteerRatRackPinionTyp 0 0 0 2 ECU_ADDRESS 0x95113796 /end MEASUREMENT
/begin MEASUREMENT MbNVM_ProxyParam.KeAP_e_VehLineCfg "" UBYTE DT24_CVADAS_AP_CodGen_CM_uint8 0 0 0 255 ECU_ADDRESS 0x9511379A /end MEASUREMENT
/begin MEASUREMENT MbNVM_ProxyParam.KeAP_e_WhlBas "" SLONG DT24_CVADAS_AP_CodGen_CM_TeAP_e_WhlBas 0 0 0 2 ECU_ADDRESS 0x9511379D /end MEASUREMENT
/begin MEASUREMENT MbNVM_ProxyParam.KeAP_mm_TyreSz "" UWORD DT24_CVADAS_AP_CodGen_CM_uint16 0 0 0 65535 ECU_ADDRESS 0x95113794 /end MEASUREMENT
/begin MEASUREMENT MbUSS_DiagFlag.commFault "" UWORD DT24_CVADAS_AP_CodGen_CM_uint16 0 0 0 65535 ECU_ADDRESS 0x95113706 /end MEASUREMENT
/begin MEASUREMENT MbUSS_DiagFlag.commUnknown "" UWORD DT24_CVADAS_AP_CodGen_CM_uint16 0 0 0 65535 ECU_ADDRESS 0x95113708 /end MEASUREMENT
/begin MEASUREMENT MbUSS_DiagFlag.hardwareFault "" UWORD DT24_CVADAS_AP_CodGen_CM_uint16 0 0 0 65535 ECU_ADDRESS 0x9511370A /end MEASUREMENT
/begin MEASUREMENT MbUSS_DiagFlag.overTempFault "" UWORD DT24_CVADAS_AP_CodGen_CM_uint16 0 0 0 65535 ECU_ADDRESS 0x95113704 /end MEASUREMENT
/begin MEASUREMENT MeAP_b_ACCEngg "" UBYTE SWC_AP_StateMachine_CM_boolean 0 0 0 1 ECU_ADDRESS 0x95115994 /end MEASUREMENT
/begin MEASUREMENT MeAP_b_BSMHandshakeFailed "" UBYTE SWC_AP_StateMachine_CM_boolean 0 0 0 1 ECU_ADDRESS 0x95115995 /end MEASUREMENT
/begin MEASUREMENT MeAP_b_BtnPsd "" UBYTE SWC_AP_StateMachine_CM_boolean 0 0 0 1 ECU_ADDRESS 0x95115996 /end MEASUREMENT
/begin MEASUREMENT MeAP_b_DoorOpen "" UBYTE SWC_AP_StateMachine_CM_boolean 0 0 0 1 ECU_ADDRESS 0x95115997 /end MEASUREMENT
/begin MEASUREMENT MeAP_b_DriverOverride "" UBYTE SWC_AP_StateMachine_CM_boolean 0 0 0 1 ECU_ADDRESS 0x95115998 /end MEASUREMENT
/begin MEASUREMENT MeAP_b_EPBStsFaulted "" UBYTE SWC_AP_StateMachine_CM_boolean 0 0 0 1 ECU_ADDRESS 0x95115999 /end MEASUREMENT
/begin MEASUREMENT MeAP_b_EPSHandshakeFailed "" UBYTE SWC_AP_StateMachine_CM_boolean 0 0 0 1 ECU_ADDRESS 0x9511599A /end MEASUREMENT
/begin MEASUREMENT MeAP_b_ESCActive "" UBYTE SWC_AP_StateMachine_CM_boolean 0 0 0 1 ECU_ADDRESS 0x9511599B /end MEASUREMENT
/begin MEASUREMENT MeAP_b_ETMHandshakeFailed "" UBYTE SWC_AP_StateMachine_CM_boolean 0 0 0 1 ECU_ADDRESS 0x9511599C /end MEASUREMENT
/begin MEASUREMENT MeAP_b_FPAStatus "" UBYTE DT24_CVADAS_AP_CodGen_CM_boolean 0 0 0 1 ECU_ADDRESS 0x9511569C /end MEASUREMENT
/begin MEASUREMENT MeAP_b_FPASwtStatus "" UBYTE DT24_CVADAS_AP_CodGen_CM_boolean 0 0 0 1 ECU_ADDRESS 0x9511569D /end MEASUREMENT
/begin MEASUREMENT MeAP_b_FeatureEnbl "" UBYTE SWC_AP_StateMachine_CM_boolean 0 0 0 1 ECU_ADDRESS 0x9511599D /end MEASUREMENT
/begin MEASUREMENT MeAP_b_FrntSnsrBlk "" UBYTE SWC_AP_StateMachine_CM_boolean 0 0 0 1 ECU_ADDRESS 0x9511599E /end MEASUREMENT
/begin MEASUREMENT MeAP_b_HandsOn "" UBYTE SWC_AP_StateMachine_CM_boolean 0 0 0 1 ECU_ADDRESS 0x9511599F /end MEASUREMENT
/begin MEASUREMENT MeAP_b_LifeGateOpen "" UBYTE SWC_AP_StateMachine_CM_boolean 0 0 0 1 ECU_ADDRESS 0x951159A0 /end MEASUREMENT
/begin MEASUREMENT MeAP_b_Lo4DriveTrain "" UBYTE SWC_AP_StateMachine_CM_boolean 0 0 0 1 ECU_ADDRESS 0x951159A1 /end MEASUREMENT
/begin MEASUREMENT MeAP_b_ManualParkReq "" UBYTE SWC_AP_StateMachine_CM_boolean 0 0 0 1 ECU_ADDRESS 0x951159A2 /end MEASUREMENT
/begin MEASUREMENT MeAP_b_MnvSpdExceed "" UBYTE SWC_AP_StateMachine_CM_boolean 0 0 0 1 ECU_ADDRESS 0x951159A3 /end MEASUREMENT
/begin MEASUREMENT MeAP_b_ObjInPath "" UBYTE DT24_CVADAS_AP_CodGen_CM_boolean 0 0 0 1 ECU_ADDRESS 0x951156A1 /end MEASUREMENT
/begin MEASUREMENT MeAP_b_ObjInPathTimeout "" UBYTE SWC_AP_StateMachine_CM_boolean 0 0 0 1 ECU_ADDRESS 0x951159A4 /end MEASUREMENT
/begin MEASUREMENT MeAP_b_ObjValid "" UBYTE SWC_AP_StateMachine_CM_boolean 0 0 0 1 ECU_ADDRESS 0x0 MATRIX_DIM 10 /end MEASUREMENT
/begin MEASUREMENT MeAP_b_PausedPressBtnTimeout "" UBYTE SWC_AP_StateMachine_CM_boolean 0 0 0 1 ECU_ADDRESS 0x951159A5 /end MEASUREMENT
/begin MEASUREMENT MeAP_b_RPAStatus "" UBYTE DT24_CVADAS_AP_CodGen_CM_boolean 0 0 0 1 ECU_ADDRESS 0x951156AC /end MEASUREMENT
/begin MEASUREMENT MeAP_b_RPASwtStatus "" UBYTE DT24_CVADAS_AP_CodGen_CM_boolean 0 0 0 1 ECU_ADDRESS 0x951156AD /end MEASUREMENT
/begin MEASUREMENT MeAP_b_RearSnsrBlk "" UBYTE SWC_AP_StateMachine_CM_boolean 0 0 0 1 ECU_ADDRESS 0x951159A6 /end MEASUREMENT
/begin MEASUREMENT MeAP_b_SeekSpdExceed "" UBYTE SWC_AP_StateMachine_CM_boolean 0 0 0 1 ECU_ADDRESS 0x951159A7 /end MEASUREMENT
/begin MEASUREMENT MeAP_b_TCMFailed "" UBYTE SWC_AP_StateMachine_CM_boolean 0 0 0 1 ECU_ADDRESS 0x951159A8 /end MEASUREMENT
/begin MEASUREMENT MeAP_b_TrlrConn "" UBYTE SWC_AP_StateMachine_CM_boolean 0 0 0 1 ECU_ADDRESS 0x951159A9 /end MEASUREMENT
/begin MEASUREMENT MeAP_b_VehCndSts "" UBYTE SWC_AP_StateMachine_CM_boolean 0 0 0 1 ECU_ADDRESS 0x951159AA /end MEASUREMENT
/begin MEASUREMENT MeAP_cm_FrntCenterMinXDist "" SWORD DT24_CVADAS_AutoPark_Func_CM_int16 0 0 -32768 32767 ECU_ADDRESS 0x95116302 /end MEASUREMENT
/begin MEASUREMENT MeAP_cm_FrntLeftMinXDist "" SWORD DT24_CVADAS_AutoPark_Func_CM_int16 0 0 -32768 32767 ECU_ADDRESS 0x95116304 /end MEASUREMENT
/begin MEASUREMENT MeAP_cm_FrntRightMinXDist "" SWORD DT24_CVADAS_AutoPark_Func_CM_int16 0 0 -32768 32767 ECU_ADDRESS 0x95116306 /end MEASUREMENT
/begin MEASUREMENT MeAP_cm_ObjXPos "" SWORD SWC_AP_StateMachine_CM_int16 0 0 -32768 32767 ECU_ADDRESS 0x0 MATRIX_DIM 10 /end MEASUREMENT
/begin MEASUREMENT MeAP_cm_ObjYPos "" SWORD SWC_AP_StateMachine_CM_int16 0 0 -32768 32767 ECU_ADDRESS 0x0 MATRIX_DIM 10 /end MEASUREMENT
/begin MEASUREMENT MeAP_cm_RearCenterMinXDist "" SWORD DT24_CVADAS_AutoPark_Func_CM_int16 0 0 -32768 32767 ECU_ADDRESS 0x95116308 /end MEASUREMENT
/begin MEASUREMENT MeAP_cm_RearLeftMinXDist "" SWORD DT24_CVADAS_AutoPark_Func_CM_int16 0 0 -32768 32767 ECU_ADDRESS 0x9511630A /end MEASUREMENT
/begin MEASUREMENT MeAP_cm_RearRightMinXDist "" SWORD DT24_CVADAS_AutoPark_Func_CM_int16 0 0 -32768 32767 ECU_ADDRESS 0x9511630C /end MEASUREMENT
/begin MEASUREMENT MeAP_cnt_StateDebugVar "" ULONG SWC_AP_StateMachine_CM_uint32 0 0 0 4294967295 ECU_ADDRESS 0x951159AC /end MEASUREMENT
/begin MEASUREMENT MeAP_cnt_TransDebugVar "" ULONG SWC_AP_StateMachine_CM_uint32 0 0 0 4294967295 ECU_ADDRESS 0x951159B0 /end MEASUREMENT
/begin MEASUREMENT MeAP_e_AutoParkStatus "" SLONG DT24_CVADAS_AP_CodGen_CM_TeAutoPark_e_AutoParkStatus 0 0 0 2147483647 ECU_ADDRESS 0x951156C0 /end MEASUREMENT
/begin MEASUREMENT MeAP_e_ParkAssistStatus "" SLONG DT24_CVADAS_AP_CodGen_CM_TeAP_e_ParkAssistStatus 0 0 0 2147483647 ECU_ADDRESS 0x951156C4 /end MEASUREMENT
/begin MEASUREMENT MeAutoPark_e_AlgoState "" SLONG DT24_CVADAS_AP_CodGen_CM_TeAP_e_AlgoState 0 0 0 2147483647 ECU_ADDRESS 0x951156C8 /end MEASUREMENT
/begin MEASUREMENT MeCtrl_deg_HeadingDeviation "Intermediate signal for Heading Deviation" FLOAT32_IEEE TRSC_VC_CM_single_deg 0 0 -3.4E+38 3.4E+38 ECU_ADDRESS 0x0 /end MEASUREMENT
/begin MEASUREMENT MeCtrl_deg_HeadingOut "Intermediate signal for Heading Output" FLOAT32_IEEE TRSC_VC_CM_single_deg 0 0 -3.4E+38 3.4E+38 ECU_ADDRESS 0x0 /end MEASUREMENT
/begin MEASUREMENT MeCtrl_deg_TAD_PID "Intermediate signal for Trailer Angle Detect for PID" FLOAT32_IEEE TRSC_VC_CM_single_deg 0 0 -3.4E+38 3.4E+38 ECU_ADDRESS 0x0 /end MEASUREMENT
/begin MEASUREMENT MeCtrl_deg_e_p "Intermediate signal for error" FLOAT32_IEEE TRSC_VC_CM_single_deg 0 0 -3.4E+38 3.4E+38 ECU_ADDRESS 0x0 /end MEASUREMENT
/begin MEASUREMENT MeSVS_b_ImgDefeatReqSts "Cancel Button" UBYTE THA_SM_Ref_CM_boolean 0 0 0 1 ECU_ADDRESS 0x95115ACC /end MEASUREMENT
/begin MEASUREMENT MeSVS_b_IsConfirmBtnPrsd "Confirm button pressed." UBYTE THA_SM_Ref_CM_boolean 0 0 0 1 ECU_ADDRESS 0x95115ACD /end MEASUREMENT
/begin MEASUREMENT MeSVS_b_THAAbortReq "THA feature abort request from HMI." UBYTE THA_SM_Ref_CM_boolean 0 0 0 1 ECU_ADDRESS 0x95115AD1 /end MEASUREMENT
/begin MEASUREMENT MeSVS_b_THAMnvrStartBtnPrsd "THA start manuever button pressed status." UBYTE THA_SM_Ref_CM_boolean 0 0 0 1 ECU_ADDRESS 0x95115AD0 /end MEASUREMENT
/begin MEASUREMENT MeSVS_b_THAScrTchSts "THA screen touch status." UBYTE THA_SM_Ref_CM_boolean 0 0 0 1 ECU_ADDRESS 0x95115ACE /end MEASUREMENT
/begin MEASUREMENT MeSVS_b_THASftBtnPrsdStsToTHA "THA soft button pressed status." UBYTE THA_SM_Ref_CM_boolean 0 0 0 1 ECU_ADDRESS 0x95115ACF /end MEASUREMENT
/begin MEASUREMENT MeSVS_b_ViewZoomSts "HMI view zoom status.\n      0 - Normal view\n      1- Zoomed view" UBYTE THA_SM_Ref_CM_boolean 0 0 0 1 ECU_ADDRESS 0x95115AD2 /end MEASUREMENT
/begin MEASUREMENT MeSVS_e_THAScrResp "THA screen request acknowledgement from HMI." SLONG THA_SM_Ref_CM_TeTHA_e_ScreenRequest 0 0 0 24 ECU_ADDRESS 0x95115ADC /end MEASUREMENT
/begin MEASUREMENT MeTHA_b_EnblRearParkAsstTrg "Enable Rear Park Assist signal from THA." UBYTE THA_SWC_CM_boolean 0 0 0 1 ECU_ADDRESS 0x95116310 /end MEASUREMENT
/begin MEASUREMENT MeTHA_b_THAAbortStatus "THA feature abort status." UBYTE THA_SWC_CM_boolean 0 0 0 1 ECU_ADDRESS 0x95116312 /end MEASUREMENT
/begin MEASUREMENT MeTHA_b_TrlrCplrStatus "Trailer Coupler Reached to Hitch location Status." UBYTE THA_SWC_CM_boolean 0 0 0 1 ECU_ADDRESS 0x95116311 /end MEASUREMENT
/begin MEASUREMENT MeTHA_b_UsrCplrSelCnfm "Coupler selection confirmation by user from HMI." UBYTE THA_SmVc_Ref_CM_boolean 0 0 0 1 ECU_ADDRESS 0x9511631D /end MEASUREMENT
/begin MEASUREMENT MeTHA_b_UsrHitchCnfm "Hitch confirmation by user from HMI." UBYTE THA_SmVc_Ref_CM_boolean 0 0 0 1 ECU_ADDRESS 0x9511631C /end MEASUREMENT
/begin MEASUREMENT MeTHA_deg_CplrAng "Coupler angle." FLOAT32_IEEE THA_SM_Ref_CM_single 0 0 0 180 ECU_ADDRESS 0x95115AD8 /end MEASUREMENT
/begin MEASUREMENT MeTHA_e_CplrDetctStatus "Coupler detection status.\n      0 - Not valid\n      1 - Not_Detected\n      2 - Detected" SLONG THA_SM_Ref_CM_TeTHA_e_CplrDetctStatus 0 0 0 2 ECU_ADDRESS 0x95115AE4 /end MEASUREMENT
/begin MEASUREMENT MeTHA_e_HitchDetctStatus "Hitch detection status.\n      0 - Not_Valid\n      1 - Not_Detected\n      2 - Detected" SLONG THA_SM_Ref_CM_TeTHA_e_HitchDetctStatus 0 0 0 2 ECU_ADDRESS 0x95115AE0 /end MEASUREMENT
/begin MEASUREMENT MeTHA_e_RearBrkSupprInfo "THA Rear Braking Supression Info.\n      0 - Invalid,\n      1 - No_Suppression,\n      2 - Suppress_Rear_Braking" SLONG THA_SWC_CM_TeTHA_e_RearBrkSupprInfo 0 0 0 2 ECU_ADDRESS 0x95116318 /end MEASUREMENT
/begin MEASUREMENT MeTHA_e_ScreenRequest "Trigger from THA Main SM to THA HMI & Detection.\n      THA_Default = 0\n      THA_Enable,    \n      THA_TCS_Msg1,  \n      THA_TCS_Msg2,  \n      THA_TCS_Msg3,  \n      THA_TCS_Msg4,  \n      THA_TCS_Msg5,  \n      THA_SM_Msg1,   \n      THA_SM_Msg2,   \n      TH" SLONG THA_SmVc_Ref_CM_TeTHA_e_ScreenRequest 0 0 0 24 ECU_ADDRESS 0x95116324 /end MEASUREMENT
/begin MEASUREMENT MeTHA_e_THAStateInfo "THA States internal signal.\n      0 -> Off\n      1 -> Initial\n      2 -> Idle\n      3 -> Enabled\n      4 -> Enabled Selection\n      5 -> Engaged\n      6 -> Engaged Delta\n      7 -> Engaged Inquiry\n      8 -> Complete\n      9 -> Faulted\n      10 -> SNA" SLONG THA_SmVc_Ref_CM_TeTHA_e_THAStateInfo 0 0 0 10 ECU_ADDRESS 0x95116320 /end MEASUREMENT
/begin MEASUREMENT MeTHA_px_HitchCplrPixDiffLat "Longitudinal Pixel X difference from hitch to coupler." UWORD THA_SM_Ref_CM_uint16 0 0 0 1920 ECU_ADDRESS 0x95115AD6 /end MEASUREMENT
/begin MEASUREMENT MeTHA_px_HitchCplrPixDiffLong "Longitudinal Pixel Y difference from hitch to coupler." UWORD THA_SM_Ref_CM_uint16 0 0 0 1080 ECU_ADDRESS 0x95115AD4 /end MEASUREMENT
/begin MEASUREMENT MeTRSC_M_TRSCStrTrq "Steering Torque input from Vehicle Control" FLOAT32_IEEE TRSC_SM_VC_CM_single_nm 0 0 -3.4E+38 3.4E+38 ECU_ADDRESS 0x0 /end MEASUREMENT
/begin MEASUREMENT MeTRSC_b_MoreCamSoftButtEnbl "More Camera Enable Soft Button Input" UBYTE TRSC_SM_VC_Int_CM_boolean 0 0 0 1 ECU_ADDRESS 0x0 /end MEASUREMENT
/begin MEASUREMENT MeTRSC_b_StrTwitchComplete "Steering Twitch Complete Status" UBYTE TRSC_SM_VC_CM_boolean 0 0 0 1 ECU_ADDRESS 0x0 /end MEASUREMENT
/begin MEASUREMENT MeTRSC_b_TRSCSwitchPressed "" UBYTE TRSC_SM_VC_Int_CM_boolean 0 0 0 1 ECU_ADDRESS 0x0 /end MEASUREMENT
/begin MEASUREMENT MeTRSC_b_TrlrCalibDelayInfo "Trailer Calibration delay information" UBYTE TRSC_StateMachine_CM_boolean 0 0 0 1 ECU_ADDRESS 0x0 /end MEASUREMENT
/begin MEASUREMENT MeTRSC_b_TrlrCalibPopInfo "Trailer Calibration Popup information" UBYTE TRSC_StateMachine_CM_boolean 0 0 0 1 ECU_ADDRESS 0x0 /end MEASUREMENT
/begin MEASUREMENT MeTRSC_b_TrlrRevSteeringStsInfo "" UBYTE TRSC_SM_VC_Int_CM_boolean 0 0 0 1 ECU_ADDRESS 0x0 /end MEASUREMENT
/begin MEASUREMENT MeTRSC_deg_JackknifeAngle "JackknifeThrAngle" FLOAT32_IEEE TRSC_SM_VC_CM_single_deg 0 0 -3.4E+38 3.4E+38 ECU_ADDRESS 0x0 /end MEASUREMENT
/begin MEASUREMENT MeTRSC_e_SpdLmtReq "Speed Limit Request from Vehicle Control" SLONG TRSC_SM_VC_CM_TeTRSC_e_SpdLmtReq_mph 0 0 0 2147483647 ECU_ADDRESS 0x0 /end MEASUREMENT
/begin MEASUREMENT MeTRSC_e_TRSCStat "Internal Current State of TRSC feature" SLONG TRSC_SM_VC_Int_CM_TeTRSC_e_TRSCStat 0 0 0 2147483647 ECU_ADDRESS 0x0 /end MEASUREMENT
/begin MEASUREMENT MeTRSC_e_TRSCStrTrqActvReq "" SLONG TRSC_SM_VC_CM_TeTRSC_e_TRSCStrTrqActvReq 0 0 0 2147483647 ECU_ADDRESS 0x0 /end MEASUREMENT
/begin MEASUREMENT MeTRSC_pct_TRSCStrDmp "Steering Damping command in %" FLOAT32_IEEE TRSC_SM_VC_CM_single__ 0 0 -3.4E+38 3.4E+38 ECU_ADDRESS 0x0 /end MEASUREMENT
/begin CHARACTERISTIC Obj_DistTable "" VAL_BLK 0x95113730 Scalar_FLOAT32_IEEE 0 Rear_ObjectDection_CM_single -3.4E+38 3.4E+38 MATRIX_DIM 5 /end CHARACTERISTIC
/begin CHARACTERISTIC Overlap_Thrsld_Switch "" VALUE 0x951131B8 Scalar_FLOAT32_IEEE 0 Rear_ObjectDection_CM_single -3.4E+38 3.4E+38 /end CHARACTERISTIC
/begin CHARACTERISTIC PS_size_para "" VAL_BLK 0x95182B30 Scalar_FLOAT32_IEEE 0 SWC_VC_CM_single 0 20 MATRIX_DIM 4 /end CHARACTERISTIC
/begin CHARACTERISTIC RAEB_Envelope_Offset "" VALUE 0x951131BC Scalar_FLOAT32_IEEE 0 Rear_ObjectDection_CM_single -3.4E+38 3.4E+38 /end CHARACTERISTIC
/begin CHARACTERISTIC RAEB_Lateral_Distance_Notification "" VALUE 0x951131C0 Scalar_FLOAT32_IEEE 0 Rear_ObjectDection_CM_single -3.4E+38 3.4E+38 /end CHARACTERISTIC
/begin CHARACTERISTIC RAEB_Minimum_Object_Heigh "Minimum acceptable height of a object" VALUE 0x951136E8 Scalar_FLOAT32_IEEE 0 Rear_ObjectDection_CM_single_m -3.4E+38 3.4E+38 /end CHARACTERISTIC
/begin MEASUREMENT RearCentreObjNum "" SBYTE SWC_AP_StateMachine_CM_int8 0 0 -128 127 ECU_ADDRESS 0x0 /end MEASUREMENT
/begin MEASUREMENT RearLeftObjNum "" SBYTE SWC_AP_StateMachine_CM_int8 0 0 -128 127 ECU_ADDRESS 0x0 /end MEASUREMENT
/begin MEASUREMENT RearRightObjNum "" SBYTE SWC_AP_StateMachine_CM_int8 0 0 -128 127 ECU_ADDRESS 0x0 /end MEASUREMENT
/begin MEASUREMENT Rear_ObjectDection_B.Divide2 "" FLOAT32_IEEE Rear_ObjectDection_CM_single 0 0 -3.4E+38 3.4E+38 ECU_ADDRESS 0x950E5768 /end MEASUREMENT
/begin MEASUREMENT Rear_ObjectDection_B.IeCS_v_VehSpdLong "" FLOAT32_IEEE Rear_ObjectDection_CM_single 0 0 -3.4E+38 3.4E+38 ECU_ADDRESS 0x950E4CD0 /end MEASUREMENT
/begin MEASUREMENT Rear_ObjectDection_B.MeTOS_Str_DblIntgrtn "" FLOAT32_IEEE Rear_ObjectDection_CM_single 0 0 -3.4E+38 3.4E+38 ECU_ADDRESS 0x950E450C /end MEASUREMENT
/begin CHARACTERISTIC Rear_ObjectDection_B.MeTOS_Str_DblIntgrtn_c "Full Roll (radians)." VALUE 0x950E452C __FLOAT32_IEEE_Z 0 NO_COMPU_METHOD -3.4028235E+38 3.4028235E+38 /end CHARACTERISTIC
/begin MEASUREMENT Rear_ObjectDection_B.MeTOS_b_Enbl_Strt_Drvng_2 "" UBYTE Rear_ObjectDection_CM_boolean 0 0 0 1 ECU_ADDRESS 0x950E79F1 /end MEASUREMENT
/begin CHARACTERISTIC Rear_ObjectDection_B.MeTOS_b_Enbl_Strt_Drvng_2_f "Full Roll (radians)." VALUE 0x0 __FLOAT32_IEEE_Z 0 NO_COMPU_METHOD -3.4028235E+38 3.4028235E+38 /end CHARACTERISTIC
/begin MEASUREMENT Rear_ObjectDection_B.MeTOS_c0_host "" FLOAT32_IEEE Rear_ObjectDection_CM_single 0 0 -3.4E+38 3.4E+38 ECU_ADDRESS 0x0 /end MEASUREMENT
/begin MEASUREMENT Rear_ObjectDection_B.MeTOS_c0_yaw_rate "" FLOAT32_IEEE Rear_ObjectDection_CM_single 0 0 -3.4E+38 3.4E+38 ECU_ADDRESS 0x950E44EC /end MEASUREMENT
/begin MEASUREMENT Rear_ObjectDection_B.Overlap_Thrsld_Values "" FLOAT64_IEEE Rear_ObjectDection_CM_double 0 0 -1.7E+308 1.7E+308 ECU_ADDRESS 0x950E41EC MATRIX_DIM 10 /end MEASUREMENT
/begin MEASUREMENT Rear_ObjectDection_B.RIPCT.host_ttj "" FLOAT32_IEEE Rear_ObjectDection_CM_single 0 0 -3.4E+38 3.4E+38 ECU_ADDRESS 0x0 /end MEASUREMENT
/begin MEASUREMENT Rear_ObjectDection_B.RIPCT.obj_ID "" UBYTE Rear_ObjectDection_CM_uint8 0 0 0 255 ECU_ADDRESS 0x0 /end MEASUREMENT
/begin MEASUREMENT Rear_ObjectDection_B.RIPCT.obj_IntersectionLat "" FLOAT32_IEEE Rear_ObjectDection_CM_single 0 0 -3.4E+38 3.4E+38 ECU_ADDRESS 0x0 /end MEASUREMENT
/begin MEASUREMENT Rear_ObjectDection_B.RIPCT.obj_IntersectionLong "" FLOAT32_IEEE Rear_ObjectDection_CM_single 0 0 -3.4E+38 3.4E+38 ECU_ADDRESS 0x0 /end MEASUREMENT
/begin MEASUREMENT Rear_ObjectDection_B.RIPCT.obj_LatTTC "" FLOAT32_IEEE Rear_ObjectDection_CM_single 0 0 -3.4E+38 3.4E+38 ECU_ADDRESS 0x0 /end MEASUREMENT
/begin MEASUREMENT Rear_ObjectDection_B.RIPCT.obj_LatTTC_valid "" UBYTE Rear_ObjectDection_CM_boolean 0 0 0 1 ECU_ADDRESS 0x0 /end MEASUREMENT
/begin MEASUREMENT Rear_ObjectDection_B.RIPCT.obj_TTC "" FLOAT32_IEEE Rear_ObjectDection_CM_single 0 0 -3.4E+38 3.4E+38 ECU_ADDRESS 0x0 /end MEASUREMENT
/begin MEASUREMENT Rear_ObjectDection_B.RIPCT.obj_TTC_valid "" UBYTE Rear_ObjectDection_CM_boolean 0 0 0 1 ECU_ADDRESS 0x0 /end MEASUREMENT
/begin MEASUREMENT Rear_ObjectDection_B.RIPCT.obj_accel "" FLOAT32_IEEE Rear_ObjectDection_CM_single 0 0 -3.4E+38 3.4E+38 ECU_ADDRESS 0x0 /end MEASUREMENT
/begin MEASUREMENT Rear_ObjectDection_B.RIPCT.obj_age "" FLOAT32_IEEE Rear_ObjectDection_CM_single 0 0 -3.4E+38 3.4E+38 ECU_ADDRESS 0x0 /end MEASUREMENT
/begin MEASUREMENT Rear_ObjectDection_B.RIPCT.obj_blinker "" UBYTE Rear_ObjectDection_CM_uint8 0 0 0 255 ECU_ADDRESS 0x0 /end MEASUREMENT
/begin MEASUREMENT Rear_ObjectDection_B.RIPCT.obj_brakelights "" UBYTE Rear_ObjectDection_CM_boolean 0 0 0 1 ECU_ADDRESS 0x0 /end MEASUREMENT
/begin MEASUREMENT Rear_ObjectDection_B.RIPCT.obj_cut_in "" UBYTE Rear_ObjectDection_CM_uint8 0 0 0 255 ECU_ADDRESS 0x0 /end MEASUREMENT
/begin MEASUREMENT Rear_ObjectDection_B.RIPCT.obj_fsn_status "" UBYTE Rear_ObjectDection_CM_uint8 0 0 0 255 ECU_ADDRESS 0x0 /end MEASUREMENT
/begin MEASUREMENT Rear_ObjectDection_B.RIPCT.obj_headway "" FLOAT32_IEEE Rear_ObjectDection_CM_single 0 0 -3.4E+38 3.4E+38 ECU_ADDRESS 0x0 /end MEASUREMENT
/begin MEASUREMENT Rear_ObjectDection_B.RIPCT.obj_lane "" UBYTE Rear_ObjectDection_CM_uint8 0 0 0 255 ECU_ADDRESS 0x0 /end MEASUREMENT
/begin MEASUREMENT Rear_ObjectDection_B.RIPCT.obj_location "" UBYTE Rear_ObjectDection_CM_uint8 0 0 0 255 ECU_ADDRESS 0x0 /end MEASUREMENT
/begin MEASUREMENT Rear_ObjectDection_B.RIPCT.obj_status "" UBYTE Rear_ObjectDection_CM_uint8 0 0 0 255 ECU_ADDRESS 0x0 /end MEASUREMENT
/begin MEASUREMENT Rear_ObjectDection_B.RIPCT.obj_type "" SLONG Rear_ObjectDection_CM_TeEnv_e_ObjClass 0 0 0 19 ECU_ADDRESS 0x0 /end MEASUREMENT
/begin MEASUREMENT Rear_ObjectDection_B.RIPCT.obj_valid "" UBYTE Rear_ObjectDection_CM_boolean 0 0 0 1 ECU_ADDRESS 0x0 /end MEASUREMENT
/begin MEASUREMENT Rear_ObjectDection_B.RIPCT.obj_vx_rel "" FLOAT32_IEEE Rear_ObjectDection_CM_single 0 0 -3.4E+38 3.4E+38 ECU_ADDRESS 0x0 /end MEASUREMENT
/begin MEASUREMENT Rear_ObjectDection_B.RIPCT.obj_vy_rel "" FLOAT32_IEEE Rear_ObjectDection_CM_single 0 0 -3.4E+38 3.4E+38 ECU_ADDRESS 0x0 /end MEASUREMENT
/begin MEASUREMENT Rear_ObjectDection_B.RIPCT.obj_width "" FLOAT32_IEEE Rear_ObjectDection_CM_single 0 0 -3.4E+38 3.4E+38 ECU_ADDRESS 0x0 /end MEASUREMENT
/begin MEASUREMENT Rear_ObjectDection_B.RIPCT.obj_x_pos "" FLOAT32_IEEE Rear_ObjectDection_CM_single 0 0 -3.4E+38 3.4E+38 ECU_ADDRESS 0x0 /end MEASUREMENT
/begin MEASUREMENT Rear_ObjectDection_B.RIPCT.obj_y_pos "" FLOAT32_IEEE Rear_ObjectDection_CM_single 0 0 -3.4E+38 3.4E+38 ECU_ADDRESS 0x0 /end MEASUREMENT
/begin MEASUREMENT Rear_ObjectDection_B.Speed "" FLOAT32_IEEE Rear_ObjectDection_CM_single 0 0 -3.4E+38 3.4E+38 ECU_ADDRESS 0x0 /end MEASUREMENT
/begin MEASUREMENT Rear_ObjectDection_B.SteerAngle "" FLOAT32_IEEE Rear_ObjectDection_CM_single 0 0 -3.4E+38 3.4E+38 ECU_ADDRESS 0x0 /end MEASUREMENT
/begin MEASUREMENT Rear_ObjectDection_B.YawRate "" FLOAT32_IEEE Rear_ObjectDection_CM_single 0 0 -3.4E+38 3.4E+38 ECU_ADDRESS 0x0 /end MEASUREMENT
/begin CHARACTERISTIC Reverse_Gr_num "Reverse Gear Number" VALUE 0x951131CE Scalar_UBYTE 0 Rear_ObjectDection_CM_uint8 0 255 /end CHARACTERISTIC
/begin MEASUREMENT SWC_VC_DW.tp_APX_Park_State_Active_ST "" UBYTE SWC_VC_CM_uint8 0 0 0 255 ECU_ADDRESS 0x950F9CC4 /end MEASUREMENT
/begin MEASUREMENT SWC_VC_DW.tp_APX_Park_State_AllStrokes_ST "" UBYTE SWC_VC_CM_uint8 0 0 0 255 ECU_ADDRESS 0x950F9CC7 /end MEASUREMENT
/begin MEASUREMENT SWC_VC_DW.tp_APX_Park_State_Backw_DeviationExceeded "" UBYTE SWC_VC_CM_uint8 0 0 0 255 ECU_ADDRESS 0x950F9CCB /end MEASUREMENT
/begin MEASUREMENT SWC_VC_DW.tp_APX_Park_State_Backw_DispForw "" UBYTE SWC_VC_CM_uint8 0 0 0 255 ECU_ADDRESS 0x950F9CC8 /end MEASUREMENT
/begin MEASUREMENT SWC_VC_DW.tp_APX_Park_State_Backw_DispForw1 "" UBYTE SWC_VC_CM_uint8 0 0 0 255 ECU_ADDRESS 0x950F9CD1 /end MEASUREMENT
/begin MEASUREMENT SWC_VC_DW.tp_APX_Park_State_Backw_PathAccepted "" UBYTE SWC_VC_CM_uint8 0 0 0 255 ECU_ADDRESS 0x950F9CCF /end MEASUREMENT
/begin MEASUREMENT SWC_VC_DW.tp_APX_Park_State_Backw_RegenPathStarted "" UBYTE SWC_VC_CM_uint8 0 0 0 255 ECU_ADDRESS 0x950F9CCD /end MEASUREMENT
/begin MEASUREMENT SWC_VC_DW.tp_APX_Park_State_Backward "" UBYTE SWC_VC_CM_uint8 0 0 0 255 ECU_ADDRESS 0x950F9CCA /end MEASUREMENT
/begin MEASUREMENT SWC_VC_DW.tp_APX_Park_State_D_gear "" UBYTE SWC_VC_CM_uint8 0 0 0 255 ECU_ADDRESS 0x950F9CD5 /end MEASUREMENT
/begin MEASUREMENT SWC_VC_DW.tp_APX_Park_State_End_ST "" UBYTE SWC_VC_CM_uint8 0 0 0 255 ECU_ADDRESS 0x950F9CC6 /end MEASUREMENT
/begin MEASUREMENT SWC_VC_DW.tp_APX_Park_State_Forw_DeviationExceeded "" UBYTE SWC_VC_CM_uint8 0 0 0 255 ECU_ADDRESS 0x950F9CD2 /end MEASUREMENT
/begin MEASUREMENT SWC_VC_DW.tp_APX_Park_State_Forw_DispBackw "" UBYTE SWC_VC_CM_uint8 0 0 0 255 ECU_ADDRESS 0x950F9CD4 /end MEASUREMENT
/begin MEASUREMENT SWC_VC_DW.tp_APX_Park_State_Forw_DispBackw1 "" UBYTE SWC_VC_CM_uint8 0 0 0 255 ECU_ADDRESS 0x950F9CCC /end MEASUREMENT
/begin MEASUREMENT SWC_VC_DW.tp_APX_Park_State_Forw_PathAccepted "" UBYTE SWC_VC_CM_uint8 0 0 0 255 ECU_ADDRESS 0x950F9CCE /end MEASUREMENT
/begin MEASUREMENT SWC_VC_DW.tp_APX_Park_State_Forw_RegenPathStarted "" UBYTE SWC_VC_CM_uint8 0 0 0 255 ECU_ADDRESS 0x950F9CD0 /end MEASUREMENT
/begin MEASUREMENT SWC_VC_DW.tp_APX_Park_State_Forward "" UBYTE SWC_VC_CM_uint8 0 0 0 255 ECU_ADDRESS 0x950F9CD3 /end MEASUREMENT
/begin MEASUREMENT SWC_VC_DW.tp_APX_Park_State_Inactive_ST "" UBYTE SWC_VC_CM_uint8 0 0 0 255 ECU_ADDRESS 0x950F9CC3 /end MEASUREMENT
/begin MEASUREMENT SWC_VC_DW.tp_APX_Park_State_Inactive_ST1 "" UBYTE SWC_VC_CM_uint8 0 0 0 255 ECU_ADDRESS 0x950F9CC2 /end MEASUREMENT
/begin MEASUREMENT SWC_VC_DW.tp_APX_Park_State_R_gear "" UBYTE SWC_VC_CM_uint8 0 0 0 255 ECU_ADDRESS 0x950F9CC5 /end MEASUREMENT
/begin MEASUREMENT SWC_VC_DW.tp_APX_Park_State_R_gear_l "" UBYTE SWC_VC_CM_uint8 0 0 0 255 ECU_ADDRESS 0x0 /end MEASUREMENT
/begin CHARACTERISTIC Steering_Angle_DeadZone_End "" VALUE 0x951136EC Scalar_FLOAT32_IEEE 0 Rear_ObjectDection_CM_single -3.4E+38 3.4E+38 /end CHARACTERISTIC
/begin CHARACTERISTIC Steering_Angle_DeadZone_Start "" VALUE 0x951136F0 Scalar_FLOAT32_IEEE 0 Rear_ObjectDection_CM_single -3.4E+38 3.4E+38 /end CHARACTERISTIC
/begin CHARACTERISTIC Straight_Driving_Thresold_rads2 "" VALUE 0x951136F4 Scalar_FLOAT32_IEEE 0 Rear_ObjectDection_CM_single -3.4E+38 3.4E+38 /end CHARACTERISTIC
/begin CHARACTERISTIC UsrCplrSelected_b.UsrCplrSelected_b "THA Manager" VALUE 0x0 __UBYTE_Z 0 NO_COMPU_METHOD 0 1 /end CHARACTERISTIC
/begin CHARACTERISTIC UsrCplrSelected_b.UsrHitchCnfm_b "THA Manager" VALUE 0x0 __UBYTE_Z 0 NO_COMPU_METHOD 0 1 /end CHARACTERISTIC
/begin MEASUREMENT blockageFlagBits "" UWORD DT24_CVADAS_AP_CodGen_CM_uint16 0 0 0 65535 ECU_ADDRESS 0x951156B2 /end MEASUREMENT
/begin CHARACTERISTIC break_point_para "" VAL_BLK 0x95183820 Scalar_FLOAT32_IEEE 0 SWC_VC_CM_single -10 10 MATRIX_DIM 2 /end CHARACTERISTIC
/begin CHARACTERISTIC break_point_perp "" VAL_BLK 0x95183828 Scalar_FLOAT32_IEEE 0 SWC_VC_CM_single -10 10 MATRIX_DIM 2 /end CHARACTERISTIC
/begin CHARACTERISTIC fin_loc_para_out "" VAL_BLK 0x95183838 Scalar_FLOAT32_IEEE 0 SWC_VC_CM_single -5 0 MATRIX_DIM 2 /end CHARACTERISTIC
/begin CHARACTERISTIC keInpAdptr_e_StWhOffset "Wheel Offset" VALUE 0x951136F8 Scalar_FLOAT32_IEEE 0 Rear_ObjectDection_CM_single -3.4E+38 3.4E+38 /end CHARACTERISTIC
/begin AXIS_PTS keVehParam_e_StrWhlRatioBrkPnts "Vehicle Steering Wheel Ratio Break Points " 0x95114F50 NO_INPUT_QUANTITY Lookup1D_X_FLOAT32_IEEE 0 Rear_ObjectDection_CM_single 19 -3.4E+38 3.4E+38 /end AXIS_PTS
/begin CHARACTERISTIC keVehParam_e_VehSteerRatioTable "" CURVE 0x95114FA0 Lookup1D_FLOAT32_IEEE 0 Rear_ObjectDection_CM_single -3.4E+38 3.4E+38
 /begin AXIS_DESCR COM_AXIS NO_INPUT_QUANTITY Rear_ObjectDection_CM_single 19 -3.4E+38 3.4E+38 AXIS_PTS_REF keVehParam_e_StrWhlRatioBrkPnts /end AXIS_DESCR
/end CHARACTERISTIC
/begin CHARACTERISTIC keVehParam_m_DistWhlBse "Reply Type In" VALUE 0x951136FC Scalar_FLOAT32_IEEE 0 Rear_ObjectDection_CM_single_m -3.4E+38 3.4E+38 /end CHARACTERISTIC
/begin CHARACTERISTIC p3_adj_perp "" VAL_BLK 0x95183840 Scalar_FLOAT32_IEEE 0 SWC_VC_CM_single -5 5 MATRIX_DIM 2 /end CHARACTERISTIC
/begin CHARACTERISTIC s_CurrentGearPosition_u8 "DID Manager" VALUE 0x0 __UBYTE_Z 0 NO_COMPU_METHOD 0 255 /end CHARACTERISTIC
/begin CHARACTERISTIC s_Flow_Control_Array_au8 "DID Manager" VALUE 0x9D116D38 __UBYTE_Z 0 NO_COMPU_METHOD 0 255 /end CHARACTERISTIC
/begin CHARACTERISTIC s_ShortTermAdjActiveFlag_b "DID Manager" VALUE 0x9D207205 __UBYTE_Z 0 NO_COMPU_METHOD 0 255 /end CHARACTERISTIC
/begin CHARACTERISTIC sampling_time "10ms sampling time" VALUE 0x95113700 Scalar_FLOAT32_IEEE 0 Rear_ObjectDection_CM_single -3.4E+38 3.4E+38 /end CHARACTERISTIC
/begin CHARACTERISTIC step_size_coeff "" VAL_BLK 0x0 Scalar_FLOAT32_IEEE 0 SWC_VC_CM_single 0 5 MATRIX_DIM 6 /end CHARACTERISTIC
/begin CHARACTERISTIC str_profile_bigPS "" VAL_BLK 0x95180EBC Scalar_FLOAT32_IEEE 0 SWC_VC_CM_single 0 60 MATRIX_DIM 34 /end CHARACTERISTIC
/begin CHARACTERISTIC str_whl_ang_park_out "" VALUE 0x0 Scalar_FLOAT32_IEEE 0 SWC_VC_CM_single -60 60 /end CHARACTERISTIC
/begin COMPU_METHOD DT24_CVADAS_AP_CodGen_CM_TeAP_e_AlgoState "Enumerated data type: TeAP_e_AlgoState" TAB_VERB "%0.6" "" COMPU_TAB_REF VTAB_FOR_DT24_CVADAS_AP_CodGen_CM_TeAP_e_AlgoState /end COMPU_METHOD
/begin COMPU_METHOD DT24_CVADAS_AP_CodGen_CM_TeAP_e_CtryCod "Enumerated data type: TeAP_e_CtryCod" TAB_VERB "%0.6" "" COMPU_TAB_REF VTAB_FOR_DT24_CVADAS_AP_CodGen_CM_TeAP_e_CtryCod /end COMPU_METHOD
/begin COMPU_METHOD DT24_CVADAS_AP_CodGen_CM_TeAP_e_DrvTypVrnt "Enumerated data type: TeAP_e_DrvTypVrnt" TAB_VERB "%0.6" "" COMPU_TAB_REF VTAB_FOR_DT24_CVADAS_AP_CodGen_CM_TeAP_e_DrvTypVrnt /end COMPU_METHOD
/begin COMPU_METHOD DT24_CVADAS_AP_CodGen_CM_TeAP_e_GbTyp "Enumerated data type: TeAP_e_GbTyp" TAB_VERB "%0.6" "" COMPU_TAB_REF VTAB_FOR_DT24_CVADAS_AP_CodGen_CM_TeAP_e_GbTyp /end COMPU_METHOD
/begin COMPU_METHOD DT24_CVADAS_AP_CodGen_CM_TeAP_e_HybTyp "Enumerated data type: TeAP_e_HybTyp" TAB_VERB "%0.6" "" COMPU_TAB_REF VTAB_FOR_DT24_CVADAS_AP_CodGen_CM_TeAP_e_HybTyp /end COMPU_METHOD
/begin COMPU_METHOD DT24_CVADAS_AP_CodGen_CM_TeAP_e_PAMTunSet "Enumerated data type: TeAP_e_PAMTunSet" TAB_VERB "%0.6" "" COMPU_TAB_REF VTAB_FOR_DT24_CVADAS_AP_CodGen_CM_TeAP_e_PAMTunSet /end COMPU_METHOD
/begin COMPU_METHOD DT24_CVADAS_AP_CodGen_CM_TeAP_e_ParkAssistStatus "Enumerated data type: TeAP_e_ParkAssistStatus" TAB_VERB "%0.6" "" COMPU_TAB_REF VTAB_FOR_DT24_CVADAS_AP_CodGen_CM_TeAP_e_ParkAssistStatus /end COMPU_METHOD
/begin COMPU_METHOD DT24_CVADAS_AP_CodGen_CM_TeAP_e_RadioDispTyp "Enumerated data type: TeAP_e_RadioDispTyp" TAB_VERB "%0.6" "" COMPU_TAB_REF VTAB_FOR_DT24_CVADAS_AP_CodGen_CM_TeAP_e_RadioDispTyp /end COMPU_METHOD
/begin COMPU_METHOD DT24_CVADAS_AP_CodGen_CM_TeAP_e_SteerRatRackPinionTyp "Enumerated data type: TeAP_e_SteerRatRackPinionTyp" TAB_VERB "%0.6" "" COMPU_TAB_REF VTAB_FOR_DT24_CVADAS_AP_CodGen_CM_TeAP_e_SteerRatRackPinionTyp /end COMPU_METHOD
/begin COMPU_METHOD DT24_CVADAS_AP_CodGen_CM_TeAP_e_WhlBas "Enumerated data type: TeAP_e_WhlBas" TAB_VERB "%0.6" "" COMPU_TAB_REF VTAB_FOR_DT24_CVADAS_AP_CodGen_CM_TeAP_e_WhlBas /end COMPU_METHOD
/begin COMPU_METHOD DT24_CVADAS_AP_CodGen_CM_TeAutoPark_e_AutoParkStatus "Enumerated data type: TeAutoPark_e_AutoParkStatus" TAB_VERB "%0.6" "" COMPU_TAB_REF VTAB_FOR_DT24_CVADAS_AP_CodGen_CM_TeAutoPark_e_AutoParkStatus /end COMPU_METHOD
/begin COMPU_METHOD DT24_CVADAS_AP_CodGen_CM_boolean "Q = V" RAT_FUNC "%1.0" "" COEFFS 0 1 0 0 0 1 /end COMPU_METHOD
/begin COMPU_METHOD DT24_CVADAS_AP_CodGen_CM_uint16 "Q = V" RAT_FUNC "%5.0" "" COEFFS 0 1 0 0 0 1 /end COMPU_METHOD
/begin COMPU_METHOD DT24_CVADAS_AP_CodGen_CM_uint8 "Q = V" RAT_FUNC "%3.0" "" COEFFS 0 1 0 0 0 1 /end COMPU_METHOD
/begin COMPU_METHOD DT24_CVADAS_AutoPark_Func_CM_int16 "Q = V" RAT_FUNC "%5.0" "" COEFFS 0 1 0 0 0 1 /end COMPU_METHOD
/begin COMPU_METHOD Rear_ObjectDection_CM_TeEnv_e_ObjClass "Enumerated data type: TeEnv_e_ObjClass" TAB_VERB "%0.6" "" COMPU_TAB_REF VTAB_FOR_Rear_ObjectDection_CM_TeEnv_e_ObjClass /end COMPU_METHOD
/begin COMPU_METHOD Rear_ObjectDection_CM_boolean "Q = V" RAT_FUNC "%1.0" "" COEFFS 0 1 0 0 0 1 /end COMPU_METHOD
/begin COMPU_METHOD Rear_ObjectDection_CM_double "Q = V" RAT_FUNC "%15.10" "" COEFFS 0 1 0 0 0 1 /end COMPU_METHOD
/begin COMPU_METHOD Rear_ObjectDection_CM_int16_cm "Q = V" RAT_FUNC "%5.0" "cm" COEFFS 0 1 0 0 0 1 /end COMPU_METHOD
/begin COMPU_METHOD Rear_ObjectDection_CM_single "Q = V" RAT_FUNC "%8.6" "" COEFFS 0 1 0 0 0 1 /end COMPU_METHOD
/begin COMPU_METHOD Rear_ObjectDection_CM_single_m "Q = V" RAT_FUNC "%8.6" "m" COEFFS 0 1 0 0 0 1 /end COMPU_METHOD
/begin COMPU_METHOD Rear_ObjectDection_CM_uint8 "Q = V" RAT_FUNC "%3.0" "" COEFFS 0 1 0 0 0 1 /end COMPU_METHOD
/begin COMPU_METHOD SWC_APA_CM_int16_cm "Q = V" RAT_FUNC "%5.0" "cm" COEFFS 0 1 0 0 0 1 /end COMPU_METHOD
/begin COMPU_METHOD SWC_APA_CM_int16_cnt "Q = V" RAT_FUNC "%5.0" "cnt" COEFFS 0 1 0 0 0 1 /end COMPU_METHOD
/begin COMPU_METHOD SWC_APA_CM_uint16_cnt "Q = V" RAT_FUNC "%5.0" "cnt" COEFFS 0 1 0 0 0 1 /end COMPU_METHOD
/begin COMPU_METHOD SWC_APA_CM_uint16_ms "Q = V" RAT_FUNC "%5.0" "ms" COEFFS 0 1 0 0 0 1 /end COMPU_METHOD
/begin COMPU_METHOD SWC_APA_CM_uint16_sec "Q = V" RAT_FUNC "%5.0" "sec" COEFFS 0 1 0 0 0 1 /end COMPU_METHOD
/begin COMPU_METHOD SWC_APA_CM_uint8 "Q = V" RAT_FUNC "%3.0" "" COEFFS 0 1 0 0 0 1 /end COMPU_METHOD
/begin COMPU_METHOD SWC_AP_StateMachine_CM_boolean "Q = V" RAT_FUNC "%1.0" "" COEFFS 0 1 0 0 0 1 /end COMPU_METHOD
/begin COMPU_METHOD SWC_AP_StateMachine_CM_int16 "Q = V" RAT_FUNC "%5.0" "" COEFFS 0 1 0 0 0 1 /end COMPU_METHOD
/begin COMPU_METHOD SWC_AP_StateMachine_CM_int16_cm "Q = V" RAT_FUNC "%5.0" "cm" COEFFS 0 1 0 0 0 1 /end COMPU_METHOD
/begin COMPU_METHOD SWC_AP_StateMachine_CM_int16_sec "Q = V" RAT_FUNC "%5.0" "sec" COEFFS 0 1 0 0 0 1 /end COMPU_METHOD
/begin COMPU_METHOD SWC_AP_StateMachine_CM_int8 "Q = V" RAT_FUNC "%3.0" "" COEFFS 0 1 0 0 0 1 /end COMPU_METHOD
/begin COMPU_METHOD SWC_AP_StateMachine_CM_single_degC "Q = V" RAT_FUNC "%8.6" "degC" COEFFS 0 1 0 0 0 1 /end COMPU_METHOD
/begin COMPU_METHOD SWC_AP_StateMachine_CM_single_kph "Q = V" RAT_FUNC "%8.6" "kph" COEFFS 0 1 0 0 0 1 /end COMPU_METHOD
/begin COMPU_METHOD SWC_AP_StateMachine_CM_uint16_cm "Q = V" RAT_FUNC "%5.0" "cm" COEFFS 0 1 0 0 0 1 /end COMPU_METHOD
/begin COMPU_METHOD SWC_AP_StateMachine_CM_uint16_ms "Q = V" RAT_FUNC "%5.0" "ms" COEFFS 0 1 0 0 0 1 /end COMPU_METHOD
/begin COMPU_METHOD SWC_AP_StateMachine_CM_uint16_sec "Q = V" RAT_FUNC "%5.0" "sec" COEFFS 0 1 0 0 0 1 /end COMPU_METHOD
/begin COMPU_METHOD SWC_AP_StateMachine_CM_uint32 "Q = V" RAT_FUNC "%10.0" "" COEFFS 0 1 0 0 0 1 /end COMPU_METHOD
/begin COMPU_METHOD SWC_AP_StateMachine_CM_uint8_pct "Q = V" RAT_FUNC "%3.0" "pct" COEFFS 0 1 0 0 0 1 /end COMPU_METHOD
/begin COMPU_METHOD SWC_VC_CM_single "Q = V" RAT_FUNC "%8.6" "" COEFFS 0 1 0 0 0 1 /end COMPU_METHOD
/begin COMPU_METHOD SWC_VC_CM_uint8 "Q = V" RAT_FUNC "%3.0" "" COEFFS 0 1 0 0 0 1 /end COMPU_METHOD
/begin COMPU_METHOD THA_SM_Ref_CM_TeTHA_e_CplrDetctStatus "Enumerated data type: TeTHA_e_CplrDetctStatus" TAB_VERB "%0.6" "" COMPU_TAB_REF VTAB_FOR_THA_SM_Ref_CM_TeTHA_e_CplrDetctStatus /end COMPU_METHOD
/begin COMPU_METHOD THA_SM_Ref_CM_TeTHA_e_HitchDetctStatus "Enumerated data type: TeTHA_e_HitchDetctStatus" TAB_VERB "%0.6" "" COMPU_TAB_REF VTAB_FOR_THA_SM_Ref_CM_TeTHA_e_HitchDetctStatus /end COMPU_METHOD
/begin COMPU_METHOD THA_SM_Ref_CM_TeTHA_e_ScreenRequest "Enumerated data type: TeTHA_e_ScreenRequest" TAB_VERB "%0.6" "" COMPU_TAB_REF VTAB_FOR_THA_SM_Ref_CM_TeTHA_e_ScreenRequest /end COMPU_METHOD
/begin COMPU_METHOD THA_SM_Ref_CM_boolean "Q = V" RAT_FUNC "%1.0" "" COEFFS 0 1 0 0 0 1 /end COMPU_METHOD
/begin COMPU_METHOD THA_SM_Ref_CM_single "Q = V" RAT_FUNC "%8.6" "" COEFFS 0 1 0 0 0 1 /end COMPU_METHOD
/begin COMPU_METHOD THA_SM_Ref_CM_single_deg "Q = V" RAT_FUNC "%8.6" "deg" COEFFS 0 1 0 0 0 1 /end COMPU_METHOD
/begin COMPU_METHOD THA_SM_Ref_CM_single_km_hr "Q = V" RAT_FUNC "%8.6" "km/hr" COEFFS 0 1 0 0 0 1 /end COMPU_METHOD
/begin COMPU_METHOD THA_SM_Ref_CM_single_s "Q = V" RAT_FUNC "%8.6" "s" COEFFS 0 1 0 0 0 1 /end COMPU_METHOD
/begin COMPU_METHOD THA_SM_Ref_CM_uint16 "Q = V" RAT_FUNC "%5.0" "" COEFFS 0 1 0 0 0 1 /end COMPU_METHOD
/begin COMPU_METHOD THA_SM_Ref_CM_uint16_pixel "Q = V" RAT_FUNC "%5.0" "pixel" COEFFS 0 1 0 0 0 1 /end COMPU_METHOD
/begin COMPU_METHOD THA_SWC_CM_TeTHA_e_RearBrkSupprInfo "Enumerated data type: TeTHA_e_RearBrkSupprInfo" TAB_VERB "%0.6" "" COMPU_TAB_REF VTAB_FOR_THA_SWC_CM_TeTHA_e_RearBrkSupprInfo /end COMPU_METHOD
/begin COMPU_METHOD THA_SWC_CM_boolean "Q = V" RAT_FUNC "%1.0" "" COEFFS 0 1 0 0 0 1 /end COMPU_METHOD
/begin COMPU_METHOD THA_SmVc_Ref_CM_TeTHA_e_ScreenRequest "Enumerated data type: TeTHA_e_ScreenRequest" TAB_VERB "%0.6" "" COMPU_TAB_REF VTAB_FOR_THA_SmVc_Ref_CM_TeTHA_e_ScreenRequest /end COMPU_METHOD
/begin COMPU_METHOD THA_SmVc_Ref_CM_TeTHA_e_THAStateInfo "Enumerated data type: TeTHA_e_THAStateInfo" TAB_VERB "%0.6" "" COMPU_TAB_REF VTAB_FOR_THA_SmVc_Ref_CM_TeTHA_e_THAStateInfo /end COMPU_METHOD
/begin COMPU_METHOD THA_SmVc_Ref_CM_boolean "Q = V" RAT_FUNC "%1.0" "" COEFFS 0 1 0 0 0 1 /end COMPU_METHOD
/begin COMPU_METHOD THA_VC_Ref_CM_int16 "Q = V" RAT_FUNC "%5.0" "" COEFFS 0 1 0 0 0 1 /end COMPU_METHOD
/begin COMPU_METHOD THA_VC_Ref_CM_single_Nm "Q = V" RAT_FUNC "%8.6" "Nm" COEFFS 0 1 0 0 0 1 /end COMPU_METHOD
/begin COMPU_METHOD THA_VC_Ref_CM_single_m "Q = V" RAT_FUNC "%8.6" "m" COEFFS 0 1 0 0 0 1 /end COMPU_METHOD
/begin COMPU_METHOD THA_VC_Ref_CM_single_nm "Q = V" RAT_FUNC "%8.6" "nm" COEFFS 0 1 0 0 0 1 /end COMPU_METHOD
/begin COMPU_METHOD THA_VC_Ref_CM_single_s "Q = V" RAT_FUNC "%8.6" "s" COEFFS 0 1 0 0 0 1 /end COMPU_METHOD
/begin COMPU_METHOD THA_VC_Ref_CM_uint16 "Q = V" RAT_FUNC "%5.0" "" COEFFS 0 1 0 0 0 1 /end COMPU_METHOD
/begin COMPU_METHOD THA_VC_Ref_CM_uint16_deg_s "Q = V" RAT_FUNC "%5.0" "deg/s" COEFFS 0 1 0 0 0 1 /end COMPU_METHOD
/begin COMPU_METHOD THA_VC_Ref_CM_uint16_pixel "Q = V" RAT_FUNC "%5.0" "pixel" COEFFS 0 1 0 0 0 1 /end COMPU_METHOD
/begin COMPU_METHOD TRSC_SM_VC_CM_TeTRSC_e_SpdLmtReq_mph "Enumerated data type: TeTRSC_e_SpdLmtReq" TAB_VERB "%0.6" "mph" COMPU_TAB_REF VTAB_FOR_TRSC_SM_VC_CM_TeTRSC_e_SpdLmtReq_mph /end COMPU_METHOD
/begin COMPU_METHOD TRSC_SM_VC_CM_TeTRSC_e_TRSCStrTrqActvReq "Enumerated data type: TeTRSC_e_TRSCStrTrqActvReq" TAB_VERB "%0.6" "" COMPU_TAB_REF VTAB_FOR_TRSC_SM_VC_CM_TeTRSC_e_TRSCStrTrqActvReq /end COMPU_METHOD
/begin COMPU_METHOD TRSC_SM_VC_CM_boolean "Q = V" RAT_FUNC "%1.0" "" COEFFS 0 1 0 0 0 1 /end COMPU_METHOD
/begin COMPU_METHOD TRSC_SM_VC_CM_single__ "Q = V" RAT_FUNC "%8.6" "%" COEFFS 0 1 0 0 0 1 /end COMPU_METHOD
/begin COMPU_METHOD TRSC_SM_VC_CM_single_deg "Q = V" RAT_FUNC "%8.6" "deg" COEFFS 0 1 0 0 0 1 /end COMPU_METHOD
/begin COMPU_METHOD TRSC_SM_VC_CM_single_nm "Q = V" RAT_FUNC "%8.6" "nm" COEFFS 0 1 0 0 0 1 /end COMPU_METHOD
/begin COMPU_METHOD TRSC_SM_VC_Int_CM_TeTRSC_e_DispView2 "Enumerated data type: TeTRSC_e_DispView2" TAB_VERB "%0.6" "" COMPU_TAB_REF VTAB_FOR_TRSC_SM_VC_Int_CM_TeTRSC_e_DispView2 /end COMPU_METHOD
/begin COMPU_METHOD TRSC_SM_VC_Int_CM_TeTRSC_e_RadDsplyTyp "Enumerated data type: TeTRSC_e_RadDsplyTyp" TAB_VERB "%0.6" "" COMPU_TAB_REF VTAB_FOR_TRSC_SM_VC_Int_CM_TeTRSC_e_RadDsplyTyp /end COMPU_METHOD
/begin COMPU_METHOD TRSC_SM_VC_Int_CM_TeTRSC_e_SpdLmtReq "Enumerated data type: TeTRSC_e_SpdLmtReq" TAB_VERB "%0.6" "" COMPU_TAB_REF VTAB_FOR_TRSC_SM_VC_Int_CM_TeTRSC_e_SpdLmtReq /end COMPU_METHOD
/begin COMPU_METHOD TRSC_SM_VC_Int_CM_TeTRSC_e_StrRackPinTyp "Enumerated data type: TeTRSC_e_StrRackPinTyp" TAB_VERB "%0.6" "" COMPU_TAB_REF VTAB_FOR_TRSC_SM_VC_Int_CM_TeTRSC_e_StrRackPinTyp /end COMPU_METHOD
/begin COMPU_METHOD TRSC_SM_VC_Int_CM_TeTRSC_e_TADState "Enumerated data type: TeTRSC_e_TADState" TAB_VERB "%0.6" "" COMPU_TAB_REF VTAB_FOR_TRSC_SM_VC_Int_CM_TeTRSC_e_TADState /end COMPU_METHOD
/begin COMPU_METHOD TRSC_SM_VC_Int_CM_TeTRSC_e_TRSCLedSts "Enumerated data type: TeTRSC_e_TRSCLedSts" TAB_VERB "%0.6" "" COMPU_TAB_REF VTAB_FOR_TRSC_SM_VC_Int_CM_TeTRSC_e_TRSCLedSts /end COMPU_METHOD
/begin COMPU_METHOD TRSC_SM_VC_Int_CM_TeTRSC_e_TRSCPopupDispInfo "Enumerated data type: TeTRSC_e_TRSCPopupDispInfo" TAB_VERB "%0.6" "" COMPU_TAB_REF VTAB_FOR_TRSC_SM_VC_Int_CM_TeTRSC_e_TRSCPopupDispInfo /end COMPU_METHOD
/begin COMPU_METHOD TRSC_SM_VC_Int_CM_TeTRSC_e_TRSCStat "Enumerated data type: TeTRSC_e_TRSCStat" TAB_VERB "%0.6" "" COMPU_TAB_REF VTAB_FOR_TRSC_SM_VC_Int_CM_TeTRSC_e_TRSCStat /end COMPU_METHOD
/begin COMPU_METHOD TRSC_SM_VC_Int_CM_TeTRSC_e_TRSCStrTrqActvReq "Enumerated data type: TeTRSC_e_TRSCStrTrqActvReq" TAB_VERB "%0.6" "" COMPU_TAB_REF VTAB_FOR_TRSC_SM_VC_Int_CM_TeTRSC_e_TRSCStrTrqActvReq /end COMPU_METHOD
/begin COMPU_METHOD TRSC_SM_VC_Int_CM_TeTRSC_e_TRSCSts "Enumerated data type: TeTRSC_e_TRSCSts" TAB_VERB "%0.6" "" COMPU_TAB_REF VTAB_FOR_TRSC_SM_VC_Int_CM_TeTRSC_e_TRSCSts /end COMPU_METHOD
/begin COMPU_METHOD TRSC_SM_VC_Int_CM_TeTRSC_e_TRSKMSts "Enumerated data type: TeTRSC_e_TRSKMSts" TAB_VERB "%0.6" "" COMPU_TAB_REF VTAB_FOR_TRSC_SM_VC_Int_CM_TeTRSC_e_TRSKMSts /end COMPU_METHOD
/begin COMPU_METHOD TRSC_SM_VC_Int_CM_TeTRSC_e_TrlrCalInfo "Enumerated data type: TeTRSC_e_TrlrCalInfo" TAB_VERB "%0.6" "" COMPU_TAB_REF VTAB_FOR_TRSC_SM_VC_Int_CM_TeTRSC_e_TrlrCalInfo /end COMPU_METHOD
/begin COMPU_METHOD TRSC_SM_VC_Int_CM_TeTRSC_e_TrlrHitchLightCtrl "Enumerated data type: TeTRSC_e_TrlrHitchLightCtrl" TAB_VERB "%0.6" "" COMPU_TAB_REF VTAB_FOR_TRSC_SM_VC_Int_CM_TeTRSC_e_TrlrHitchLightCtrl /end COMPU_METHOD
/begin COMPU_METHOD TRSC_SM_VC_Int_CM_TeTRSC_e_TrlrPrsntInfo "Enumerated data type: TeTRSC_e_TrlrPrsntInfo" TAB_VERB "%0.6" "" COMPU_TAB_REF VTAB_FOR_TRSC_SM_VC_Int_CM_TeTRSC_e_TrlrPrsntInfo /end COMPU_METHOD
/begin COMPU_METHOD TRSC_SM_VC_Int_CM_TeTRSC_e_TrlrRecogInfo "Enumerated data type: TeTRSC_e_TrlrRecogInfo" TAB_VERB "%0.6" "" COMPU_TAB_REF VTAB_FOR_TRSC_SM_VC_Int_CM_TeTRSC_e_TrlrRecogInfo /end COMPU_METHOD
/begin COMPU_METHOD TRSC_SM_VC_Int_CM_TeTRSC_e_VehStpReq "Enumerated data type: TeTRSC_e_VehStpReq" TAB_VERB "%0.6" "" COMPU_TAB_REF VTAB_FOR_TRSC_SM_VC_Int_CM_TeTRSC_e_VehStpReq /end COMPU_METHOD
/begin COMPU_METHOD TRSC_SM_VC_Int_CM_TeTRSC_e_VehWhlBase "Enumerated data type: TeTRSC_e_VehWhlBase" TAB_VERB "%0.6" "" COMPU_TAB_REF VTAB_FOR_TRSC_SM_VC_Int_CM_TeTRSC_e_VehWhlBase /end COMPU_METHOD
/begin COMPU_METHOD TRSC_SM_VC_Int_CM_TeVBII_e_CamDispSts "Enumerated data type: TeVBII_e_CamDispSts" TAB_VERB "%0.6" "" COMPU_TAB_REF VTAB_FOR_TRSC_SM_VC_Int_CM_TeVBII_e_CamDispSts /end COMPU_METHOD
/begin COMPU_METHOD TRSC_SM_VC_Int_CM_TeVBII_e_CenterBtnSts "Enumerated data type: TeVBII_e_CenterBtnSts" TAB_VERB "%0.6" "" COMPU_TAB_REF VTAB_FOR_TRSC_SM_VC_Int_CM_TeVBII_e_CenterBtnSts /end COMPU_METHOD
/begin COMPU_METHOD TRSC_SM_VC_Int_CM_TeVBII_e_CmdIgnSts "Enumerated data type: TeVBII_e_CmdIgnSts" TAB_VERB "%0.6" "" COMPU_TAB_REF VTAB_FOR_TRSC_SM_VC_Int_CM_TeVBII_e_CmdIgnSts /end COMPU_METHOD
/begin COMPU_METHOD TRSC_SM_VC_Int_CM_TeVBII_e_EcmTrscResp "Enumerated data type: TeVBII_e_EcmTrscResp" TAB_VERB "%0.6" "" COMPU_TAB_REF VTAB_FOR_TRSC_SM_VC_Int_CM_TeVBII_e_EcmTrscResp /end COMPU_METHOD
/begin COMPU_METHOD TRSC_SM_VC_Int_CM_TeVBII_e_EnblBtnSts "Enumerated data type: TeVBII_e_EnblBtnSts" TAB_VERB "%0.6" "" COMPU_TAB_REF VTAB_FOR_TRSC_SM_VC_Int_CM_TeVBII_e_EnblBtnSts /end COMPU_METHOD
/begin COMPU_METHOD TRSC_SM_VC_Int_CM_TeVBII_e_EngineSts "Enumerated data type: TeVBII_e_EngineSts" TAB_VERB "%0.6" "" COMPU_TAB_REF VTAB_FOR_TRSC_SM_VC_Int_CM_TeVBII_e_EngineSts /end COMPU_METHOD
/begin COMPU_METHOD TRSC_SM_VC_Int_CM_TeVBII_e_EscTrscBrkResp "Enumerated data type: TeVBII_e_EscTrscBrkResp" TAB_VERB "%0.6" "" COMPU_TAB_REF VTAB_FOR_TRSC_SM_VC_Int_CM_TeVBII_e_EscTrscBrkResp /end COMPU_METHOD
/begin COMPU_METHOD TRSC_SM_VC_Int_CM_TeVBII_e_GearEngagedForDsply "Enumerated data type: TeVBII_e_GearEngagedForDsply" TAB_VERB "%0.6" "" COMPU_TAB_REF VTAB_FOR_TRSC_SM_VC_Int_CM_TeVBII_e_GearEngagedForDsply /end COMPU_METHOD
/begin COMPU_METHOD TRSC_SM_VC_Int_CM_TeVBII_e_GearRptState "Enumerated data type: TeVBII_e_GearRptState" TAB_VERB "%0.6" "" COMPU_TAB_REF VTAB_FOR_TRSC_SM_VC_Int_CM_TeVBII_e_GearRptState /end COMPU_METHOD
/begin COMPU_METHOD TRSC_SM_VC_Int_CM_TeVBII_e_SBR1RowDriverSeatSts "Enumerated data type: TeVBII_e_SBR1RowDriverSeatSts" TAB_VERB "%0.6" "" COMPU_TAB_REF VTAB_FOR_TRSC_SM_VC_Int_CM_TeVBII_e_SBR1RowDriverSeatSts /end COMPU_METHOD
/begin COMPU_METHOD TRSC_SM_VC_Int_CM_TeVBII_e_SPMLatCtrlRespSts "Enumerated data type: TeVBII_e_SPMLatCtrlRespSts" TAB_VERB "%0.6" "" COMPU_TAB_REF VTAB_FOR_TRSC_SM_VC_Int_CM_TeVBII_e_SPMLatCtrlRespSts /end COMPU_METHOD
/begin COMPU_METHOD TRSC_SM_VC_Int_CM_TeVBII_e_ShiftLvrPos "Enumerated data type: TeVBII_e_ShiftLvrPos" TAB_VERB "%0.6" "" COMPU_TAB_REF VTAB_FOR_TRSC_SM_VC_Int_CM_TeVBII_e_ShiftLvrPos /end COMPU_METHOD
/begin COMPU_METHOD TRSC_SM_VC_Int_CM_TeVBII_e_StrTrqResp "Enumerated data type: TeVBII_e_StrTrqResp" TAB_VERB "%0.6" "" COMPU_TAB_REF VTAB_FOR_TRSC_SM_VC_Int_CM_TeVBII_e_StrTrqResp /end COMPU_METHOD
/begin COMPU_METHOD TRSC_SM_VC_Int_CM_TeVBII_e_StrWhlAngleType "Enumerated data type: TeVBII_e_StrWhlAngleType" TAB_VERB "%0.6" "" COMPU_TAB_REF VTAB_FOR_TRSC_SM_VC_Int_CM_TeVBII_e_StrWhlAngleType /end COMPU_METHOD
/begin COMPU_METHOD TRSC_SM_VC_Int_CM_TeVBII_e_TGWCamDispSts "Enumerated data type: TeVBII_e_TGWCamDispSts" TAB_VERB "%0.6" "" COMPU_TAB_REF VTAB_FOR_TRSC_SM_VC_Int_CM_TeVBII_e_TGWCamDispSts /end COMPU_METHOD
/begin COMPU_METHOD TRSC_SM_VC_Int_CM_TeVBII_e_TchScrSts "Enumerated data type: TeVBII_e_TchScrSts" TAB_VERB "%0.6" "" COMPU_TAB_REF VTAB_FOR_TRSC_SM_VC_Int_CM_TeVBII_e_TchScrSts /end COMPU_METHOD
/begin COMPU_METHOD TRSC_SM_VC_Int_CM_TeVBII_e_TrailerConnectionSts "Enumerated data type: TeVBII_e_TrailerConnectionSts" TAB_VERB "%0.6" "" COMPU_TAB_REF VTAB_FOR_TRSC_SM_VC_Int_CM_TeVBII_e_TrailerConnectionSts /end COMPU_METHOD
/begin COMPU_METHOD TRSC_SM_VC_Int_CM_TeVBII_e_TrlrPrsntSts "Enumerated data type: TeVBII_e_TrlrPrsntSts" TAB_VERB "%0.6" "" COMPU_TAB_REF VTAB_FOR_TRSC_SM_VC_Int_CM_TeVBII_e_TrlrPrsntSts /end COMPU_METHOD
/begin COMPU_METHOD TRSC_SM_VC_Int_CM_TeVBII_e_TrscEnblBtnSts "Enumerated data type: TeVBII_e_TrscEnblBtnSts" TAB_VERB "%0.6" "" COMPU_TAB_REF VTAB_FOR_TRSC_SM_VC_Int_CM_TeVBII_e_TrscEnblBtnSts /end COMPU_METHOD
/begin COMPU_METHOD TRSC_SM_VC_Int_CM_TeVBII_e_VehAscmSts "Enumerated data type: TeVBII_e_VehAscmSts" TAB_VERB "%0.6" "" COMPU_TAB_REF VTAB_FOR_TRSC_SM_VC_Int_CM_TeVBII_e_VehAscmSts /end COMPU_METHOD
/begin COMPU_METHOD TRSC_SM_VC_Int_CM_TeVBII_e_VehStandStillSts "Enumerated data type: TeVBII_e_VehStandStillSts" TAB_VERB "%0.6" "" COMPU_TAB_REF VTAB_FOR_TRSC_SM_VC_Int_CM_TeVBII_e_VehStandStillSts /end COMPU_METHOD
/begin COMPU_METHOD TRSC_SM_VC_Int_CM_TeVBII_e_WhlSpnSts "Enumerated data type: TeVBII_e_WhlSpnSts" TAB_VERB "%0.6" "" COMPU_TAB_REF VTAB_FOR_TRSC_SM_VC_Int_CM_TeVBII_e_WhlSpnSts /end COMPU_METHOD
/begin COMPU_METHOD TRSC_SM_VC_Int_CM_boolean "Q = V" RAT_FUNC "%1.0" "" COEFFS 0 1 0 0 0 1 /end COMPU_METHOD
/begin COMPU_METHOD TRSC_SM_VC_Int_CM_single "Q = V" RAT_FUNC "%8.6" "" COEFFS 0 1 0 0 0 1 /end COMPU_METHOD
/begin COMPU_METHOD TRSC_SM_VC_Int_CM_single_km_h "Q = V" RAT_FUNC "%8.6" "km/h" COEFFS 0 1 0 0 0 1 /end COMPU_METHOD
/begin COMPU_METHOD TRSC_SM_VC_Int_CM_single_nm "Q = V" RAT_FUNC "%8.6" "nm" COEFFS 0 1 0 0 0 1 /end COMPU_METHOD
/begin COMPU_METHOD TRSC_SM_VC_Int_CM_single_percent "Q = V" RAT_FUNC "%8.6" "percent" COEFFS 0 1 0 0 0 1 /end COMPU_METHOD
/begin COMPU_METHOD TRSC_SM_VC_Int_CM_uint16 "Q = V" RAT_FUNC "%5.0" "" COEFFS 0 1 0 0 0 1 /end COMPU_METHOD
/begin COMPU_METHOD TRSC_SM_VC_Int_CM_uint32 "Q = V" RAT_FUNC "%10.0" "" COEFFS 0 1 0 0 0 1 /end COMPU_METHOD
/begin COMPU_METHOD TRSC_SM_VC_Int_CM_uint8 "Q = V" RAT_FUNC "%3.0" "" COEFFS 0 1 0 0 0 1 /end COMPU_METHOD
/begin COMPU_METHOD TRSC_SM_VC_Int_CM_uint8_count "Q = V" RAT_FUNC "%3.0" "count" COEFFS 0 1 0 0 0 1 /end COMPU_METHOD
/begin COMPU_METHOD TRSC_StateMachine_CM_boolean "Q = V" RAT_FUNC "%1.0" "" COEFFS 0 1 0 0 0 1 /end COMPU_METHOD
/begin COMPU_METHOD TRSC_StateMachine_CM_single__ "Q = V" RAT_FUNC "%8.6" "%" COEFFS 0 1 0 0 0 1 /end COMPU_METHOD
/begin COMPU_METHOD TRSC_StateMachine_CM_single_km_h "Q = V" RAT_FUNC "%8.6" "km/h" COEFFS 0 1 0 0 0 1 /end COMPU_METHOD
/begin COMPU_METHOD TRSC_StateMachine_CM_single_sec "Q = V" RAT_FUNC "%8.6" "sec" COEFFS 0 1 0 0 0 1 /end COMPU_METHOD
/begin COMPU_METHOD TRSC_StateMachine_CM_uint8 "Q = V" RAT_FUNC "%3.0" "" COEFFS 0 1 0 0 0 1 /end COMPU_METHOD
/begin COMPU_METHOD TRSC_StateMachine_CM_uint8_count "Q = V" RAT_FUNC "%3.0" "count" COEFFS 0 1 0 0 0 1 /end COMPU_METHOD
/begin COMPU_METHOD TRSC_VC_CM_boolean "Q = V" RAT_FUNC "%1.0" "" COEFFS 0 1 0 0 0 1 /end COMPU_METHOD
/begin COMPU_METHOD TRSC_VC_CM_single "Q = V" RAT_FUNC "%8.6" "" COEFFS 0 1 0 0 0 1 /end COMPU_METHOD
/begin COMPU_METHOD TRSC_VC_CM_single_deg "Q = V" RAT_FUNC "%8.6" "deg" COEFFS 0 1 0 0 0 1 /end COMPU_METHOD
/begin COMPU_METHOD TRSC_VC_CM_single_m "Q = V" RAT_FUNC "%8.6" "m" COEFFS 0 1 0 0 0 1 /end COMPU_METHOD
/begin COMPU_METHOD TRSC_VC_CM_single_mps "Q = V" RAT_FUNC "%8.6" "mps" COEFFS 0 1 0 0 0 1 /end COMPU_METHOD
/begin COMPU_METHOD TRSC_VC_CM_single_sec "Q = V" RAT_FUNC "%8.6" "sec" COEFFS 0 1 0 0 0 1 /end COMPU_METHOD
/begin COMPU_METHOD TRSC_VC_CM_uint8 "Q = V" RAT_FUNC "%3.0" "" COEFFS 0 1 0 0 0 1 /end COMPU_METHOD
/begin COMPU_VTAB VTAB_FOR_DT24_CVADAS_AP_CodGen_CM_TeAP_e_AlgoState "Enumerated data type: TeAP_e_AlgoState" TAB_VERB 6 0 "TeAP_e_AlgoState_Idle" 1 "TeAP_e_AlgoState_Scanning" 2 "TeAP_e_AlgoState_Park_In" 3 "TeAP_e_AlgoState_Park_Out" 4 "TeAP_e_AlgoState_Handshake" 2147483647 "TeAP_e_AlgoState_MAX" /end COMPU_VTAB
/begin COMPU_VTAB VTAB_FOR_DT24_CVADAS_AP_CodGen_CM_TeAP_e_CtryCod "Enumerated data type: TeAP_e_CtryCod" TAB_VERB 14 0 "TeAP_e_CtryCod_World" 2 "TeAP_e_CtryCod_USA" 4 "TeAP_e_CtryCod_Canada" 14 "TeAP_e_CtryCod_Mexico" 18 "TeAP_e_CtryCod_Bahrain" 97 "TeAP_e_CtryCod_Iraq" 104 "TeAP_e_CtryCod_Jordan" 108 "TeAP_e_CtryCod_Kuwait" 112 "TeAP_e_CtryCod_Lebanon" 149 "TeAP_e_CtryCod_Oman" 160 "TeAP_e_CtryCod_Qatar" 165 "TeAP_e_CtryCod_Saudi_Arabia" 204 "TeAP_e_CtryCod_UAE" 215 "TeAP_e_CtryCod_Yemen" /end COMPU_VTAB
/begin COMPU_VTAB VTAB_FOR_DT24_CVADAS_AP_CodGen_CM_TeAP_e_DrvTypVrnt "Enumerated data type: TeAP_e_DrvTypVrnt" TAB_VERB 5 0 "TeAP_e_DrvTypVrnt_FWD" 1 "TeAP_e_DrvTypVrnt_RWD" 2 "TeAP_e_DrvTypVrnt_Single_Speed_AWD" 3 "TeAP_e_DrvTypVrnt_Double_Speed_4WD" 4 "TeAP_e_DrvTypVrnt_Double_Speed_4WDwith_ELSD" /end COMPU_VTAB
/begin COMPU_VTAB VTAB_FOR_DT24_CVADAS_AP_CodGen_CM_TeAP_e_GbTyp "Enumerated data type: TeAP_e_GbTyp" TAB_VERB 5 0 "TeAP_e_GbTyp_Not_Valid" 1 "TeAP_e_GbTyp_MTX" 2 "TeAP_e_GbTyp_MTA" 3 "TeAP_e_GbTyp_DDCT" 4 "TeAP_e_GbTyp_ATX" /end COMPU_VTAB
/begin COMPU_VTAB VTAB_FOR_DT24_CVADAS_AP_CodGen_CM_TeAP_e_HybTyp "Enumerated data type: TeAP_e_HybTyp" TAB_VERB 6 0 "TeAP_e_HybTyp_Not_Applicable" 1 "TeAP_e_HybTyp_Battery_Electric_Vehicle" 2 "TeAP_e_HybTyp_Hybrid_Electric_Vehicle" 3 "TeAP_e_HybTyp_Plugin_Hybrid_Electric_Vehicle" 4 "TeAP_e_HybTyp_Belt48V_Start_Generator" 5 "TeAP_e_HybTyp_Belt12V_Start_Generator" /end COMPU_VTAB
/begin COMPU_VTAB VTAB_FOR_DT24_CVADAS_AP_CodGen_CM_TeAP_e_PAMTunSet "Enumerated data type: TeAP_e_PAMTunSet" TAB_VERB 5 0 "TeAP_e_PAMTunSet_None" 1 "TeAP_e_PAMTunSet_Base" 2 "TeAP_e_PAMTunSet_Rebel" 3 "TeAP_e_PAMTunSet_TRX" 4 "TeAP_e_PAMTunSet_Tungsten" /end COMPU_VTAB
/begin COMPU_VTAB VTAB_FOR_DT24_CVADAS_AP_CodGen_CM_TeAP_e_ParkAssistStatus "Enumerated data type: TeAP_e_ParkAssistStatus" TAB_VERB 6 0 "TeAP_e_ParkAssistStatus_Off" 1 "TeAP_e_ParkAssistStatus_Initialize" 2 "TeAP_e_ParkAssistStatus_Standby" 3 "TeAP_e_ParkAssistStatus_Active" 4 "TeAP_e_ParkAssistStatus_Sensor_Fault" 2147483647 "TeAP_e_ParkAssistStatus_MAX" /end COMPU_VTAB
/begin COMPU_VTAB VTAB_FOR_DT24_CVADAS_AP_CodGen_CM_TeAP_e_RadioDispTyp "Enumerated data type: TeAP_e_RadioDispTyp" TAB_VERB 10 0 "TeAP_e_RadioDispTyp_Type_0" 1 "TeAP_e_RadioDispTyp_Type_1" 2 "TeAP_e_RadioDispTyp_Type_2" 3 "TeAP_e_RadioDispTyp_Type_3" 4 "TeAP_e_RadioDispTyp_Type_4" 5 "TeAP_e_RadioDispTyp_Type_5" 6 "TeAP_e_RadioDispTyp_Type_6" 7 "TeAP_e_RadioDispTyp_Type_7" 8 "TeAP_e_RadioDispTyp_Type_8" 9 "TeAP_e_RadioDispTyp_Type_9" /end COMPU_VTAB
/begin COMPU_VTAB VTAB_FOR_DT24_CVADAS_AP_CodGen_CM_TeAP_e_SteerRatRackPinionTyp "Enumerated data type: TeAP_e_SteerRatRackPinionTyp" TAB_VERB 3 0 "TeAP_e_SteerRatRackPinionTyp_Type_1" 1 "TeAP_e_SteerRatRackPinionTyp_Type_2" 2 "TeAP_e_SteerRatRackPinionTyp_Type_3" /end COMPU_VTAB
/begin COMPU_VTAB VTAB_FOR_DT24_CVADAS_AP_CodGen_CM_TeAP_e_WhlBas "Enumerated data type: TeAP_e_WhlBas" TAB_VERB 3 0 "TeAP_e_WhlBas_Type_1" 1 "TeAP_e_WhlBas_Type_2" 2 "TeAP_e_WhlBas_Type_3" /end COMPU_VTAB
/begin COMPU_VTAB VTAB_FOR_DT24_CVADAS_AP_CodGen_CM_TeAutoPark_e_AutoParkStatus "Enumerated data type: TeAutoPark_e_AutoParkStatus" TAB_VERB 8 0 "TeAutoPark_e_AutoParkStatus_Off" 1 "TeAutoPark_e_AutoParkStatus_Initialize" 2 "TeAutoPark_e_AutoParkStatus_Standby" 3 "TeAutoPark_e_AutoParkStatus_Active" 4 "TeAutoPark_e_AutoParkStatus_Fault" 5 "TeAutoPark_e_AutoParkStatus_Abort" 6 "TeAutoPark_e_AutoParkStatus_Complete" 2147483647 "TeAutoPark_e_AutoParkStatus_MAX" /end COMPU_VTAB
/begin COMPU_VTAB VTAB_FOR_Rear_ObjectDection_CM_TeEnv_e_ObjClass "Enumerated data type: TeEnv_e_ObjClass" TAB_VERB 20 0 "TeEnv_e_ObjClass_OBJ_INVALID" 1 "TeEnv_e_ObjClass_OBJ_PEDESTRIAN" 2 "TeEnv_e_ObjClass_OBJ_BICYCLE" 3 "TeEnv_e_ObjClass_OBJ_CAR" 4 "TeEnv_e_ObjClass_OBJ_BUS" 5 "TeEnv_e_ObjClass_OBJ_TRUCK" 6 "TeEnv_e_ObjClass_OBJ_FIRE_HYDRANT" 7 "TeEnv_e_ObjClass_OBJ_ISO_POLE" 8 "TeEnv_e_ObjClass_OBJ_MOTORCYCLE" 9 "TeEnv_e_ObjClass_OBJ_RIDER" 10 "TeEnv_e_ObjClass_OBJ_THREE_WHEELER" 11 "TeEnv_e_ObjClass_OBJ_GARBAGE_BIN" 12 "TeEnv_e_ObjClass_OBJ_POLE" 13 "TeEnv_e_ObjClass_OBJ_TRAFFIC_CONE" 14 "TeEnv_e_ObjClass_OBJ_TRAFFIC_BARREL" 15 "TeEnv_e_ObjClass_OBJ_SHOPPING_CART" 16 "TeEnv_e_ObjClass_OBJ_STROLLER" 17 "TeEnv_e_ObjClass_OBJ_FENCE_POST" 18 "TeEnv_e_ObjClass_OBJ_TRAILER" 19 "TeEnv_e_ObjClass_OBJ_GENERAL_OBJECT" /end COMPU_VTAB
/begin COMPU_VTAB VTAB_FOR_THA_SM_Ref_CM_TeTHA_e_CplrDetctStatus "Enumerated data type: TeTHA_e_CplrDetctStatus" TAB_VERB 3 0 "TeTHA_e_CplrDetctStatus_Not_Valid" 1 "TeTHA_e_CplrDetctStatus_Not_Detected" 2 "TeTHA_e_CplrDetctStatus_Detected" /end COMPU_VTAB
/begin COMPU_VTAB VTAB_FOR_THA_SM_Ref_CM_TeTHA_e_HitchDetctStatus "Enumerated data type: TeTHA_e_HitchDetctStatus" TAB_VERB 3 0 "TeTHA_e_HitchDetctStatus_Not_Valid" 1 "TeTHA_e_HitchDetctStatus_Not_Detected" 2 "TeTHA_e_HitchDetctStatus_Detected" /end COMPU_VTAB
/begin COMPU_VTAB VTAB_FOR_THA_SM_Ref_CM_TeTHA_e_ScreenRequest "Enumerated data type: TeTHA_e_ScreenRequest" TAB_VERB 25 0 "TeTHA_e_ScreenRequest_THA_Default" 1 "TeTHA_e_ScreenRequest_THA_Enable" 2 "TeTHA_e_ScreenRequest_THA_TCS_Msg1" 3 "TeTHA_e_ScreenRequest_THA_TCS_Msg2" 4 "TeTHA_e_ScreenRequest_THA_TCS_Msg3" 5 "TeTHA_e_ScreenRequest_THA_TCS_Msg4" 6 "TeTHA_e_ScreenRequest_THA_TCS_Msg5" 7 "TeTHA_e_ScreenRequest_THA_SM_Msg1" 8 "TeTHA_e_ScreenRequest_THA_SM_Msg2" 9 "TeTHA_e_ScreenRequest_THA_CM_Msg1" 10 "TeTHA_e_ScreenRequest_THA_CM_Msg2" 11 "TeTHA_e_ScreenRequest_THA_CM_Msg3" 12 "TeTHA_e_ScreenRequest_THA_CM_Msg4" 13 "TeTHA_e_ScreenRequest_THA_CM_Msg5" 14 "TeTHA_e_ScreenRequest_THA_CM_Msg6" 15 "TeTHA_e_ScreenRequest_THA_CM_Msg7" 16 "TeTHA_e_ScreenRequest_THA_CM_Msg8" 17 "TeTHA_e_ScreenRequest_THA_CM_Msg9" 18 "TeTHA_e_ScreenRequest_THA_CM_Msg10" 19 "TeTHA_e_ScreenRequest_THA_EOM_Msg1" 20 "TeTHA_e_ScreenRequest_THA_EOM_Msg2" 21 "TeTHA_e_ScreenRequest_THA_EOM_Msg3" 22 "TeTHA_e_ScreenRequest_THA_EOM_Msg4" 23 "TeTHA_e_ScreenRequest_THA_ERR_Msg1" 24 "TeTHA_e_ScreenRequest_THA_ERR_Msg2" /end COMPU_VTAB
/begin COMPU_VTAB VTAB_FOR_THA_SWC_CM_TeTHA_e_RearBrkSupprInfo "Enumerated data type: TeTHA_e_RearBrkSupprInfo" TAB_VERB 3 0 "TeTHA_e_RearBrkSupprInfo_Invalid" 1 "TeTHA_e_RearBrkSupprInfo_No_Suppression" 2 "TeTHA_e_RearBrkSupprInfo_Suppress_Rear_Braking" /end COMPU_VTAB
/begin COMPU_VTAB VTAB_FOR_THA_SmVc_Ref_CM_TeTHA_e_ScreenRequest "Enumerated data type: TeTHA_e_ScreenRequest" TAB_VERB 25 0 "TeTHA_e_ScreenRequest_THA_Default" 1 "TeTHA_e_ScreenRequest_THA_Enable" 2 "TeTHA_e_ScreenRequest_THA_TCS_Msg1" 3 "TeTHA_e_ScreenRequest_THA_TCS_Msg2" 4 "TeTHA_e_ScreenRequest_THA_TCS_Msg3" 5 "TeTHA_e_ScreenRequest_THA_TCS_Msg4" 6 "TeTHA_e_ScreenRequest_THA_TCS_Msg5" 7 "TeTHA_e_ScreenRequest_THA_SM_Msg1" 8 "TeTHA_e_ScreenRequest_THA_SM_Msg2" 9 "TeTHA_e_ScreenRequest_THA_CM_Msg1" 10 "TeTHA_e_ScreenRequest_THA_CM_Msg2" 11 "TeTHA_e_ScreenRequest_THA_CM_Msg3" 12 "TeTHA_e_ScreenRequest_THA_CM_Msg4" 13 "TeTHA_e_ScreenRequest_THA_CM_Msg5" 14 "TeTHA_e_ScreenRequest_THA_CM_Msg6" 15 "TeTHA_e_ScreenRequest_THA_CM_Msg7" 16 "TeTHA_e_ScreenRequest_THA_CM_Msg8" 17 "TeTHA_e_ScreenRequest_THA_CM_Msg9" 18 "TeTHA_e_ScreenRequest_THA_CM_Msg10" 19 "TeTHA_e_ScreenRequest_THA_EOM_Msg1" 20 "TeTHA_e_ScreenRequest_THA_EOM_Msg2" 21 "TeTHA_e_ScreenRequest_THA_EOM_Msg3" 22 "TeTHA_e_ScreenRequest_THA_EOM_Msg4" 23 "TeTHA_e_ScreenRequest_THA_ERR_Msg1" 24 "TeTHA_e_ScreenRequest_THA_ERR_Msg2" /end COMPU_VTAB
/begin COMPU_VTAB VTAB_FOR_THA_SmVc_Ref_CM_TeTHA_e_THAStateInfo "Enumerated data type: TeTHA_e_THAStateInfo" TAB_VERB 11 0 "TeTHA_e_THAStateInfo_Off" 1 "TeTHA_e_THAStateInfo_Initial" 2 "TeTHA_e_THAStateInfo_Idle" 3 "TeTHA_e_THAStateInfo_Enabled" 4 "TeTHA_e_THAStateInfo_Enabled_Selection" 5 "TeTHA_e_THAStateInfo_Engaged" 6 "TeTHA_e_THAStateInfo_Engaged_Delta" 7 "TeTHA_e_THAStateInfo_Engaged_Inquiry" 8 "TeTHA_e_THAStateInfo_Complete" 9 "TeTHA_e_THAStateInfo_Faulted" 10 "TeTHA_e_THAStateInfo_SNA" /end COMPU_VTAB
/begin COMPU_VTAB VTAB_FOR_TRSC_SM_VC_CM_TeTRSC_e_SpdLmtReq_mph "Enumerated data type: TeTRSC_e_SpdLmtReq" TAB_VERB 10 0 "TeTRSC_e_SpdLmtReq_NotLim" 1 "TeTRSC_e_SpdLmtReq_Spd4" 2 "TeTRSC_e_SpdLmtReq_Spd5" 3 "TeTRSC_e_SpdLmtReq_Spd6" 4 "TeTRSC_e_SpdLmtReq_Spd7" 5 "TeTRSC_e_SpdLmtReq_Spd8" 6 "TeTRSC_e_SpdLmtReq_Spd9" 7 "TeTRSC_e_SpdLmtReq_Spd10" 15 "TeTRSC_e_SpdLmtReq_SNA" 2147483647 "TeTRSC_e_SpdLmtReq_Dummy" /end COMPU_VTAB
/begin COMPU_VTAB VTAB_FOR_TRSC_SM_VC_CM_TeTRSC_e_TRSCStrTrqActvReq "Enumerated data type: TeTRSC_e_TRSCStrTrqActvReq" TAB_VERB 4 0 "TeTRSC_e_TRSCStrTrqActvReq_False" 1 "TeTRSC_e_TRSCStrTrqActvReq_True" 3 "TeTRSC_e_TRSCStrTrqActvReq_SNA" 2147483647 "TeTRSC_e_TRSCStrTrqActvReq_Dummy" /end COMPU_VTAB
/begin COMPU_VTAB VTAB_FOR_TRSC_SM_VC_Int_CM_TeTRSC_e_DispView2 "Enumerated data type: TeTRSC_e_DispView2" TAB_VERB 17 0 "TeTRSC_e_DispView2_Off" 1 "TeTRSC_e_DispView2_View1" 2 "TeTRSC_e_DispView2_View2" 3 "TeTRSC_e_DispView2_View3" 4 "TeTRSC_e_DispView2_View4" 5 "TeTRSC_e_DispView2_View5" 6 "TeTRSC_e_DispView2_View6" 7 "TeTRSC_e_DispView2_View7" 8 "TeTRSC_e_DispView2_View8" 9 "TeTRSC_e_DispView2_View9" 10 "TeTRSC_e_DispView2_View10" 11 "TeTRSC_e_DispView2_View11" 12 "TeTRSC_e_DispView2_View12" 13 "TeTRSC_e_DispView2_View13" 14 "TeTRSC_e_DispView2_View14" 15 "TeTRSC_e_DispView2_View15" 2147483647 "TeTRSC_e_DispView2_Dummy" /end COMPU_VTAB
/begin COMPU_VTAB VTAB_FOR_TRSC_SM_VC_Int_CM_TeTRSC_e_RadDsplyTyp "Enumerated data type: TeTRSC_e_RadDsplyTyp" TAB_VERB 10 0 "TeTRSC_e_RadDsplyTyp_zero" 1 "TeTRSC_e_RadDsplyTyp_one" 2 "TeTRSC_e_RadDsplyTyp_two" 3 "TeTRSC_e_RadDsplyTyp_three" 4 "TeTRSC_e_RadDsplyTyp_four" 5 "TeTRSC_e_RadDsplyTyp_five" 6 "TeTRSC_e_RadDsplyTyp_six" 7 "TeTRSC_e_RadDsplyTyp_seven" 8 "TeTRSC_e_RadDsplyTyp_eight" 2147483647 "TeTRSC_e_RadDsplyTyp_Dummy" /end COMPU_VTAB
/begin COMPU_VTAB VTAB_FOR_TRSC_SM_VC_Int_CM_TeTRSC_e_SpdLmtReq "Enumerated data type: TeTRSC_e_SpdLmtReq" TAB_VERB 10 0 "TeTRSC_e_SpdLmtReq_NotLim" 1 "TeTRSC_e_SpdLmtReq_Spd4" 2 "TeTRSC_e_SpdLmtReq_Spd5" 3 "TeTRSC_e_SpdLmtReq_Spd6" 4 "TeTRSC_e_SpdLmtReq_Spd7" 5 "TeTRSC_e_SpdLmtReq_Spd8" 6 "TeTRSC_e_SpdLmtReq_Spd9" 7 "TeTRSC_e_SpdLmtReq_Spd10" 15 "TeTRSC_e_SpdLmtReq_SNA" 2147483647 "TeTRSC_e_SpdLmtReq_Dummy" /end COMPU_VTAB
/begin COMPU_VTAB VTAB_FOR_TRSC_SM_VC_Int_CM_TeTRSC_e_StrRackPinTyp "Enumerated data type: TeTRSC_e_StrRackPinTyp" TAB_VERB 3 0 "TeTRSC_e_StrRackPinTyp_Type1" 1 "TeTRSC_e_StrRackPinTyp_Type2" 2147483647 "TeTRSC_e_StrRackPinTyp_Dummy" /end COMPU_VTAB
/begin COMPU_VTAB VTAB_FOR_TRSC_SM_VC_Int_CM_TeTRSC_e_TADState "Enumerated data type: TeTRSC_e_TADState" TAB_VERB 9 0 "TeTRSC_e_TADState_Idle" 1 "TeTRSC_e_TADState_TrailerDetection" 2 "TeTRSC_e_TADState_TrailerRecognition" 3 "TeTRSC_e_TADState_Calibration" 4 "TeTRSC_e_TADState_ScanningForTrailer" 5 "TeTRSC_e_TADState_Turnaround" 6 "TeTRSC_e_TADState_AngleDetection" 7 "TeTRSC_e_TADState_Trackinglost" 2147483647 "TeTRSC_e_TADState_Dummy" /end COMPU_VTAB
/begin COMPU_VTAB VTAB_FOR_TRSC_SM_VC_Int_CM_TeTRSC_e_TRSCLedSts "Enumerated data type: TeTRSC_e_TRSCLedSts" TAB_VERB 5 0 "TeTRSC_e_TRSCLedSts_Off" 1 "TeTRSC_e_TRSCLedSts_Solid" 2 "TeTRSC_e_TRSCLedSts_Blink" 3 "TeTRSC_e_TRSCLedSts_SNA" 2147483647 "TeTRSC_e_TRSCLedSts_Dummy" /end COMPU_VTAB
/begin COMPU_VTAB VTAB_FOR_TRSC_SM_VC_Int_CM_TeTRSC_e_TRSCPopupDispInfo "Enumerated data type: TeTRSC_e_TRSCPopupDispInfo" TAB_VERB 17 0 "TeTRSC_e_TRSCPopupDispInfo_Disp0" 1 "TeTRSC_e_TRSCPopupDispInfo_Disp1" 2 "TeTRSC_e_TRSCPopupDispInfo_Disp2" 3 "TeTRSC_e_TRSCPopupDispInfo_Disp3" 4 "TeTRSC_e_TRSCPopupDispInfo_Disp4" 5 "TeTRSC_e_TRSCPopupDispInfo_Disp5" 6 "TeTRSC_e_TRSCPopupDispInfo_Disp6" 7 "TeTRSC_e_TRSCPopupDispInfo_Disp7" 8 "TeTRSC_e_TRSCPopupDispInfo_Disp8" 9 "TeTRSC_e_TRSCPopupDispInfo_Disp9" 10 "TeTRSC_e_TRSCPopupDispInfo_Disp10" 11 "TeTRSC_e_TRSCPopupDispInfo_Disp11" 12 "TeTRSC_e_TRSCPopupDispInfo_Disp12" 13 "TeTRSC_e_TRSCPopupDispInfo_Disp13" 14 "TeTRSC_e_TRSCPopupDispInfo_Disp14" 15 "TeTRSC_e_TRSCPopupDispInfo_SNA" 2147483647 "TeTRSC_e_TRSCPopupDispInfo_Dummy" /end COMPU_VTAB
/begin COMPU_VTAB VTAB_FOR_TRSC_SM_VC_Int_CM_TeTRSC_e_TRSCStat "Enumerated data type: TeTRSC_e_TRSCStat" TAB_VERB 9 0 "TeTRSC_e_TRSCStat_Off" 1 "TeTRSC_e_TRSCStat_Standby" 2 "TeTRSC_e_TRSCStat_Calibrating" 3 "TeTRSC_e_TRSCStat_PreActive" 4 "TeTRSC_e_TRSCStat_Active" 5 "TeTRSC_e_TRSCStat_ActiveHoldOvr" 6 "TeTRSC_e_TRSCStat_Fault" 7 "TeTRSC_e_TRSCStat_SNA" 2147483647 "TeTRSC_e_TRSCStat_Dummy" /end COMPU_VTAB
/begin COMPU_VTAB VTAB_FOR_TRSC_SM_VC_Int_CM_TeTRSC_e_TRSCStrTrqActvReq "Enumerated data type: TeTRSC_e_TRSCStrTrqActvReq" TAB_VERB 4 0 "TeTRSC_e_TRSCStrTrqActvReq_False" 1 "TeTRSC_e_TRSCStrTrqActvReq_True" 3 "TeTRSC_e_TRSCStrTrqActvReq_SNA" 2147483647 "TeTRSC_e_TRSCStrTrqActvReq_Dummy" /end COMPU_VTAB
/begin COMPU_VTAB VTAB_FOR_TRSC_SM_VC_Int_CM_TeTRSC_e_TRSCSts "Enumerated data type: TeTRSC_e_TRSCSts" TAB_VERB 7 0 "TeTRSC_e_TRSCSts_Standby" 1 "TeTRSC_e_TRSCSts_Calibrating" 2 "TeTRSC_e_TRSCSts_PreActive" 3 "TeTRSC_e_TRSCSts_Active" 4 "TeTRSC_e_TRSCSts_Off" 7 "TeTRSC_e_TRSCSts_SNA" 2147483647 "TeTRSC_e_TRSCSts_Dummy" /end COMPU_VTAB
/begin COMPU_VTAB VTAB_FOR_TRSC_SM_VC_Int_CM_TeTRSC_e_TRSKMSts "Enumerated data type: TeTRSC_e_TRSKMSts" TAB_VERB 4 0 "TeTRSC_e_TRSKMSts_NotEnabled" 1 "TeTRSC_e_TRSKMSts_Enabled" 2 "TeTRSC_e_TRSKMSts_SNA" 2147483647 "TeTRSC_e_TRSKMSts_Dummy" /end COMPU_VTAB
/begin COMPU_VTAB VTAB_FOR_TRSC_SM_VC_Int_CM_TeTRSC_e_TrlrCalInfo "Enumerated data type: TeTRSC_e_TrlrCalInfo" TAB_VERB 4 0 "TeTRSC_e_TrlrCalInfo_NotCalibrated" 1 "TeTRSC_e_TrlrCalInfo_Calibrated" 2 "TeTRSC_e_TrlrCalInfo_Undefined" 2147483647 "TeTRSC_e_TrlrCalInfo_Dummy" /end COMPU_VTAB
/begin COMPU_VTAB VTAB_FOR_TRSC_SM_VC_Int_CM_TeTRSC_e_TrlrHitchLightCtrl "Enumerated data type: TeTRSC_e_TrlrHitchLightCtrl" TAB_VERB 4 0 "TeTRSC_e_TrlrHitchLightCtrl_ON" 1 "TeTRSC_e_TrlrHitchLightCtrl_OFF" 3 "TeTRSC_e_TrlrHitchLightCtrl_SNA" 2147483647 "TeTRSC_e_TrlrHitchLightCtrl_Dummy" /end COMPU_VTAB
/begin COMPU_VTAB VTAB_FOR_TRSC_SM_VC_Int_CM_TeTRSC_e_TrlrPrsntInfo "Enumerated data type: TeTRSC_e_TrlrPrsntInfo" TAB_VERB 4 0 "TeTRSC_e_TrlrPrsntInfo_Unknown" 1 "TeTRSC_e_TrlrPrsntInfo_NoTrlr" 2 "TeTRSC_e_TrlrPrsntInfo_TrlrPrsnt" 2147483647 "TeTRSC_e_TrlrPrsntInfo_Dummy" /end COMPU_VTAB
/begin COMPU_VTAB VTAB_FOR_TRSC_SM_VC_Int_CM_TeTRSC_e_TrlrRecogInfo "Enumerated data type: TeTRSC_e_TrlrRecogInfo" TAB_VERB 3 0 "TeTRSC_e_TrlrRecogInfo_Unknown" 1 "TeTRSC_e_TrlrRecogInfo_Known" 2147483647 "TeTRSC_e_TrlrRecogInfo_Dummy" /end COMPU_VTAB
/begin COMPU_VTAB VTAB_FOR_TRSC_SM_VC_Int_CM_TeTRSC_e_VehStpReq "Enumerated data type: TeTRSC_e_VehStpReq" TAB_VERB 4 0 "TeTRSC_e_VehStpReq_False" 1 "TeTRSC_e_VehStpReq_True" 3 "TeTRSC_e_VehStpReq_SNA" 2147483647 "TeTRSC_e_VehStpReq_Dummy" /end COMPU_VTAB
/begin COMPU_VTAB VTAB_FOR_TRSC_SM_VC_Int_CM_TeTRSC_e_VehWhlBase "Enumerated data type: TeTRSC_e_VehWhlBase" TAB_VERB 4 0 "TeTRSC_e_VehWhlBase_Invalid" 1 "TeTRSC_e_VehWhlBase_Type1" 2 "TeTRSC_e_VehWhlBase_Type2" 2147483647 "TeTRSC_e_VehWhlBase_Dummy" /end COMPU_VTAB
/begin COMPU_VTAB VTAB_FOR_TRSC_SM_VC_Int_CM_TeVBII_e_CamDispSts "Enumerated data type: TeVBII_e_CamDispSts" TAB_VERB 9 0 "TeVBII_e_CamDispSts_Default" 1 "TeVBII_e_CamDispSts_View1" 2 "TeVBII_e_CamDispSts_View2" 3 "TeVBII_e_CamDispSts_View3" 4 "TeVBII_e_CamDispSts_View4" 5 "TeVBII_e_CamDispSts_View5" 6 "TeVBII_e_CamDispSts_View6" 7 "TeVBII_e_CamDispSts_View7" 2147483647 "TeVBII_e_CamDispSts_Dummy" /end COMPU_VTAB
/begin COMPU_VTAB VTAB_FOR_TRSC_SM_VC_Int_CM_TeVBII_e_CenterBtnSts "Enumerated data type: TeVBII_e_CenterBtnSts" TAB_VERB 4 0 "TeVBII_e_CenterBtnSts_NotPressed" 1 "TeVBII_e_CenterBtnSts_Pressed" 2 "TeVBII_e_CenterBtnSts_SNA" 2147483647 "TeVBII_e_CenterBtnSts_Dummy" /end COMPU_VTAB
/begin COMPU_VTAB VTAB_FOR_TRSC_SM_VC_Int_CM_TeVBII_e_CmdIgnSts "Enumerated data type: TeVBII_e_CmdIgnSts" TAB_VERB 7 0 "TeVBII_e_CmdIgnSts_Init" 1 "TeVBII_e_CmdIgnSts_IgnLk" 3 "TeVBII_e_CmdIgnSts_ACC" 4 "TeVBII_e_CmdIgnSts_Run" 5 "TeVBII_e_CmdIgnSts_Start" 7 "TeVBII_e_CmdIgnSts_SNA" 2147483647 "TeVBII_e_CmdIgnSts_Dummy" /end COMPU_VTAB
/begin COMPU_VTAB VTAB_FOR_TRSC_SM_VC_Int_CM_TeVBII_e_EcmTrscResp "Enumerated data type: TeVBII_e_EcmTrscResp" TAB_VERB 4 0 "TeVBII_e_EcmTrscResp_Off" 1 "TeVBII_e_EcmTrscResp_Actv" 3 "TeVBII_e_EcmTrscResp_SNA" 2147483647 "TeVBII_e_EcmTrscResp_Dummy" /end COMPU_VTAB
/begin COMPU_VTAB VTAB_FOR_TRSC_SM_VC_Int_CM_TeVBII_e_EnblBtnSts "Enumerated data type: TeVBII_e_EnblBtnSts" TAB_VERB 4 0 "TeVBII_e_EnblBtnSts_NotPressed" 1 "TeVBII_e_EnblBtnSts_Pressed" 2 "TeVBII_e_EnblBtnSts_SNA" 2147483647 "TeVBII_e_EnblBtnSts_Dummy" /end COMPU_VTAB
/begin COMPU_VTAB VTAB_FOR_TRSC_SM_VC_Int_CM_TeVBII_e_EngineSts "Enumerated data type: TeVBII_e_EngineSts" TAB_VERB 5 0 "TeVBII_e_EngineSts_EngOff" 1 "TeVBII_e_EngineSts_EngCranking" 2 "TeVBII_e_EngineSts_EngOn" 3 "TeVBII_e_EngineSts_SNA" 2147483647 "TeVBII_e_EngineSts_Dummy" /end COMPU_VTAB
/begin COMPU_VTAB VTAB_FOR_TRSC_SM_VC_Int_CM_TeVBII_e_EscTrscBrkResp "Enumerated data type: TeVBII_e_EscTrscBrkResp" TAB_VERB 5 0 "TeVBII_e_EscTrscBrkResp_Off" 1 "TeVBII_e_EscTrscBrkResp_Actv" 2 "TeVBII_e_EscTrscBrkResp_BrkOverHeated" 3 "TeVBII_e_EscTrscBrkResp_SNA" 2147483647 "TeVBII_e_EscTrscBrkResp_Dummy" /end COMPU_VTAB
/begin COMPU_VTAB VTAB_FOR_TRSC_SM_VC_Int_CM_TeVBII_e_GearEngagedForDsply "Enumerated data type: TeVBII_e_GearEngagedForDsply" TAB_VERB 21 0 "TeVBII_e_GearEngagedForDsply_Init" 1 "TeVBII_e_GearEngagedForDsply_Gear1" 2 "TeVBII_e_GearEngagedForDsply_Gear2" 3 "TeVBII_e_GearEngagedForDsply_Gear3" 4 "TeVBII_e_GearEngagedForDsply_Gear4" 5 "TeVBII_e_GearEngagedForDsply_Gear5" 6 "TeVBII_e_GearEngagedForDsply_Gear6" 7 "TeVBII_e_GearEngagedForDsply_Gear7" 8 "TeVBII_e_GearEngagedForDsply_Gear8" 9 "TeVBII_e_GearEngagedForDsply_Gear9" 10 "TeVBII_e_GearEngagedForDsply_NotUsed1" 11 "TeVBII_e_GearEngagedForDsply_NotUsed2" 12 "TeVBII_e_GearEngagedForDsply_P" 13 "TeVBII_e_GearEngagedForDsply_N" 14 "TeVBII_e_GearEngagedForDsply_R" 15 "TeVBII_e_GearEngagedForDsply_D" 16 "TeVBII_e_GearEngagedForDsply_L" 17 "TeVBII_e_GearEngagedForDsply_M" 18 "TeVBII_e_GearEngagedForDsply_S" 31 "TeVBII_e_GearEngagedForDsply_SNA" 2147483647 "TeVBII_e_GearEngagedForDsply_Dummy" /end COMPU_VTAB
/begin COMPU_VTAB VTAB_FOR_TRSC_SM_VC_Int_CM_TeVBII_e_GearRptState "Enumerated data type: TeVBII_e_GearRptState" TAB_VERB 14 0 "TeVBII_e_GearRptState_Neutral" 1 "TeVBII_e_GearRptState_FwdGr1" 2 "TeVBII_e_GearRptState_FwdGr2" 3 "TeVBII_e_GearRptState_FwdGr3" 4 "TeVBII_e_GearRptState_FwdGr4" 5 "TeVBII_e_GearRptState_FwdGr5" 6 "TeVBII_e_GearRptState_FwdGr6" 7 "TeVBII_e_GearRptState_FwdGr7" 8 "TeVBII_e_GearRptState_FwdGr8" 9 "TeVBII_e_GearRptState_FwdGr9" 13 "TeVBII_e_GearRptState_Park" 14 "TeVBII_e_GearRptState_RevGr" 15 "TeVBII_e_GearRptState_SNA" 2147483647 "TeVBII_e_GearRptState_Dummy" /end COMPU_VTAB
/begin COMPU_VTAB VTAB_FOR_TRSC_SM_VC_Int_CM_TeVBII_e_SBR1RowDriverSeatSts "Enumerated data type: TeVBII_e_SBR1RowDriverSeatSts" TAB_VERB 4 0 "TeVBII_e_SBR1RowDriverSeatSts_SeatBeltFasten" 1 "TeVBII_e_SBR1RowDriverSeatSts_SeatBeltNotFasten" 3 "TeVBII_e_SBR1RowDriverSeatSts_SNA" 2147483647 "TeVBII_e_SBR1RowDriverSeatSts_Dummy" /end COMPU_VTAB
/begin COMPU_VTAB VTAB_FOR_TRSC_SM_VC_Int_CM_TeVBII_e_SPMLatCtrlRespSts "Enumerated data type: TeVBII_e_SPMLatCtrlRespSts" TAB_VERB 9 0 "TeVBII_e_SPMLatCtrlRespSts_Idle" 1 "TeVBII_e_SPMLatCtrlRespSts_PermNotAvail" 2 "TeVBII_e_SPMLatCtrlRespSts_TempNotAvail" 3 "TeVBII_e_SPMLatCtrlRespSts_HasOpen" 4 "TeVBII_e_SPMLatCtrlRespSts_HasOpenBackup" 5 "TeVBII_e_SPMLatCtrlRespSts_Init" 6 "TeVBII_e_SPMLatCtrlRespSts_DampedExit" 7 "TeVBII_e_SPMLatCtrlRespSts_Faulted" 2147483647 "TeVBII_e_SPMLatCtrlRespSts_Dummy" /end COMPU_VTAB
/begin COMPU_VTAB VTAB_FOR_TRSC_SM_VC_Int_CM_TeVBII_e_ShiftLvrPos "Enumerated data type: TeVBII_e_ShiftLvrPos" TAB_VERB 12 0 "TeVBII_e_ShiftLvrPos_NoSelActvOrAvail" 1 "TeVBII_e_ShiftLvrPos_P" 2 "TeVBII_e_ShiftLvrPos_R" 3 "TeVBII_e_ShiftLvrPos_N" 4 "TeVBII_e_ShiftLvrPos_D" 5 "TeVBII_e_ShiftLvrPos_L" 6 "TeVBII_e_ShiftLvrPos_TIPAutostick" 7 "TeVBII_e_ShiftLvrPos_Plus" 8 "TeVBII_e_ShiftLvrPos_Minus" 9 "TeVBII_e_ShiftLvrPos_Sport" 15 "TeVBII_e_ShiftLvrPos_SNA" 2147483647 "TeVBII_e_ShiftLvrPos_Dummy" /end COMPU_VTAB
/begin COMPU_VTAB VTAB_FOR_TRSC_SM_VC_Int_CM_TeVBII_e_StrTrqResp "Enumerated data type: TeVBII_e_StrTrqResp" TAB_VERB 4 0 "TeVBII_e_StrTrqResp_Off" 1 "TeVBII_e_StrTrqResp_Active" 3 "TeVBII_e_StrTrqResp_SNA" 2147483647 "TeVBII_e_StrTrqResp_Dummy" /end COMPU_VTAB
/begin COMPU_VTAB VTAB_FOR_TRSC_SM_VC_Int_CM_TeVBII_e_StrWhlAngleType "Enumerated data type: TeVBII_e_StrWhlAngleType" TAB_VERB 4 0 "TeVBII_e_StrWhlAngleType_Absolute" 1 "TeVBII_e_StrWhlAngleType_Relative" 3 "TeVBII_e_StrWhlAngleType_SNA" 2147483647 "TeVBII_e_StrWhlAngleType_Dummy" /end COMPU_VTAB
/begin COMPU_VTAB VTAB_FOR_TRSC_SM_VC_Int_CM_TeVBII_e_TGWCamDispSts "Enumerated data type: TeVBII_e_TGWCamDispSts" TAB_VERB 11 0 "TeVBII_e_TGWCamDispSts_DispNonCam" 1 "TeVBII_e_TGWCamDispSts_DispDigRvcCam" 2 "TeVBII_e_TGWCamDispSts_DispAnaRvcCam" 3 "TeVBII_e_TGWCamDispSts_DispAnaChmslCam" 4 "TeVBII_e_TGWCamDispSts_DispSurViewCam" 5 "TeVBII_e_TGWCamDispSts_DispTrlrCam" 6 "TeVBII_e_TGWCamDispSts_DispWirelessCam" 7 "TeVBII_e_TGWCamDispSts_DispSvsMoreCamsPopup" 8 "TeVBII_e_TGWCamDispSts_DispIntCam" 15 "TeVBII_e_TGWCamDispSts_SNA" 2147483647 "TeVBII_e_TGWCamDispSts_Dummy" /end COMPU_VTAB
/begin COMPU_VTAB VTAB_FOR_TRSC_SM_VC_Int_CM_TeVBII_e_TchScrSts "Enumerated data type: TeVBII_e_TchScrSts" TAB_VERB 9 0 "TeVBII_e_TchScrSts_TchNotPSD" 1 "TeVBII_e_TchScrSts_TchPSD" 2 "TeVBII_e_TchScrSts_TchPSCan" 3 "TeVBII_e_TchScrSts_NotUsed" 4 "TeVBII_e_TchScrSts_TchCfgRes" 5 "TeVBII_e_TchScrSts_TchCfgOfst" 6 "TeVBII_e_TchScrSts_TchCfgMax" 7 "TeVBII_e_TchScrSts_SNA" 2147483647 "TeVBII_e_TchScrSts_Dummy" /end COMPU_VTAB
/begin COMPU_VTAB VTAB_FOR_TRSC_SM_VC_Int_CM_TeVBII_e_TrailerConnectionSts "Enumerated data type: TeVBII_e_TrailerConnectionSts" TAB_VERB 5 0 "TeVBII_e_TrailerConnectionSts_NotConnected" 1 "TeVBII_e_TrailerConnectionSts_Connected" 2 "TeVBII_e_TrailerConnectionSts_NotUsed" 3 "TeVBII_e_TrailerConnectionSts_SNA" 2147483647 "TeVBII_e_TrailerConnectionSts_Dummy" /end COMPU_VTAB
/begin COMPU_VTAB VTAB_FOR_TRSC_SM_VC_Int_CM_TeVBII_e_TrlrPrsntSts "Enumerated data type: TeVBII_e_TrlrPrsntSts" TAB_VERB 5 0 "TeVBII_e_TrlrPrsntSts_NoTrlr" 1 "TeVBII_e_TrlrPrsntSts_TrlrPrsnt" 2 "TeVBII_e_TrlrPrsntSts_TrlrDconn" 3 "TeVBII_e_TrlrPrsntSts_SNA" 2147483647 "TeVBII_e_TrlrPrsntSts_Dummy" /end COMPU_VTAB
/begin COMPU_VTAB VTAB_FOR_TRSC_SM_VC_Int_CM_TeVBII_e_TrscEnblBtnSts "Enumerated data type: TeVBII_e_TrscEnblBtnSts" TAB_VERB 4 0 "TeVBII_e_TrscEnblBtnSts_NotPressed" 1 "TeVBII_e_TrscEnblBtnSts_Pressed" 2 "TeVBII_e_TrscEnblBtnSts_SNA" 2147483647 "TeVBII_e_TrscEnblBtnSts_Dummy" /end COMPU_VTAB
/begin COMPU_VTAB VTAB_FOR_TRSC_SM_VC_Int_CM_TeVBII_e_VehAscmSts "Enumerated data type: TeVBII_e_VehAscmSts" TAB_VERB 15 0 "TeVBII_e_VehAscmSts_None" 1 "TeVBII_e_VehAscmSts_Dump" 2 "TeVBII_e_VehAscmSts_Park" 3 "TeVBII_e_VehAscmSts_Aero" 4 "TeVBII_e_VehAscmSts_Nvl" 5 "TeVBII_e_VehAscmSts_OR1" 6 "TeVBII_e_VehAscmSts_ORL2" 7 "TeVBII_e_VehAscmSts_Lifter" 8 "TeVBII_e_VehAscmSts_Raise" 9 "TeVBII_e_VehAscmSts_Lower" 10 "TeVBII_e_VehAscmSts_SysFail" 11 "TeVBII_e_VehAscmSts_SRVS" 12 "TeVBII_e_VehAscmSts_Aero2" 15 "TeVBII_e_VehAscmSts_SNA" 2147483647 "TeVBII_e_VehAscmSts_Dummy" /end COMPU_VTAB
/begin COMPU_VTAB VTAB_FOR_TRSC_SM_VC_Int_CM_TeVBII_e_VehStandStillSts "Enumerated data type: TeVBII_e_VehStandStillSts" TAB_VERB 4 0 "TeVBII_e_VehStandStillSts_True" 1 "TeVBII_e_VehStandStillSts_False" 3 "TeVBII_e_VehStandStillSts_SNA" 2147483647 "TeVBII_e_VehStandStillSts_Dummy" /end COMPU_VTAB
/begin COMPU_VTAB VTAB_FOR_TRSC_SM_VC_Int_CM_TeVBII_e_WhlSpnSts "Enumerated data type: TeVBII_e_WhlSpnSts" TAB_VERB 5 0 "TeVBII_e_WhlSpnSts_StandStill" 1 "TeVBII_e_WhlSpnSts_Forward" 2 "TeVBII_e_WhlSpnSts_Backward" 3 "TeVBII_e_WhlSpnSts_SNA" 2147483647 "TeVBII_e_WhlSpnSts_Dummy" /end COMPU_VTAB
/begin RECORD_LAYOUT Lookup1D_BOOLEAN FNC_VALUES 1 UBYTE COLUMN_DIR DIRECT /end RECORD_LAYOUT
/begin RECORD_LAYOUT Lookup1D_BYTE FNC_VALUES 1 SBYTE COLUMN_DIR DIRECT /end RECORD_LAYOUT
/begin RECORD_LAYOUT Lookup1D_FLOAT32_IEEE FNC_VALUES 1 FLOAT32_IEEE COLUMN_DIR DIRECT /end RECORD_LAYOUT
/begin RECORD_LAYOUT Lookup1D_FLOAT64_IEEE FNC_VALUES 1 FLOAT64_IEEE COLUMN_DIR DIRECT /end RECORD_LAYOUT
/begin RECORD_LAYOUT Lookup1D_SLONG FNC_VALUES 1 SLONG COLUMN_DIR DIRECT /end RECORD_LAYOUT
/begin RECORD_LAYOUT Lookup1D_UBYTE FNC_VALUES 1 UBYTE COLUMN_DIR DIRECT /end RECORD_LAYOUT
/begin RECORD_LAYOUT Lookup1D_ULONG FNC_VALUES 1 ULONG COLUMN_DIR DIRECT /end RECORD_LAYOUT
/begin RECORD_LAYOUT Lookup1D_UWORD FNC_VALUES 1 UWORD COLUMN_DIR DIRECT /end RECORD_LAYOUT
/begin RECORD_LAYOUT Lookup1D_WORD FNC_VALUES 1 SWORD COLUMN_DIR DIRECT /end RECORD_LAYOUT
/begin RECORD_LAYOUT Lookup1D_X_BOOLEAN AXIS_PTS_X 1 UBYTE INDEX_INCR DIRECT /end RECORD_LAYOUT
/begin RECORD_LAYOUT Lookup1D_X_BYTE AXIS_PTS_X 1 SBYTE INDEX_INCR DIRECT /end RECORD_LAYOUT
/begin RECORD_LAYOUT Lookup1D_X_FLOAT32_IEEE AXIS_PTS_X 1 FLOAT32_IEEE INDEX_INCR DIRECT /end RECORD_LAYOUT
/begin RECORD_LAYOUT Lookup1D_X_FLOAT64_IEEE AXIS_PTS_X 1 FLOAT64_IEEE INDEX_INCR DIRECT /end RECORD_LAYOUT
/begin RECORD_LAYOUT Lookup1D_X_LONG AXIS_PTS_X 1 SLONG INDEX_INCR DIRECT /end RECORD_LAYOUT
/begin RECORD_LAYOUT Lookup1D_X_UBYTE AXIS_PTS_X 1 UBYTE INDEX_INCR DIRECT /end RECORD_LAYOUT
/begin RECORD_LAYOUT Lookup1D_X_ULONG AXIS_PTS_X 1 ULONG INDEX_INCR DIRECT /end RECORD_LAYOUT
/begin RECORD_LAYOUT Lookup1D_X_UWORD AXIS_PTS_X 1 UWORD INDEX_INCR DIRECT /end RECORD_LAYOUT
/begin RECORD_LAYOUT Lookup1D_X_WORD AXIS_PTS_X 1 SWORD INDEX_INCR DIRECT /end RECORD_LAYOUT
/begin RECORD_LAYOUT Lookup2D_BOOLEAN FNC_VALUES 1 UBYTE COLUMN_DIR DIRECT /end RECORD_LAYOUT
/begin RECORD_LAYOUT Lookup2D_BYTE FNC_VALUES 1 SBYTE COLUMN_DIR DIRECT /end RECORD_LAYOUT
/begin RECORD_LAYOUT Lookup2D_FLOAT32_IEEE FNC_VALUES 1 FLOAT32_IEEE COLUMN_DIR DIRECT /end RECORD_LAYOUT
/begin RECORD_LAYOUT Lookup2D_FLOAT64_IEEE FNC_VALUES 1 FLOAT64_IEEE COLUMN_DIR DIRECT /end RECORD_LAYOUT
/begin RECORD_LAYOUT Lookup2D_LONG FNC_VALUES 1 SLONG COLUMN_DIR DIRECT /end RECORD_LAYOUT
/begin RECORD_LAYOUT Lookup2D_UBYTE FNC_VALUES 1 UBYTE COLUMN_DIR DIRECT /end RECORD_LAYOUT
/begin RECORD_LAYOUT Lookup2D_ULONG FNC_VALUES 1 ULONG COLUMN_DIR DIRECT /end RECORD_LAYOUT
/begin RECORD_LAYOUT Lookup2D_UWORD FNC_VALUES 1 UWORD COLUMN_DIR DIRECT /end RECORD_LAYOUT
/begin RECORD_LAYOUT Lookup2D_WORD FNC_VALUES 1 SWORD COLUMN_DIR DIRECT /end RECORD_LAYOUT
/begin RECORD_LAYOUT Lookup2D_X_BOOLEAN AXIS_PTS_X 1 UBYTE INDEX_INCR DIRECT /end RECORD_LAYOUT
/begin RECORD_LAYOUT Lookup2D_X_BYTE AXIS_PTS_X 1 SBYTE INDEX_INCR DIRECT /end RECORD_LAYOUT
/begin RECORD_LAYOUT Lookup2D_X_FLOAT32_IEEE AXIS_PTS_X 1 FLOAT32_IEEE INDEX_INCR DIRECT /end RECORD_LAYOUT
/begin RECORD_LAYOUT Lookup2D_X_FLOAT64_IEEE AXIS_PTS_X 1 FLOAT64_IEEE INDEX_INCR DIRECT /end RECORD_LAYOUT
/begin RECORD_LAYOUT Lookup2D_X_LONG AXIS_PTS_X 1 SLONG INDEX_INCR DIRECT /end RECORD_LAYOUT
/begin RECORD_LAYOUT Lookup2D_X_UBYTE AXIS_PTS_X 1 UBYTE INDEX_INCR DIRECT /end RECORD_LAYOUT
/begin RECORD_LAYOUT Lookup2D_X_ULONG AXIS_PTS_X 1 ULONG INDEX_INCR DIRECT /end RECORD_LAYOUT
/begin RECORD_LAYOUT Lookup2D_X_UWORD AXIS_PTS_X 1 UWORD INDEX_INCR DIRECT /end RECORD_LAYOUT
/begin RECORD_LAYOUT Lookup2D_X_WORD AXIS_PTS_X 1 SWORD INDEX_INCR DIRECT /end RECORD_LAYOUT
/begin RECORD_LAYOUT RL_AXIS_DB AXIS_PTS_X 1 FLOAT64_IEEE INDEX_INCR DIRECT /end RECORD_LAYOUT
/begin RECORD_LAYOUT RL_AXIS_FL AXIS_PTS_X 1 FLOAT32_IEEE INDEX_INCR DIRECT /end RECORD_LAYOUT
/begin RECORD_LAYOUT RL_AXIS_SB NO_AXIS_PTS_X 1 SBYTE AXIS_PTS_X 2 SBYTE INDEX_INCR DIRECT /end RECORD_LAYOUT
/begin RECORD_LAYOUT RL_AXIS_SBA AXIS_PTS_X 1 SBYTE INDEX_INCR DIRECT /end RECORD_LAYOUT
/begin RECORD_LAYOUT RL_AXIS_SLA AXIS_PTS_X 1 SLONG INDEX_INCR DIRECT /end RECORD_LAYOUT
/begin RECORD_LAYOUT RL_AXIS_SW NO_AXIS_PTS_X 1 UWORD AXIS_PTS_X 2 SWORD INDEX_INCR DIRECT /end RECORD_LAYOUT
/begin RECORD_LAYOUT RL_AXIS_SWA AXIS_PTS_X 1 SWORD INDEX_INCR DIRECT /end RECORD_LAYOUT
/begin RECORD_LAYOUT RL_AXIS_UB NO_AXIS_PTS_X 1 UBYTE AXIS_PTS_X 2 UBYTE INDEX_INCR DIRECT /end RECORD_LAYOUT
/begin RECORD_LAYOUT RL_AXIS_UBA AXIS_PTS_X 1 UBYTE INDEX_INCR DIRECT /end RECORD_LAYOUT
/begin RECORD_LAYOUT RL_AXIS_UL NO_AXIS_PTS_X 1 UWORD AXIS_PTS_X 2 ULONG INDEX_INCR DIRECT /end RECORD_LAYOUT
/begin RECORD_LAYOUT RL_AXIS_ULA AXIS_PTS_X 1 ULONG INDEX_INCR DIRECT /end RECORD_LAYOUT
/begin RECORD_LAYOUT RL_AXIS_UW NO_AXIS_PTS_X 1 UWORD AXIS_PTS_X 2 UWORD INDEX_INCR DIRECT /end RECORD_LAYOUT
/begin RECORD_LAYOUT RL_AXIS_UWA AXIS_PTS_X 1 UWORD INDEX_INCR DIRECT /end RECORD_LAYOUT
/begin RECORD_LAYOUT RL_CURVE_DB FNC_VALUES 1 FLOAT64_IEEE ROW_DIR DIRECT /end RECORD_LAYOUT
/begin RECORD_LAYOUT RL_CURVE_FL FNC_VALUES 1 FLOAT32_IEEE ROW_DIR DIRECT /end RECORD_LAYOUT
/begin RECORD_LAYOUT RL_CURVE_SB NO_AXIS_PTS_X 1 UBYTE RESERVED 2 BYTE FNC_VALUES 3 SBYTE ROW_DIR DIRECT /end RECORD_LAYOUT
/begin RECORD_LAYOUT RL_CURVE_SBA FNC_VALUES 1 SBYTE ROW_DIR DIRECT /end RECORD_LAYOUT
/begin RECORD_LAYOUT RL_CURVE_SW NO_AXIS_PTS_X 1 UWORD FNC_VALUES 2 SWORD ROW_DIR DIRECT /end RECORD_LAYOUT
/begin RECORD_LAYOUT RL_CURVE_SWA FNC_VALUES 1 SWORD ROW_DIR DIRECT /end RECORD_LAYOUT
/begin RECORD_LAYOUT RL_CURVE_UB NO_AXIS_PTS_X 1 UBYTE RESERVED 2 BYTE FNC_VALUES 3 UBYTE ROW_DIR DIRECT /end RECORD_LAYOUT
/begin RECORD_LAYOUT RL_CURVE_UBA FNC_VALUES 1 UBYTE ROW_DIR DIRECT /end RECORD_LAYOUT
/begin RECORD_LAYOUT RL_CURVE_UW NO_AXIS_PTS_X 1 UWORD FNC_VALUES 2 UWORD ROW_DIR DIRECT /end RECORD_LAYOUT
/begin RECORD_LAYOUT RL_CURVE_UWA FNC_VALUES 1 UWORD ROW_DIR DIRECT /end RECORD_LAYOUT
/begin RECORD_LAYOUT RL_MAP_DB FNC_VALUES 1 FLOAT64_IEEE ROW_DIR DIRECT /end RECORD_LAYOUT
/begin RECORD_LAYOUT RL_MAP_FL FNC_VALUES 1 FLOAT32_IEEE ROW_DIR DIRECT /end RECORD_LAYOUT
/begin RECORD_LAYOUT RL_MAP_SB NO_AXIS_PTS_X 1 UBYTE NO_AXIS_PTS_Y 2 UBYTE RESERVED 3 BYTE FNC_VALUES 4 SBYTE ROW_DIR DIRECT /end RECORD_LAYOUT
/begin RECORD_LAYOUT RL_MAP_SBA FNC_VALUES 1 SBYTE ROW_DIR DIRECT /end RECORD_LAYOUT
/begin RECORD_LAYOUT RL_MAP_SW NO_AXIS_PTS_X 1 UWORD NO_AXIS_PTS_Y 2 UWORD FNC_VALUES 3 SWORD ROW_DIR DIRECT /end RECORD_LAYOUT
/begin RECORD_LAYOUT RL_MAP_SWA FNC_VALUES 1 SWORD ROW_DIR DIRECT /end RECORD_LAYOUT
/begin RECORD_LAYOUT RL_MAP_UB NO_AXIS_PTS_X 1 UBYTE NO_AXIS_PTS_Y 2 UBYTE RESERVED 3 BYTE FNC_VALUES 4 UBYTE ROW_DIR DIRECT /end RECORD_LAYOUT
/begin RECORD_LAYOUT RL_MAP_UBA FNC_VALUES 1 UBYTE ROW_DIR DIRECT /end RECORD_LAYOUT
/begin RECORD_LAYOUT RL_MAP_UW NO_AXIS_PTS_X 1 UWORD NO_AXIS_PTS_Y 2 UWORD FNC_VALUES 3 UWORD ROW_DIR DIRECT /end RECORD_LAYOUT
/begin RECORD_LAYOUT RL_MAP_UWA FNC_VALUES 1 UWORD ROW_DIR DIRECT /end RECORD_LAYOUT
/begin RECORD_LAYOUT RL_VALUE_DB FNC_VALUES 1 FLOAT64_IEEE COLUMN_DIR DIRECT /end RECORD_LAYOUT
/begin RECORD_LAYOUT RL_VALUE_FL FNC_VALUES 1 FLOAT32_IEEE COLUMN_DIR DIRECT /end RECORD_LAYOUT
/begin RECORD_LAYOUT RL_VALUE_SB FNC_VALUES 1 SBYTE COLUMN_DIR DIRECT /end RECORD_LAYOUT
/begin RECORD_LAYOUT RL_VALUE_SL FNC_VALUES 1 SLONG COLUMN_DIR DIRECT /end RECORD_LAYOUT
/begin RECORD_LAYOUT RL_VALUE_SW FNC_VALUES 1 SWORD COLUMN_DIR DIRECT /end RECORD_LAYOUT
/begin RECORD_LAYOUT RL_VALUE_UB FNC_VALUES 1 UBYTE COLUMN_DIR DIRECT /end RECORD_LAYOUT
/begin RECORD_LAYOUT RL_VALUE_UL FNC_VALUES 1 ULONG COLUMN_DIR DIRECT /end RECORD_LAYOUT
/begin RECORD_LAYOUT RL_VALUE_UW FNC_VALUES 1 UWORD COLUMN_DIR DIRECT /end RECORD_LAYOUT
/begin RECORD_LAYOUT SSV__FLOAT32_IEEE_S AXIS_PTS_X 1 FLOAT32_IEEE INDEX_INCR DIRECT /end RECORD_LAYOUT
/begin RECORD_LAYOUT SSV__FLOAT64_IEEE_S AXIS_PTS_X 1 FLOAT64_IEEE INDEX_INCR DIRECT /end RECORD_LAYOUT
/begin RECORD_LAYOUT SSV__SBYTE_S AXIS_PTS_X 1 SBYTE INDEX_INCR DIRECT /end RECORD_LAYOUT
/begin RECORD_LAYOUT SSV__SLONG_S AXIS_PTS_X 1 SLONG INDEX_INCR DIRECT /end RECORD_LAYOUT
/begin RECORD_LAYOUT SSV__SWORD_S AXIS_PTS_X 1 SWORD INDEX_INCR DIRECT /end RECORD_LAYOUT
/begin RECORD_LAYOUT SSV__UBYTE_S AXIS_PTS_X 1 UBYTE INDEX_INCR DIRECT /end RECORD_LAYOUT
/begin RECORD_LAYOUT SSV__ULONG_S AXIS_PTS_X 1 ULONG INDEX_INCR DIRECT /end RECORD_LAYOUT
/begin RECORD_LAYOUT SSV__UWORD_S AXIS_PTS_X 1 UWORD INDEX_INCR DIRECT /end RECORD_LAYOUT
/begin RECORD_LAYOUT Scalar_BOOLEAN FNC_VALUES 1 UBYTE COLUMN_DIR DIRECT /end RECORD_LAYOUT
/begin RECORD_LAYOUT Scalar_BYTE FNC_VALUES 1 SBYTE COLUMN_DIR DIRECT /end RECORD_LAYOUT
/begin RECORD_LAYOUT Scalar_FLOAT32_IEEE FNC_VALUES 1 FLOAT32_IEEE COLUMN_DIR DIRECT /end RECORD_LAYOUT
/begin RECORD_LAYOUT Scalar_FLOAT64_IEEE FNC_VALUES 1 FLOAT64_IEEE COLUMN_DIR DIRECT /end RECORD_LAYOUT
/begin RECORD_LAYOUT Scalar_LONG FNC_VALUES 1 SLONG COLUMN_DIR DIRECT /end RECORD_LAYOUT
/begin RECORD_LAYOUT Scalar_SWORD FNC_VALUES 1 SWORD COLUMN_DIR DIRECT /end RECORD_LAYOUT
/begin RECORD_LAYOUT Scalar_UBYTE FNC_VALUES 1 UBYTE COLUMN_DIR DIRECT /end RECORD_LAYOUT
/begin RECORD_LAYOUT Scalar_ULONG FNC_VALUES 1 ULONG COLUMN_DIR DIRECT /end RECORD_LAYOUT
/begin RECORD_LAYOUT Scalar_UWORD FNC_VALUES 1 UWORD COLUMN_DIR DIRECT /end RECORD_LAYOUT
/begin RECORD_LAYOUT __FLOAT32_IEEE_S FNC_VALUES 1 FLOAT32_IEEE COLUMN_DIR DIRECT /end RECORD_LAYOUT
/begin RECORD_LAYOUT __FLOAT32_IEEE_Z FNC_VALUES 1 FLOAT32_IEEE ROW_DIR DIRECT /end RECORD_LAYOUT
/begin RECORD_LAYOUT __FLOAT64_IEEE_S FNC_VALUES 1 FLOAT64_IEEE COLUMN_DIR DIRECT /end RECORD_LAYOUT
/begin RECORD_LAYOUT __FLOAT64_IEEE_Z FNC_VALUES 1 FLOAT64_IEEE ROW_DIR DIRECT /end RECORD_LAYOUT
/begin RECORD_LAYOUT __SBYTE_S FNC_VALUES 1 SBYTE COLUMN_DIR DIRECT /end RECORD_LAYOUT
/begin RECORD_LAYOUT __SBYTE_Z FNC_VALUES 1 SBYTE ROW_DIR DIRECT /end RECORD_LAYOUT
/begin RECORD_LAYOUT __SLONG_S FNC_VALUES 1 SLONG COLUMN_DIR DIRECT /end RECORD_LAYOUT
/begin RECORD_LAYOUT __SLONG_Z FNC_VALUES 1 SLONG ROW_DIR DIRECT /end RECORD_LAYOUT
/begin RECORD_LAYOUT __SWORD_S FNC_VALUES 1 SWORD COLUMN_DIR DIRECT /end RECORD_LAYOUT
/begin RECORD_LAYOUT __SWORD_Z FNC_VALUES 1 SWORD ROW_DIR DIRECT /end RECORD_LAYOUT
/begin RECORD_LAYOUT __UBYTE_S FNC_VALUES 1 UBYTE COLUMN_DIR DIRECT /end RECORD_LAYOUT
/begin RECORD_LAYOUT __UBYTE_Z FNC_VALUES 1 UBYTE ROW_DIR DIRECT /end RECORD_LAYOUT
/begin RECORD_LAYOUT __ULONG_S FNC_VALUES 1 ULONG COLUMN_DIR DIRECT /end RECORD_LAYOUT
/begin RECORD_LAYOUT __ULONG_Z FNC_VALUES 1 ULONG ROW_DIR DIRECT /end RECORD_LAYOUT
/begin RECORD_LAYOUT __UWORD_S FNC_VALUES 1 UWORD COLUMN_DIR DIRECT /end RECORD_LAYOUT
/begin RECORD_LAYOUT __UWORD_Z FNC_VALUES 1 UWORD ROW_DIR DIRECT /end RECORD_LAYOUT
/begin GROUP Calibration ""
 /begin REF_CHARACTERISTIC Rear_ObjectDection_B.MeTOS_Str_DblIntgrtn_c Rear_ObjectDection_B.MeTOS_b_Enbl_Strt_Drvng_2_f /end REF_CHARACTERISTIC
/end GROUP
/begin GROUP DT24_CVADAS_AP_CodGen "DT24_CVADAS_AP_CodGen" ROOT
 /begin REF_MEASUREMENT MeAP_b_FPAStatus MeAP_b_FPASwtStatus MeAP_b_RPAStatus MeAP_b_RPASwtStatus MeAP_e_AutoParkStatus MeAP_e_ParkAssistStatus MeAutoPark_e_AlgoState /end REF_MEASUREMENT
 /begin SUB_GROUP Root_Input_Adapter mr_grp2link_DT24_CVADAS_AutoPark_Func /end SUB_GROUP
/end GROUP
/begin GROUP DT24_CVADAS_AutoPark_Func "DT24_CVADAS_AutoPark_Func" ROOT /begin SUB_GROUP Root_Controller /end SUB_GROUP /end GROUP
/begin GROUP IbFID_PA ""
 /begin REF_MEASUREMENT IbFID_PA.MeAP_b_FPADisable IbFID_PA.MeAP_b_FPAVolDefMed IbFID_PA.MeAP_b_PAVolDefMed IbFID_PA.MeAP_b_RPAActvTrlr IbFID_PA.MeAP_b_RPADisable IbFID_PA.MeAP_b_RPAVolDefMed /end REF_MEASUREMENT
/end GROUP
/begin GROUP IbFID_PARB ""
 /begin REF_MEASUREMENT IbFID_PARB.MeAP_b_PARBActv4LOW IbFID_PARB.MeAP_b_PARBActvTrlr IbFID_PARB.MeAP_b_PARBDiable /end REF_MEASUREMENT
/end GROUP
/begin GROUP IbFID_PPPA ""
 /begin REF_MEASUREMENT IbFID_PPPA.MeAP_b_PPPAActv4LOW IbFID_PPPA.MeAP_b_PPPAActvTrlr IbFID_PPPA.MeAP_b_PPPADefEng IbFID_PPPA.MeAP_b_PPPADisable /end REF_MEASUREMENT
/end GROUP
/begin GROUP IbTRSC_InpBus ""
 /begin REF_MEASUREMENT IbTRSC_InpBus.MeTRSC_b_InternalFault IbTRSC_InpBus.MeTRSC_e_CamBlockSts /end REF_MEASUREMENT
 /begin SUB_GROUP IbTRSC_InpBus.IbTRSC_MEProxiToIpc IbTRSC_InpBus.IbTRSC_SVStoTRSC IbTRSC_InpBus.IbTRSC_TrailerDetInp IbTRSC_InpBus.IbTRSC_VehInpFromCAN14 IbTRSC_InpBus.IbTRSC_VehInpFromCAN2 /end SUB_GROUP
/end GROUP
/begin GROUP IbTRSC_InpBus.IbTRSC_MEProxiToIpc ""
 /begin REF_MEASUREMENT IbTRSC_InpBus.IbTRSC_MEProxiToIpc.IePRX_b_AuxTrlrCam IbTRSC_InpBus.IbTRSC_MEProxiToIpc.IePRX_b_CanNode27AsmAscm IbTRSC_InpBus.IbTRSC_MEProxiToIpc.IePRX_b_CanNode63Ttm IbTRSC_InpBus.IbTRSC_MEProxiToIpc.IePRX_b_CanNode95ItbmItcm IbTRSC_InpBus.IbTRSC_MEProxiToIpc.IePRX_b_SRT IbTRSC_InpBus.IbTRSC_MEProxiToIpc.IePRX_b_SVSPresent IbTRSC_InpBus.IbTRSC_MEProxiToIpc.IePRX_b_TRSCPresent IbTRSC_InpBus.IbTRSC_MEProxiToIpc.IePRX_b_TrlrSurroundPresence IbTRSC_InpBus.IbTRSC_MEProxiToIpc.IePRX_e_RadDsplyTyp IbTRSC_InpBus.IbTRSC_MEProxiToIpc.IePRX_e_StrRackPinTyp IbTRSC_InpBus.IbTRSC_MEProxiToIpc.IePRX_e_VehWhlBase IbTRSC_InpBus.IbTRSC_MEProxiToIpc.IePRX_mm_VehTyreSize /end REF_MEASUREMENT
/end GROUP
/begin GROUP IbTRSC_InpBus.IbTRSC_SVStoTRSC ""
 /begin REF_MEASUREMENT IbTRSC_InpBus.IbTRSC_SVStoTRSC.IeHMI_b_MoreCamReq IbTRSC_InpBus.IbTRSC_SVStoTRSC.MeSVS_e_DispView2Info /end REF_MEASUREMENT
/end GROUP
/begin GROUP IbTRSC_InpBus.IbTRSC_TrailerDetInp ""
 /begin REF_MEASUREMENT IbTRSC_InpBus.IbTRSC_TrailerDetInp.MeTRSC_b_OBTLRecalibrate IbTRSC_InpBus.IbTRSC_TrailerDetInp.MeTRSC_cnt_TrlrCalibFailCntInfo IbTRSC_InpBus.IbTRSC_TrailerDetInp.MeTRSC_deg_DetJackKnifeAngle IbTRSC_InpBus.IbTRSC_TrailerDetInp.MeTRSC_deg_DetJackknifeThrAngle IbTRSC_InpBus.IbTRSC_TrailerDetInp.MeTRSC_deg_TADAngle IbTRSC_InpBus.IbTRSC_TrailerDetInp.MeTRSC_deg_TADAngleRate IbTRSC_InpBus.IbTRSC_TrailerDetInp.MeTRSC_e_TADState IbTRSC_InpBus.IbTRSC_TrailerDetInp.MeTRSC_e_TrlrCalInfo IbTRSC_InpBus.IbTRSC_TrailerDetInp.MeTRSC_e_TrlrPrsntInfo IbTRSC_InpBus.IbTRSC_TrailerDetInp.MeTRSC_e_TrlrRecogInfo IbTRSC_InpBus.IbTRSC_TrailerDetInp.MeTRSC_m_DetTrailerBeamLen IbTRSC_InpBus.IbTRSC_TrailerDetInp.MeTRSC_m_HitchLength /end REF_MEASUREMENT
/end GROUP
/begin GROUP IbTRSC_InpBus.IbTRSC_VehInpFromCAN14 ""
 /begin REF_MEASUREMENT IbTRSC_InpBus.IbTRSC_VehInpFromCAN14.IeVBII_M_StrWhlTrq IbTRSC_InpBus.IbTRSC_VehInpFromCAN14.IeVBII_a_VehLatAcc IbTRSC_InpBus.IbTRSC_VehInpFromCAN14.IeVBII_a_VehLatAccOffset IbTRSC_InpBus.IbTRSC_VehInpFromCAN14.IeVBII_a_VehLongAcc IbTRSC_InpBus.IbTRSC_VehInpFromCAN14.IeVBII_a_VehLongAccOffset IbTRSC_InpBus.IbTRSC_VehInpFromCAN14.IeVBII_b_StrTchSts IbTRSC_InpBus.IbTRSC_VehInpFromCAN14.IeVBII_cnt_LhfPulseCtr IbTRSC_InpBus.IbTRSC_VehInpFromCAN14.IeVBII_cnt_LhrPulseCtr IbTRSC_InpBus.IbTRSC_VehInpFromCAN14.IeVBII_cnt_RhfPulseCtr IbTRSC_InpBus.IbTRSC_VehInpFromCAN14.IeVBII_cnt_RhrPulseCtr IbTRSC_InpBus.IbTRSC_VehInpFromCAN14.IeVBII_ddeg_StrWhlSpd IbTRSC_InpBus.IbTRSC_VehInpFromCAN14.IeVBII_ddeg_VehYawRate IbTRSC_InpBus.IbTRSC_VehInpFromCAN14.IeVBII_deg_StrWhlAng IbTRSC_InpBus.IbTRSC_VehInpFromCAN14.IeVBII_e_EcmTrscResp IbTRSC_InpBus.IbTRSC_VehInpFromCAN14.IeVBII_e_EngineSts IbTRSC_InpBus.IbTRSC_VehInpFromCAN14.IeVBII_e_EscTrscBrkResp IbTRSC_InpBus.IbTRSC_VehInpFromCAN14.IeVBII_e_LhfWhlSpnSts IbTRSC_InpBus.IbTRSC_VehInpFromCAN14.IeVBII_e_LhrWhlSpnSts IbTRSC_InpBus.IbTRSC_VehInpFromCAN14.IeVBII_e_RhfWhlSpnSts IbTRSC_InpBus.IbTRSC_VehInpFromCAN14.IeVBII_e_RhrWhlSpnSts IbTRSC_InpBus.IbTRSC_VehInpFromCAN14.IeVBII_e_SPMLatCtrlRespSts IbTRSC_InpBus.IbTRSC_VehInpFromCAN14.IeVBII_e_StrTrqResp IbTRSC_InpBus.IbTRSC_VehInpFromCAN14.IeVBII_e_StrWhlAngleType IbTRSC_InpBus.IbTRSC_VehInpFromCAN14.IeVBII_e_VehStandStillSts IbTRSC_InpBus.IbTRSC_VehInpFromCAN14.IeVBII_kph_LhfWhlSpd IbTRSC_InpBus.IbTRSC_VehInpFromCAN14.IeVBII_kph_LhrWhlSpd IbTRSC_InpBus.IbTRSC_VehInpFromCAN14.IeVBII_kph_RefVehSpd IbTRSC_InpBus.IbTRSC_VehInpFromCAN14.IeVBII_kph_RhfWhlSpd IbTRSC_InpBus.IbTRSC_VehInpFromCAN14.IeVBII_kph_RhrWhlSpd IbTRSC_InpBus.IbTRSC_VehInpFromCAN14.IeVBII_kph_VehSpeedVSOSig /end REF_MEASUREMENT
/end GROUP
/begin GROUP IbTRSC_InpBus.IbTRSC_VehInpFromCAN2 ""
 /begin REF_MEASUREMENT IbTRSC_InpBus.IbTRSC_VehInpFromCAN2.IeVBII_b_DriverDoorSts IbTRSC_InpBus.IbTRSC_VehInpFromCAN2.IeVBII_b_TrnkStatus IbTRSC_InpBus.IbTRSC_VehInpFromCAN2.IeVBII_b_VehAscmSysFail IbTRSC_InpBus.IbTRSC_VehInpFromCAN2.IeVBII_e_CamDispSts IbTRSC_InpBus.IbTRSC_VehInpFromCAN2.IeVBII_e_CenterBtnSts IbTRSC_InpBus.IbTRSC_VehInpFromCAN2.IeVBII_e_CmdIgnSts IbTRSC_InpBus.IbTRSC_VehInpFromCAN2.IeVBII_e_EnblBtnSts IbTRSC_InpBus.IbTRSC_VehInpFromCAN2.IeVBII_e_GearEngagedForDsply IbTRSC_InpBus.IbTRSC_VehInpFromCAN2.IeVBII_e_GearRptState IbTRSC_InpBus.IbTRSC_VehInpFromCAN2.IeVBII_e_SBR1RowDriverSeatSts IbTRSC_InpBus.IbTRSC_VehInpFromCAN2.IeVBII_e_ShiftLvrPos IbTRSC_InpBus.IbTRSC_VehInpFromCAN2.IeVBII_e_TGWCamDispSts IbTRSC_InpBus.IbTRSC_VehInpFromCAN2.IeVBII_e_TchScrSts IbTRSC_InpBus.IbTRSC_VehInpFromCAN2.IeVBII_e_TrailerConnectionSts IbTRSC_InpBus.IbTRSC_VehInpFromCAN2.IeVBII_e_TrlrPrsntSts IbTRSC_InpBus.IbTRSC_VehInpFromCAN2.IeVBII_e_TrscEnblBtnSts IbTRSC_InpBus.IbTRSC_VehInpFromCAN2.IeVBII_e_VehAscmSts IbTRSC_InpBus.IbTRSC_VehInpFromCAN2.IeVBII_e_VehFlLvlAdj IbTRSC_InpBus.IbTRSC_VehInpFromCAN2.IeVBII_e_VehFrLvlAdj IbTRSC_InpBus.IbTRSC_VehInpFromCAN2.IeVBII_e_VehRlLvlAdj IbTRSC_InpBus.IbTRSC_VehInpFromCAN2.IeVBII_e_VehRrLvlAdj IbTRSC_InpBus.IbTRSC_VehInpFromCAN2.IeVBII_k_KnobAngl IbTRSC_InpBus.IbTRSC_VehInpFromCAN2.IeVBII_mm_VehFlLvl IbTRSC_InpBus.IbTRSC_VehInpFromCAN2.IeVBII_mm_VehFrLvl IbTRSC_InpBus.IbTRSC_VehInpFromCAN2.IeVBII_mm_VehRlLvl IbTRSC_InpBus.IbTRSC_VehInpFromCAN2.IeVBII_mm_VehRrLvl IbTRSC_InpBus.IbTRSC_VehInpFromCAN2.IeVBII_px_TchXCoord IbTRSC_InpBus.IbTRSC_VehInpFromCAN2.IeVBII_px_TchYCoord /end REF_MEASUREMENT
/end GROUP
/begin GROUP MCU1_0 ""
 /begin REF_CHARACTERISTIC s_CurrentGearPosition_u8 s_Flow_Control_Array_au8 s_ShortTermAdjActiveFlag_b /end REF_CHARACTERISTIC
/end GROUP
/begin GROUP MCU2_0 "" /begin REF_CHARACTERISTIC KeTRSC_Cnt_FailedCnt /end REF_CHARACTERISTIC /begin REF_MEASUREMENT IbTRSC_InpBus.MeTRSC_b_InternalFault /end REF_MEASUREMENT /end GROUP
/begin GROUP MCU2_1 "" /begin REF_CHARACTERISTIC ErrorMgr_Satellite_RunningCount_B /end REF_CHARACTERISTIC /begin SUB_GROUP Calibration /end SUB_GROUP /end GROUP
/begin GROUP MPU1_0 ""
 /begin REF_CHARACTERISTIC UsrCplrSelected_b.UsrCplrSelected_b UsrCplrSelected_b.UsrHitchCnfm_b /end REF_CHARACTERISTIC
/end GROUP
/begin GROUP MbNVM_ProxyParam ""
 /begin REF_MEASUREMENT MbNVM_ProxyParam.KeAP_b_CVPAMPres MbNVM_ProxyParam.KeAP_b_CanNode24PAMCVADAS MbNVM_ProxyParam.KeAP_b_CanNode63TTM MbNVM_ProxyParam.KeAP_b_CanNode67DTCM MbNVM_ProxyParam.KeAP_b_CanNode95ITBMTCM MbNVM_ProxyParam.KeAP_b_DrvSide MbNVM_ProxyParam.KeAP_b_FullAutoPrkgSys MbNVM_ProxyParam.KeAP_b_PAMCfg MbNVM_ProxyParam.KeAP_b_ParkWithStop MbNVM_ProxyParam.KeAP_b_PullOutCtrlPres MbNVM_ProxyParam.KeAP_b_SemiAutoPrkgSys MbNVM_ProxyParam.KeAP_b_StopAndStrt MbNVM_ProxyParam.KeAP_b_TrlrHitchAsstPres MbNVM_ProxyParam.KeAP_b_TrlrRvsSteerPres MbNVM_ProxyParam.KeAP_e_CtryCod MbNVM_ProxyParam.KeAP_e_DrvTypVrnt MbNVM_ProxyParam.KeAP_e_GbTyp MbNVM_ProxyParam.KeAP_e_HybTyp MbNVM_ProxyParam.KeAP_e_MdlYr MbNVM_ProxyParam.KeAP_e_PAMTunSet MbNVM_ProxyParam.KeAP_e_RadioDispTyp MbNVM_ProxyParam.KeAP_e_SteerRatRackPinionTyp MbNVM_ProxyParam.KeAP_e_VehLineCfg MbNVM_ProxyParam.KeAP_e_WhlBas MbNVM_ProxyParam.KeAP_mm_TyreSz /end REF_MEASUREMENT
/end GROUP
/begin GROUP MbUSS_DiagFlag ""
 /begin REF_MEASUREMENT MbUSS_DiagFlag.commFault MbUSS_DiagFlag.commUnknown MbUSS_DiagFlag.hardwareFault MbUSS_DiagFlag.overTempFault /end REF_MEASUREMENT
/end GROUP
/begin GROUP Rear_ObjectDection "Rear_ObjectDection" ROOT /begin SUB_GROUP Root_CMR_LongThrtAssess /end SUB_GROUP /end GROUP
/begin GROUP Rear_ObjectDection_B.RIPCT ""
 /begin REF_MEASUREMENT Rear_ObjectDection_B.RIPCT.host_ttj Rear_ObjectDection_B.RIPCT.obj_ID Rear_ObjectDection_B.RIPCT.obj_IntersectionLat Rear_ObjectDection_B.RIPCT.obj_IntersectionLong Rear_ObjectDection_B.RIPCT.obj_LatTTC Rear_ObjectDection_B.RIPCT.obj_LatTTC_valid Rear_ObjectDection_B.RIPCT.obj_TTC Rear_ObjectDection_B.RIPCT.obj_TTC_valid Rear_ObjectDection_B.RIPCT.obj_accel Rear_ObjectDection_B.RIPCT.obj_age Rear_ObjectDection_B.RIPCT.obj_blinker Rear_ObjectDection_B.RIPCT.obj_brakelights Rear_ObjectDection_B.RIPCT.obj_cut_in Rear_ObjectDection_B.RIPCT.obj_fsn_status Rear_ObjectDection_B.RIPCT.obj_headway Rear_ObjectDection_B.RIPCT.obj_lane Rear_ObjectDection_B.RIPCT.obj_location Rear_ObjectDection_B.RIPCT.obj_status Rear_ObjectDection_B.RIPCT.obj_type Rear_ObjectDection_B.RIPCT.obj_valid Rear_ObjectDection_B.RIPCT.obj_vx_rel Rear_ObjectDection_B.RIPCT.obj_vy_rel Rear_ObjectDection_B.RIPCT.obj_width Rear_ObjectDection_B.RIPCT.obj_x_pos Rear_ObjectDection_B.RIPCT.obj_y_pos /end REF_MEASUREMENT
/end GROUP
/begin GROUP Root_CMR_LongThrtAssess "Rear_ObjectDection/CMR_LongThrtAssess"
 /begin SUB_GROUP S1_PathPrediction S1_Path_overlap_Estimator_ S1_RIPCT_Selector /end SUB_GROUP
/end GROUP
/begin GROUP Root_Controller "DT24_CVADAS_AutoPark_Func/Controller"
 /begin REF_MEASUREMENT MeAP_cm_FrntCenterMinXDist MeAP_cm_FrntLeftMinXDist MeAP_cm_FrntRightMinXDist MeAP_cm_RearCenterMinXDist MeAP_cm_RearLeftMinXDist MeAP_cm_RearRightMinXDist /end REF_MEASUREMENT
 /begin SUB_GROUP mr_grp2link_SWC_APA mr_grp2link_SWC_AP_StateMachine mr_grp2link_SWC_VC /end SUB_GROUP
/end GROUP
/begin GROUP Root_FCA_AutoPark_VC "SWC_VC/FCA_AutoPark_VC" /begin SUB_GROUP S1_ADASManeuverManager S1_PathPlanner /end SUB_GROUP /end GROUP
/begin GROUP Root_FCA_THA_VC "THA_VC_Ref/FCA_THA_VC" /begin REF_CHARACTERISTIC KeTHA_s_SteerTweakTime /end REF_CHARACTERISTIC /begin SUB_GROUP S6_Maneuvre_abort_engaged S6_THA_Engaged S6_init_subsystem /end SUB_GROUP /end GROUP
/begin GROUP Root_Input_Adapter "DT24_CVADAS_AP_CodGen/Input_Adapter"
 /begin SUB_GROUP S3_Inputs_Signal_Processing_SM S3_Inputs_Signal_Processing_VC /end SUB_GROUP
/end GROUP
/begin GROUP Root_SWC_APA "SWC_APA/SWC_APA" /begin SUB_GROUP S2_Rear_Front_ParkAssist /end SUB_GROUP /end GROUP
/begin GROUP Root_SWC_AP_StateMachine "SWC_AP_StateMachine/SWC_AP_StateMachine"
 /begin SUB_GROUP S2_AP_PreRequisits S2_AP_Statemachine S2_CalibrationParameters S2_USSFiringModes /end SUB_GROUP
/end GROUP
/begin GROUP Root_THA_SM_Controller "THA_SM_Ref/THA_SM_Controller"
 /begin SUB_GROUP S1_THA_Chime_Manager S1_THA_FaultCheck_Manager S1_THA_HMILogicFlow_Manager S1_THA_MainStateMachine_Manager S1_THA_RearParkAssist_Manager /end SUB_GROUP
/end GROUP
/begin GROUP Root_THA_SM_InputProcessing "THA_SM_Ref/THA_SM_InputProcessing"
 /begin REF_MEASUREMENT MeSVS_b_ImgDefeatReqSts MeSVS_b_IsConfirmBtnPrsd MeSVS_b_THAAbortReq MeSVS_b_THAMnvrStartBtnPrsd MeSVS_b_THAScrTchSts MeSVS_b_THASftBtnPrsdStsToTHA MeSVS_b_ViewZoomSts MeSVS_e_THAScrResp MeTHA_deg_CplrAng MeTHA_e_CplrDetctStatus MeTHA_e_HitchDetctStatus MeTHA_px_HitchCplrPixDiffLat MeTHA_px_HitchCplrPixDiffLong /end REF_MEASUREMENT
/end GROUP
/begin GROUP Root_THA_SmVc_Enabled "THA_SmVc_Ref/THA_SmVc_Enabled"
 /begin REF_MEASUREMENT MeTHA_b_UsrCplrSelCnfm MeTHA_b_UsrHitchCnfm MeTHA_e_ScreenRequest MeTHA_e_THAStateInfo /end REF_MEASUREMENT
 /begin SUB_GROUP mr_grp2link_THA_SM_Ref mr_grp2link_THA_VC_Ref /end SUB_GROUP
/end GROUP
/begin GROUP Root_TRSC_StateLogic "TRSC_StateMachine/TRSC_StateLogic"
 /begin REF_CHARACTERISTIC KeTRSC_Cnt_FailedCnt KeTRSC_e_CamBlockAcceptLvl KeTRSC_kph_DeactivationSpd KeTRSC_pct_TrlrJackKnifePerc KeTRSC_s_ActTransRevDbnc2 KeTRSC_s_CalibDlyTh KeTRSC_s_EpsRespTmOut KeTRSC_s_FifteenSecTh KeTRSC_s_FiveSecTh KeTRSC_s_GearDbncTh KeTRSC_s_LEDTmrTh KeTRSC_s_RespNotRcvdTmOut KeTRSC_s_TenMinTh KeTRSC_s_ThirtySecTh KeTRSC_s_TrlrUnkwnSet KeTRSC_s_TwoSecTh /end REF_CHARACTERISTIC
 /begin REF_MEASUREMENT MeTRSC_b_TrlrCalibDelayInfo MeTRSC_b_TrlrCalibPopInfo /end REF_MEASUREMENT
/end GROUP
/begin GROUP Root_TRSC_VC2 "TRSC_VC/TRSC_VC2" /begin SUB_GROUP S1_Kinematic_Model S1_Torque_Control /end SUB_GROUP /end GROUP
/begin GROUP S101_Subsystem1 "Rear_ObjectDection/CMR_LongThrtAssess/PathPrediction/check_straight_driving/Subsystem1"
 /begin REF_CHARACTERISTIC Steering_Angle_DeadZone_End Steering_Angle_DeadZone_Start Straight_Driving_Thresold_rads2 /end REF_CHARACTERISTIC
 /begin REF_MEASUREMENT Rear_ObjectDection_B.MeTOS_Str_DblIntgrtn_c Rear_ObjectDection_B.MeTOS_b_Enbl_Strt_Drvng_2_f /end REF_MEASUREMENT
/end GROUP
/begin GROUP S102_heading_angle "TRSC_VC/TRSC_VC2/Torque Control/VehicleControl/Controller_Main2/Heading_Deviation1/heading_angle"
 /begin REF_CHARACTERISTIC CeConst_k_ConstOne CeConst_k_ConstZero CeTRA_deg_AngleOneEighty CeTRA_deg_AngleThreeSixty /end REF_CHARACTERISTIC
 /begin REF_MEASUREMENT MeCtrl_deg_HeadingOut /end REF_MEASUREMENT
/end GROUP
/begin GROUP S102_path_prediction "Rear_ObjectDection/CMR_LongThrtAssess/PathPrediction/host path prediction/path prediction" /begin SUB_GROUP S109_check_straight_driving S109_host_path_prediction /end SUB_GROUP /end GROUP
/begin GROUP S106_Discrete_PID_Controller "TRSC_VC/TRSC_VC2/Torque Control/VehicleControl/Controller_Main2/TAD_PID1/Discrete_PID_Controller" /begin REF_MEASUREMENT MeCtrl_deg_TAD_PID /end REF_MEASUREMENT /end GROUP
/begin GROUP S107_TAD_PID "TRSC_VC/TRSC_VC2/Torque Control/VehicleControl/Controller_Main2/TAD_des1/TAD_PID"
 /begin REF_CHARACTERISTIC CeConst_k_ConstZero CeTRA_k_ConstTen CeTRA_sec_SampleTime KaTRA_k_TAD_IGainLUTTblData KaTRA_k_VehSpdLUTTblData KeTRA_deg_TrailerBeamLenYBrkPts KeTRA_m_TrailerBeamLenXBrkPts /end REF_CHARACTERISTIC
/end GROUP
/begin GROUP S109_check_straight_driving "Rear_ObjectDection/CMR_LongThrtAssess/PathPrediction/host path prediction/path prediction/check_straight_driving"
 /begin REF_CHARACTERISTIC KeTOS_s_InTurnDbncTm KeTOS_s_StrDrvDbncTm KeTOS_s_TurnExitDbncTm KeTOS_x_InTurnThd KeTOS_x_TurnExitThd sampling_time /end REF_CHARACTERISTIC
 /begin SUB_GROUP S111_Subsystem1 /end SUB_GROUP
/end GROUP
/begin GROUP S109_host_path_prediction "Rear_ObjectDection/CMR_LongThrtAssess/PathPrediction/host path prediction/path prediction/host path prediction"
 /begin SUB_GROUP S112_calc_c0_host S112_curvature_steering__wheel_angle_based S112_curvature_yaw_rate_based /end SUB_GROUP
/end GROUP
/begin GROUP S10_Kinematic_Model "THA_VC_Ref/FCA_THA_VC/THA_Engaged/Kinematic_Model"
 /begin REF_CHARACTERISTIC KeTHA_cnt_WhlPlsCntHighLim KeTHA_cnt_WhlPlsCntLowLim KeTHA_m_WhlBase KeTHA_m_WhlCircumference /end REF_CHARACTERISTIC
/end GROUP
/begin GROUP S10_PAMStopCtrlStatusUpdate "SWC_APA/SWC_APA/Rear_Front_ParkAssist/RPAwithBrk/PAMStopCtrlStatusUpdate" /begin REF_CHARACTERISTIC KeAP_e_GbTypAT /end REF_CHARACTERISTIC /end GROUP
/begin GROUP S10_STR_Control1 "THA_VC_Ref/FCA_THA_VC/THA_Engaged/STR_Control1" /begin REF_CHARACTERISTIC KeTHA_ddeg_StrRateLimFinal KeTHA_ddeg_StrRateLimInit /end REF_CHARACTERISTIC /end GROUP
/begin GROUP S111_Subsystem1 "Rear_ObjectDection/CMR_LongThrtAssess/PathPrediction/host path prediction/path prediction/check_straight_driving/Subsystem1"
 /begin REF_CHARACTERISTIC Steering_Angle_DeadZone_End Steering_Angle_DeadZone_Start Straight_Driving_Thresold_rads2 /end REF_CHARACTERISTIC
 /begin REF_MEASUREMENT Rear_ObjectDection_B.MeTOS_Str_DblIntgrtn Rear_ObjectDection_B.MeTOS_b_Enbl_Strt_Drvng_2 /end REF_MEASUREMENT
/end GROUP
/begin GROUP S112_calc_c0_host "Rear_ObjectDection/CMR_LongThrtAssess/PathPrediction/host path prediction/path prediction/host path prediction/calc c0 host" /begin REF_MEASUREMENT Rear_ObjectDection_B.MeTOS_c0_host /end REF_MEASUREMENT /end GROUP
/begin GROUP S112_curvature_steering__wheel_angle_based "Rear_ObjectDection/CMR_LongThrtAssess/PathPrediction/host path prediction/path prediction/host path prediction/curvature steering  wheel angle based"
 /begin REF_CHARACTERISTIC CONST_RPS2DPS keVehParam_e_VehSteerRatioTable keVehParam_m_DistWhlBse /end REF_CHARACTERISTIC
 /begin REF_MEASUREMENT Rear_ObjectDection_B.Divide2 /end REF_MEASUREMENT
/end GROUP
/begin GROUP S112_curvature_yaw_rate_based "Rear_ObjectDection/CMR_LongThrtAssess/PathPrediction/host path prediction/path prediction/host path prediction/curvature yaw rate based" /begin REF_MEASUREMENT Rear_ObjectDection_B.MeTOS_c0_yaw_rate /end REF_MEASUREMENT /end GROUP
/begin GROUP S11_AP_FeatureEnable "SWC_AP_StateMachine/SWC_AP_StateMachine/AP_PreRequisits/AP_EnablingCondition/AP_FeatureEnable" /begin REF_MEASUREMENT MeAP_b_FeatureEnbl /end REF_MEASUREMENT /end GROUP
/begin GROUP S11_AP_VehicleConditions "SWC_AP_StateMachine/SWC_AP_StateMachine/AP_PreRequisits/AP_EnablingCondition/AP_VehicleConditions" /begin REF_MEASUREMENT MeAP_b_VehCndSts /end REF_MEASUREMENT /end GROUP
/begin GROUP S11_DriverOverride "SWC_AP_StateMachine/SWC_AP_StateMachine/AP_PreRequisits/AP_EnablingCondition/DriverOverride" /begin REF_CHARACTERISTIC KeAP_Cnt_GearOverrideTimeThd KeAP_cnt_TimeStep /end REF_CHARACTERISTIC /begin REF_MEASUREMENT MeAP_b_DriverOverride /end REF_MEASUREMENT /end GROUP
/begin GROUP S11_TargetGearFiltering2 "SWC_APA/SWC_APA/Rear_Front_ParkAssist/TargetGearFiltering/TargetGearFiltering2" /begin REF_CHARACTERISTIC KeAP_Cnt_GearFiltTimeThd KeAP_cnt_TimeStep /end REF_CHARACTERISTIC /end GROUP
/begin GROUP S120_LeftChimeAlertGen "SWC_APA/SWC_APA/Rear_Front_ParkAssist/RPA/RPA_ChimeAlertGen/LeftChimeAlertGen"
 /begin REF_CHARACTERISTIC KeAP_cm_DistZone1 KeAP_cm_DistZone2 KeAP_cm_DistZone3 KeAP_cm_DistZone4 KeAP_cm_DistZone5 KeAP_cm_DistZone6 KeAP_cnt_HalfSecChimeAlert KeAP_cnt_TimeStep /end REF_CHARACTERISTIC
/end GROUP
/begin GROUP S120_LtDebounceCounter "SWC_APA/SWC_APA/Rear_Front_ParkAssist/RPA/RPA_ChimeAlertGen/LtDebounceCounter" /begin REF_CHARACTERISTIC KeAP_cnt_DebounceTimeThd KeAP_cnt_TimeStep /end REF_CHARACTERISTIC /end GROUP
/begin GROUP S120_RightChimeAlertGen "SWC_APA/SWC_APA/Rear_Front_ParkAssist/RPA/RPA_ChimeAlertGen/RightChimeAlertGen"
 /begin REF_CHARACTERISTIC KeAP_cm_DistZone1 KeAP_cm_DistZone2 KeAP_cm_DistZone3 KeAP_cm_DistZone4 KeAP_cm_DistZone5 KeAP_cm_DistZone6 KeAP_cnt_HalfSecChimeAlert KeAP_cnt_TimeStep /end REF_CHARACTERISTIC
/end GROUP
/begin GROUP S120_RtDebounceCounter "SWC_APA/SWC_APA/Rear_Front_ParkAssist/RPA/RPA_ChimeAlertGen/RtDebounceCounter" /begin REF_CHARACTERISTIC KeAP_cnt_DebounceTimeThd KeAP_cnt_TimeStep /end REF_CHARACTERISTIC /end GROUP
/begin GROUP S122_CenterGraphicAlertGen "SWC_APA/SWC_APA/Rear_Front_ParkAssist/RPA/RPA_GraphicAlertGen/CenterGraphicAlertGen"
 /begin REF_CHARACTERISTIC KeAP_cm_DistZone1 KeAP_cm_DistZone2 KeAP_cm_DistZone3 KeAP_cm_DistZone4 KeAP_cm_DistZone5 KeAP_cm_DistZone6 /end REF_CHARACTERISTIC
/end GROUP
/begin GROUP S122_LeftGraphicAlertGen "SWC_APA/SWC_APA/Rear_Front_ParkAssist/RPA/RPA_GraphicAlertGen/LeftGraphicAlertGen" /begin REF_CHARACTERISTIC KeAP_cm_DistZone1 KeAP_cm_DistZone2 /end REF_CHARACTERISTIC /end GROUP
/begin GROUP S122_RightGraphicAlertGen "SWC_APA/SWC_APA/Rear_Front_ParkAssist/RPA/RPA_GraphicAlertGen/RightGraphicAlertGen" /begin REF_CHARACTERISTIC KeAP_cm_DistZone1 KeAP_cm_DistZone2 /end REF_CHARACTERISTIC /end GROUP
/begin GROUP S123_RIPCT_Obj_Hold "Rear_ObjectDection/CMR_LongThrtAssess/RIPCT Selector/Select Target/RIPCT_Obj_Hold" /begin REF_CHARACTERISTIC KeCMbB_b_EnblOncObjDbnc /end REF_CHARACTERISTIC /end GROUP
/begin GROUP S14_DebugVar "SWC_AP_StateMachine/SWC_AP_StateMachine/AP_PreRequisits/ParkAssistObjSel/DebugVar" /begin REF_MEASUREMENT MeAP_b_ObjValid MeAP_cm_ObjXPos MeAP_cm_ObjYPos /end REF_MEASUREMENT /end GROUP
/begin GROUP S14_HookLengthCnsd "SWC_AP_StateMachine/SWC_AP_StateMachine/AP_PreRequisits/ParkAssistObjSel/HookLengthCnsd" /begin REF_CHARACTERISTIC KeAP_b_HookConnected KeAP_cm_HookDistOffset /end REF_CHARACTERISTIC /end GROUP
/begin GROUP S14_HookLengthCnsd1 "SWC_AP_StateMachine/SWC_AP_StateMachine/AP_PreRequisits/ParkAssistObjSel/HookLengthCnsd1" /begin REF_CHARACTERISTIC KeAP_b_HookConnected KeAP_cm_HookDistOffset /end REF_CHARACTERISTIC /end GROUP
/begin GROUP S14_HookLengthCnsd2 "SWC_AP_StateMachine/SWC_AP_StateMachine/AP_PreRequisits/ParkAssistObjSel/HookLengthCnsd2" /begin REF_CHARACTERISTIC KeAP_b_HookConnected KeAP_cm_HookDistOffset /end REF_CHARACTERISTIC /end GROUP
/begin GROUP S15_KM_Gyro_YawRate "TRSC_VC/TRSC_VC2/Kinematic Model/Kinematic_model/KM_Gyro_YawRate" /begin REF_CHARACTERISTIC KeKM_k_KM_YawRateGyroBiasInit /end REF_CHARACTERISTIC
 /begin SUB_GROUP S19_Bias_Calculation_Enable_Criteria S19_Gyro_Measurement_Signal_Processing S19_Gyro_YawRate_Bias /end SUB_GROUP
/end GROUP
/begin GROUP S15_KM_Integrator_Trapazoidal "TRSC_VC/TRSC_VC2/Kinematic Model/Kinematic_model/KM_Integrator_Trapazoidal" /begin REF_CHARACTERISTIC CeConst_k_ConstTwo KeKM_s_SampleTime /end REF_CHARACTERISTIC /end GROUP
/begin GROUP S15_KM_Integrator_Trapazoidal1 "TRSC_VC/TRSC_VC2/Kinematic Model/Kinematic_model/KM_Integrator_Trapazoidal1" /begin REF_CHARACTERISTIC CeConst_k_ConstTwo KeKM_s_SampleTime /end REF_CHARACTERISTIC /end GROUP
/begin GROUP S15_KM_Integrator_Trapazoidal2 "TRSC_VC/TRSC_VC2/Kinematic Model/Kinematic_model/KM_Integrator_Trapazoidal2" /begin REF_CHARACTERISTIC CeConst_k_ConstTwo KeKM_s_SampleTime /end REF_CHARACTERISTIC /end GROUP
/begin GROUP S15_KM_Rear_Axle_ds "TRSC_VC/TRSC_VC2/Kinematic Model/Kinematic_model/KM_Rear_Axle_ds" /begin REF_CHARACTERISTIC CeConst_k_ConstZero /end REF_CHARACTERISTIC /end GROUP
/begin GROUP S15_KM_Reset "TRSC_VC/TRSC_VC2/Kinematic Model/Kinematic_model/KM_Reset" /begin REF_CHARACTERISTIC CeConst_k_ConstZero /end REF_CHARACTERISTIC /begin SUB_GROUP S24_reset_KM /end SUB_GROUP /end GROUP
/begin GROUP S15_KM_Wheel_Angle "TRSC_VC/TRSC_VC2/Kinematic Model/Kinematic_model/KM_Wheel_Angle" /begin REF_CHARACTERISTIC CeConst_k_ConstOne CeConst_k_ConstZero /end REF_CHARACTERISTIC /end GROUP
/begin GROUP S15_KM_heading_angle "TRSC_VC/TRSC_VC2/Kinematic Model/Kinematic_model/KM_heading_angle"
 /begin REF_CHARACTERISTIC CeConst_k_ConstOne CeConst_k_ConstZero CeKM_deg_180 CeKM_deg_360 /end REF_CHARACTERISTIC
/end GROUP
/begin GROUP S15_KeKM_k_NoiseCovQ1 "TRSC_VC/TRSC_VC2/Kinematic Model/Kinematic_model/KeKM_k_NoiseCovQ1"
 /begin REF_CHARACTERISTIC KeKM_k_KM_SF_RelAngCov KeKM_k_KM_SF_RelAngRateCov KeKM_k_KM_SF_YawRateCov /end REF_CHARACTERISTIC
/end GROUP
/begin GROUP S15_Predict "TRSC_VC/TRSC_VC2/Kinematic Model/Kinematic_model/Predict"
 /begin SUB_GROUP S29_StateTransitionFunction_Avg_tanAngle S29_StateTransitionFunction_x_next /end SUB_GROUP
/end GROUP
/begin GROUP S15_TrailerPositionAndHeadingCalculation "TRSC_VC/TRSC_VC2/Kinematic Model/Kinematic_model/TrailerPositionAndHeadingCalculation" /begin SUB_GROUP S30_Calc_T_H /end SUB_GROUP /end GROUP
/begin GROUP S15_YawRate "TRSC_VC/TRSC_VC2/Kinematic Model/Kinematic_model/YawRate" /begin REF_CHARACTERISTIC CeKM_deg_180 CeKM_k_pi /end REF_CHARACTERISTIC /end GROUP
/begin GROUP S15_YawRateEnableCriteria "TRSC_VC/TRSC_VC2/Kinematic Model/Kinematic_model/YawRateEnableCriteria" /begin REF_CHARACTERISTIC CeConst_k_ConstZero /end REF_CHARACTERISTIC /end GROUP
/begin GROUP S15_YawRateWhlRPMEn "TRSC_VC/TRSC_VC2/Kinematic Model/Kinematic_model/YawRateWhlRPMEn" /begin REF_CHARACTERISTIC CeConst_k_ConstOne CeConst_k_ConstZero KeKM_k_SWA_Res /end REF_CHARACTERISTIC /end GROUP
/begin GROUP S15_YawRate_RPM "TRSC_VC/TRSC_VC2/Kinematic Model/Kinematic_model/YawRate_RPM"
 /begin REF_CHARACTERISTIC CeConst_k_ConstZero CeKM_b_False CeKM_b_True CeKM_deg_180 CeKM_k_pi /end REF_CHARACTERISTIC
/end GROUP
/begin GROUP S15_YawRate_RPM_Bias "TRSC_VC/TRSC_VC2/Kinematic Model/Kinematic_model/YawRate_RPM_Bias" /begin REF_CHARACTERISTIC CeConst_k_ConstOne /end REF_CHARACTERISTIC /begin SUB_GROUP S38_Accumulator /end SUB_GROUP /end GROUP
/begin GROUP S15_x_Out "TRSC_VC/TRSC_VC2/Kinematic Model/Kinematic_model/x_Out" /begin REF_CHARACTERISTIC CeConst_k_ConstTwo CeConst_k_ConstZero /end REF_CHARACTERISTIC /end GROUP
/begin GROUP S179_TargetGearFiltering2 "SWC_AP_StateMachine/SWC_AP_StateMachine/AP_Statemachine/TargetGearFiltering/TargetGearFiltering2" /begin REF_CHARACTERISTIC KeAP_Cnt_GearFiltTimeThd KeAP_cnt_TimeStep /end REF_CHARACTERISTIC /end GROUP
/begin GROUP S19_Bias_Calculation_Enable_Criteria "TRSC_VC/TRSC_VC2/Kinematic Model/Kinematic_model/KM_Gyro_YawRate/Bias_Calculation_Enable_Criteria" /begin REF_CHARACTERISTIC CeConst_k_ConstOne CeConst_k_ConstZero KeKM_deg_AngTh /end REF_CHARACTERISTIC /end GROUP
/begin GROUP S19_Gyro_Measurement_Signal_Processing "TRSC_VC/TRSC_VC2/Kinematic Model/Kinematic_model/KM_Gyro_YawRate/Gyro_Measurement_Signal_Processing" /begin REF_CHARACTERISTIC CeConst_k_ConstZero /end REF_CHARACTERISTIC /end GROUP
/begin GROUP S19_Gyro_YawRate_Bias "TRSC_VC/TRSC_VC2/Kinematic Model/Kinematic_model/KM_Gyro_YawRate/Gyro_YawRate_Bias" /begin REF_CHARACTERISTIC CeConst_k_ConstOne /end REF_CHARACTERISTIC /end GROUP
/begin GROUP S1_ADASManeuverManager "SWC_VC/FCA_AutoPark_VC/ADASManeuverManager" /begin SUB_GROUP S4_ParkingManeucerManager_SM /end SUB_GROUP /end GROUP
/begin GROUP S1_Kinematic_Model "TRSC_VC/TRSC_VC2/Kinematic Model" /begin SUB_GROUP S7_Kinematic_model /end SUB_GROUP /end GROUP
/begin GROUP S1_PathPlanner "SWC_VC/FCA_AutoPark_VC/PathPlanner" /begin SUB_GROUP S9_Pathplanner_AP /end SUB_GROUP /end GROUP
/begin GROUP S1_PathPrediction "Rear_ObjectDection/CMR_LongThrtAssess/PathPrediction"
 /begin SUB_GROUP S3_Subsystem2 S3_Subsystem5 S3_Subsystem6 S3_check_straight_driving S3_host_path_prediction /end SUB_GROUP
/end GROUP
/begin GROUP S1_Path_overlap_Estimator_ "Rear_ObjectDection/CMR_LongThrtAssess/Path overlap Estimator " /begin REF_CHARACTERISTIC KeAP_b_HookConnected /end REF_CHARACTERISTIC /begin SUB_GROUP S2_Determine_Trust_1 S2_RAEB_Obj_Xpos_Hook /end SUB_GROUP /end GROUP
/begin GROUP S1_RIPCT_Selector "Rear_ObjectDection/CMR_LongThrtAssess/RIPCT Selector" /begin REF_MEASUREMENT Rear_ObjectDection_B.IeCS_v_VehSpdLong /end REF_MEASUREMENT /begin SUB_GROUP S4_Select_Target /end SUB_GROUP /end GROUP
/begin GROUP S1_THA_Chime_Manager "THA_SM_Ref/THA_SM_Controller/THA_Chime_Manager" /begin REF_CHARACTERISTIC KeTHA_s_ChimeActvTime KeTHA_s_ThaSampleTime /end REF_CHARACTERISTIC /end GROUP
/begin GROUP S1_THA_FaultCheck_Manager "THA_SM_Ref/THA_SM_Controller/THA_FaultCheck_Manager"
 /begin SUB_GROUP S4_Abort_Condition_THA_Enabled S4_Abort_Condition_THA_Engaged /end SUB_GROUP
/end GROUP
/begin GROUP S1_THA_HMILogicFlow_Manager "THA_SM_Ref/THA_SM_Controller/THA_HMILogicFlow_Manager" /begin REF_CHARACTERISTIC KeTHA_deg_VehTrlrInitAngMax KeTHA_kph_ActvSpdThd /end REF_CHARACTERISTIC /end GROUP
/begin GROUP S1_THA_MainStateMachine_Manager "THA_SM_Ref/THA_SM_Controller/THA_MainStateMachine_Manager" /begin REF_CHARACTERISTIC KeTHA_s_MnvTimeout /end REF_CHARACTERISTIC /begin SUB_GROUP S6_THAStates_PreProcessing /end SUB_GROUP /end GROUP
/begin GROUP S1_THA_RearParkAssist_Manager "THA_SM_Ref/THA_SM_Controller/THA_RearParkAssist_Manager" /begin REF_CHARACTERISTIC KeTHA_px_RearBrkSuppDist /end REF_CHARACTERISTIC /end GROUP
/begin GROUP S1_Torque_Control "TRSC_VC/TRSC_VC2/Torque Control" /begin SUB_GROUP S9_VehicleControl /end SUB_GROUP /end GROUP
/begin GROUP S21_ChimeAlertUpdate "SWC_APA/SWC_APA/Rear_Front_ParkAssist/FPA/FPA_ChimeAlertGen/ChimeAlertUpdate" /begin REF_CHARACTERISTIC KeAP_cnt_FrntChimeDisTimeThd KeAP_cnt_TimeStep /end REF_CHARACTERISTIC /end GROUP
/begin GROUP S21_LeftChimeAlertGen "SWC_APA/SWC_APA/Rear_Front_ParkAssist/FPA/FPA_ChimeAlertGen/LeftChimeAlertGen" /begin REF_CHARACTERISTIC KeAP_cm_DistZone1 KeAP_cm_DistZone2 /end REF_CHARACTERISTIC /end GROUP
/begin GROUP S21_LtDebounceCounter "SWC_APA/SWC_APA/Rear_Front_ParkAssist/FPA/FPA_ChimeAlertGen/LtDebounceCounter" /begin REF_CHARACTERISTIC KeAP_cnt_DebounceTimeThd KeAP_cnt_TimeStep /end REF_CHARACTERISTIC /end GROUP
/begin GROUP S21_RightChimeAlertGen "SWC_APA/SWC_APA/Rear_Front_ParkAssist/FPA/FPA_ChimeAlertGen/RightChimeAlertGen" /begin REF_CHARACTERISTIC KeAP_cm_DistZone1 KeAP_cm_DistZone2 /end REF_CHARACTERISTIC /end GROUP
/begin GROUP S21_RtDebounceCounter "SWC_APA/SWC_APA/Rear_Front_ParkAssist/FPA/FPA_ChimeAlertGen/RtDebounceCounter" /begin REF_CHARACTERISTIC KeAP_cnt_DebounceTimeThd KeAP_cnt_TimeStep /end REF_CHARACTERISTIC /end GROUP
/begin GROUP S224_TargetGearFiltering2 "SWC_AP_StateMachine/SWC_AP_StateMachine/USSFiringModes/TargetGearFiltering/TargetGearFiltering2" /begin REF_CHARACTERISTIC KeAP_Cnt_GearFiltTimeThd KeAP_cnt_TimeStep /end REF_CHARACTERISTIC /end GROUP
/begin GROUP S23_CenterGraphicAlertGen "SWC_APA/SWC_APA/Rear_Front_ParkAssist/FPA/FPA_GraphicAlertGen/CenterGraphicAlertGen"
 /begin REF_CHARACTERISTIC KeAP_cm_DistZone1 KeAP_cm_DistZone2 KeAP_cm_DistZone3 KeAP_cm_DistZone4 /end REF_CHARACTERISTIC
/end GROUP
/begin GROUP S23_LeftGraphicAlertGen "SWC_APA/SWC_APA/Rear_Front_ParkAssist/FPA/FPA_GraphicAlertGen/LeftGraphicAlertGen" /begin REF_CHARACTERISTIC KeAP_cm_DistZone1 KeAP_cm_DistZone2 /end REF_CHARACTERISTIC /end GROUP
/begin GROUP S23_RightGraphicAlertGen "SWC_APA/SWC_APA/Rear_Front_ParkAssist/FPA/FPA_GraphicAlertGen/RightGraphicAlertGen" /begin REF_CHARACTERISTIC KeAP_cm_DistZone1 KeAP_cm_DistZone2 /end REF_CHARACTERISTIC /end GROUP
/begin GROUP S24_Overlap_Lookup_Table "Rear_ObjectDection/CMR_LongThrtAssess/Path overlap Estimator /Determine_Trust 1/Trust_Level_3_and_4/Overlap_Lookup_Table" /begin REF_CHARACTERISTIC K_Overlap_Thrsld_RAEB Obj_DistTable Overlap_Thrsld_Switch /end REF_CHARACTERISTIC /begin REF_MEASUREMENT Rear_ObjectDection_B.Overlap_Thrsld_Values /end REF_MEASUREMENT /end GROUP
/begin GROUP S24_reset_KM "TRSC_VC/TRSC_VC2/Kinematic Model/Kinematic_model/KM_Reset/reset_KM" /begin REF_CHARACTERISTIC CeKM_b_False /end REF_CHARACTERISTIC /end GROUP
/begin GROUP S29_StateTransitionFunction_Avg_tanAngle "TRSC_VC/TRSC_VC2/Kinematic Model/Kinematic_model/Predict/StateTransitionFunction_Avg_tanAngle"
 /begin SUB_GROUP S48_Enable_Average_Wheel_Angle_Calculation S48_ResettableSubsystem /end SUB_GROUP
/end GROUP
/begin GROUP S29_StateTransitionFunction_x_next "TRSC_VC/TRSC_VC2/Kinematic Model/Kinematic_model/Predict/StateTransitionFunction_x_next" /begin REF_CHARACTERISTIC CeKM_k_ArrayZeros /end REF_CHARACTERISTIC /begin SUB_GROUP S49_X_next_2_ S49_X_next_2_1 S49_x_next_1_ S49_x_next_3_ /end SUB_GROUP /end GROUP
/begin GROUP S2_AP_PreRequisits "SWC_AP_StateMachine/SWC_AP_StateMachine/AP_PreRequisits"
 /begin SUB_GROUP S3_AP_EnablingCondition S3_ParkAssistObjSel S3_ParkManoeuvreObjDet S3_Subsystem /end SUB_GROUP
/end GROUP
/begin GROUP S2_AP_Statemachine "SWC_AP_StateMachine/SWC_AP_StateMachine/AP_Statemachine" /begin REF_MEASUREMENT MeAP_cnt_StateDebugVar MeAP_cnt_TransDebugVar /end REF_MEASUREMENT /begin SUB_GROUP S4_TargetGearFiltering /end SUB_GROUP /end GROUP
/begin GROUP S2_CalibrationParameters "SWC_AP_StateMachine/SWC_AP_StateMachine/CalibrationParameters"
 /begin REF_CHARACTERISTIC KeAP_Cnt_GearOverrideTimeThd KeAP_b_AutoParkEn KeAP_b_FPAEn KeAP_b_FullAutoPark KeAP_b_RPAwithBrk KeAP_b_RPAwithSurroundView KeAP_b_SteerOnlyAutoPark KeAP_cm_FrntLongDistAdj KeAP_cm_HalfVehicleWidth KeAP_cm_MaxNoObjDetctDist KeAP_cm_ObjPrestFCDistThd KeAP_cm_ObjPrestRCDistThd KeAP_cm_RearLongDistAdj KeAP_cm_VehicleWidth KeAP_cm_WarnOffset KeAP_cnt_SwtStuckTimeThd KeAP_cnt_TimeStep KeAP_degC_OperatingTempThd KeAP_kph_EnblHysThd KeAP_kph_FrntWarnMaxSpdThd KeAP_kph_PSDOffThd KeAP_kph_PSDOnThd KeAP_kph_ParkMnvThd KeAP_kph_RearWarnMaxSpdThd KeAP_pct_ObjConfidenceThd KeAP_s_BSMInterfaceCntTimeout KeAP_s_CamHandshakeDur KeAP_s_EPSInterfaceCntTimeout KeAP_s_GearShiftWaitCntTimeout KeAP_s_MaxStandstillTimeThd KeAP_s_ObjInPathTimeoutDur KeAP_s_PausedPressBtnTimeoutDur /end REF_CHARACTERISTIC
/end GROUP
/begin GROUP S2_Determine_Trust_1 "Rear_ObjectDection/CMR_LongThrtAssess/Path overlap Estimator /Determine_Trust 1" /begin SUB_GROUP S7_Trust_Level_3_and_4 /end SUB_GROUP /end GROUP
/begin GROUP S2_RAEB_Obj_Xpos_Hook "Rear_ObjectDection/CMR_LongThrtAssess/Path overlap Estimator /RAEB_Obj_Xpos_Hook"
 /begin REF_CHARACTERISTIC CeAP_m_CMtoM KeAP_cm_HookDistOffset KeAP_cm_RearLongDistAdj /end REF_CHARACTERISTIC
/end GROUP
/begin GROUP S2_Rear_Front_ParkAssist "SWC_APA/SWC_APA/Rear_Front_ParkAssist"
 /begin SUB_GROUP S3_FPA S3_PAMPopUpReq_update S3_RPA S3_RPAwithBrk S3_TargetGearFiltering /end SUB_GROUP
/end GROUP
/begin GROUP S2_USSFiringModes "SWC_AP_StateMachine/SWC_AP_StateMachine/USSFiringModes" /begin SUB_GROUP S8_TargetGearFiltering S8_USSSystemModeCal /end SUB_GROUP /end GROUP
/begin GROUP S30_Calc_T_H "TRSC_VC/TRSC_VC2/Kinematic Model/Kinematic_model/TrailerPositionAndHeadingCalculation/Calc_T_H" /begin SUB_GROUP S73_heading_angle /end SUB_GROUP /end GROUP
/begin GROUP S38_Accumulator "TRSC_VC/TRSC_VC2/Kinematic Model/Kinematic_model/YawRate_RPM_Bias/Accumulator" /begin REF_CHARACTERISTIC CeConst_k_ConstOne /end REF_CHARACTERISTIC /end GROUP
/begin GROUP S3_AP_EnablingCondition "SWC_AP_StateMachine/SWC_AP_StateMachine/AP_PreRequisits/AP_EnablingCondition"
 /begin SUB_GROUP S11_AP_FeatureEnable S11_AP_VehicleConditions S11_DriverOverride /end SUB_GROUP
/end GROUP
/begin GROUP S3_FPA "SWC_APA/SWC_APA/Rear_Front_ParkAssist/FPA"
 /begin SUB_GROUP S5_AP_FrntPAMLedStatusGen S5_Alert_DebounceLogic S5_Alert_DebounceLogic1 S5_Alert_DebounceLogic2 S5_FPA_ChimeAlertGen S5_FPA_ChimeAlertUpdate S5_FPA_GraphicAlertGen S5_FlashRate_DebounceLogic1 S5_FlashRate_DebounceLogic2 S5_FlashRate_DebounceLogic3 /end SUB_GROUP
/end GROUP
/begin GROUP S3_Inputs_Signal_Processing_SM "DT24_CVADAS_AP_CodGen/Input_Adapter/Inputs_Signal_Processing_SM" /begin REF_MEASUREMENT blockageFlagBits /end REF_MEASUREMENT
 /begin SUB_GROUP IbFID_PA IbFID_PARB IbFID_PPPA MbNVM_ProxyParam MbUSS_DiagFlag /end SUB_GROUP
/end GROUP
/begin GROUP S3_Inputs_Signal_Processing_VC "DT24_CVADAS_AP_CodGen/Input_Adapter/Inputs_Signal_Processing_VC" /begin REF_MEASUREMENT MeAP_b_ObjInPath /end REF_MEASUREMENT /end GROUP
/begin GROUP S3_PAMPopUpReq_update "SWC_APA/SWC_APA/Rear_Front_ParkAssist/PAMPopUpReq_update" /begin REF_CHARACTERISTIC KeAP_cnt_TimeStep KeAP_cnt_VehKeyOnTimeThd /end REF_CHARACTERISTIC /end GROUP
/begin GROUP S3_ParkAssistObjSel "SWC_AP_StateMachine/SWC_AP_StateMachine/AP_PreRequisits/ParkAssistObjSel"
 /begin REF_MEASUREMENT FrontCentreObjNum FrontLeftObjNum FrontRightObjNum RearCentreObjNum RearLeftObjNum RearRightObjNum /end REF_MEASUREMENT
 /begin SUB_GROUP S14_DebugVar S14_HookLengthCnsd S14_HookLengthCnsd1 S14_HookLengthCnsd2 /end SUB_GROUP
/end GROUP
/begin GROUP S3_ParkManoeuvreObjDet "SWC_AP_StateMachine/SWC_AP_StateMachine/AP_PreRequisits/ParkManoeuvreObjDet" /begin REF_CHARACTERISTIC KeAP_cm_ObjPrestFCDistThd KeAP_cm_ObjPrestRCDistThd /end REF_CHARACTERISTIC /end GROUP
/begin GROUP S3_RPA "SWC_APA/SWC_APA/Rear_Front_ParkAssist/RPA"
 /begin SUB_GROUP S9_AP_RearPAMLedStatusGen S9_Alert_DebounceLogic1 S9_Alert_DebounceLogic2 S9_Alert_DebounceLogic3 S9_FlashRate_DebounceLogic1 S9_FlashRate_DebounceLogic2 S9_FlashRate_DebounceLogic3 S9_RPA_ChimeAlertGen S9_RPA_ChimeAlertUpdate S9_RPA_GraphicAlertGen /end SUB_GROUP
/end GROUP
/begin GROUP S3_RPAwithBrk "SWC_APA/SWC_APA/Rear_Front_ParkAssist/RPAwithBrk" /begin SUB_GROUP S10_PAMStopCtrlStatusUpdate mr_grp2link_Rear_ObjectDection /end SUB_GROUP /end GROUP
/begin GROUP S3_Subsystem "SWC_AP_StateMachine/SWC_AP_StateMachine/AP_PreRequisits/Subsystem" /begin REF_CHARACTERISTIC KeAP_kph_PSDOffThd KeAP_kph_ParkMnvThd /end REF_CHARACTERISTIC
 /begin REF_MEASUREMENT MeAP_b_ACCEngg MeAP_b_BSMHandshakeFailed MeAP_b_BtnPsd MeAP_b_DoorOpen MeAP_b_EPBStsFaulted MeAP_b_EPSHandshakeFailed MeAP_b_ESCActive MeAP_b_ETMHandshakeFailed MeAP_b_FrntSnsrBlk MeAP_b_HandsOn MeAP_b_LifeGateOpen MeAP_b_Lo4DriveTrain MeAP_b_ManualParkReq MeAP_b_MnvSpdExceed MeAP_b_ObjInPathTimeout MeAP_b_PausedPressBtnTimeout MeAP_b_RearSnsrBlk MeAP_b_SeekSpdExceed MeAP_b_TCMFailed MeAP_b_TrlrConn /end REF_MEASUREMENT
/end GROUP
/begin GROUP S3_Subsystem2 "Rear_ObjectDection/CMR_LongThrtAssess/PathPrediction/Subsystem2" /begin REF_CHARACTERISTIC CONST_KPH2MPS /end REF_CHARACTERISTIC /begin REF_MEASUREMENT Rear_ObjectDection_B.Speed /end REF_MEASUREMENT /end GROUP
/begin GROUP S3_Subsystem5 "Rear_ObjectDection/CMR_LongThrtAssess/PathPrediction/Subsystem5" /begin REF_CHARACTERISTIC CONST_DPS2RPS /end REF_CHARACTERISTIC /begin REF_MEASUREMENT Rear_ObjectDection_B.YawRate /end REF_MEASUREMENT /end GROUP
/begin GROUP S3_Subsystem6 "Rear_ObjectDection/CMR_LongThrtAssess/PathPrediction/Subsystem6" /begin REF_CHARACTERISTIC CONST_DPS2RPS keInpAdptr_e_StWhOffset /end REF_CHARACTERISTIC /begin REF_MEASUREMENT Rear_ObjectDection_B.SteerAngle /end REF_MEASUREMENT /end GROUP
/begin GROUP S3_TargetGearFiltering "SWC_APA/SWC_APA/Rear_Front_ParkAssist/TargetGearFiltering" /begin SUB_GROUP S11_TargetGearFiltering2 /end SUB_GROUP /end GROUP
/begin GROUP S3_check_straight_driving "Rear_ObjectDection/CMR_LongThrtAssess/PathPrediction/check_straight_driving"
 /begin REF_CHARACTERISTIC KeTOS_s_InTurnDbncTm KeTOS_s_StrDrvDbncTm KeTOS_s_TurnExitDbncTm KeTOS_x_InTurnThd KeTOS_x_TurnExitThd sampling_time /end REF_CHARACTERISTIC
 /begin SUB_GROUP S101_Subsystem1 /end SUB_GROUP
/end GROUP
/begin GROUP S3_host_path_prediction "Rear_ObjectDection/CMR_LongThrtAssess/PathPrediction/host path prediction" /begin SUB_GROUP S102_path_prediction /end SUB_GROUP /end GROUP
/begin GROUP S48_Enable_Average_Wheel_Angle_Calculation "TRSC_VC/TRSC_VC2/Kinematic Model/Kinematic_model/Predict/StateTransitionFunction_Avg_tanAngle/Enable_Average_Wheel_Angle_Calculation"
 /begin REF_CHARACTERISTIC CeConst_k_ConstOne CeConst_k_ConstTwo CeConst_k_ConstZero CeKM_k_ConstFour /end REF_CHARACTERISTIC
/end GROUP
/begin GROUP S48_ResettableSubsystem "TRSC_VC/TRSC_VC2/Kinematic Model/Kinematic_model/Predict/StateTransitionFunction_Avg_tanAngle/ResettableSubsystem" /begin REF_CHARACTERISTIC CeConst_k_ConstOne /end REF_CHARACTERISTIC /begin SUB_GROUP S51_AvgTanAngleCal /end SUB_GROUP /end GROUP
/begin GROUP S49_PathPlanner1 "SWC_VC/FCA_AutoPark_VC/PathPlanner/Pathplanner_AP/PathPlanner1"
 /begin REF_CHARACTERISTIC CurbLim_para PS_size_para break_point_para break_point_perp fin_loc_para_out p3_adj_perp step_size_coeff str_profile_bigPS str_whl_ang_park_out /end REF_CHARACTERISTIC
/end GROUP
/begin GROUP S49_X_next_2_ "TRSC_VC/TRSC_VC2/Kinematic Model/Kinematic_model/Predict/StateTransitionFunction_x_next/X_next(2)"
 /begin REF_CHARACTERISTIC CeConst_k_ConstOne CeConst_k_ConstTwo CeKM_deg_180 CeKM_k_pi /end REF_CHARACTERISTIC
/end GROUP
/begin GROUP S49_X_next_2_1 "TRSC_VC/TRSC_VC2/Kinematic Model/Kinematic_model/Predict/StateTransitionFunction_x_next/X_next(2)1"
 /begin REF_CHARACTERISTIC CeConst_k_ConstOne CeConst_k_ConstTwo CeKM_deg_180 CeKM_k_pi KeKM_s_SampleTime /end REF_CHARACTERISTIC
/end GROUP
/begin GROUP S49_x_next_1_ "TRSC_VC/TRSC_VC2/Kinematic Model/Kinematic_model/Predict/StateTransitionFunction_x_next/x_next(1)" /begin REF_CHARACTERISTIC CeKM_deg_180 CeKM_k_pi /end REF_CHARACTERISTIC /end GROUP
/begin GROUP S49_x_next_3_ "TRSC_VC/TRSC_VC2/Kinematic Model/Kinematic_model/Predict/StateTransitionFunction_x_next/x_next(3)" /begin REF_CHARACTERISTIC CeConst_k_ConstOne CeConst_k_ConstTwo KeKM_s_SampleTime /end REF_CHARACTERISTIC /end GROUP
/begin GROUP S4_Abort_Condition_THA_Enabled "THA_SM_Ref/THA_SM_Controller/THA_FaultCheck_Manager/Abort_Condition_THA_Enabled" /begin REF_CHARACTERISTIC KeTHA_s_MnvTimeout KeTHA_s_ThaSampleTime /end REF_CHARACTERISTIC /end GROUP
/begin GROUP S4_Abort_Condition_THA_Engaged "THA_SM_Ref/THA_SM_Controller/THA_FaultCheck_Manager/Abort_Condition_THA_Engaged" /begin REF_CHARACTERISTIC KeTHA_kph_ActvSpdThd /end REF_CHARACTERISTIC /end GROUP
/begin GROUP S4_ParkingManeucerManager_SM "SWC_VC/FCA_AutoPark_VC/ADASManeuverManager/ParkingManeucerManager_SM"
 /begin REF_MEASUREMENT SWC_VC_DW.tp_APX_Park_State_Active_ST SWC_VC_DW.tp_APX_Park_State_AllStrokes_ST SWC_VC_DW.tp_APX_Park_State_Backw_DeviationExceeded SWC_VC_DW.tp_APX_Park_State_Backw_DispForw SWC_VC_DW.tp_APX_Park_State_Backw_DispForw1 SWC_VC_DW.tp_APX_Park_State_Backw_PathAccepted SWC_VC_DW.tp_APX_Park_State_Backw_RegenPathStarted SWC_VC_DW.tp_APX_Park_State_Backward SWC_VC_DW.tp_APX_Park_State_D_gear SWC_VC_DW.tp_APX_Park_State_End_ST SWC_VC_DW.tp_APX_Park_State_Forw_DeviationExceeded SWC_VC_DW.tp_APX_Park_State_Forw_DispBackw SWC_VC_DW.tp_APX_Park_State_Forw_DispBackw1 SWC_VC_DW.tp_APX_Park_State_Forw_PathAccepted SWC_VC_DW.tp_APX_Park_State_Forw_RegenPathStarted SWC_VC_DW.tp_APX_Park_State_Forward SWC_VC_DW.tp_APX_Park_State_Inactive_ST SWC_VC_DW.tp_APX_Park_State_Inactive_ST1 SWC_VC_DW.tp_APX_Park_State_R_gear SWC_VC_DW.tp_APX_Park_State_R_gear_l /end REF_MEASUREMENT
/end GROUP
/begin GROUP S4_Select_Target "Rear_ObjectDection/CMR_LongThrtAssess/RIPCT Selector/Select Target" /begin SUB_GROUP Rear_ObjectDection_B.RIPCT S123_RIPCT_Obj_Hold /end SUB_GROUP /end GROUP
/begin GROUP S4_TargetGearFiltering "SWC_AP_StateMachine/SWC_AP_StateMachine/AP_Statemachine/TargetGearFiltering" /begin SUB_GROUP S179_TargetGearFiltering2 /end SUB_GROUP /end GROUP
/begin GROUP S51_AvgTanAngleCal "TRSC_VC/TRSC_VC2/Kinematic Model/Kinematic_model/Predict/StateTransitionFunction_Avg_tanAngle/ResettableSubsystem/AvgTanAngleCal" /begin REF_CHARACTERISTIC CeConst_k_ConstZero /end REF_CHARACTERISTIC /end GROUP
/begin GROUP S5_AP_FrntPAMLedStatusGen "SWC_APA/SWC_APA/Rear_Front_ParkAssist/FPA/AP_FrntPAMLedStatusGen" /begin REF_CHARACTERISTIC KeAP_cnt_LEDBlinkTimeThd KeAP_cnt_TimeStep /end REF_CHARACTERISTIC /end GROUP
/begin GROUP S5_Alert_DebounceLogic "SWC_APA/SWC_APA/Rear_Front_ParkAssist/FPA/Alert_DebounceLogic" /begin REF_CHARACTERISTIC KeAP_cnt_DebounceTimeThd KeAP_cnt_TimeStep /end REF_CHARACTERISTIC /end GROUP
/begin GROUP S5_Alert_DebounceLogic1 "SWC_APA/SWC_APA/Rear_Front_ParkAssist/FPA/Alert_DebounceLogic1" /begin REF_CHARACTERISTIC KeAP_cnt_DebounceTimeThd KeAP_cnt_TimeStep /end REF_CHARACTERISTIC /end GROUP
/begin GROUP S5_Alert_DebounceLogic2 "SWC_APA/SWC_APA/Rear_Front_ParkAssist/FPA/Alert_DebounceLogic2" /begin REF_CHARACTERISTIC KeAP_cnt_DebounceTimeThd KeAP_cnt_TimeStep /end REF_CHARACTERISTIC /end GROUP
/begin GROUP S5_FPA_ChimeAlertGen "SWC_APA/SWC_APA/Rear_Front_ParkAssist/FPA/FPA_ChimeAlertGen"
 /begin SUB_GROUP S21_ChimeAlertUpdate S21_LeftChimeAlertGen S21_LtDebounceCounter S21_RightChimeAlertGen S21_RtDebounceCounter /end SUB_GROUP
/end GROUP
/begin GROUP S5_FPA_ChimeAlertUpdate "SWC_APA/SWC_APA/Rear_Front_ParkAssist/FPA/FPA_ChimeAlertUpdate" /begin REF_CHARACTERISTIC KeAP_cnt_ChimeVolChgAlert KeAP_cnt_TimeStep /end REF_CHARACTERISTIC /end GROUP
/begin GROUP S5_FPA_GraphicAlertGen "SWC_APA/SWC_APA/Rear_Front_ParkAssist/FPA/FPA_GraphicAlertGen"
 /begin SUB_GROUP S23_CenterGraphicAlertGen S23_LeftGraphicAlertGen S23_RightGraphicAlertGen /end SUB_GROUP
/end GROUP
/begin GROUP S5_FlashRate_DebounceLogic1 "SWC_APA/SWC_APA/Rear_Front_ParkAssist/FPA/FlashRate_DebounceLogic1" /begin REF_CHARACTERISTIC KeAP_cnt_DebounceTimeThd KeAP_cnt_TimeStep /end REF_CHARACTERISTIC /end GROUP
/begin GROUP S5_FlashRate_DebounceLogic2 "SWC_APA/SWC_APA/Rear_Front_ParkAssist/FPA/FlashRate_DebounceLogic2" /begin REF_CHARACTERISTIC KeAP_cnt_DebounceTimeThd KeAP_cnt_TimeStep /end REF_CHARACTERISTIC /end GROUP
/begin GROUP S5_FlashRate_DebounceLogic3 "SWC_APA/SWC_APA/Rear_Front_ParkAssist/FPA/FlashRate_DebounceLogic3" /begin REF_CHARACTERISTIC KeAP_cnt_DebounceTimeThd KeAP_cnt_TimeStep /end REF_CHARACTERISTIC /end GROUP
/begin GROUP S6_Maneuvre_abort_engaged "THA_VC_Ref/FCA_THA_VC/Maneuvre_abort_engaged" /begin REF_CHARACTERISTIC KeTHA_M_AbortStrTrq /end REF_CHARACTERISTIC /end GROUP
/begin GROUP S6_THAStates_PreProcessing "THA_SM_Ref/THA_SM_Controller/THA_MainStateMachine_Manager/THAStates_PreProcessing"
 /begin SUB_GROUP S71_CompleteStateCheck S71_EngagedDeltaInquiryCheck S71_EngagedHandShakeCheck /end SUB_GROUP
/end GROUP
/begin GROUP S6_THA_Engaged "THA_VC_Ref/FCA_THA_VC/THA_Engaged" /begin REF_CHARACTERISTIC KeTHA_px_HitchCplrDeltaThd2 /end REF_CHARACTERISTIC /begin SUB_GROUP S10_Kinematic_Model S10_STR_Control1 /end SUB_GROUP /end GROUP
/begin GROUP S6_init_subsystem "THA_VC_Ref/FCA_THA_VC/init_subsystem" /begin REF_CHARACTERISTIC KeTHA_M_SteerTweakTrq /end REF_CHARACTERISTIC /end GROUP
/begin GROUP S71_CompleteStateCheck "THA_SM_Ref/THA_SM_Controller/THA_MainStateMachine_Manager/THAStates_PreProcessing/CompleteStateCheck" /begin REF_CHARACTERISTIC KeTHA_s_Standstill KeTHA_s_ThaSampleTime /end REF_CHARACTERISTIC /end GROUP
/begin GROUP S71_EngagedDeltaInquiryCheck "THA_SM_Ref/THA_SM_Controller/THA_MainStateMachine_Manager/THAStates_PreProcessing/EngagedDeltaInquiryCheck" /begin REF_CHARACTERISTIC KeTHA_px_HitchCplrDeltaThd1 KeTHA_px_HitchCplrDeltaThd2 /end REF_CHARACTERISTIC /end GROUP
/begin GROUP S71_EngagedHandShakeCheck "THA_SM_Ref/THA_SM_Controller/THA_MainStateMachine_Manager/THAStates_PreProcessing/EngagedHandShakeCheck" /begin SUB_GROUP S76_BSMSpdLimtReq S76_ECMSpdLimtReq S76_EPSTrqOvrHandShake /end SUB_GROUP /end GROUP
/begin GROUP S73_heading_angle "TRSC_VC/TRSC_VC2/Kinematic Model/Kinematic_model/TrailerPositionAndHeadingCalculation/Calc_T_H/heading_angle"
 /begin REF_CHARACTERISTIC CeConst_k_ConstOne CeConst_k_ConstZero CeKM_deg_180 CeKM_deg_360 /end REF_CHARACTERISTIC
/end GROUP
/begin GROUP S76_BSMSpdLimtReq "THA_SM_Ref/THA_SM_Controller/THA_MainStateMachine_Manager/THAStates_PreProcessing/EngagedHandShakeCheck/BSMSpdLimtReq" /begin REF_CHARACTERISTIC KeTHA_s_BsmHandshake KeTHA_s_ThaSampleTime /end REF_CHARACTERISTIC /end GROUP
/begin GROUP S76_ECMSpdLimtReq "THA_SM_Ref/THA_SM_Controller/THA_MainStateMachine_Manager/THAStates_PreProcessing/EngagedHandShakeCheck/ECMSpdLimtReq" /begin REF_CHARACTERISTIC KeTHA_s_EcmHandshake KeTHA_s_ThaSampleTime /end REF_CHARACTERISTIC /end GROUP
/begin GROUP S76_EPSTrqOvrHandShake "THA_SM_Ref/THA_SM_Controller/THA_MainStateMachine_Manager/THAStates_PreProcessing/EngagedHandShakeCheck/EPSTrqOvrHandShake" /begin REF_CHARACTERISTIC KeTHA_s_EpsHandshake KeTHA_s_ThaSampleTime /end REF_CHARACTERISTIC /end GROUP
/begin GROUP S7_Kinematic_model "TRSC_VC/TRSC_VC2/Kinematic Model/Kinematic_model"
 /begin REF_CHARACTERISTIC KeKM_k_GyroYawCov KeKM_k_NumWheelPulses KeKM_k_TADCov KeKM_k_UpdateIMU_H KeKM_k_UpdateRPM_H KeKM_k_UpdateTAD_H KeKM_k_WhlPlsCnt_high_lim KeKM_k_WhlPlsCnt_low_lim KeKM_k_WhlRPMYawCov KeKM_m_TrackWidth KeKM_m_WheelCircumference KeKM_s_SampleTime /end REF_CHARACTERISTIC
 /begin SUB_GROUP S15_KM_Gyro_YawRate S15_KM_Integrator_Trapazoidal S15_KM_Integrator_Trapazoidal1 S15_KM_Integrator_Trapazoidal2 S15_KM_Rear_Axle_ds S15_KM_Reset S15_KM_Wheel_Angle S15_KM_heading_angle S15_KeKM_k_NoiseCovQ1 S15_Predict S15_TrailerPositionAndHeadingCalculation S15_YawRate S15_YawRateEnableCriteria S15_YawRateWhlRPMEn S15_YawRate_RPM S15_YawRate_RPM_Bias S15_x_Out /end SUB_GROUP
/end GROUP
/begin GROUP S7_Trust_Level_3_and_4 "Rear_ObjectDection/CMR_LongThrtAssess/Path overlap Estimator /Determine_Trust 1/Trust_Level_3_and_4"
 /begin REF_CHARACTERISTIC K_e_RAEB_VehicleWidth RAEB_Envelope_Offset RAEB_Lateral_Distance_Notification RAEB_Minimum_Object_Heigh Reverse_Gr_num /end REF_CHARACTERISTIC
 /begin SUB_GROUP S24_Overlap_Lookup_Table /end SUB_GROUP
/end GROUP
/begin GROUP S8_TargetGearFiltering "SWC_AP_StateMachine/SWC_AP_StateMachine/USSFiringModes/TargetGearFiltering" /begin SUB_GROUP S224_TargetGearFiltering2 /end SUB_GROUP /end GROUP
/begin GROUP S8_USSSystemModeCal "SWC_AP_StateMachine/SWC_AP_StateMachine/USSFiringModes/USSSystemModeCal" /begin REF_CHARACTERISTIC KeAP_kph_FrntWarnMaxSpdThd KeAP_kph_RearWarnMaxSpdThd /end REF_CHARACTERISTIC /end GROUP
/begin GROUP S96_Controller_Main2 "TRSC_VC/TRSC_VC2/Torque Control/VehicleControl/Controller_Main2" /begin REF_CHARACTERISTIC KeTRA_m_K_beta /end REF_CHARACTERISTIC
 /begin SUB_GROUP S97_Desired_angle_controller S97_Heading_Deviation1 S97_Path_Deviation S97_TAD_PID1 S97_TAD_des1 S97_TAD_ep1 S97_TravDist_TrapIntegrator /end SUB_GROUP
/end GROUP
/begin GROUP S96_Controller_T_h_init "TRSC_VC/TRSC_VC2/Torque Control/VehicleControl/Controller_T_h_init" /begin SUB_GROUP S98_Calc_T_H_init /end SUB_GROUP /end GROUP
/begin GROUP S97_Desired_angle_controller "TRSC_VC/TRSC_VC2/Torque Control/VehicleControl/Controller_Main2/Desired_angle_controller" /begin REF_CHARACTERISTIC CeConst_k_ConstOne CeConst_ku_deg2rad /end REF_CHARACTERISTIC /end GROUP
/begin GROUP S97_Heading_Deviation1 "TRSC_VC/TRSC_VC2/Torque Control/VehicleControl/Controller_Main2/Heading_Deviation1" /begin REF_CHARACTERISTIC CeConst_k_ConstOne CeConst_k_ConstZero /end REF_CHARACTERISTIC /begin REF_MEASUREMENT MeCtrl_deg_HeadingDeviation MeCtrl_deg_e_p /end REF_MEASUREMENT /begin SUB_GROUP S102_heading_angle /end SUB_GROUP /end GROUP
/begin GROUP S97_Path_Deviation "TRSC_VC/TRSC_VC2/Torque Control/VehicleControl/Controller_Main2/Path_Deviation" /begin REF_CHARACTERISTIC CeTRA_deg_AngleNinety /end REF_CHARACTERISTIC /end GROUP
/begin GROUP S97_TAD_PID1 "TRSC_VC/TRSC_VC2/Torque Control/VehicleControl/Controller_Main2/TAD_PID1"
 /begin REF_CHARACTERISTIC CeConst_k_ConstZero CeTRA_k_ConstTen CeTRA_k_OnePerHundred CeTRA_sec_SampleTime KaTRA_k_PGainLUTTblData KaTRA_k_VehSpd_IGainLUTTblData /end REF_CHARACTERISTIC
 /begin SUB_GROUP S106_Discrete_PID_Controller /end SUB_GROUP
/end GROUP
/begin GROUP S97_TAD_des1 "TRSC_VC/TRSC_VC2/Torque Control/VehicleControl/Controller_Main2/TAD_des1" /begin REF_CHARACTERISTIC CeTRA_k_fifteen KaTRA_k_VehSpd_HdgDeviatLUTTblData /end REF_CHARACTERISTIC /begin SUB_GROUP S107_TAD_PID /end SUB_GROUP /end GROUP
/begin GROUP S97_TAD_ep1 "TRSC_VC/TRSC_VC2/Torque Control/VehicleControl/Controller_Main2/TAD_ep1"
 /begin REF_CHARACTERISTIC CeConst_k_ConstZero CeTRA_k_ConstTen CeTRA_k_One_Four CeTRA_k_fifteen CeTRA_sec_SampleTime KaTRA_k_TADLUTTblData KaTRA_k_TravDistLUTTblData KaTRA_k_VehSpdLUTTblData KeTRA_k_Kp /end REF_CHARACTERISTIC
/end GROUP
/begin GROUP S97_TravDist_TrapIntegrator "TRSC_VC/TRSC_VC2/Torque Control/VehicleControl/Controller_Main2/TravDist_TrapIntegrator" /begin REF_CHARACTERISTIC CeConst_k_ConstTwo CeTRA_sec_SampleTime /end REF_CHARACTERISTIC /end GROUP
/begin GROUP S98_Calc_T_H_init "TRSC_VC/TRSC_VC2/Torque Control/VehicleControl/Controller_T_h_init/Calc_T_H_init" /begin REF_CHARACTERISTIC CeConst_k_ConstZero /end REF_CHARACTERISTIC /end GROUP
/begin GROUP S9_AP_RearPAMLedStatusGen "SWC_APA/SWC_APA/Rear_Front_ParkAssist/RPA/AP_RearPAMLedStatusGen" /begin REF_CHARACTERISTIC KeAP_cnt_LEDBlinkTimeThd KeAP_cnt_TimeStep /end REF_CHARACTERISTIC /end GROUP
/begin GROUP S9_Alert_DebounceLogic1 "SWC_APA/SWC_APA/Rear_Front_ParkAssist/RPA/Alert_DebounceLogic1" /begin REF_CHARACTERISTIC KeAP_cnt_DebounceTimeThd KeAP_cnt_TimeStep /end REF_CHARACTERISTIC /end GROUP
/begin GROUP S9_Alert_DebounceLogic2 "SWC_APA/SWC_APA/Rear_Front_ParkAssist/RPA/Alert_DebounceLogic2" /begin REF_CHARACTERISTIC KeAP_cnt_DebounceTimeThd KeAP_cnt_TimeStep /end REF_CHARACTERISTIC /end GROUP
/begin GROUP S9_Alert_DebounceLogic3 "SWC_APA/SWC_APA/Rear_Front_ParkAssist/RPA/Alert_DebounceLogic3" /begin REF_CHARACTERISTIC KeAP_cnt_DebounceTimeThd KeAP_cnt_TimeStep /end REF_CHARACTERISTIC /end GROUP
/begin GROUP S9_FlashRate_DebounceLogic1 "SWC_APA/SWC_APA/Rear_Front_ParkAssist/RPA/FlashRate_DebounceLogic1" /begin REF_CHARACTERISTIC KeAP_cnt_DebounceTimeThd KeAP_cnt_TimeStep /end REF_CHARACTERISTIC /end GROUP
/begin GROUP S9_FlashRate_DebounceLogic2 "SWC_APA/SWC_APA/Rear_Front_ParkAssist/RPA/FlashRate_DebounceLogic2" /begin REF_CHARACTERISTIC KeAP_cnt_DebounceTimeThd KeAP_cnt_TimeStep /end REF_CHARACTERISTIC /end GROUP
/begin GROUP S9_FlashRate_DebounceLogic3 "SWC_APA/SWC_APA/Rear_Front_ParkAssist/RPA/FlashRate_DebounceLogic3" /begin REF_CHARACTERISTIC KeAP_cnt_DebounceTimeThd KeAP_cnt_TimeStep /end REF_CHARACTERISTIC /end GROUP
/begin GROUP S9_Pathplanner_AP "SWC_VC/FCA_AutoPark_VC/PathPlanner/Pathplanner_AP" /begin SUB_GROUP S49_PathPlanner1 /end SUB_GROUP /end GROUP
/begin GROUP S9_RPA_ChimeAlertGen "SWC_APA/SWC_APA/Rear_Front_ParkAssist/RPA/RPA_ChimeAlertGen"
 /begin SUB_GROUP S120_LeftChimeAlertGen S120_LtDebounceCounter S120_RightChimeAlertGen S120_RtDebounceCounter /end SUB_GROUP
/end GROUP
/begin GROUP S9_RPA_ChimeAlertUpdate "SWC_APA/SWC_APA/Rear_Front_ParkAssist/RPA/RPA_ChimeAlertUpdate" /begin REF_CHARACTERISTIC KeAP_cnt_ChimeVolChgAlert KeAP_cnt_TimeStep /end REF_CHARACTERISTIC /end GROUP
/begin GROUP S9_RPA_GraphicAlertGen "SWC_APA/SWC_APA/Rear_Front_ParkAssist/RPA/RPA_GraphicAlertGen"
 /begin SUB_GROUP S122_CenterGraphicAlertGen S122_LeftGraphicAlertGen S122_RightGraphicAlertGen /end SUB_GROUP
/end GROUP
/begin GROUP S9_VehicleControl "TRSC_VC/TRSC_VC2/Torque Control/VehicleControl" /begin SUB_GROUP S96_Controller_Main2 S96_Controller_T_h_init /end SUB_GROUP /end GROUP
/begin GROUP SWC_APA "SWC_APA" ROOT /begin SUB_GROUP Root_SWC_APA /end SUB_GROUP /end GROUP
/begin GROUP SWC_AP_StateMachine "SWC_AP_StateMachine" ROOT /begin SUB_GROUP Root_SWC_AP_StateMachine /end SUB_GROUP /end GROUP
/begin GROUP SWC_VC "SWC_VC" ROOT /begin SUB_GROUP Root_FCA_AutoPark_VC /end SUB_GROUP /end GROUP
/begin GROUP THA_SM_Ref "THA_SM_Ref" ROOT /begin SUB_GROUP Root_THA_SM_Controller Root_THA_SM_InputProcessing /end SUB_GROUP /end GROUP
/begin GROUP THA_SWC "THA_SWC" ROOT
 /begin REF_MEASUREMENT MeTHA_b_EnblRearParkAsstTrg MeTHA_b_THAAbortStatus MeTHA_b_TrlrCplrStatus MeTHA_e_RearBrkSupprInfo /end REF_MEASUREMENT
 /begin SUB_GROUP mr_grp2link_THA_SmVc_Ref /end SUB_GROUP
/end GROUP
/begin GROUP THA_SmVc_Ref "THA_SmVc_Ref" ROOT /begin SUB_GROUP Root_THA_SmVc_Enabled /end SUB_GROUP /end GROUP
/begin GROUP THA_VC_Ref "THA_VC_Ref" ROOT /begin SUB_GROUP Root_FCA_THA_VC /end SUB_GROUP /end GROUP
/begin GROUP TRSC_SM_VC "TRSC_SM_VC" ROOT
 /begin REF_MEASUREMENT MeTRSC_M_TRSCStrTrq MeTRSC_b_StrTwitchComplete MeTRSC_deg_JackknifeAngle MeTRSC_e_SpdLmtReq MeTRSC_e_TRSCStrTrqActvReq MeTRSC_pct_TRSCStrDmp /end REF_MEASUREMENT
 /begin SUB_GROUP mr_grp2link_TRSC_StateMachine mr_grp2link_TRSC_VC /end SUB_GROUP
/end GROUP
/begin GROUP TRSC_SM_VC_Int "TRSC_SM_VC_Int" ROOT
 /begin REF_MEASUREMENT IeTRSC_M_TRSCStrTrq IeTRSC_b_MoreCamReqSts IeTRSC_cnt_KnobPos IeTRSC_deg_FrntWhlAng IeTRSC_deg_JackknifeThrAngle IeTRSC_deg_TrlrAngKnob IeTRSC_e_GearShiftSts IeTRSC_e_SpdLmtReq IeTRSC_e_TRSCAbortReas IeTRSC_e_TRSCLedSts IeTRSC_e_TRSCPopupDispInfo IeTRSC_e_TRSCStrTrqActvReq IeTRSC_e_TRSCSts IeTRSC_e_TRSCUnavailReas IeTRSC_e_TRSKMBtnSts IeTRSC_e_TRSKMCenBtnSts IeTRSC_e_TRSKMSts IeTRSC_e_TrlrHitchLightCtrl IeTRSC_e_VehStpReq IeTRSC_kph_VehSpeedVSOSig IeTRSC_m_TrlrWhlBaseEff IeTRSC_pct_TRSCStrDmp MeTRSC_b_MoreCamSoftButtEnbl MeTRSC_b_TRSCSwitchPressed MeTRSC_b_TrlrRevSteeringStsInfo MeTRSC_e_TRSCStat /end REF_MEASUREMENT
 /begin SUB_GROUP IbTRSC_InpBus mr_grp2link_TRSC_InputAdapter mr_grp2link_TRSC_OutputAdapter mr_grp2link_TRSC_SM_VC /end SUB_GROUP
/end GROUP
/begin GROUP TRSC_StateMachine "TRSC_StateMachine" ROOT /begin SUB_GROUP Root_TRSC_StateLogic /end SUB_GROUP /end GROUP
/begin GROUP TRSC_VC "TRSC_VC" ROOT /begin SUB_GROUP Root_TRSC_VC2 /end SUB_GROUP /end GROUP
/end MODULE
/end PROJECT
