VERSION ""

NS_ :

BS_:

BU_: BCM BSM2 CADM2 CVADAS EPS ORC PAM SGW TRSKM

BO_ 2654339184 PDC_INFO_FD_SGW: 64 SGW
 SG_ CurrentCanNMState_FD01_SGW : 15|4@0+ (1,0) [0|15] ""  BSM2,CADM2,CVADAS,EPS,ORC,PAM,TRSKM
 SG_ CurrentCanNMState_FD02_SGW : 103|4@0+ (1,0) [0|15] ""  BSM2,CADM2,CVADAS,EPS,ORC,PAM,TRSKM
 SG_ CurrentCanNMState_FD03_SGW : 191|4@0+ (1,0) [0|15] ""  BSM2,CADM2,CVADAS,EPS,ORC,PAM,TRSKM
 SG_ CurrentCanNMState_FD08_SGW : 367|4@0+ (1,0) [0|15] ""  BSM2,CADM2,CVADAS,EPS,ORC,PAM,TRSKM
 SG_ CurrentCanNMState_FD11_SGW : 279|4@0+ (1,0) [0|15] ""  BSM2,CADM2,CVADAS,EPS,ORC,PAM,TRSKM
 SG_ CurrentFailSts_FD01_SGW : 6|1@0+ (1,0) [0|1] ""  BSM2,CADM2,CVADAS,EPS,ORC,PAM,TRSKM
 SG_ CurrentFailSts_FD02_SGW : 94|1@0+ (1,0) [0|1] ""  BSM2,CADM2,CVADAS,EPS,ORC,PAM,TRSKM
 SG_ CurrentFailSts_FD03_SGW : 182|1@0+ (1,0) [0|1] ""  BSM2,CADM2,CVADAS,EPS,ORC,PAM,TRSKM
 SG_ CurrentFailSts_FD08_SGW : 358|1@0+ (1,0) [0|1] ""  BSM2,CADM2,CVADAS,EPS,ORC,PAM,TRSKM
 SG_ CurrentFailSts_FD11_SGW : 270|1@0+ (1,0) [0|1] ""  BSM2,CADM2,CVADAS,EPS,ORC,PAM,TRSKM
 SG_ DES_FD01_SGW : 4|2@0+ (1,0) [0|3] ""  BSM2,CADM2,CVADAS,EPS,ORC,PAM,TRSKM
 SG_ DES_FD02_SGW : 92|2@0+ (1,0) [0|3] ""  BSM2,CADM2,CVADAS,EPS,ORC,PAM,TRSKM
 SG_ DES_FD03_SGW : 180|2@0+ (1,0) [0|3] ""  BSM2,CADM2,CVADAS,EPS,ORC,PAM,TRSKM
 SG_ DES_FD08_SGW : 356|2@0+ (1,0) [0|3] ""  BSM2,CADM2,CVADAS,EPS,ORC,PAM,TRSKM
 SG_ DES_FD11_SGW : 268|2@0+ (1,0) [0|3] ""  BSM2,CADM2,CVADAS,EPS,ORC,PAM,TRSKM
 SG_ EOL_FD01_SGW : 7|1@0+ (1,0) [0|1] "-"  BSM2,CADM2,CVADAS,EPS,ORC,PAM,TRSKM
 SG_ EOL_FD02_SGW : 95|1@0+ (1,0) [0|1] "-"  BSM2,CADM2,CVADAS,EPS,ORC,PAM,TRSKM
 SG_ EOL_FD03_SGW : 183|1@0+ (1,0) [0|1] "-"  BSM2,CADM2,CVADAS,EPS,ORC,PAM,TRSKM
 SG_ EOL_FD08_SGW : 359|1@0+ (1,0) [0|1] "-"  BSM2,CADM2,CVADAS,EPS,ORC,PAM,TRSKM
 SG_ EOL_FD11_SGW : 271|1@0+ (1,0) [0|1] "-"  BSM2,CADM2,CVADAS,EPS,ORC,PAM,TRSKM
 SG_ GenericFailSts_FD01_SGW : 5|1@0+ (1,0) [0|1] ""  BSM2,CADM2,CVADAS,EPS,ORC,PAM,TRSKM
 SG_ GenericFailSts_FD02_SGW : 93|1@0+ (1,0) [0|1] ""  BSM2,CADM2,CVADAS,EPS,ORC,PAM,TRSKM
 SG_ GenericFailSts_FD03_SGW : 181|1@0+ (1,0) [0|1] ""  BSM2,CADM2,CVADAS,EPS,ORC,PAM,TRSKM
 SG_ GenericFailSts_FD08_SGW : 357|1@0+ (1,0) [0|1] ""  BSM2,CADM2,CVADAS,EPS,ORC,PAM,TRSKM
 SG_ GenericFailSts_FD11_SGW : 269|1@0+ (1,0) [0|1] ""  BSM2,CADM2,CVADAS,EPS,ORC,PAM,TRSKM
 SG_ PreviousCanNMState_FD01_SGW : 11|4@0+ (1,0) [0|15] ""  BSM2,CADM2,CVADAS,EPS,ORC,PAM,TRSKM
 SG_ PreviousCanNMState_FD02_SGW : 99|4@0+ (1,0) [0|15] ""  BSM2,CADM2,CVADAS,EPS,ORC,PAM,TRSKM
 SG_ PreviousCanNMState_FD03_SGW : 187|4@0+ (1,0) [0|15] ""  BSM2,CADM2,CVADAS,EPS,ORC,PAM,TRSKM
 SG_ PreviousCanNMState_FD08_SGW : 363|4@0+ (1,0) [0|15] ""  BSM2,CADM2,CVADAS,EPS,ORC,PAM,TRSKM
 SG_ PreviousCanNMState_FD11_SGW : 275|4@0+ (1,0) [0|15] ""  BSM2,CADM2,CVADAS,EPS,ORC,PAM,TRSKM
 SG_ StayActiveSource_FD01_SGW : 31|64@0+ (1,0) [0|1.84467440737096E+019] ""  BSM2,CADM2,CVADAS,EPS,ORC,PAM,TRSKM
 SG_ StayActiveSource_FD02_SGW : 119|64@0+ (1,0) [0|1.84467440737096E+019] ""  BSM2,CADM2,CVADAS,EPS,ORC,PAM,TRSKM
 SG_ StayActiveSource_FD03_SGW : 207|64@0+ (1,0) [0|1.84467440737096E+019] ""  BSM2,CADM2,CVADAS,EPS,ORC,PAM,TRSKM
 SG_ StayActiveSource_FD08_SGW : 383|64@0+ (1,0) [0|1.84467440737096E+019] ""  BSM2,CADM2,CVADAS,EPS,ORC,PAM,TRSKM
 SG_ StayActiveSource_FD11_SGW : 295|64@0+ (1,0) [0|1.84467440737096E+019] ""  BSM2,CADM2,CVADAS,EPS,ORC,PAM,TRSKM
 SG_ WakeupSource_FD01_SGW : 23|8@0+ (1,0) [0|255] ""  BSM2,CADM2,CVADAS,EPS,ORC,PAM,TRSKM
 SG_ WakeupSource_FD02_SGW : 111|8@0+ (1,0) [0|255] ""  BSM2,CADM2,CVADAS,EPS,ORC,PAM,TRSKM
 SG_ WakeupSource_FD03_SGW : 199|8@0+ (1,0) [0|255] ""  BSM2,CADM2,CVADAS,EPS,ORC,PAM,TRSKM
 SG_ WakeupSource_FD08_SGW : 375|8@0+ (1,0) [0|255] ""  BSM2,CADM2,CVADAS,EPS,ORC,PAM,TRSKM
 SG_ WakeupSource_FD11_SGW : 287|8@0+ (1,0) [0|255] ""  BSM2,CADM2,CVADAS,EPS,ORC,PAM,TRSKM

BO_ 2654339101 PDC_INFO_FD_SLML: 12 BCM
 SG_ CurrentCanNMState_FD04_SLML : 15|4@0+ (1,0) [0|15] "" Vector__XXX
 SG_ CurrentFailSts_FD04_SLML : 6|1@0+ (1,0) [0|1] "" Vector__XXX
 SG_ DES_FD04_SLML : 4|2@0+ (1,0) [0|3] "" Vector__XXX
 SG_ EOL_FD04_SLML : 7|1@0+ (1,0) [0|1] "-" Vector__XXX
 SG_ GenericFailSts_FD04_SLML : 5|1@0+ (1,0) [0|1] "" Vector__XXX
 SG_ PreviousCanNMState_FD04_SLML : 11|4@0+ (1,0) [0|15] "" Vector__XXX
 SG_ StayActiveSource_FD04_SLML : 31|64@0+ (1,0) [0|1.84467440737096E+019] "" Vector__XXX
 SG_ WakeupSource_FD04_SLML : 23|8@0+ (1,0) [0|255] "" Vector__XXX

BO_ 2654339198 PDC_INFO_FD_SLMR: 12 BCM
 SG_ CurrentCanNMState_FD04_SLMR : 15|4@0+ (1,0) [0|15] "" Vector__XXX
 SG_ CurrentFailSts_FD04_SLMR : 6|1@0+ (1,0) [0|1] "" Vector__XXX
 SG_ DES_FD04_SLMR : 4|2@0+ (1,0) [0|3] "" Vector__XXX
 SG_ EOL_FD04_SLMR : 7|1@0+ (1,0) [0|1] "-" Vector__XXX
 SG_ GenericFailSts_FD04_SLMR : 5|1@0+ (1,0) [0|1] "" Vector__XXX
 SG_ PreviousCanNMState_FD04_SLMR : 11|4@0+ (1,0) [0|15] "" Vector__XXX
 SG_ StayActiveSource_FD04_SLMR : 31|64@0+ (1,0) [0|1.84467440737096E+019] "" Vector__XXX
 SG_ WakeupSource_FD04_SLMR : 23|8@0+ (1,0) [0|255] "" Vector__XXX

BO_ 2654339250 PDC_INFO_FD_SPAAK: 12 BCM
 SG_ CurrentCanNMState_FD01_SPAAK : 15|4@0+ (1,0) [0|15] "" Vector__XXX
 SG_ CurrentFailSts_FD01_SPAAK : 6|1@0+ (1,0) [0|1] "" Vector__XXX
 SG_ DES_FD01_SPAAK : 4|2@0+ (1,0) [0|3] "" Vector__XXX
 SG_ EOL_FD01_SPAAK : 7|1@0+ (1,0) [0|1] "-" Vector__XXX
 SG_ GenericFailSts_FD01_SPAAK : 5|1@0+ (1,0) [0|1] "" Vector__XXX
 SG_ PreviousCanNMState_FD01_SPAAK : 11|4@0+ (1,0) [0|15] "" Vector__XXX
 SG_ StayActiveSource_FD01_SPAAK : 31|64@0+ (1,0) [0|1.84467440737096E+019] "" Vector__XXX
 SG_ WakeupSource_FD01_SPAAK : 23|8@0+ (1,0) [0|255] "" Vector__XXX

BO_ 2654339107 PDC_INFO_FD_TBM: 12 SGW
 SG_ CurrentCanNMState_FD08_TBM : 15|4@0+ (1,0) [0|15] "" Vector__XXX
 SG_ CurrentFailSts_FD08_TBM : 6|1@0+ (1,0) [0|1] "" Vector__XXX
 SG_ DES_FD08_TBM : 4|2@0+ (1,0) [0|3] "" Vector__XXX
 SG_ EOL_FD08_TBM : 7|1@0+ (1,0) [0|1] "-" Vector__XXX
 SG_ GenericFailSts_FD08_TBM : 5|1@0+ (1,0) [0|1] "" Vector__XXX
 SG_ PreviousCanNMState_FD08_TBM : 11|4@0+ (1,0) [0|15] "" Vector__XXX
 SG_ StayActiveSource_FD08_TBM : 31|64@0+ (1,0) [0|1.84467440737096E+019] "" Vector__XXX
 SG_ WakeupSource_FD08_TBM : 23|8@0+ (1,0) [0|255] "" Vector__XXX

BO_ 2654339083 PDC_INFO_FD_TCM: 12 BCM
 SG_ CurrentCanNMState_FD03_TCM : 15|4@0+ (1,0) [0|15] "" Vector__XXX
 SG_ CurrentFailSts_FD03_TCM : 6|1@0+ (1,0) [0|1] "" Vector__XXX
 SG_ DES_FD03_TCM : 4|2@0+ (1,0) [0|3] "" Vector__XXX
 SG_ EOL_FD03_TCM : 7|1@0+ (1,0) [0|1] "-" Vector__XXX
 SG_ GenericFailSts_FD03_TCM : 5|1@0+ (1,0) [0|1] "" Vector__XXX
 SG_ PreviousCanNMState_FD03_TCM : 11|4@0+ (1,0) [0|15] "" Vector__XXX
 SG_ StayActiveSource_FD03_TCM : 31|64@0+ (1,0) [0|1.84467440737096E+019] "" Vector__XXX
 SG_ WakeupSource_FD03_TCM : 23|8@0+ (1,0) [0|255] "" Vector__XXX

BO_ 2654339249 PDC_INFO_FD_TRLR_REV: 12 TRSKM
 SG_ CurrentCanNMState_FD02_TRLR_REV : 15|4@0+ (1,0) [0|15] ""  BCM,BSM2,CADM2,CVADAS,EPS,ORC,PAM,SGW
 SG_ CurrentFailSts_FD02_TRLR_REV : 6|1@0+ (1,0) [0|1] ""  BCM,BSM2,CADM2,CVADAS,EPS,ORC,PAM,SGW
 SG_ DES_FD02_TRLR_REV : 4|2@0+ (1,0) [0|3] ""  BCM,BSM2,CADM2,CVADAS,EPS,ORC,PAM,SGW
 SG_ EOL_FD02_TRLR_REV : 7|1@0+ (1,0) [0|1] "-"  BCM,BSM2,CADM2,CVADAS,EPS,ORC,PAM,SGW
 SG_ GenericFailSts_FD02_TRLR_REV : 5|1@0+ (1,0) [0|1] ""  BCM,BSM2,CADM2,CVADAS,EPS,ORC,PAM,SGW
 SG_ PreviousCanNMState_FD02_TRLR_REV : 11|4@0+ (1,0) [0|15] ""  BCM,BSM2,CADM2,CVADAS,EPS,ORC,PAM,SGW
 SG_ StayActiveSource_FD02_TRLR_REV : 31|64@0+ (1,0) [0|1.84467440737096E+019] ""  BCM,BSM2,CADM2,CVADAS,EPS,ORC,PAM,SGW
 SG_ WakeupSource_FD02_TRLR_REV : 23|8@0+ (1,0) [0|255] ""  BCM,BSM2,CADM2,CVADAS,EPS,ORC,PAM,SGW

BO_ 2654339258 PDC_INFO_FD_UWBS1: 12 BCM
 SG_ CurrentCanNMState_FD13_UWBS1 : 15|4@0+ (1,0) [0|15] "" Vector__XXX
 SG_ CurrentFailSts_FD13_UWBS1 : 6|1@0+ (1,0) [0|1] "" Vector__XXX
 SG_ DES_FD13_UWBS1 : 4|2@0+ (1,0) [0|3] "" Vector__XXX
 SG_ EOL_FD13_UWBS1 : 7|1@0+ (1,0) [0|1] "-" Vector__XXX
 SG_ GenericFailSts_FD13_UWBS1 : 5|1@0+ (1,0) [0|1] "" Vector__XXX
 SG_ PreviousCanNMState_FD13_UWBS1 : 11|4@0+ (1,0) [0|15] "" Vector__XXX
 SG_ StayActiveSource_FD13_UWBS1 : 31|64@0+ (1,0) [0|1.84467440737096E+019] "" Vector__XXX
 SG_ WakeupSource_FD13_UWBS1 : 23|8@0+ (1,0) [0|255] "" Vector__XXX

BO_ 2654339259 PDC_INFO_FD_UWBS2: 12 BCM
 SG_ CurrentCanNMState_FD13_UWBS2 : 15|4@0+ (1,0) [0|15] "" Vector__XXX
 SG_ CurrentFailSts_FD13_UWBS2 : 6|1@0+ (1,0) [0|1] "" Vector__XXX
 SG_ DES_FD13_UWBS2 : 4|2@0+ (1,0) [0|3] "" Vector__XXX
 SG_ EOL_FD13_UWBS2 : 7|1@0+ (1,0) [0|1] "-" Vector__XXX
 SG_ GenericFailSts_FD13_UWBS2 : 5|1@0+ (1,0) [0|1] "" Vector__XXX
 SG_ PreviousCanNMState_FD13_UWBS2 : 11|4@0+ (1,0) [0|15] "" Vector__XXX
 SG_ StayActiveSource_FD13_UWBS2 : 31|64@0+ (1,0) [0|1.84467440737096E+019] "" Vector__XXX
 SG_ WakeupSource_FD13_UWBS2 : 23|8@0+ (1,0) [0|255] "" Vector__XXX

BO_ 2654339260 PDC_INFO_FD_UWBS3: 12 BCM
 SG_ CurrentCanNMState_FD13_UWBS3 : 15|4@0+ (1,0) [0|15] "" Vector__XXX
 SG_ CurrentFailSts_FD13_UWBS3 : 6|1@0+ (1,0) [0|1] "" Vector__XXX
 SG_ DES_FD13_UWBS3 : 4|2@0+ (1,0) [0|3] "" Vector__XXX
 SG_ EOL_FD13_UWBS3 : 7|1@0+ (1,0) [0|1] "-" Vector__XXX
 SG_ GenericFailSts_FD13_UWBS3 : 5|1@0+ (1,0) [0|1] "" Vector__XXX
 SG_ PreviousCanNMState_FD13_UWBS3 : 11|4@0+ (1,0) [0|15] "" Vector__XXX
 SG_ StayActiveSource_FD13_UWBS3 : 31|64@0+ (1,0) [0|1.84467440737096E+019] "" Vector__XXX
 SG_ WakeupSource_FD13_UWBS3 : 23|8@0+ (1,0) [0|255] "" Vector__XXX

BO_ 2654339261 PDC_INFO_FD_UWBS4: 12 BCM
 SG_ CurrentCanNMState_FD13_UWBS4 : 15|4@0+ (1,0) [0|15] "" Vector__XXX
 SG_ CurrentFailSts_FD13_UWBS4 : 6|1@0+ (1,0) [0|1] "" Vector__XXX
 SG_ DES_FD13_UWBS4 : 4|2@0+ (1,0) [0|3] "" Vector__XXX
 SG_ EOL_FD13_UWBS4 : 7|1@0+ (1,0) [0|1] "-" Vector__XXX
 SG_ GenericFailSts_FD13_UWBS4 : 5|1@0+ (1,0) [0|1] "" Vector__XXX
 SG_ PreviousCanNMState_FD13_UWBS4 : 11|4@0+ (1,0) [0|15] "" Vector__XXX
 SG_ StayActiveSource_FD13_UWBS4 : 31|64@0+ (1,0) [0|1.84467440737096E+019] "" Vector__XXX
 SG_ WakeupSource_FD13_UWBS4 : 23|8@0+ (1,0) [0|255] "" Vector__XXX

BO_ 2654339262 PDC_INFO_FD_UWBS5: 12 BCM
 SG_ CurrentCanNMState_FD13_UWBS5 : 15|4@0+ (1,0) [0|15] "" Vector__XXX
 SG_ CurrentFailSts_FD13_UWBS5 : 6|1@0+ (1,0) [0|1] "" Vector__XXX
 SG_ DES_FD13_UWBS5 : 4|2@0+ (1,0) [0|3] "" Vector__XXX
 SG_ EOL_FD13_UWBS5 : 7|1@0+ (1,0) [0|1] "-" Vector__XXX
 SG_ GenericFailSts_FD13_UWBS5 : 5|1@0+ (1,0) [0|1] "" Vector__XXX
 SG_ PreviousCanNMState_FD13_UWBS5 : 11|4@0+ (1,0) [0|15] "" Vector__XXX
 SG_ StayActiveSource_FD13_UWBS5 : 31|64@0+ (1,0) [0|1.84467440737096E+019] "" Vector__XXX
 SG_ WakeupSource_FD13_UWBS5 : 23|8@0+ (1,0) [0|255] "" Vector__XXX

BO_ 2654339199 PDC_INFO_FD_VRM: 12 SGW
 SG_ CurrentCanNMState_FD08_VRM : 15|4@0+ (1,0) [0|15] "" Vector__XXX
 SG_ CurrentFailSts_FD08_VRM : 6|1@0+ (1,0) [0|1] "" Vector__XXX
 SG_ DES_FD08_VRM : 4|2@0+ (1,0) [0|3] "" Vector__XXX
 SG_ EOL_FD08_VRM : 7|1@0+ (1,0) [0|1] "-" Vector__XXX
 SG_ GenericFailSts_FD08_VRM : 5|1@0+ (1,0) [0|1] "" Vector__XXX
 SG_ PreviousCanNMState_FD08_VRM : 11|4@0+ (1,0) [0|15] "" Vector__XXX
 SG_ StayActiveSource_FD08_VRM : 31|64@0+ (1,0) [0|1.84467440737096E+019] "" Vector__XXX
 SG_ WakeupSource_FD08_VRM : 23|8@0+ (1,0) [0|255] "" Vector__XXX

BO_ 2654339257 PDC_INFO_FD_WCPM2: 12 BCM
 SG_ CurrentCanNMState_FD09_WCPM2 : 15|4@0+ (1,0) [0|15] "" Vector__XXX
 SG_ CurrentFailSts_FD09_WCPM2 : 6|1@0+ (1,0) [0|1] "" Vector__XXX
 SG_ DES_FD09_WCPM2 : 4|2@0+ (1,0) [0|3] "" Vector__XXX
 SG_ EOL_FD09_WCPM2 : 7|1@0+ (1,0) [0|1] "-" Vector__XXX
 SG_ GenericFailSts_FD09_WCPM2 : 5|1@0+ (1,0) [0|1] "" Vector__XXX
 SG_ PreviousCanNMState_FD09_WCPM2 : 11|4@0+ (1,0) [0|15] "" Vector__XXX
 SG_ StayActiveSource_FD09_WCPM2 : 31|64@0+ (1,0) [0|1.84467440737096E+019] "" Vector__XXX
 SG_ WakeupSource_FD09_WCPM2 : 23|8@0+ (1,0) [0|255] "" Vector__XXX

BO_ 255 PT_TORQUE_FD_1: 48 BCM
 SG_ ACC_NCC_TrqEnblRq_Allowed : 23|1@0+ (1,0) [0|1] "-"  ORC
 SG_ Accel_Pedal_Override : 37|1@0+ (1,0) [0|1] "-"  BSM2,CADM2
 SG_ SumTorque_DrvReqMod : 20|13@0+ (0.25,-500) [-500|1547.5] "Nm"  ORC
 SG_ Total_AxleTorque_Static : 151|16@0+ (2,-65534) [-65534|65536] "Nm"  ORC

BO_ 1876 RFHUB_FD_3: 32 BCM
 SG_ InflationState_LHF_Tyre : 83|3@0+ (1,0) [0|4] "-"  ORC
 SG_ InflationState_LHR_Tyre : 92|3@0+ (1,0) [0|4] "-"  ORC
 SG_ InflationState_RHF_Tyre : 86|3@0+ (1,0) [0|4] "-"  ORC
 SG_ InflationState_RHR_Tyre : 95|3@0+ (1,0) [0|4] "-"  ORC
 SG_ PressureValue_LHF_Tyre : 119|8@0+ (0.03529,0) [0|8.96366] "bar"  ORC
 SG_ PressureValue_LHR_Tyre : 135|8@0+ (0.03529,0) [0|8.96366] "bar"  ORC
 SG_ PressureValue_RHF_Tyre : 111|8@0+ (0.03529,0) [0|8.96366] "bar"  ORC
 SG_ PressureValue_RHR_Tyre : 127|8@0+ (0.03529,0) [0|8.96366] "bar"  ORC
 SG_ TyrePressureSystemFailSts : 88|1@0+ (1,0) [0|1] "-"  ORC

BO_ 151 SWSM_1: 32 BCM
 SG_ CRC_SWSM_1 : 63|8@0+ (1,0) [0|255] "-"  CADM2
 SG_ ERR_ST_HOD : 43|4@0+ (1,0) [0|14] "-"  CADM2
 SG_ HOFF_RCOG_SEN : 51|4@0+ (1,0) [0|14] "-"  CADM2,ORC
 SG_ MC_SWSM_1 : 55|4@0+ (1,0) [0|15] "-"  CADM2

BO_ 1585 TBM_FD_2: 32 SGW
 SG_ WiFi_Client_Mode_Confirm : 13|2@0+ (1,0) [0|3] "-"  CADM2

BO_ 1452 TBM_SCHEDULE_FD_2: 32 SGW
 SG_ LTESts : 147|3@0+ (1,0) [0|7] "-"  CADM2
 SG_ NetConnection : 163|2@0+ (1,0) [0|3] "-"  CADM2
 SG_ PrivacyMode : 134|1@0+ (1,0) [0|1] "-"  CADM2
 SG_ SignalStrength : 159|3@0+ (1,0) [0|7] "-"  CADM2
 SG_ WiFiSts : 154|2@0+ (1,0) [0|3] "-"  CADM2

BO_ 156 TELEMATIC_FD_1: 32 SGW
 SG_ GPS_Date_Day : 63|8@0+ (1,0) [1|31] "Days"  ORC
 SG_ GPS_Date_Month : 71|8@0+ (1,0) [1|12] "Months"  ORC
 SG_ GPS_Date_Year : 167|16@0+ (1,0) [0|65534] "Years"  ORC
 SG_ GPS_UTC_Hour : 55|8@0+ (1,0) [0|23] "h"  ORC
 SG_ GPS_UTC_Minute : 47|8@0+ (1,0) [0|59] "min"  ORC
 SG_ GPS_UTC_Second : 151|16@0+ (0.01,0) [0|59.99] "s"  ORC

BO_ 608 TELEMATIC_FD_11: 32 SGW
 SG_ CRC_Telematic11 : 191|8@0+ (1,0) [0|255] "-"  CVADAS
 SG_ HU_TRSC_EnableBtn_Sts : 43|2@0+ (1,0) [0|1] "-"  CVADAS
 SG_ MessageCounter_Telematic11 : 179|4@0+ (1,0) [0|15] "-"  CVADAS

BO_ 1465 TELEMATIC_FD_14: 32 SGW
 SG_ CRC_Telematic14 : 191|8@0+ (1,0) [0|255] "-"  CVADAS
 SG_ MessageCounter_Telematic14 : 179|4@0+ (1,0) [0|15] "-"  CVADAS
 SG_ TGW_CAMERA_DISP_STAT : 91|4@0+ (1,0) [0|14] "-"  CVADAS

BO_ 1428 TELEMATIC_FD_5: 32 SGW
 SG_ CameraDisplaySts2 : 183|4@0+ (1,0) [0|15] ""  CVADAS
 SG_ CM_TCH_STAT : 74|3@0+ (1,0) [0|6] ""  CVADAS
 SG_ CM_TCH_X_COORD : 143|16@0+ (1,0) [0|65535] ""  CVADAS
 SG_ CM_TCH_Y_COORD : 159|16@0+ (1,0) [0|65535] ""  CVADAS
 SG_ CRC_Telematic5 : 191|8@0+ (1,0) [0|255] "-"  CVADAS
 SG_ MessageCounter_Telematic5 : 179|4@0+ (1,0) [0|15] "-"  CVADAS

BO_ 278 TRANSM_FD_1: 64 BCM
 SG_ CRC_TRANSM1 : 447|8@0+ (1,0) [0|255] "-"  CADM2,CVADAS
 SG_ MessageCounter_TRANSM1 : 435|4@0+ (1,0) [0|15] "-"  CADM2,CVADAS
 SG_ TargetGear : 151|4@0+ (1,0) [0|15] "-"  CADM2,CVADAS,EPS,PAM
 SG_ TRANS_ADAS_Inhibit : 311|1@0+ (1,0) [0|1] "-"  CVADAS
 SG_ TransmissionSailingSts : 119|4@0+ (1,0) [0|15] "-"  CADM2,CVADAS,ORC,PAM

BO_ 520 TRANSM_FD_2: 32 BCM
 SG_ CRC_TRANSM2 : 191|8@0+ (1,0) [0|255] "-"  CADM2,CVADAS
 SG_ GearEngagedForDisplay : 15|5@0+ (1,0) [0|30] "-"  CADM2,CVADAS,EPS,ORC
 SG_ MessageCounter_TRANSM2 : 179|4@0+ (1,0) [0|15] "-"  CADM2,CVADAS
 SG_ TransReadyForESS : 124|1@0+ (1,0) [0|1] "-"  ORC

BO_ 1450 TRANSM_FD_4: 32 BCM
 SG_ CRC_TRANSM4 : 191|8@0+ (1,0) [0|255] "-"  CVADAS,BSM2,CADM2,EPS,ORC
 SG_ DriveModeSts : 83|4@0+ (1,0) [0|15] "-"  ORC
 SG_ GearDisplayForCluster : 75|4@0+ (1,0) [0|14] ""  CADM2
 SG_ GearEngaged : 107|4@0+ (1,0) [0|15] "-"  BSM2,CADM2,CVADAS,EPS,ORC
 SG_ HAS_SoH_TCM : 117|1@0+ (1,0) [0|1] "-"  CADM2
 SG_ LimpHomeSts : 112|1@0+ (1,0) [0|1] "-"  ORC
 SG_ MessageCounter_TRANSM4 : 179|4@0+ (1,0) [0|15] "-"  CVADAS,BSM2,CADM2,EPS,ORC
 SG_ ShiftLeverPosition : 111|4@0+ (1,0) [0|15] "-"  CVADAS,EPS,ORC
 SG_ TransmissionFailSts : 87|1@0+ (1,0) [0|1] "-"  ORC
 SG_ TransmissionWarnings : 93|6@0+ (1,0) [0|63] "-"  ORC

BO_ 1472 TRSCM_FD_1: 32 CVADAS
 SG_ CRC_TRSCM1 : 191|8@0+ (1,0) [0|255] "-"  BCM,EPS
 SG_ MessageCounter_TRSCM1 : 179|4@0+ (1,0) [0|15] "-"  BCM,EPS
 SG_ THA_EPB_Req : 95|2@0+ (1,0) [0|3] ""  BCM
 SG_ THA_Speed_Limit : 85|5@0+ (1,0) [0|31] ""  BCM,EPS
 SG_ THA_SpeedLimit_Req : 52|2@0+ (1,0) [0|3] ""  BCM
 SG_ THA_STAT : 55|3@0+ (1,0) [0|6] ""  BCM,EPS,SGW
 SG_ THA_SteeringDamping : 79|8@0+ (0.78125,0) [0|199.21875] "%"  EPS
 SG_ THA_SteeringTorqueInfo : 63|11@0+ (0.0078125,-8) [-8|7.9921875] ""  EPS
 SG_ THA_SteeringTorqueReq : 87|2@0+ (1,0) [0|3] ""  EPS
 SG_ Trailer_Angle : 47|8@0+ (1,0) [0|255] "degrees"  SGW
 SG_ Trailer_Angle_Sign : 33|2@0+ (1,0) [0|3] ""  SGW
 SG_ Trailer_Calibration : 50|2@0+ (1,0) [0|2] ""  SGW
 SG_ TrlrHitchLight_Cntrl : 93|2@0+ (1,0) [0|2] ""  BCM
 SG_ TRSC_PopupDisp_Info : 3|4@0+ (1,0) [0|14] ""  BCM
 SG_ TRSC_SpeedLimit_Req : 15|4@0+ (1,0) [0|14] ""  BCM
 SG_ TRSC_STAT : 7|3@0+ (1,0) [0|6] ""  BCM,SGW
 SG_ TRSC_SteeringDamping : 23|8@0+ (0.78125,0) [0|199.21875] "%"  EPS
 SG_ TRSC_SteeringTorqueInfo : 31|11@0+ (0.0078125,-8) [-8|7.9921875] ""  EPS,SGW
 SG_ TRSC_SteeringTorqueReq : 11|2@0+ (1,0) [0|2] ""  EPS
 SG_ TRSC_VehicleStop_Req : 36|2@0+ (1,0) [0|2] ""  BCM
 SG_ TRSCMoreCamRQSts : 4|1@0+ (1,0) [0|1] ""  BCM,SGW

BO_ 1476 TRSKM_FD_1: 32 TRSKM
 SG_ CRC_TRSKM_FD_1 : 191|8@0+ (1,0) [0|255] "-"  CVADAS
 SG_ MessageCounter_TRSKM_FD_1 : 179|4@0+ (1,0) [0|15] "-"  CVADAS
 SG_ TRSC_CenterBtn_Sts : 13|2@0+ (1,0) [0|2] ""  CVADAS
 SG_ TRSC_EnableBtn_Sts : 15|2@0+ (1,0) [0|2] ""  CVADAS
 SG_ TRSC_RawKnob : 8|9@0+ (1,0) [0|511] ""  CVADAS

BO_ 1053 VIN: 32 BCM
 SG_ VIN_DATA : 87|56@0+ (1,0) [0|7.20575940379279E+016] ""  BSM2,CADM2,CVADAS,EPS,ORC,PAM,TRSKM
 SG_ VIN_MSG : 75|2@0+ (1,0) [0|3] ""  BSM2,CADM2,CVADAS,EPS,ORC,PAM,TRSKM

CM_ SG_ 2654339184 CurrentCanNMState_FD01_SGW "Indicates that CanNM state the ECU is currently executing";
CM_ SG_ 2654339184 CurrentCanNMState_FD02_SGW "Indicates that CanNM state the ECU is currently executing";
CM_ SG_ 2654339184 CurrentCanNMState_FD03_SGW "Indicates that CanNM state the ECU is currently executing";
CM_ SG_ 2654339184 CurrentCanNMState_FD08_SGW "Indicates that CanNM state the ECU is currently executing";
CM_ SG_ 2654339184 CurrentCanNMState_FD11_SGW "Indicates that CanNM state the ECU is currently executing";
CM_ SG_ 2654339184 CurrentFailSts_FD01_SGW "Indicates the presence/absence of at least one DTC with DTCStatus = present in the System Memory";
CM_ SG_ 2654339184 CurrentFailSts_FD02_SGW "Indicates the presence/absence of at least one DTC with DTCStatus = present in the System Memory";
CM_ SG_ 2654339184 CurrentFailSts_FD03_SGW "Indicates the presence/absence of at least one DTC with DTCStatus = present in the System Memory";
CM_ SG_ 2654339184 CurrentFailSts_FD08_SGW "Indicates the presence/absence of at least one DTC with DTCStatus = present in the System Memory";
CM_ SG_ 2654339184 CurrentFailSts_FD11_SGW "Indicates the presence/absence of at least one DTC with DTCStatus = present in the System Memory";
CM_ SG_ 2654339184 DES_FD01_SGW "Indicates whether the ECU?s CAN cell is in either ErrorActive, or ErrorPassive state OR has just now recovered from a BusOff condition";
CM_ SG_ 2654339184 DES_FD02_SGW "Indicates whether the ECU?s CAN cell is in either ErrorActive, or ErrorPassive state OR has just now recovered from a BusOff condition";
CM_ SG_ 2654339184 DES_FD03_SGW "Indicates whether the ECU?s CAN cell is in either ErrorActive, or ErrorPassive state OR has just now recovered from a BusOff condition";
CM_ SG_ 2654339184 DES_FD08_SGW "Indicates whether the ECU?s CAN cell is in either ErrorActive, or ErrorPassive state OR has just now recovered from a BusOff condition";
CM_ SG_ 2654339184 DES_FD11_SGW "Indicates whether the ECU?s CAN cell is in either ErrorActive, or ErrorPassive state OR has just now recovered from a BusOff condition";
CM_ SG_ 2654339184 EOL_FD01_SGW "Indicates if the ECU requires configuration data at the assembly plant End Of Line";
CM_ SG_ 2654339184 EOL_FD02_SGW "Indicates if the ECU requires configuration data at the assembly plant End Of Line";
CM_ SG_ 2654339184 EOL_FD03_SGW "Indicates if the ECU requires configuration data at the assembly plant End Of Line";
CM_ SG_ 2654339184 EOL_FD08_SGW "Indicates if the ECU requires configuration data at the assembly plant End Of Line";
CM_ SG_ 2654339184 EOL_FD11_SGW "Indicates if the ECU requires configuration data at the assembly plant End Of Line";
CM_ SG_ 2654339184 GenericFailSts_FD01_SGW "Indicates the presence/absent of at least one DTC in the System Memory";
CM_ SG_ 2654339184 GenericFailSts_FD02_SGW "Indicates the presence/absent of at least one DTC in the System Memory";
CM_ SG_ 2654339184 GenericFailSts_FD03_SGW "Indicates the presence/absent of at least one DTC in the System Memory";
CM_ SG_ 2654339184 GenericFailSts_FD08_SGW "Indicates the presence/absent of at least one DTC in the System Memory";
CM_ SG_ 2654339184 GenericFailSts_FD11_SGW "Indicates the presence/absent of at least one DTC in the System Memory";
CM_ SG_ 2654339184 PreviousCanNMState_FD01_SGW "Indicates the last CanNM state that the ECU existed in";
CM_ SG_ 2654339184 PreviousCanNMState_FD02_SGW "Indicates the last CanNM state that the ECU existed in";
CM_ SG_ 2654339184 PreviousCanNMState_FD03_SGW "Indicates the last CanNM state that the ECU existed in";
CM_ SG_ 2654339184 PreviousCanNMState_FD08_SGW "Indicates the last CanNM state that the ECU existed in";
CM_ SG_ 2654339184 PreviousCanNMState_FD11_SGW "Indicates the last CanNM state that the ECU existed in";
CM_ SG_ 2654339184 StayActiveSource_FD01_SGW "Indicates the source that requests the ECU to stay active";
CM_ SG_ 2654339184 StayActiveSource_FD02_SGW "Indicates the source that requests the ECU to stay active";
CM_ SG_ 2654339184 StayActiveSource_FD03_SGW "Indicates the source that requests the ECU to stay active";
CM_ SG_ 2654339184 StayActiveSource_FD08_SGW "Indicates the source that requests the ECU to stay active";
CM_ SG_ 2654339184 StayActiveSource_FD11_SGW "Indicates the source that requests the ECU to stay active";
CM_ SG_ 2654339184 WakeupSource_FD01_SGW "Indicates the reason the ECU was most recently awakened";
CM_ SG_ 2654339184 WakeupSource_FD02_SGW "Indicates the reason the ECU was most recently awakened";
CM_ SG_ 2654339184 WakeupSource_FD03_SGW "Indicates the reason the ECU was most recently awakened";
CM_ SG_ 2654339184 WakeupSource_FD08_SGW "Indicates the reason the ECU was most recently awakened";
CM_ SG_ 2654339184 WakeupSource_FD11_SGW "Indicates the reason the ECU was most recently awakened";
CM_ SG_ 2654339101 CurrentCanNMState_FD04_SLML "Indicates that CanNM state the ECU is currently executing";
CM_ SG_ 2654339101 CurrentFailSts_FD04_SLML "Indicates the presence/absence of at least one DTC with DTCStatus = present in the System Memory";
CM_ SG_ 2654339101 DES_FD04_SLML "Indicates whether the ECU?s CAN cell is in either ErrorActive, or ErrorPassive state OR has just now recovered from a BusOff condition";
CM_ SG_ 2654339101 EOL_FD04_SLML "Indicates if the ECU requires configuration data at the assembly plant End Of Line";
CM_ SG_ 2654339101 GenericFailSts_FD04_SLML "Indicates the presence/absent of at least one DTC in the System Memory";
CM_ SG_ 2654339101 PreviousCanNMState_FD04_SLML "Indicates the last CanNM state that the ECU existed in";
CM_ SG_ 2654339101 StayActiveSource_FD04_SLML "Indicates the source that requests the ECU to stay active";
CM_ SG_ 2654339101 WakeupSource_FD04_SLML "Indicates the reason the ECU was most recently awakened";
CM_ SG_ 2654339198 CurrentCanNMState_FD04_SLMR "Indicates that CanNM state the ECU is currently executing";
CM_ SG_ 2654339198 CurrentFailSts_FD04_SLMR "Indicates the presence/absence of at least one DTC with DTCStatus = present in the System Memory";
CM_ SG_ 2654339198 DES_FD04_SLMR "Indicates whether the ECU?s CAN cell is in either ErrorActive, or ErrorPassive state OR has just now recovered from a BusOff condition";
CM_ SG_ 2654339198 EOL_FD04_SLMR "Indicates if the ECU requires configuration data at the assembly plant End Of Line";
CM_ SG_ 2654339198 GenericFailSts_FD04_SLMR "Indicates the presence/absent of at least one DTC in the System Memory";
CM_ SG_ 2654339198 PreviousCanNMState_FD04_SLMR "Indicates the last CanNM state that the ECU existed in";
CM_ SG_ 2654339198 StayActiveSource_FD04_SLMR "Indicates the source that requests the ECU to stay active";
CM_ SG_ 2654339198 WakeupSource_FD04_SLMR "Indicates the reason the ECU was most recently awakened";
CM_ SG_ 2654339250 CurrentCanNMState_FD01_SPAAK "Indicates that CanNM state the ECU is currently executing";
CM_ SG_ 2654339250 CurrentFailSts_FD01_SPAAK "Indicates the presence/absence of at least one DTC with DTCStatus = present in the System Memory";
CM_ SG_ 2654339250 DES_FD01_SPAAK "Indicates whether the ECU?s CAN cell is in either ErrorActive, or ErrorPassive state OR has just now recovered from a BusOff condition";
CM_ SG_ 2654339250 EOL_FD01_SPAAK "Indicates if the ECU requires configuration data at the assembly plant End Of Line";
CM_ SG_ 2654339250 GenericFailSts_FD01_SPAAK "Indicates the presence/absent of at least one DTC in the System Memory";
CM_ SG_ 2654339250 PreviousCanNMState_FD01_SPAAK "Indicates the last CanNM state that the ECU existed in";
CM_ SG_ 2654339250 StayActiveSource_FD01_SPAAK "Indicates the source that requests the ECU to stay active";
CM_ SG_ 2654339250 WakeupSource_FD01_SPAAK "Indicates the reason the ECU was most recently awakened";
CM_ SG_ 2654339107 CurrentCanNMState_FD08_TBM "Indicates that CanNM state the ECU is currently executing";
CM_ SG_ 2654339107 CurrentFailSts_FD08_TBM "Indicates the presence/absence of at least one DTC with DTCStatus = present in the System Memory";
CM_ SG_ 2654339107 DES_FD08_TBM "Indicates whether the ECU?s CAN cell is in either ErrorActive, or ErrorPassive state OR has just now recovered from a BusOff condition";
CM_ SG_ 2654339107 EOL_FD08_TBM "Indicates if the ECU requires configuration data at the assembly plant End Of Line";
CM_ SG_ 2654339107 GenericFailSts_FD08_TBM "Indicates the presence/absent of at least one DTC in the System Memory";
CM_ SG_ 2654339107 PreviousCanNMState_FD08_TBM "Indicates the last CanNM state that the ECU existed in";
CM_ SG_ 2654339107 StayActiveSource_FD08_TBM "Indicates the source that requests the ECU to stay active";
CM_ SG_ 2654339107 WakeupSource_FD08_TBM "Indicates the reason the ECU was most recently awakened";
CM_ SG_ 2654339083 CurrentCanNMState_FD03_TCM "Indicates that CanNM state the ECU is currently executing";
CM_ SG_ 2654339083 CurrentFailSts_FD03_TCM "Indicates the presence/absence of at least one DTC with DTCStatus = present in the System Memory";
CM_ SG_ 2654339083 DES_FD03_TCM "Indicates whether the ECU?s CAN cell is in either ErrorActive, or ErrorPassive state OR has just now recovered from a BusOff condition";
CM_ SG_ 2654339083 EOL_FD03_TCM "Indicates if the ECU requires configuration data at the assembly plant End Of Line";
CM_ SG_ 2654339083 GenericFailSts_FD03_TCM "Indicates the presence/absent of at least one DTC in the System Memory";
CM_ SG_ 2654339083 PreviousCanNMState_FD03_TCM "Indicates the last CanNM state that the ECU existed in";
CM_ SG_ 2654339083 StayActiveSource_FD03_TCM "Indicates the source that requests the ECU to stay active";
CM_ SG_ 2654339083 WakeupSource_FD03_TCM "Indicates the reason the ECU was most recently awakened";
CM_ SG_ 2654339249 CurrentCanNMState_FD02_TRLR_REV "Indicates that CanNM state the ECU is currently executing";
CM_ SG_ 2654339249 CurrentFailSts_FD02_TRLR_REV "Indicates the presence/absence of at least one DTC with DTCStatus = present in the System Memory";
CM_ SG_ 2654339249 DES_FD02_TRLR_REV "Indicates whether the ECU?s CAN cell is in either ErrorActive, or ErrorPassive state OR has just now recovered from a BusOff condition";
CM_ SG_ 2654339249 EOL_FD02_TRLR_REV "Indicates if the ECU requires configuration data at the assembly plant End Of Line";
CM_ SG_ 2654339249 GenericFailSts_FD02_TRLR_REV "Indicates the presence/absent of at least one DTC in the System Memory";
CM_ SG_ 2654339249 PreviousCanNMState_FD02_TRLR_REV "Indicates the last CanNM state that the ECU existed in";
CM_ SG_ 2654339249 StayActiveSource_FD02_TRLR_REV "Indicates the source that requests the ECU to stay active";
CM_ SG_ 2654339249 WakeupSource_FD02_TRLR_REV "Indicates the reason the ECU was most recently awakened";
CM_ SG_ 2654339258 CurrentCanNMState_FD13_UWBS1 "Indicates that CanNM state the ECU is currently executing";
CM_ SG_ 2654339258 CurrentFailSts_FD13_UWBS1 "Indicates the presence/absence of at least one DTC with DTCStatus = present in the System Memory";
CM_ SG_ 2654339258 DES_FD13_UWBS1 "Indicates whether the ECU?s CAN cell is in either ErrorActive, or ErrorPassive state OR has just now recovered from a BusOff condition";
CM_ SG_ 2654339258 EOL_FD13_UWBS1 "Indicates if the ECU requires configuration data at the assembly plant End Of Line";
CM_ SG_ 2654339258 GenericFailSts_FD13_UWBS1 "Indicates the presence/absent of at least one DTC in the System Memory";
CM_ SG_ 2654339258 PreviousCanNMState_FD13_UWBS1 "Indicates the last CanNM state that the ECU existed in";
CM_ SG_ 2654339258 StayActiveSource_FD13_UWBS1 "Indicates the source that requests the ECU to stay active";
CM_ SG_ 2654339258 WakeupSource_FD13_UWBS1 "Indicates the reason the ECU was most recently awakened";
CM_ SG_ 2654339259 CurrentCanNMState_FD13_UWBS2 "Indicates that CanNM state the ECU is currently executing";
CM_ SG_ 2654339259 CurrentFailSts_FD13_UWBS2 "Indicates the presence/absence of at least one DTC with DTCStatus = present in the System Memory";
CM_ SG_ 2654339259 DES_FD13_UWBS2 "Indicates whether the ECU?s CAN cell is in either ErrorActive, or ErrorPassive state OR has just now recovered from a BusOff condition";
CM_ SG_ 2654339259 EOL_FD13_UWBS2 "Indicates if the ECU requires configuration data at the assembly plant End Of Line";
CM_ SG_ 2654339259 GenericFailSts_FD13_UWBS2 "Indicates the presence/absent of at least one DTC in the System Memory";
CM_ SG_ 2654339259 PreviousCanNMState_FD13_UWBS2 "Indicates the last CanNM state that the ECU existed in";
CM_ SG_ 2654339259 StayActiveSource_FD13_UWBS2 "Indicates the source that requests the ECU to stay active";
CM_ SG_ 2654339259 WakeupSource_FD13_UWBS2 "Indicates the reason the ECU was most recently awakened";
CM_ SG_ 2654339260 CurrentCanNMState_FD13_UWBS3 "Indicates that CanNM state the ECU is currently executing";
CM_ SG_ 2654339260 CurrentFailSts_FD13_UWBS3 "Indicates the presence/absence of at least one DTC with DTCStatus = present in the System Memory";
CM_ SG_ 2654339260 DES_FD13_UWBS3 "Indicates whether the ECU?s CAN cell is in either ErrorActive, or ErrorPassive state OR has just now recovered from a BusOff condition";
CM_ SG_ 2654339260 EOL_FD13_UWBS3 "Indicates if the ECU requires configuration data at the assembly plant End Of Line";
CM_ SG_ 2654339260 GenericFailSts_FD13_UWBS3 "Indicates the presence/absent of at least one DTC in the System Memory";
CM_ SG_ 2654339260 PreviousCanNMState_FD13_UWBS3 "Indicates the last CanNM state that the ECU existed in";
CM_ SG_ 2654339260 StayActiveSource_FD13_UWBS3 "Indicates the source that requests the ECU to stay active";
CM_ SG_ 2654339260 WakeupSource_FD13_UWBS3 "Indicates the reason the ECU was most recently awakened";
CM_ SG_ 2654339261 CurrentCanNMState_FD13_UWBS4 "Indicates that CanNM state the ECU is currently executing";
CM_ SG_ 2654339261 CurrentFailSts_FD13_UWBS4 "Indicates the presence/absence of at least one DTC with DTCStatus = present in the System Memory";
CM_ SG_ 2654339261 DES_FD13_UWBS4 "Indicates whether the ECU?s CAN cell is in either ErrorActive, or ErrorPassive state OR has just now recovered from a BusOff condition";
CM_ SG_ 2654339261 EOL_FD13_UWBS4 "Indicates if the ECU requires configuration data at the assembly plant End Of Line";
CM_ SG_ 2654339261 GenericFailSts_FD13_UWBS4 "Indicates the presence/absent of at least one DTC in the System Memory";
CM_ SG_ 2654339261 PreviousCanNMState_FD13_UWBS4 "Indicates the last CanNM state that the ECU existed in";
CM_ SG_ 2654339261 StayActiveSource_FD13_UWBS4 "Indicates the source that requests the ECU to stay active";
CM_ SG_ 2654339261 WakeupSource_FD13_UWBS4 "Indicates the reason the ECU was most recently awakened";
CM_ SG_ 2654339262 CurrentCanNMState_FD13_UWBS5 "Indicates that CanNM state the ECU is currently executing";
CM_ SG_ 2654339262 CurrentFailSts_FD13_UWBS5 "Indicates the presence/absence of at least one DTC with DTCStatus = present in the System Memory";
CM_ SG_ 2654339262 DES_FD13_UWBS5 "Indicates whether the ECU?s CAN cell is in either ErrorActive, or ErrorPassive state OR has just now recovered from a BusOff condition";
CM_ SG_ 2654339262 EOL_FD13_UWBS5 "Indicates if the ECU requires configuration data at the assembly plant End Of Line";
CM_ SG_ 2654339262 GenericFailSts_FD13_UWBS5 "Indicates the presence/absent of at least one DTC in the System Memory";
CM_ SG_ 2654339262 PreviousCanNMState_FD13_UWBS5 "Indicates the last CanNM state that the ECU existed in";
CM_ SG_ 2654339262 StayActiveSource_FD13_UWBS5 "Indicates the source that requests the ECU to stay active";
CM_ SG_ 2654339262 WakeupSource_FD13_UWBS5 "Indicates the reason the ECU was most recently awakened";
CM_ SG_ 2654339199 CurrentCanNMState_FD08_VRM "Indicates that CanNM state the ECU is currently executing";
CM_ SG_ 2654339199 CurrentFailSts_FD08_VRM "Indicates the presence/absence of at least one DTC with DTCStatus = present in the System Memory";
CM_ SG_ 2654339199 DES_FD08_VRM "Indicates whether the ECU?s CAN cell is in either ErrorActive, or ErrorPassive state OR has just now recovered from a BusOff condition";
CM_ SG_ 2654339199 EOL_FD08_VRM "Indicates if the ECU requires configuration data at the assembly plant End Of Line";
CM_ SG_ 2654339199 GenericFailSts_FD08_VRM "Indicates the presence/absent of at least one DTC in the System Memory";
CM_ SG_ 2654339199 PreviousCanNMState_FD08_VRM "Indicates the last CanNM state that the ECU existed in";
CM_ SG_ 2654339199 StayActiveSource_FD08_VRM "Indicates the source that requests the ECU to stay active";
CM_ SG_ 2654339199 WakeupSource_FD08_VRM "Indicates the reason the ECU was most recently awakened";
CM_ SG_ 2654339257 CurrentCanNMState_FD09_WCPM2 "Indicates that CanNM state the ECU is currently executing";
CM_ SG_ 2654339257 CurrentFailSts_FD09_WCPM2 "Indicates the presence/absence of at least one DTC with DTCStatus = present in the System Memory";
CM_ SG_ 2654339257 DES_FD09_WCPM2 "Indicates whether the ECU?s CAN cell is in either ErrorActive, or ErrorPassive state OR has just now recovered from a BusOff condition";
CM_ SG_ 2654339257 EOL_FD09_WCPM2 "Indicates if the ECU requires configuration data at the assembly plant End Of Line";
CM_ SG_ 2654339257 GenericFailSts_FD09_WCPM2 "Indicates the presence/absent of at least one DTC in the System Memory";
CM_ SG_ 2654339257 PreviousCanNMState_FD09_WCPM2 "Indicates the last CanNM state that the ECU existed in";
CM_ SG_ 2654339257 StayActiveSource_FD09_WCPM2 "Indicates the source that requests the ECU to stay active";
CM_ SG_ 2654339257 WakeupSource_FD09_WCPM2 "Indicates the reason the ECU was most recently awakened";
CM_ SG_ 255 ACC_NCC_TrqEnblRq_Allowed "ACC/NCC Torque request allowed. True =[1]";
CM_ SG_ 255 Accel_Pedal_Override "Driver Accelerator Pedal Override. True =[1]";
CM_ SG_ 255 SumTorque_DrvReqMod "Driver requested sum torque modified";
CM_ SG_ 255 Total_AxleTorque_Static "Static Axle Torque (effective total Axle torque)";
CM_ SG_ 1876 InflationState_LHF_Tyre "It signal indicated the state for the pressure of the wheel identified";
CM_ SG_ 1876 InflationState_LHR_Tyre "It signal indicated the state for the pressure of the wheel identified";
CM_ SG_ 1876 InflationState_RHF_Tyre "It signal indicated the state for the pressure of the wheel identified";
CM_ SG_ 1876 InflationState_RHR_Tyre "It signal indicated the state for the pressure of the wheel identified";
CM_ SG_ 1876 PressureValue_LHF_Tyre "It is the value of indicated tyre wheel [bar]";
CM_ SG_ 1876 PressureValue_LHR_Tyre "It is the value of indicated tyre wheel [bar]";
CM_ SG_ 1876 PressureValue_RHF_Tyre "It is the value of indicated tyre wheel [bar]";
CM_ SG_ 1876 PressureValue_RHR_Tyre "It is the value of indicated tyre wheel [bar]";
CM_ SG_ 1876 TyrePressureSystemFailSts "It indicates that the TPM System is in Fault or not";
CM_ SG_ 151 CRC_SWSM_1 "CRC-checksum byte 1 to 2 according to SAE J1850";
CM_ SG_ 151 ERR_ST_HOD "Hands Off Status";
CM_ SG_ 151 HOFF_RCOG_SEN "Hands Off Status";
CM_ SG_ 151 MC_SWSM_1 "Message counter";
CM_ SG_ 1585 WiFi_Client_Mode_Confirm "WiFI Client Mode Confirmation";
CM_ SG_ 1452 LTESts "It is used to show the cell network level";
CM_ SG_ 1452 NetConnection "It is used to estimate data connection";
CM_ SG_ 1452 PrivacyMode "It is used to give information about  the Privacy Mode functionality.";
CM_ SG_ 1452 SignalStrength "It is used to show the cell signal strength";
CM_ SG_ 1452 WiFiSts "It indicates the status of the WiFi modem";
CM_ SG_ 156 GPS_Date_Day "GPS date day";
CM_ SG_ 156 GPS_Date_Month "GPS date month";
CM_ SG_ 156 GPS_Date_Year "GPS date year";
CM_ SG_ 156 GPS_UTC_Hour "GPS UTC hour";
CM_ SG_ 156 GPS_UTC_Minute "GPS UTC minute";
CM_ SG_ 156 GPS_UTC_Second "GPS UTC second";
CM_ SG_ 608 CRC_Telematic11 "CRC according to SAE J1850 standard at each frame transmission.";
CM_ SG_ 608 HU_TRSC_EnableBtn_Sts "Radio TRSC Enable Button Pressed";
CM_ SG_ 608 MessageCounter_Telematic11 "This signal is a counter used for safety checks strategies. This counter is incremented of 1 (one) unit at each frame transmission.";
CM_ SG_ 1465 CRC_Telematic14 "CRC according to SAE J1850 standard at each frame transmission.";
CM_ SG_ 1465 MessageCounter_Telematic14 "This signal is a counter used for safety checks strategies. This counter is incremented of 1 (one) unit at each frame transmission.";
CM_ SG_ 1465 TGW_CAMERA_DISP_STAT "None";
CM_ SG_ 1428 CameraDisplaySts2 "CameraDisplaySts2";
CM_ SG_ 1428 CM_TCH_STAT "Touch Screen Status";
CM_ SG_ 1428 CM_TCH_X_COORD "Value for the touch screen X axis coordinates";
CM_ SG_ 1428 CM_TCH_Y_COORD "Value for the touch screen Y axis coordinates";
CM_ SG_ 1428 CRC_Telematic5 "CRC according to SAE J1850 standard at each frame transmission.";
CM_ SG_ 1428 MessageCounter_Telematic5 "This signal is a counter used for safety checks strategies. This counter is incremented of 1 (one) unit at each frame transmission.";
CM_ SG_ 278 CRC_TRANSM1 "CRC according to SAE J1850 standard at each frame transmission.";
CM_ SG_ 278 MessageCounter_TRANSM1 "This signal is a counter used for safety checks strategies. This counter is incremented of 1 (one) unit at each frame transmission.";
CM_ SG_ 278 TargetGear "Tells of the intended target gear that the transmission will be shifting to. Also includes an cancel shift that the DASM uses for better control.";
CM_ SG_ 278 TRANS_ADAS_Inhibit "TCM's ability to accept external gear shift requests";
CM_ SG_ 278 TransmissionSailingSts "This signal indicates the status of the Sailing functionality";
CM_ SG_ 520 CRC_TRANSM2 "CRC according to SAE J1850 standard at each frame transmission.";
CM_ SG_ 520 GearEngagedForDisplay "Transmission Gear engaged signal for Display on cluster.";
CM_ SG_ 520 MessageCounter_TRANSM2 "This signal is a counter used for safety checks strategies. This counter is incremented of 1 (one) unit at each frame transmission.";
CM_ SG_ 520 TransReadyForESS "-";
CM_ SG_ 1450 CRC_TRANSM4 "CRC according to SAE J1850 standard at each frame transmission.";
CM_ SG_ 1450 DriveModeSts "-";
CM_ SG_ 1450 GearDisplayForCluster "GearDisplayForCluster";
CM_ SG_ 1450 GearEngaged "Current engaged gear.";
CM_ SG_ 1450 HAS_SoH_TCM "HAS SoH TCM";
CM_ SG_ 1450 LimpHomeSts "This signal is used in case of those gearbox faults that limit the higher usable gear.";
CM_ SG_ 1450 MessageCounter_TRANSM4 "This signal is a counter used for safety checks strategies. This counter is incremented of 1 (one) unit at each frame transmission.";
CM_ SG_ 1450 ShiftLeverPosition "This signal indicates the executed shift lever position.";
CM_ SG_ 1450 TransmissionFailSts "This signal indicates if the TCM currently detects the failure or not (for TCM)";
CM_ SG_ 1450 TransmissionWarnings "-";
CM_ SG_ 1472 CRC_TRSCM1 "CRC according to SAE J1850 standard at each frame transmission.";
CM_ SG_ 1472 MessageCounter_TRSCM1 "This signal is a counter used for safety checks strategies. This counter is incremented of 1 (one) unit at each frame transmission.";
CM_ SG_ 1472 THA_EPB_Req "THA EPB securement request";
CM_ SG_ 1472 THA_Speed_Limit "THA Speed Limiter Threshold";
CM_ SG_ 1472 THA_SpeedLimit_Req "THA requested speed limit";
CM_ SG_ 1472 THA_STAT "Current trailer hitch assist maneuver state";
CM_ SG_ 1472 THA_SteeringDamping "THA Steering Damping";
CM_ SG_ 1472 THA_SteeringTorqueInfo "THA Steering Torque";
CM_ SG_ 1472 THA_SteeringTorqueReq "Trailer Hitch Assist steering torque request";
CM_ SG_ 1472 Trailer_Angle "Trailer Angle";
CM_ SG_ 1472 Trailer_Angle_Sign "Trailer Angle Sign";
CM_ SG_ 1472 Trailer_Calibration "Trailer Calibrated/ Not Calibrated ; Calibrated = [1]";
CM_ SG_ 1472 TrlrHitchLight_Cntrl "Trailer Hitch light Control when trailer is connected";
CM_ SG_ 1472 TRSC_PopupDisp_Info "TRSC Cluster PopUp Request";
CM_ SG_ 1472 TRSC_SpeedLimit_Req "TRSC ECM Speed limit request";
CM_ SG_ 1472 TRSC_STAT "Trailer Reverse steering status signal";
CM_ SG_ 1472 TRSC_SteeringDamping "TRSC Steering damping percentage";
CM_ SG_ 1472 TRSC_SteeringTorqueInfo "TRSC Steering Torque";
CM_ SG_ 1472 TRSC_SteeringTorqueReq "TRSC steering torque overlay activation request";
CM_ SG_ 1472 TRSC_VehicleStop_Req "TRSC break activation request";
CM_ SG_ 1472 TRSCMoreCamRQSts "ITBM warning request";
CM_ SG_ 1476 CRC_TRSKM_FD_1 "CRC according to SAE J1850 standard at each frame transmission.";
CM_ SG_ 1476 MessageCounter_TRSKM_FD_1 "This signal is a counter used for safety checks strategies. This counter is incremented of 1 (one) unit at each frame transmission.";
CM_ SG_ 1476 TRSC_CenterBtn_Sts "TRSKM center button status";
CM_ SG_ 1476 TRSC_EnableBtn_Sts "TRSKM enable button status";
CM_ SG_ 1476 TRSC_RawKnob "TRSKM Knob Angle";
CM_ SG_ 1053 VIN_DATA "VIN Digits (8 bit ascii encoded)";
CM_ SG_ 1053 VIN_MSG "VIN Message Information";
BA_DEF_ SG_  "GenSigStartValue" INT 0 2147483647;
BA_DEF_ SG_  "GenSigInactiveValue" INT 0 2147483647;
BA_DEF_ SG_  "GenSigSendType" ENUM  "NotUsed","OnWrite","OnWriteWithRepetition","OnChange","OnChangeWithRepetition","IfActive","IfActiveWithRepetition","NoSigSendType";
BA_DEF_ SG_  "GenSigTimeoutTime_BCM" INT 0 65535;
BA_DEF_ SG_  "GenSigTimeoutTime_BSM2" INT 0 65535;
BA_DEF_ SG_  "GenSigTimeoutTime_CADM2" INT 0 65535;
BA_DEF_ SG_  "GenSigTimeoutTime_CVADAS" INT 0 65535;
BA_DEF_ SG_  "GenSigTimeoutTime_EPS" INT 0 65535;
BA_DEF_ SG_  "GenSigTimeoutTime_ORC" INT 0 65535;
BA_DEF_ SG_  "GenSigTimeoutTime_PAM" INT 0 65535;
BA_DEF_ SG_  "GenSigTimeoutTime_SGW" INT 0 65535;
BA_DEF_ SG_  "GenSigTimeoutTime_TRSKM" INT 0 65535;
BA_DEF_ BO_  "DiagRequest" ENUM  "No","Yes";
BA_DEF_ BO_  "Type" ENUM  "P","C","PE","COC","PE_Cntrl","E","E_Cntrl","OC","S","BAF","DC","EM","MM","ISO-TP","-";
BA_DEF_ BO_  "DiagResponse" ENUM  "No","Yes";
BA_DEF_ BO_  "NmMessage" ENUM  "No","Yes";
BA_DEF_ BO_  "GenMsgSendType" ENUM  "Cyclic","NotUsed","NotUsed","NotUsed","NotUsed","NotUsed","NotUsed","NotUsed","NoMsgSendType";
BA_DEF_ BO_  "GenMsgNrOfRepetition" INT 0 255;
BA_DEF_ BO_  "GenMsgILSupport" ENUM  "No","Yes";
BA_DEF_ BO_  "GenMsgStartDelayTime" INT 0 65535;
BA_DEF_ BO_  "GenMsgCycleTimeFast" INT 0 65535;
BA_DEF_ BO_  "GenMsgCycleTime" INT 0 65535;
BA_DEF_ BO_  "GenMsgDelayTime" INT 0 65535;
BA_DEF_ BO_  "NmAsrMessage" ENUM  "No","Yes";
BA_DEF_ BO_  "DiagState" ENUM  "No","Yes";
BA_DEF_ BO_  "DiagConnection" HEX 0 65535;
BA_DEF_ BO_  "VFrameFormat" ENUM  "StandardCAN","ExtendedCAN","reserved","reserved","reserved","reserved","reserved","reserved","reserved","reserved","reserved","reserved","reserved","reserved","StandardCAN_FD","ExtendedCAN_FD";
BA_DEF_ BO_  "CANFD_BRS" INT 0 1;
BA_DEF_DEF_  "GenSigStartValue" 0;
BA_DEF_DEF_  "GenSigInactiveValue" 0;
BA_DEF_DEF_  "GenSigSendType" "NoSigSendType";
BA_DEF_DEF_  "GenSigTimeoutTime_BCM" 2500;
BA_DEF_DEF_  "GenSigTimeoutTime_BSM2" 2500;
BA_DEF_DEF_  "GenSigTimeoutTime_CADM2" 2500;
BA_DEF_DEF_  "GenSigTimeoutTime_CVADAS" 2500;
BA_DEF_DEF_  "GenSigTimeoutTime_EPS" 2500;
BA_DEF_DEF_  "GenSigTimeoutTime_ORC" 2500;
BA_DEF_DEF_  "GenSigTimeoutTime_PAM" 2500;
BA_DEF_DEF_  "GenSigTimeoutTime_SGW" 2500;
BA_DEF_DEF_  "GenSigTimeoutTime_TRSKM" 2500;
BA_DEF_DEF_  "DiagRequest" "No";
BA_DEF_DEF_  "Type" "-";
BA_DEF_DEF_  "DiagResponse" "No";
BA_DEF_DEF_  "NmMessage" "No";
BA_DEF_DEF_  "GenMsgSendType" "NoMsgSendType";
BA_DEF_DEF_  "GenMsgNrOfRepetition" 0;
BA_DEF_DEF_  "GenMsgILSupport" "No";
BA_DEF_DEF_  "GenMsgStartDelayTime" 0;
BA_DEF_DEF_  "GenMsgCycleTimeFast" 0;
BA_DEF_DEF_  "GenMsgCycleTime" 0;
BA_DEF_DEF_  "GenMsgDelayTime" 0;
BA_DEF_DEF_  "NmAsrMessage" "No";
BA_DEF_DEF_  "DiagState" "No";
BA_DEF_DEF_  "DiagConnection" 0;
BA_DEF_DEF_  "VFrameFormat" "StandardCAN_FD";
BA_DEF_DEF_  "CANFD_BRS" 0;
BA_ "Type" BO_ 2654339184 1;
BA_ "GenMsgSendType" BO_ 2654339184 0;
BA_ "GenMsgILSupport" BO_ 2654339184 1;
BA_ "GenMsgCycleTime" BO_ 2654339184 1000;
BA_ "CANFD_BRS" BO_ 2654339184 1;
BA_ "VFrameFormat" BO_ 2654339184 15;
BA_ "Type" BO_ 2654339101 1;
BA_ "GenMsgSendType" BO_ 2654339101 0;
BA_ "GenMsgILSupport" BO_ 2654339101 1;
BA_ "GenMsgStartDelayTime" BO_ 2654339101 340;
BA_ "GenMsgCycleTime" BO_ 2654339101 1000;
BA_ "CANFD_BRS" BO_ 2654339101 1;
BA_ "VFrameFormat" BO_ 2654339101 15;
BA_ "Type" BO_ 2654339198 1;
BA_ "GenMsgSendType" BO_ 2654339198 0;
BA_ "GenMsgILSupport" BO_ 2654339198 1;
BA_ "GenMsgStartDelayTime" BO_ 2654339198 345;
BA_ "GenMsgCycleTime" BO_ 2654339198 1000;
BA_ "CANFD_BRS" BO_ 2654339198 1;
BA_ "VFrameFormat" BO_ 2654339198 15;
BA_ "Type" BO_ 2654339250 1;
BA_ "GenMsgSendType" BO_ 2654339250 0;
BA_ "GenMsgILSupport" BO_ 2654339250 1;
BA_ "GenMsgCycleTime" BO_ 2654339250 1000;
BA_ "CANFD_BRS" BO_ 2654339250 1;
BA_ "VFrameFormat" BO_ 2654339250 15;
BA_ "Type" BO_ 2654339107 1;
BA_ "GenMsgSendType" BO_ 2654339107 0;
BA_ "GenMsgILSupport" BO_ 2654339107 1;
BA_ "GenMsgStartDelayTime" BO_ 2654339107 350;
BA_ "GenMsgCycleTime" BO_ 2654339107 1000;
BA_ "CANFD_BRS" BO_ 2654339107 1;
BA_ "VFrameFormat" BO_ 2654339107 15;
BA_ "Type" BO_ 2654339083 1;
BA_ "GenMsgSendType" BO_ 2654339083 0;
BA_ "GenMsgILSupport" BO_ 2654339083 1;
BA_ "GenMsgStartDelayTime" BO_ 2654339083 355;
BA_ "GenMsgCycleTime" BO_ 2654339083 1000;
BA_ "CANFD_BRS" BO_ 2654339083 1;
BA_ "VFrameFormat" BO_ 2654339083 15;
BA_ "Type" BO_ 2654339249 1;
BA_ "GenMsgSendType" BO_ 2654339249 0;
BA_ "GenMsgILSupport" BO_ 2654339249 1;
BA_ "GenMsgCycleTime" BO_ 2654339249 1000;
BA_ "CANFD_BRS" BO_ 2654339249 1;
BA_ "VFrameFormat" BO_ 2654339249 15;
BA_ "Type" BO_ 2654339258 1;
BA_ "GenMsgSendType" BO_ 2654339258 0;
BA_ "GenMsgILSupport" BO_ 2654339258 1;
BA_ "GenMsgCycleTime" BO_ 2654339258 1000;
BA_ "CANFD_BRS" BO_ 2654339258 1;
BA_ "VFrameFormat" BO_ 2654339258 15;
BA_ "Type" BO_ 2654339259 1;
BA_ "GenMsgSendType" BO_ 2654339259 0;
BA_ "GenMsgILSupport" BO_ 2654339259 1;
BA_ "GenMsgCycleTime" BO_ 2654339259 1000;
BA_ "CANFD_BRS" BO_ 2654339259 1;
BA_ "VFrameFormat" BO_ 2654339259 15;
BA_ "Type" BO_ 2654339260 1;
BA_ "GenMsgSendType" BO_ 2654339260 0;
BA_ "GenMsgILSupport" BO_ 2654339260 1;
BA_ "GenMsgCycleTime" BO_ 2654339260 1000;
BA_ "CANFD_BRS" BO_ 2654339260 1;
BA_ "VFrameFormat" BO_ 2654339260 15;
BA_ "Type" BO_ 2654339261 1;
BA_ "GenMsgSendType" BO_ 2654339261 0;
BA_ "GenMsgILSupport" BO_ 2654339261 1;
BA_ "GenMsgCycleTime" BO_ 2654339261 1000;
BA_ "CANFD_BRS" BO_ 2654339261 1;
BA_ "VFrameFormat" BO_ 2654339261 15;
BA_ "Type" BO_ 2654339262 1;
BA_ "GenMsgSendType" BO_ 2654339262 0;
BA_ "GenMsgILSupport" BO_ 2654339262 1;
BA_ "GenMsgCycleTime" BO_ 2654339262 1000;
BA_ "CANFD_BRS" BO_ 2654339262 1;
BA_ "VFrameFormat" BO_ 2654339262 15;
BA_ "Type" BO_ 2654339199 1;
BA_ "GenMsgSendType" BO_ 2654339199 0;
BA_ "GenMsgILSupport" BO_ 2654339199 1;
BA_ "GenMsgStartDelayTime" BO_ 2654339199 360;
BA_ "GenMsgCycleTime" BO_ 2654339199 1000;
BA_ "CANFD_BRS" BO_ 2654339199 1;
BA_ "VFrameFormat" BO_ 2654339199 15;
BA_ "Type" BO_ 2654339257 1;
BA_ "GenMsgSendType" BO_ 2654339257 0;
BA_ "GenMsgILSupport" BO_ 2654339257 1;
BA_ "GenMsgCycleTime" BO_ 2654339257 1000;
BA_ "CANFD_BRS" BO_ 2654339257 1;
BA_ "VFrameFormat" BO_ 2654339257 15;
BA_ "Type" BO_ 255 1;
BA_ "GenMsgSendType" BO_ 255 0;
BA_ "GenMsgILSupport" BO_ 255 1;
BA_ "GenMsgStartDelayTime" BO_ 255 5;
BA_ "GenMsgCycleTime" BO_ 255 10;
BA_ "CANFD_BRS" BO_ 255 1;
BA_ "Type" BO_ 1876 3;
BA_ "GenMsgSendType" BO_ 1876 0;
BA_ "GenMsgNrOfRepetition" BO_ 1876 2;
BA_ "GenMsgILSupport" BO_ 1876 1;
BA_ "GenMsgStartDelayTime" BO_ 1876 100;
BA_ "GenMsgCycleTimeFast" BO_ 1876 20;
BA_ "GenMsgCycleTime" BO_ 1876 2000;
BA_ "GenMsgDelayTime" BO_ 1876 20;
BA_ "CANFD_BRS" BO_ 1876 1;
BA_ "Type" BO_ 151 8;
BA_ "GenMsgILSupport" BO_ 151 1;
BA_ "GenMsgDelayTime" BO_ 151 20;
BA_ "CANFD_BRS" BO_ 151 1;
BA_ "Type" BO_ 1585 1;
BA_ "GenMsgSendType" BO_ 1585 0;
BA_ "GenMsgILSupport" BO_ 1585 1;
BA_ "GenMsgCycleTime" BO_ 1585 500;
BA_ "CANFD_BRS" BO_ 1585 1;
BA_ "Type" BO_ 1452 3;
BA_ "GenMsgSendType" BO_ 1452 0;
BA_ "GenMsgILSupport" BO_ 1452 1;
BA_ "GenMsgCycleTime" BO_ 1452 1000;
BA_ "CANFD_BRS" BO_ 1452 1;
BA_ "Type" BO_ 156 8;
BA_ "GenMsgILSupport" BO_ 156 1;
BA_ "CANFD_BRS" BO_ 156 1;
BA_ "Type" BO_ 608 3;
BA_ "GenMsgSendType" BO_ 608 0;
BA_ "GenMsgNrOfRepetition" BO_ 608 2;
BA_ "GenMsgILSupport" BO_ 608 1;
BA_ "GenMsgCycleTimeFast" BO_ 608 20;
BA_ "GenMsgCycleTime" BO_ 608 100;
BA_ "GenMsgDelayTime" BO_ 608 20;
BA_ "CANFD_BRS" BO_ 608 1;
BA_ "Type" BO_ 1465 3;
BA_ "GenMsgSendType" BO_ 1465 0;
BA_ "GenMsgNrOfRepetition" BO_ 1465 2;
BA_ "GenMsgILSupport" BO_ 1465 1;
BA_ "GenMsgCycleTimeFast" BO_ 1465 20;
BA_ "GenMsgCycleTime" BO_ 1465 1000;
BA_ "GenMsgDelayTime" BO_ 1465 20;
BA_ "CANFD_BRS" BO_ 1465 1;
BA_ "Type" BO_ 1428 3;
BA_ "GenMsgSendType" BO_ 1428 0;
BA_ "GenMsgNrOfRepetition" BO_ 1428 2;
BA_ "GenMsgILSupport" BO_ 1428 1;
BA_ "GenMsgCycleTimeFast" BO_ 1428 20;
BA_ "GenMsgCycleTime" BO_ 1428 1000;
BA_ "GenMsgDelayTime" BO_ 1428 20;
BA_ "CANFD_BRS" BO_ 1428 1;
BA_ "Type" BO_ 278 1;
BA_ "GenMsgSendType" BO_ 278 0;
BA_ "GenMsgILSupport" BO_ 278 1;
BA_ "GenMsgStartDelayTime" BO_ 278 5;
BA_ "GenMsgCycleTime" BO_ 278 10;
BA_ "CANFD_BRS" BO_ 278 1;
BA_ "Type" BO_ 520 1;
BA_ "GenMsgSendType" BO_ 520 0;
BA_ "GenMsgILSupport" BO_ 520 1;
BA_ "GenMsgStartDelayTime" BO_ 520 15;
BA_ "GenMsgCycleTime" BO_ 520 20;
BA_ "CANFD_BRS" BO_ 520 1;
BA_ "Type" BO_ 1450 3;
BA_ "GenMsgSendType" BO_ 1450 0;
BA_ "GenMsgNrOfRepetition" BO_ 1450 2;
BA_ "GenMsgILSupport" BO_ 1450 1;
BA_ "GenMsgStartDelayTime" BO_ 1450 370;
BA_ "GenMsgCycleTimeFast" BO_ 1450 20;
BA_ "GenMsgCycleTime" BO_ 1450 1000;
BA_ "GenMsgDelayTime" BO_ 1450 20;
BA_ "CANFD_BRS" BO_ 1450 1;
BA_ "Type" BO_ 1472 3;
BA_ "GenMsgSendType" BO_ 1472 0;
BA_ "GenMsgILSupport" BO_ 1472 1;
BA_ "GenMsgStartDelayTime" BO_ 1472 125;
BA_ "GenMsgCycleTime" BO_ 1472 1000;
BA_ "GenMsgDelayTime" BO_ 1472 20;
BA_ "CANFD_BRS" BO_ 1472 1;
BA_ "Type" BO_ 1476 3;
BA_ "GenMsgSendType" BO_ 1476 0;
BA_ "GenMsgNrOfRepetition" BO_ 1476 2;
BA_ "GenMsgILSupport" BO_ 1476 1;
BA_ "GenMsgStartDelayTime" BO_ 1476 125;
BA_ "GenMsgCycleTimeFast" BO_ 1476 20;
BA_ "GenMsgCycleTime" BO_ 1476 1000;
BA_ "GenMsgDelayTime" BO_ 1476 20;
BA_ "CANFD_BRS" BO_ 1476 1;
BA_ "Type" BO_ 1053 1;
BA_ "GenMsgSendType" BO_ 1053 0;
BA_ "GenMsgILSupport" BO_ 1053 1;
BA_ "GenMsgStartDelayTime" BO_ 1053 40;
BA_ "GenMsgCycleTime" BO_ 1053 100;
BA_ "CANFD_BRS" BO_ 1053 1;
BA_ "GenSigTimeoutTime_BCM" SG_ 2654339184 CurrentCanNMState_FD01_SGW 0;
BA_ "GenSigTimeoutTime_SGW" SG_ 2654339184 CurrentCanNMState_FD01_SGW 0;
BA_ "GenSigTimeoutTime_BCM" SG_ 2654339184 CurrentCanNMState_FD02_SGW 0;
BA_ "GenSigTimeoutTime_SGW" SG_ 2654339184 CurrentCanNMState_FD02_SGW 0;
BA_ "GenSigTimeoutTime_BCM" SG_ 2654339184 CurrentCanNMState_FD03_SGW 0;
BA_ "GenSigTimeoutTime_SGW" SG_ 2654339184 CurrentCanNMState_FD03_SGW 0;
BA_ "GenSigTimeoutTime_BCM" SG_ 2654339184 CurrentCanNMState_FD08_SGW 0;
BA_ "GenSigTimeoutTime_SGW" SG_ 2654339184 CurrentCanNMState_FD08_SGW 0;
BA_ "GenSigTimeoutTime_BCM" SG_ 2654339184 CurrentCanNMState_FD11_SGW 0;
BA_ "GenSigTimeoutTime_SGW" SG_ 2654339184 CurrentCanNMState_FD11_SGW 0;
BA_ "GenSigTimeoutTime_BCM" SG_ 2654339184 CurrentFailSts_FD01_SGW 0;
BA_ "GenSigTimeoutTime_SGW" SG_ 2654339184 CurrentFailSts_FD01_SGW 0;
BA_ "GenSigTimeoutTime_BCM" SG_ 2654339184 CurrentFailSts_FD02_SGW 0;
BA_ "GenSigTimeoutTime_SGW" SG_ 2654339184 CurrentFailSts_FD02_SGW 0;
BA_ "GenSigTimeoutTime_BCM" SG_ 2654339184 CurrentFailSts_FD03_SGW 0;
BA_ "GenSigTimeoutTime_SGW" SG_ 2654339184 CurrentFailSts_FD03_SGW 0;
BA_ "GenSigTimeoutTime_BCM" SG_ 2654339184 CurrentFailSts_FD08_SGW 0;
BA_ "GenSigTimeoutTime_SGW" SG_ 2654339184 CurrentFailSts_FD08_SGW 0;
BA_ "GenSigTimeoutTime_BCM" SG_ 2654339184 CurrentFailSts_FD11_SGW 0;
BA_ "GenSigTimeoutTime_SGW" SG_ 2654339184 CurrentFailSts_FD11_SGW 0;
BA_ "GenSigTimeoutTime_BCM" SG_ 2654339184 DES_FD01_SGW 0;
BA_ "GenSigTimeoutTime_SGW" SG_ 2654339184 DES_FD01_SGW 0;
BA_ "GenSigTimeoutTime_BCM" SG_ 2654339184 DES_FD02_SGW 0;
BA_ "GenSigTimeoutTime_SGW" SG_ 2654339184 DES_FD02_SGW 0;
BA_ "GenSigTimeoutTime_BCM" SG_ 2654339184 DES_FD03_SGW 0;
BA_ "GenSigTimeoutTime_SGW" SG_ 2654339184 DES_FD03_SGW 0;
BA_ "GenSigTimeoutTime_BCM" SG_ 2654339184 DES_FD08_SGW 0;
BA_ "GenSigTimeoutTime_SGW" SG_ 2654339184 DES_FD08_SGW 0;
BA_ "GenSigTimeoutTime_BCM" SG_ 2654339184 DES_FD11_SGW 0;
BA_ "GenSigTimeoutTime_SGW" SG_ 2654339184 DES_FD11_SGW 0;
BA_ "GenSigTimeoutTime_BCM" SG_ 2654339184 EOL_FD01_SGW 0;
BA_ "GenSigTimeoutTime_SGW" SG_ 2654339184 EOL_FD01_SGW 0;
BA_ "GenSigTimeoutTime_BCM" SG_ 2654339184 EOL_FD02_SGW 0;
BA_ "GenSigTimeoutTime_SGW" SG_ 2654339184 EOL_FD02_SGW 0;
BA_ "GenSigTimeoutTime_BCM" SG_ 2654339184 EOL_FD03_SGW 0;
BA_ "GenSigTimeoutTime_SGW" SG_ 2654339184 EOL_FD03_SGW 0;
BA_ "GenSigTimeoutTime_BCM" SG_ 2654339184 EOL_FD08_SGW 0;
BA_ "GenSigTimeoutTime_SGW" SG_ 2654339184 EOL_FD08_SGW 0;
BA_ "GenSigTimeoutTime_BCM" SG_ 2654339184 EOL_FD11_SGW 0;
BA_ "GenSigTimeoutTime_SGW" SG_ 2654339184 EOL_FD11_SGW 0;
BA_ "GenSigTimeoutTime_BCM" SG_ 2654339184 GenericFailSts_FD01_SGW 0;
BA_ "GenSigTimeoutTime_SGW" SG_ 2654339184 GenericFailSts_FD01_SGW 0;
BA_ "GenSigTimeoutTime_BCM" SG_ 2654339184 GenericFailSts_FD02_SGW 0;
BA_ "GenSigTimeoutTime_SGW" SG_ 2654339184 GenericFailSts_FD02_SGW 0;
BA_ "GenSigTimeoutTime_BCM" SG_ 2654339184 GenericFailSts_FD03_SGW 0;
BA_ "GenSigTimeoutTime_SGW" SG_ 2654339184 GenericFailSts_FD03_SGW 0;
BA_ "GenSigTimeoutTime_BCM" SG_ 2654339184 GenericFailSts_FD08_SGW 0;
BA_ "GenSigTimeoutTime_SGW" SG_ 2654339184 GenericFailSts_FD08_SGW 0;
BA_ "GenSigTimeoutTime_BCM" SG_ 2654339184 GenericFailSts_FD11_SGW 0;
BA_ "GenSigTimeoutTime_SGW" SG_ 2654339184 GenericFailSts_FD11_SGW 0;
BA_ "GenSigTimeoutTime_BCM" SG_ 2654339184 PreviousCanNMState_FD01_SGW 0;
BA_ "GenSigTimeoutTime_SGW" SG_ 2654339184 PreviousCanNMState_FD01_SGW 0;
BA_ "GenSigTimeoutTime_BCM" SG_ 2654339184 PreviousCanNMState_FD02_SGW 0;
BA_ "GenSigTimeoutTime_SGW" SG_ 2654339184 PreviousCanNMState_FD02_SGW 0;
BA_ "GenSigTimeoutTime_BCM" SG_ 2654339184 PreviousCanNMState_FD03_SGW 0;
BA_ "GenSigTimeoutTime_SGW" SG_ 2654339184 PreviousCanNMState_FD03_SGW 0;
BA_ "GenSigTimeoutTime_BCM" SG_ 2654339184 PreviousCanNMState_FD08_SGW 0;
BA_ "GenSigTimeoutTime_SGW" SG_ 2654339184 PreviousCanNMState_FD08_SGW 0;
BA_ "GenSigTimeoutTime_BCM" SG_ 2654339184 PreviousCanNMState_FD11_SGW 0;
BA_ "GenSigTimeoutTime_SGW" SG_ 2654339184 PreviousCanNMState_FD11_SGW 0;
BA_ "GenSigTimeoutTime_BCM" SG_ 2654339184 StayActiveSource_FD01_SGW 0;
BA_ "GenSigTimeoutTime_SGW" SG_ 2654339184 StayActiveSource_FD01_SGW 0;
BA_ "GenSigTimeoutTime_BCM" SG_ 2654339184 StayActiveSource_FD02_SGW 0;
BA_ "GenSigTimeoutTime_SGW" SG_ 2654339184 StayActiveSource_FD02_SGW 0;
BA_ "GenSigTimeoutTime_BCM" SG_ 2654339184 StayActiveSource_FD03_SGW 0;
BA_ "GenSigTimeoutTime_SGW" SG_ 2654339184 StayActiveSource_FD03_SGW 0;
BA_ "GenSigTimeoutTime_BCM" SG_ 2654339184 StayActiveSource_FD08_SGW 0;
BA_ "GenSigTimeoutTime_SGW" SG_ 2654339184 StayActiveSource_FD08_SGW 0;
BA_ "GenSigTimeoutTime_BCM" SG_ 2654339184 StayActiveSource_FD11_SGW 0;
BA_ "GenSigTimeoutTime_SGW" SG_ 2654339184 StayActiveSource_FD11_SGW 0;
BA_ "GenSigTimeoutTime_BCM" SG_ 2654339184 WakeupSource_FD01_SGW 0;
BA_ "GenSigTimeoutTime_SGW" SG_ 2654339184 WakeupSource_FD01_SGW 0;
BA_ "GenSigTimeoutTime_BCM" SG_ 2654339184 WakeupSource_FD02_SGW 0;
BA_ "GenSigTimeoutTime_SGW" SG_ 2654339184 WakeupSource_FD02_SGW 0;
BA_ "GenSigTimeoutTime_BCM" SG_ 2654339184 WakeupSource_FD03_SGW 0;
BA_ "GenSigTimeoutTime_SGW" SG_ 2654339184 WakeupSource_FD03_SGW 0;
BA_ "GenSigTimeoutTime_BCM" SG_ 2654339184 WakeupSource_FD08_SGW 0;
BA_ "GenSigTimeoutTime_SGW" SG_ 2654339184 WakeupSource_FD08_SGW 0;
BA_ "GenSigTimeoutTime_BCM" SG_ 2654339184 WakeupSource_FD11_SGW 0;
BA_ "GenSigTimeoutTime_SGW" SG_ 2654339184 WakeupSource_FD11_SGW 0;
BA_ "GenSigTimeoutTime_BCM" SG_ 2654339101 CurrentCanNMState_FD04_SLML 0;
BA_ "GenSigTimeoutTime_BSM2" SG_ 2654339101 CurrentCanNMState_FD04_SLML 0;
BA_ "GenSigTimeoutTime_CADM2" SG_ 2654339101 CurrentCanNMState_FD04_SLML 0;
BA_ "GenSigTimeoutTime_CVADAS" SG_ 2654339101 CurrentCanNMState_FD04_SLML 0;
BA_ "GenSigTimeoutTime_EPS" SG_ 2654339101 CurrentCanNMState_FD04_SLML 0;
BA_ "GenSigTimeoutTime_ORC" SG_ 2654339101 CurrentCanNMState_FD04_SLML 0;
BA_ "GenSigTimeoutTime_PAM" SG_ 2654339101 CurrentCanNMState_FD04_SLML 0;
BA_ "GenSigTimeoutTime_SGW" SG_ 2654339101 CurrentCanNMState_FD04_SLML 0;
BA_ "GenSigTimeoutTime_TRSKM" SG_ 2654339101 CurrentCanNMState_FD04_SLML 0;
BA_ "GenSigTimeoutTime_BCM" SG_ 2654339101 CurrentFailSts_FD04_SLML 0;
BA_ "GenSigTimeoutTime_BSM2" SG_ 2654339101 CurrentFailSts_FD04_SLML 0;
BA_ "GenSigTimeoutTime_CADM2" SG_ 2654339101 CurrentFailSts_FD04_SLML 0;
BA_ "GenSigTimeoutTime_CVADAS" SG_ 2654339101 CurrentFailSts_FD04_SLML 0;
BA_ "GenSigTimeoutTime_EPS" SG_ 2654339101 CurrentFailSts_FD04_SLML 0;
BA_ "GenSigTimeoutTime_ORC" SG_ 2654339101 CurrentFailSts_FD04_SLML 0;
BA_ "GenSigTimeoutTime_PAM" SG_ 2654339101 CurrentFailSts_FD04_SLML 0;
BA_ "GenSigTimeoutTime_SGW" SG_ 2654339101 CurrentFailSts_FD04_SLML 0;
BA_ "GenSigTimeoutTime_TRSKM" SG_ 2654339101 CurrentFailSts_FD04_SLML 0;
BA_ "GenSigTimeoutTime_BCM" SG_ 2654339101 DES_FD04_SLML 0;
BA_ "GenSigTimeoutTime_BSM2" SG_ 2654339101 DES_FD04_SLML 0;
BA_ "GenSigTimeoutTime_CADM2" SG_ 2654339101 DES_FD04_SLML 0;
BA_ "GenSigTimeoutTime_CVADAS" SG_ 2654339101 DES_FD04_SLML 0;
BA_ "GenSigTimeoutTime_EPS" SG_ 2654339101 DES_FD04_SLML 0;
BA_ "GenSigTimeoutTime_ORC" SG_ 2654339101 DES_FD04_SLML 0;
BA_ "GenSigTimeoutTime_PAM" SG_ 2654339101 DES_FD04_SLML 0;
BA_ "GenSigTimeoutTime_SGW" SG_ 2654339101 DES_FD04_SLML 0;
BA_ "GenSigTimeoutTime_TRSKM" SG_ 2654339101 DES_FD04_SLML 0;
BA_ "GenSigTimeoutTime_BCM" SG_ 2654339101 EOL_FD04_SLML 0;
BA_ "GenSigTimeoutTime_BSM2" SG_ 2654339101 EOL_FD04_SLML 0;
BA_ "GenSigTimeoutTime_CADM2" SG_ 2654339101 EOL_FD04_SLML 0;
BA_ "GenSigTimeoutTime_CVADAS" SG_ 2654339101 EOL_FD04_SLML 0;
BA_ "GenSigTimeoutTime_EPS" SG_ 2654339101 EOL_FD04_SLML 0;
BA_ "GenSigTimeoutTime_ORC" SG_ 2654339101 EOL_FD04_SLML 0;
BA_ "GenSigTimeoutTime_PAM" SG_ 2654339101 EOL_FD04_SLML 0;
BA_ "GenSigTimeoutTime_SGW" SG_ 2654339101 EOL_FD04_SLML 0;
BA_ "GenSigTimeoutTime_TRSKM" SG_ 2654339101 EOL_FD04_SLML 0;
BA_ "GenSigTimeoutTime_BCM" SG_ 2654339101 GenericFailSts_FD04_SLML 0;
BA_ "GenSigTimeoutTime_BSM2" SG_ 2654339101 GenericFailSts_FD04_SLML 0;
BA_ "GenSigTimeoutTime_CADM2" SG_ 2654339101 GenericFailSts_FD04_SLML 0;
BA_ "GenSigTimeoutTime_CVADAS" SG_ 2654339101 GenericFailSts_FD04_SLML 0;
BA_ "GenSigTimeoutTime_EPS" SG_ 2654339101 GenericFailSts_FD04_SLML 0;
BA_ "GenSigTimeoutTime_ORC" SG_ 2654339101 GenericFailSts_FD04_SLML 0;
BA_ "GenSigTimeoutTime_PAM" SG_ 2654339101 GenericFailSts_FD04_SLML 0;
BA_ "GenSigTimeoutTime_SGW" SG_ 2654339101 GenericFailSts_FD04_SLML 0;
BA_ "GenSigTimeoutTime_TRSKM" SG_ 2654339101 GenericFailSts_FD04_SLML 0;
BA_ "GenSigTimeoutTime_BCM" SG_ 2654339101 PreviousCanNMState_FD04_SLML 0;
BA_ "GenSigTimeoutTime_BSM2" SG_ 2654339101 PreviousCanNMState_FD04_SLML 0;
BA_ "GenSigTimeoutTime_CADM2" SG_ 2654339101 PreviousCanNMState_FD04_SLML 0;
BA_ "GenSigTimeoutTime_CVADAS" SG_ 2654339101 PreviousCanNMState_FD04_SLML 0;
BA_ "GenSigTimeoutTime_EPS" SG_ 2654339101 PreviousCanNMState_FD04_SLML 0;
BA_ "GenSigTimeoutTime_ORC" SG_ 2654339101 PreviousCanNMState_FD04_SLML 0;
BA_ "GenSigTimeoutTime_PAM" SG_ 2654339101 PreviousCanNMState_FD04_SLML 0;
BA_ "GenSigTimeoutTime_SGW" SG_ 2654339101 PreviousCanNMState_FD04_SLML 0;
BA_ "GenSigTimeoutTime_TRSKM" SG_ 2654339101 PreviousCanNMState_FD04_SLML 0;
BA_ "GenSigTimeoutTime_BCM" SG_ 2654339101 StayActiveSource_FD04_SLML 0;
BA_ "GenSigTimeoutTime_BSM2" SG_ 2654339101 StayActiveSource_FD04_SLML 0;
BA_ "GenSigTimeoutTime_CADM2" SG_ 2654339101 StayActiveSource_FD04_SLML 0;
BA_ "GenSigTimeoutTime_CVADAS" SG_ 2654339101 StayActiveSource_FD04_SLML 0;
BA_ "GenSigTimeoutTime_EPS" SG_ 2654339101 StayActiveSource_FD04_SLML 0;
BA_ "GenSigTimeoutTime_ORC" SG_ 2654339101 StayActiveSource_FD04_SLML 0;
BA_ "GenSigTimeoutTime_PAM" SG_ 2654339101 StayActiveSource_FD04_SLML 0;
BA_ "GenSigTimeoutTime_SGW" SG_ 2654339101 StayActiveSource_FD04_SLML 0;
BA_ "GenSigTimeoutTime_TRSKM" SG_ 2654339101 StayActiveSource_FD04_SLML 0;
BA_ "GenSigTimeoutTime_BCM" SG_ 2654339101 WakeupSource_FD04_SLML 0;
BA_ "GenSigTimeoutTime_BSM2" SG_ 2654339101 WakeupSource_FD04_SLML 0;
BA_ "GenSigTimeoutTime_CADM2" SG_ 2654339101 WakeupSource_FD04_SLML 0;
BA_ "GenSigTimeoutTime_CVADAS" SG_ 2654339101 WakeupSource_FD04_SLML 0;
BA_ "GenSigTimeoutTime_EPS" SG_ 2654339101 WakeupSource_FD04_SLML 0;
BA_ "GenSigTimeoutTime_ORC" SG_ 2654339101 WakeupSource_FD04_SLML 0;
BA_ "GenSigTimeoutTime_PAM" SG_ 2654339101 WakeupSource_FD04_SLML 0;
BA_ "GenSigTimeoutTime_SGW" SG_ 2654339101 WakeupSource_FD04_SLML 0;
BA_ "GenSigTimeoutTime_TRSKM" SG_ 2654339101 WakeupSource_FD04_SLML 0;
BA_ "GenSigTimeoutTime_BCM" SG_ 2654339198 CurrentCanNMState_FD04_SLMR 0;
BA_ "GenSigTimeoutTime_BSM2" SG_ 2654339198 CurrentCanNMState_FD04_SLMR 0;
BA_ "GenSigTimeoutTime_CADM2" SG_ 2654339198 CurrentCanNMState_FD04_SLMR 0;
BA_ "GenSigTimeoutTime_CVADAS" SG_ 2654339198 CurrentCanNMState_FD04_SLMR 0;
BA_ "GenSigTimeoutTime_EPS" SG_ 2654339198 CurrentCanNMState_FD04_SLMR 0;
BA_ "GenSigTimeoutTime_ORC" SG_ 2654339198 CurrentCanNMState_FD04_SLMR 0;
BA_ "GenSigTimeoutTime_PAM" SG_ 2654339198 CurrentCanNMState_FD04_SLMR 0;
BA_ "GenSigTimeoutTime_SGW" SG_ 2654339198 CurrentCanNMState_FD04_SLMR 0;
BA_ "GenSigTimeoutTime_TRSKM" SG_ 2654339198 CurrentCanNMState_FD04_SLMR 0;
BA_ "GenSigTimeoutTime_BCM" SG_ 2654339198 CurrentFailSts_FD04_SLMR 0;
BA_ "GenSigTimeoutTime_BSM2" SG_ 2654339198 CurrentFailSts_FD04_SLMR 0;
BA_ "GenSigTimeoutTime_CADM2" SG_ 2654339198 CurrentFailSts_FD04_SLMR 0;
BA_ "GenSigTimeoutTime_CVADAS" SG_ 2654339198 CurrentFailSts_FD04_SLMR 0;
BA_ "GenSigTimeoutTime_EPS" SG_ 2654339198 CurrentFailSts_FD04_SLMR 0;
BA_ "GenSigTimeoutTime_ORC" SG_ 2654339198 CurrentFailSts_FD04_SLMR 0;
BA_ "GenSigTimeoutTime_PAM" SG_ 2654339198 CurrentFailSts_FD04_SLMR 0;
BA_ "GenSigTimeoutTime_SGW" SG_ 2654339198 CurrentFailSts_FD04_SLMR 0;
BA_ "GenSigTimeoutTime_TRSKM" SG_ 2654339198 CurrentFailSts_FD04_SLMR 0;
BA_ "GenSigTimeoutTime_BCM" SG_ 2654339198 DES_FD04_SLMR 0;
BA_ "GenSigTimeoutTime_BSM2" SG_ 2654339198 DES_FD04_SLMR 0;
BA_ "GenSigTimeoutTime_CADM2" SG_ 2654339198 DES_FD04_SLMR 0;
BA_ "GenSigTimeoutTime_CVADAS" SG_ 2654339198 DES_FD04_SLMR 0;
BA_ "GenSigTimeoutTime_EPS" SG_ 2654339198 DES_FD04_SLMR 0;
BA_ "GenSigTimeoutTime_ORC" SG_ 2654339198 DES_FD04_SLMR 0;
BA_ "GenSigTimeoutTime_PAM" SG_ 2654339198 DES_FD04_SLMR 0;
BA_ "GenSigTimeoutTime_SGW" SG_ 2654339198 DES_FD04_SLMR 0;
BA_ "GenSigTimeoutTime_TRSKM" SG_ 2654339198 DES_FD04_SLMR 0;
BA_ "GenSigTimeoutTime_BCM" SG_ 2654339198 EOL_FD04_SLMR 0;
BA_ "GenSigTimeoutTime_BSM2" SG_ 2654339198 EOL_FD04_SLMR 0;
BA_ "GenSigTimeoutTime_CADM2" SG_ 2654339198 EOL_FD04_SLMR 0;
BA_ "GenSigTimeoutTime_CVADAS" SG_ 2654339198 EOL_FD04_SLMR 0;
BA_ "GenSigTimeoutTime_EPS" SG_ 2654339198 EOL_FD04_SLMR 0;
BA_ "GenSigTimeoutTime_ORC" SG_ 2654339198 EOL_FD04_SLMR 0;
BA_ "GenSigTimeoutTime_PAM" SG_ 2654339198 EOL_FD04_SLMR 0;
BA_ "GenSigTimeoutTime_SGW" SG_ 2654339198 EOL_FD04_SLMR 0;
BA_ "GenSigTimeoutTime_TRSKM" SG_ 2654339198 EOL_FD04_SLMR 0;
BA_ "GenSigTimeoutTime_BCM" SG_ 2654339198 GenericFailSts_FD04_SLMR 0;
BA_ "GenSigTimeoutTime_BSM2" SG_ 2654339198 GenericFailSts_FD04_SLMR 0;
BA_ "GenSigTimeoutTime_CADM2" SG_ 2654339198 GenericFailSts_FD04_SLMR 0;
BA_ "GenSigTimeoutTime_CVADAS" SG_ 2654339198 GenericFailSts_FD04_SLMR 0;
BA_ "GenSigTimeoutTime_EPS" SG_ 2654339198 GenericFailSts_FD04_SLMR 0;
BA_ "GenSigTimeoutTime_ORC" SG_ 2654339198 GenericFailSts_FD04_SLMR 0;
BA_ "GenSigTimeoutTime_PAM" SG_ 2654339198 GenericFailSts_FD04_SLMR 0;
BA_ "GenSigTimeoutTime_SGW" SG_ 2654339198 GenericFailSts_FD04_SLMR 0;
BA_ "GenSigTimeoutTime_TRSKM" SG_ 2654339198 GenericFailSts_FD04_SLMR 0;
BA_ "GenSigTimeoutTime_BCM" SG_ 2654339198 PreviousCanNMState_FD04_SLMR 0;
BA_ "GenSigTimeoutTime_BSM2" SG_ 2654339198 PreviousCanNMState_FD04_SLMR 0;
BA_ "GenSigTimeoutTime_CADM2" SG_ 2654339198 PreviousCanNMState_FD04_SLMR 0;
BA_ "GenSigTimeoutTime_CVADAS" SG_ 2654339198 PreviousCanNMState_FD04_SLMR 0;
BA_ "GenSigTimeoutTime_EPS" SG_ 2654339198 PreviousCanNMState_FD04_SLMR 0;
BA_ "GenSigTimeoutTime_ORC" SG_ 2654339198 PreviousCanNMState_FD04_SLMR 0;
BA_ "GenSigTimeoutTime_PAM" SG_ 2654339198 PreviousCanNMState_FD04_SLMR 0;
BA_ "GenSigTimeoutTime_SGW" SG_ 2654339198 PreviousCanNMState_FD04_SLMR 0;
BA_ "GenSigTimeoutTime_TRSKM" SG_ 2654339198 PreviousCanNMState_FD04_SLMR 0;
BA_ "GenSigTimeoutTime_BCM" SG_ 2654339198 StayActiveSource_FD04_SLMR 0;
BA_ "GenSigTimeoutTime_BSM2" SG_ 2654339198 StayActiveSource_FD04_SLMR 0;
BA_ "GenSigTimeoutTime_CADM2" SG_ 2654339198 StayActiveSource_FD04_SLMR 0;
BA_ "GenSigTimeoutTime_CVADAS" SG_ 2654339198 StayActiveSource_FD04_SLMR 0;
BA_ "GenSigTimeoutTime_EPS" SG_ 2654339198 StayActiveSource_FD04_SLMR 0;
BA_ "GenSigTimeoutTime_ORC" SG_ 2654339198 StayActiveSource_FD04_SLMR 0;
BA_ "GenSigTimeoutTime_PAM" SG_ 2654339198 StayActiveSource_FD04_SLMR 0;
BA_ "GenSigTimeoutTime_SGW" SG_ 2654339198 StayActiveSource_FD04_SLMR 0;
BA_ "GenSigTimeoutTime_TRSKM" SG_ 2654339198 StayActiveSource_FD04_SLMR 0;
BA_ "GenSigTimeoutTime_BCM" SG_ 2654339198 WakeupSource_FD04_SLMR 0;
BA_ "GenSigTimeoutTime_BSM2" SG_ 2654339198 WakeupSource_FD04_SLMR 0;
BA_ "GenSigTimeoutTime_CADM2" SG_ 2654339198 WakeupSource_FD04_SLMR 0;
BA_ "GenSigTimeoutTime_CVADAS" SG_ 2654339198 WakeupSource_FD04_SLMR 0;
BA_ "GenSigTimeoutTime_EPS" SG_ 2654339198 WakeupSource_FD04_SLMR 0;
BA_ "GenSigTimeoutTime_ORC" SG_ 2654339198 WakeupSource_FD04_SLMR 0;
BA_ "GenSigTimeoutTime_PAM" SG_ 2654339198 WakeupSource_FD04_SLMR 0;
BA_ "GenSigTimeoutTime_SGW" SG_ 2654339198 WakeupSource_FD04_SLMR 0;
BA_ "GenSigTimeoutTime_TRSKM" SG_ 2654339198 WakeupSource_FD04_SLMR 0;
BA_ "GenSigTimeoutTime_BCM" SG_ 2654339250 CurrentCanNMState_FD01_SPAAK 0;
BA_ "GenSigTimeoutTime_BSM2" SG_ 2654339250 CurrentCanNMState_FD01_SPAAK 0;
BA_ "GenSigTimeoutTime_CADM2" SG_ 2654339250 CurrentCanNMState_FD01_SPAAK 0;
BA_ "GenSigTimeoutTime_CVADAS" SG_ 2654339250 CurrentCanNMState_FD01_SPAAK 0;
BA_ "GenSigTimeoutTime_EPS" SG_ 2654339250 CurrentCanNMState_FD01_SPAAK 0;
BA_ "GenSigTimeoutTime_ORC" SG_ 2654339250 CurrentCanNMState_FD01_SPAAK 0;
BA_ "GenSigTimeoutTime_PAM" SG_ 2654339250 CurrentCanNMState_FD01_SPAAK 0;
BA_ "GenSigTimeoutTime_SGW" SG_ 2654339250 CurrentCanNMState_FD01_SPAAK 0;
BA_ "GenSigTimeoutTime_TRSKM" SG_ 2654339250 CurrentCanNMState_FD01_SPAAK 0;
BA_ "GenSigTimeoutTime_BCM" SG_ 2654339250 CurrentFailSts_FD01_SPAAK 0;
BA_ "GenSigTimeoutTime_BSM2" SG_ 2654339250 CurrentFailSts_FD01_SPAAK 0;
BA_ "GenSigTimeoutTime_CADM2" SG_ 2654339250 CurrentFailSts_FD01_SPAAK 0;
BA_ "GenSigTimeoutTime_CVADAS" SG_ 2654339250 CurrentFailSts_FD01_SPAAK 0;
BA_ "GenSigTimeoutTime_EPS" SG_ 2654339250 CurrentFailSts_FD01_SPAAK 0;
BA_ "GenSigTimeoutTime_ORC" SG_ 2654339250 CurrentFailSts_FD01_SPAAK 0;
BA_ "GenSigTimeoutTime_PAM" SG_ 2654339250 CurrentFailSts_FD01_SPAAK 0;
BA_ "GenSigTimeoutTime_SGW" SG_ 2654339250 CurrentFailSts_FD01_SPAAK 0;
BA_ "GenSigTimeoutTime_TRSKM" SG_ 2654339250 CurrentFailSts_FD01_SPAAK 0;
BA_ "GenSigTimeoutTime_BCM" SG_ 2654339250 DES_FD01_SPAAK 0;
BA_ "GenSigTimeoutTime_BSM2" SG_ 2654339250 DES_FD01_SPAAK 0;
BA_ "GenSigTimeoutTime_CADM2" SG_ 2654339250 DES_FD01_SPAAK 0;
BA_ "GenSigTimeoutTime_CVADAS" SG_ 2654339250 DES_FD01_SPAAK 0;
BA_ "GenSigTimeoutTime_EPS" SG_ 2654339250 DES_FD01_SPAAK 0;
BA_ "GenSigTimeoutTime_ORC" SG_ 2654339250 DES_FD01_SPAAK 0;
BA_ "GenSigTimeoutTime_PAM" SG_ 2654339250 DES_FD01_SPAAK 0;
BA_ "GenSigTimeoutTime_SGW" SG_ 2654339250 DES_FD01_SPAAK 0;
BA_ "GenSigTimeoutTime_TRSKM" SG_ 2654339250 DES_FD01_SPAAK 0;
BA_ "GenSigTimeoutTime_BCM" SG_ 2654339250 EOL_FD01_SPAAK 0;
BA_ "GenSigTimeoutTime_BSM2" SG_ 2654339250 EOL_FD01_SPAAK 0;
BA_ "GenSigTimeoutTime_CADM2" SG_ 2654339250 EOL_FD01_SPAAK 0;
BA_ "GenSigTimeoutTime_CVADAS" SG_ 2654339250 EOL_FD01_SPAAK 0;
BA_ "GenSigTimeoutTime_EPS" SG_ 2654339250 EOL_FD01_SPAAK 0;
BA_ "GenSigTimeoutTime_ORC" SG_ 2654339250 EOL_FD01_SPAAK 0;
BA_ "GenSigTimeoutTime_PAM" SG_ 2654339250 EOL_FD01_SPAAK 0;
BA_ "GenSigTimeoutTime_SGW" SG_ 2654339250 EOL_FD01_SPAAK 0;
BA_ "GenSigTimeoutTime_TRSKM" SG_ 2654339250 EOL_FD01_SPAAK 0;
BA_ "GenSigTimeoutTime_BCM" SG_ 2654339250 GenericFailSts_FD01_SPAAK 0;
BA_ "GenSigTimeoutTime_BSM2" SG_ 2654339250 GenericFailSts_FD01_SPAAK 0;
BA_ "GenSigTimeoutTime_CADM2" SG_ 2654339250 GenericFailSts_FD01_SPAAK 0;
BA_ "GenSigTimeoutTime_CVADAS" SG_ 2654339250 GenericFailSts_FD01_SPAAK 0;
BA_ "GenSigTimeoutTime_EPS" SG_ 2654339250 GenericFailSts_FD01_SPAAK 0;
BA_ "GenSigTimeoutTime_ORC" SG_ 2654339250 GenericFailSts_FD01_SPAAK 0;
BA_ "GenSigTimeoutTime_PAM" SG_ 2654339250 GenericFailSts_FD01_SPAAK 0;
BA_ "GenSigTimeoutTime_SGW" SG_ 2654339250 GenericFailSts_FD01_SPAAK 0;
BA_ "GenSigTimeoutTime_TRSKM" SG_ 2654339250 GenericFailSts_FD01_SPAAK 0;
BA_ "GenSigTimeoutTime_BCM" SG_ 2654339250 PreviousCanNMState_FD01_SPAAK 0;
BA_ "GenSigTimeoutTime_BSM2" SG_ 2654339250 PreviousCanNMState_FD01_SPAAK 0;
BA_ "GenSigTimeoutTime_CADM2" SG_ 2654339250 PreviousCanNMState_FD01_SPAAK 0;
BA_ "GenSigTimeoutTime_CVADAS" SG_ 2654339250 PreviousCanNMState_FD01_SPAAK 0;
BA_ "GenSigTimeoutTime_EPS" SG_ 2654339250 PreviousCanNMState_FD01_SPAAK 0;
BA_ "GenSigTimeoutTime_ORC" SG_ 2654339250 PreviousCanNMState_FD01_SPAAK 0;
BA_ "GenSigTimeoutTime_PAM" SG_ 2654339250 PreviousCanNMState_FD01_SPAAK 0;
BA_ "GenSigTimeoutTime_SGW" SG_ 2654339250 PreviousCanNMState_FD01_SPAAK 0;
BA_ "GenSigTimeoutTime_TRSKM" SG_ 2654339250 PreviousCanNMState_FD01_SPAAK 0;
BA_ "GenSigTimeoutTime_BCM" SG_ 2654339250 StayActiveSource_FD01_SPAAK 0;
BA_ "GenSigTimeoutTime_BSM2" SG_ 2654339250 StayActiveSource_FD01_SPAAK 0;
BA_ "GenSigTimeoutTime_CADM2" SG_ 2654339250 StayActiveSource_FD01_SPAAK 0;
BA_ "GenSigTimeoutTime_CVADAS" SG_ 2654339250 StayActiveSource_FD01_SPAAK 0;
BA_ "GenSigTimeoutTime_EPS" SG_ 2654339250 StayActiveSource_FD01_SPAAK 0;
BA_ "GenSigTimeoutTime_ORC" SG_ 2654339250 StayActiveSource_FD01_SPAAK 0;
BA_ "GenSigTimeoutTime_PAM" SG_ 2654339250 StayActiveSource_FD01_SPAAK 0;
BA_ "GenSigTimeoutTime_SGW" SG_ 2654339250 StayActiveSource_FD01_SPAAK 0;
BA_ "GenSigTimeoutTime_TRSKM" SG_ 2654339250 StayActiveSource_FD01_SPAAK 0;
BA_ "GenSigTimeoutTime_BCM" SG_ 2654339250 WakeupSource_FD01_SPAAK 0;
BA_ "GenSigTimeoutTime_BSM2" SG_ 2654339250 WakeupSource_FD01_SPAAK 0;
BA_ "GenSigTimeoutTime_CADM2" SG_ 2654339250 WakeupSource_FD01_SPAAK 0;
BA_ "GenSigTimeoutTime_CVADAS" SG_ 2654339250 WakeupSource_FD01_SPAAK 0;
BA_ "GenSigTimeoutTime_EPS" SG_ 2654339250 WakeupSource_FD01_SPAAK 0;
BA_ "GenSigTimeoutTime_ORC" SG_ 2654339250 WakeupSource_FD01_SPAAK 0;
BA_ "GenSigTimeoutTime_PAM" SG_ 2654339250 WakeupSource_FD01_SPAAK 0;
BA_ "GenSigTimeoutTime_SGW" SG_ 2654339250 WakeupSource_FD01_SPAAK 0;
BA_ "GenSigTimeoutTime_TRSKM" SG_ 2654339250 WakeupSource_FD01_SPAAK 0;
BA_ "GenSigTimeoutTime_BCM" SG_ 2654339107 CurrentCanNMState_FD08_TBM 0;
BA_ "GenSigTimeoutTime_BSM2" SG_ 2654339107 CurrentCanNMState_FD08_TBM 0;
BA_ "GenSigTimeoutTime_CADM2" SG_ 2654339107 CurrentCanNMState_FD08_TBM 0;
BA_ "GenSigTimeoutTime_CVADAS" SG_ 2654339107 CurrentCanNMState_FD08_TBM 0;
BA_ "GenSigTimeoutTime_EPS" SG_ 2654339107 CurrentCanNMState_FD08_TBM 0;
BA_ "GenSigTimeoutTime_ORC" SG_ 2654339107 CurrentCanNMState_FD08_TBM 0;
BA_ "GenSigTimeoutTime_PAM" SG_ 2654339107 CurrentCanNMState_FD08_TBM 0;
BA_ "GenSigTimeoutTime_SGW" SG_ 2654339107 CurrentCanNMState_FD08_TBM 0;
BA_ "GenSigTimeoutTime_TRSKM" SG_ 2654339107 CurrentCanNMState_FD08_TBM 0;
BA_ "GenSigTimeoutTime_BCM" SG_ 2654339107 CurrentFailSts_FD08_TBM 0;
BA_ "GenSigTimeoutTime_BSM2" SG_ 2654339107 CurrentFailSts_FD08_TBM 0;
BA_ "GenSigTimeoutTime_CADM2" SG_ 2654339107 CurrentFailSts_FD08_TBM 0;
BA_ "GenSigTimeoutTime_CVADAS" SG_ 2654339107 CurrentFailSts_FD08_TBM 0;
BA_ "GenSigTimeoutTime_EPS" SG_ 2654339107 CurrentFailSts_FD08_TBM 0;
BA_ "GenSigTimeoutTime_ORC" SG_ 2654339107 CurrentFailSts_FD08_TBM 0;
BA_ "GenSigTimeoutTime_PAM" SG_ 2654339107 CurrentFailSts_FD08_TBM 0;
BA_ "GenSigTimeoutTime_SGW" SG_ 2654339107 CurrentFailSts_FD08_TBM 0;
BA_ "GenSigTimeoutTime_TRSKM" SG_ 2654339107 CurrentFailSts_FD08_TBM 0;
BA_ "GenSigTimeoutTime_BCM" SG_ 2654339107 DES_FD08_TBM 0;
BA_ "GenSigTimeoutTime_BSM2" SG_ 2654339107 DES_FD08_TBM 0;
BA_ "GenSigTimeoutTime_CADM2" SG_ 2654339107 DES_FD08_TBM 0;
BA_ "GenSigTimeoutTime_CVADAS" SG_ 2654339107 DES_FD08_TBM 0;
BA_ "GenSigTimeoutTime_EPS" SG_ 2654339107 DES_FD08_TBM 0;
BA_ "GenSigTimeoutTime_ORC" SG_ 2654339107 DES_FD08_TBM 0;
BA_ "GenSigTimeoutTime_PAM" SG_ 2654339107 DES_FD08_TBM 0;
BA_ "GenSigTimeoutTime_SGW" SG_ 2654339107 DES_FD08_TBM 0;
BA_ "GenSigTimeoutTime_TRSKM" SG_ 2654339107 DES_FD08_TBM 0;
BA_ "GenSigTimeoutTime_BCM" SG_ 2654339107 EOL_FD08_TBM 0;
BA_ "GenSigTimeoutTime_BSM2" SG_ 2654339107 EOL_FD08_TBM 0;
BA_ "GenSigTimeoutTime_CADM2" SG_ 2654339107 EOL_FD08_TBM 0;
BA_ "GenSigTimeoutTime_CVADAS" SG_ 2654339107 EOL_FD08_TBM 0;
BA_ "GenSigTimeoutTime_EPS" SG_ 2654339107 EOL_FD08_TBM 0;
BA_ "GenSigTimeoutTime_ORC" SG_ 2654339107 EOL_FD08_TBM 0;
BA_ "GenSigTimeoutTime_PAM" SG_ 2654339107 EOL_FD08_TBM 0;
BA_ "GenSigTimeoutTime_SGW" SG_ 2654339107 EOL_FD08_TBM 0;
BA_ "GenSigTimeoutTime_TRSKM" SG_ 2654339107 EOL_FD08_TBM 0;
BA_ "GenSigTimeoutTime_BCM" SG_ 2654339107 GenericFailSts_FD08_TBM 0;
BA_ "GenSigTimeoutTime_BSM2" SG_ 2654339107 GenericFailSts_FD08_TBM 0;
BA_ "GenSigTimeoutTime_CADM2" SG_ 2654339107 GenericFailSts_FD08_TBM 0;
BA_ "GenSigTimeoutTime_CVADAS" SG_ 2654339107 GenericFailSts_FD08_TBM 0;
BA_ "GenSigTimeoutTime_EPS" SG_ 2654339107 GenericFailSts_FD08_TBM 0;
BA_ "GenSigTimeoutTime_ORC" SG_ 2654339107 GenericFailSts_FD08_TBM 0;
BA_ "GenSigTimeoutTime_PAM" SG_ 2654339107 GenericFailSts_FD08_TBM 0;
BA_ "GenSigTimeoutTime_SGW" SG_ 2654339107 GenericFailSts_FD08_TBM 0;
BA_ "GenSigTimeoutTime_TRSKM" SG_ 2654339107 GenericFailSts_FD08_TBM 0;
BA_ "GenSigTimeoutTime_BCM" SG_ 2654339107 PreviousCanNMState_FD08_TBM 0;
BA_ "GenSigTimeoutTime_BSM2" SG_ 2654339107 PreviousCanNMState_FD08_TBM 0;
BA_ "GenSigTimeoutTime_CADM2" SG_ 2654339107 PreviousCanNMState_FD08_TBM 0;
BA_ "GenSigTimeoutTime_CVADAS" SG_ 2654339107 PreviousCanNMState_FD08_TBM 0;
BA_ "GenSigTimeoutTime_EPS" SG_ 2654339107 PreviousCanNMState_FD08_TBM 0;
BA_ "GenSigTimeoutTime_ORC" SG_ 2654339107 PreviousCanNMState_FD08_TBM 0;
BA_ "GenSigTimeoutTime_PAM" SG_ 2654339107 PreviousCanNMState_FD08_TBM 0;
BA_ "GenSigTimeoutTime_SGW" SG_ 2654339107 PreviousCanNMState_FD08_TBM 0;
BA_ "GenSigTimeoutTime_TRSKM" SG_ 2654339107 PreviousCanNMState_FD08_TBM 0;
BA_ "GenSigTimeoutTime_BCM" SG_ 2654339107 StayActiveSource_FD08_TBM 0;
BA_ "GenSigTimeoutTime_BSM2" SG_ 2654339107 StayActiveSource_FD08_TBM 0;
BA_ "GenSigTimeoutTime_CADM2" SG_ 2654339107 StayActiveSource_FD08_TBM 0;
BA_ "GenSigTimeoutTime_CVADAS" SG_ 2654339107 StayActiveSource_FD08_TBM 0;
BA_ "GenSigTimeoutTime_EPS" SG_ 2654339107 StayActiveSource_FD08_TBM 0;
BA_ "GenSigTimeoutTime_ORC" SG_ 2654339107 StayActiveSource_FD08_TBM 0;
BA_ "GenSigTimeoutTime_PAM" SG_ 2654339107 StayActiveSource_FD08_TBM 0;
BA_ "GenSigTimeoutTime_SGW" SG_ 2654339107 StayActiveSource_FD08_TBM 0;
BA_ "GenSigTimeoutTime_TRSKM" SG_ 2654339107 StayActiveSource_FD08_TBM 0;
BA_ "GenSigTimeoutTime_BCM" SG_ 2654339107 WakeupSource_FD08_TBM 0;
BA_ "GenSigTimeoutTime_BSM2" SG_ 2654339107 WakeupSource_FD08_TBM 0;
BA_ "GenSigTimeoutTime_CADM2" SG_ 2654339107 WakeupSource_FD08_TBM 0;
BA_ "GenSigTimeoutTime_CVADAS" SG_ 2654339107 WakeupSource_FD08_TBM 0;
BA_ "GenSigTimeoutTime_EPS" SG_ 2654339107 WakeupSource_FD08_TBM 0;
BA_ "GenSigTimeoutTime_ORC" SG_ 2654339107 WakeupSource_FD08_TBM 0;
BA_ "GenSigTimeoutTime_PAM" SG_ 2654339107 WakeupSource_FD08_TBM 0;
BA_ "GenSigTimeoutTime_SGW" SG_ 2654339107 WakeupSource_FD08_TBM 0;
BA_ "GenSigTimeoutTime_TRSKM" SG_ 2654339107 WakeupSource_FD08_TBM 0;
BA_ "GenSigTimeoutTime_BCM" SG_ 2654339083 CurrentCanNMState_FD03_TCM 0;
BA_ "GenSigTimeoutTime_BSM2" SG_ 2654339083 CurrentCanNMState_FD03_TCM 0;
BA_ "GenSigTimeoutTime_CADM2" SG_ 2654339083 CurrentCanNMState_FD03_TCM 0;
BA_ "GenSigTimeoutTime_CVADAS" SG_ 2654339083 CurrentCanNMState_FD03_TCM 0;
BA_ "GenSigTimeoutTime_EPS" SG_ 2654339083 CurrentCanNMState_FD03_TCM 0;
BA_ "GenSigTimeoutTime_ORC" SG_ 2654339083 CurrentCanNMState_FD03_TCM 0;
BA_ "GenSigTimeoutTime_PAM" SG_ 2654339083 CurrentCanNMState_FD03_TCM 0;
BA_ "GenSigTimeoutTime_SGW" SG_ 2654339083 CurrentCanNMState_FD03_TCM 0;
BA_ "GenSigTimeoutTime_TRSKM" SG_ 2654339083 CurrentCanNMState_FD03_TCM 0;
BA_ "GenSigTimeoutTime_BCM" SG_ 2654339083 CurrentFailSts_FD03_TCM 0;
BA_ "GenSigTimeoutTime_BSM2" SG_ 2654339083 CurrentFailSts_FD03_TCM 0;
BA_ "GenSigTimeoutTime_CADM2" SG_ 2654339083 CurrentFailSts_FD03_TCM 0;
BA_ "GenSigTimeoutTime_CVADAS" SG_ 2654339083 CurrentFailSts_FD03_TCM 0;
BA_ "GenSigTimeoutTime_EPS" SG_ 2654339083 CurrentFailSts_FD03_TCM 0;
BA_ "GenSigTimeoutTime_ORC" SG_ 2654339083 CurrentFailSts_FD03_TCM 0;
BA_ "GenSigTimeoutTime_PAM" SG_ 2654339083 CurrentFailSts_FD03_TCM 0;
BA_ "GenSigTimeoutTime_SGW" SG_ 2654339083 CurrentFailSts_FD03_TCM 0;
BA_ "GenSigTimeoutTime_TRSKM" SG_ 2654339083 CurrentFailSts_FD03_TCM 0;
BA_ "GenSigTimeoutTime_BCM" SG_ 2654339083 DES_FD03_TCM 0;
BA_ "GenSigTimeoutTime_BSM2" SG_ 2654339083 DES_FD03_TCM 0;
BA_ "GenSigTimeoutTime_CADM2" SG_ 2654339083 DES_FD03_TCM 0;
BA_ "GenSigTimeoutTime_CVADAS" SG_ 2654339083 DES_FD03_TCM 0;
BA_ "GenSigTimeoutTime_EPS" SG_ 2654339083 DES_FD03_TCM 0;
BA_ "GenSigTimeoutTime_ORC" SG_ 2654339083 DES_FD03_TCM 0;
BA_ "GenSigTimeoutTime_PAM" SG_ 2654339083 DES_FD03_TCM 0;
BA_ "GenSigTimeoutTime_SGW" SG_ 2654339083 DES_FD03_TCM 0;
BA_ "GenSigTimeoutTime_TRSKM" SG_ 2654339083 DES_FD03_TCM 0;
BA_ "GenSigTimeoutTime_BCM" SG_ 2654339083 EOL_FD03_TCM 0;
BA_ "GenSigTimeoutTime_BSM2" SG_ 2654339083 EOL_FD03_TCM 0;
BA_ "GenSigTimeoutTime_CADM2" SG_ 2654339083 EOL_FD03_TCM 0;
BA_ "GenSigTimeoutTime_CVADAS" SG_ 2654339083 EOL_FD03_TCM 0;
BA_ "GenSigTimeoutTime_EPS" SG_ 2654339083 EOL_FD03_TCM 0;
BA_ "GenSigTimeoutTime_ORC" SG_ 2654339083 EOL_FD03_TCM 0;
BA_ "GenSigTimeoutTime_PAM" SG_ 2654339083 EOL_FD03_TCM 0;
BA_ "GenSigTimeoutTime_SGW" SG_ 2654339083 EOL_FD03_TCM 0;
BA_ "GenSigTimeoutTime_TRSKM" SG_ 2654339083 EOL_FD03_TCM 0;
BA_ "GenSigTimeoutTime_BCM" SG_ 2654339083 GenericFailSts_FD03_TCM 0;
BA_ "GenSigTimeoutTime_BSM2" SG_ 2654339083 GenericFailSts_FD03_TCM 0;
BA_ "GenSigTimeoutTime_CADM2" SG_ 2654339083 GenericFailSts_FD03_TCM 0;
BA_ "GenSigTimeoutTime_CVADAS" SG_ 2654339083 GenericFailSts_FD03_TCM 0;
BA_ "GenSigTimeoutTime_EPS" SG_ 2654339083 GenericFailSts_FD03_TCM 0;
BA_ "GenSigTimeoutTime_ORC" SG_ 2654339083 GenericFailSts_FD03_TCM 0;
BA_ "GenSigTimeoutTime_PAM" SG_ 2654339083 GenericFailSts_FD03_TCM 0;
BA_ "GenSigTimeoutTime_SGW" SG_ 2654339083 GenericFailSts_FD03_TCM 0;
BA_ "GenSigTimeoutTime_TRSKM" SG_ 2654339083 GenericFailSts_FD03_TCM 0;
BA_ "GenSigTimeoutTime_BCM" SG_ 2654339083 PreviousCanNMState_FD03_TCM 0;
BA_ "GenSigTimeoutTime_BSM2" SG_ 2654339083 PreviousCanNMState_FD03_TCM 0;
BA_ "GenSigTimeoutTime_CADM2" SG_ 2654339083 PreviousCanNMState_FD03_TCM 0;
BA_ "GenSigTimeoutTime_CVADAS" SG_ 2654339083 PreviousCanNMState_FD03_TCM 0;
BA_ "GenSigTimeoutTime_EPS" SG_ 2654339083 PreviousCanNMState_FD03_TCM 0;
BA_ "GenSigTimeoutTime_ORC" SG_ 2654339083 PreviousCanNMState_FD03_TCM 0;
BA_ "GenSigTimeoutTime_PAM" SG_ 2654339083 PreviousCanNMState_FD03_TCM 0;
BA_ "GenSigTimeoutTime_SGW" SG_ 2654339083 PreviousCanNMState_FD03_TCM 0;
BA_ "GenSigTimeoutTime_TRSKM" SG_ 2654339083 PreviousCanNMState_FD03_TCM 0;
BA_ "GenSigTimeoutTime_BCM" SG_ 2654339083 StayActiveSource_FD03_TCM 0;
BA_ "GenSigTimeoutTime_BSM2" SG_ 2654339083 StayActiveSource_FD03_TCM 0;
BA_ "GenSigTimeoutTime_CADM2" SG_ 2654339083 StayActiveSource_FD03_TCM 0;
BA_ "GenSigTimeoutTime_CVADAS" SG_ 2654339083 StayActiveSource_FD03_TCM 0;
BA_ "GenSigTimeoutTime_EPS" SG_ 2654339083 StayActiveSource_FD03_TCM 0;
BA_ "GenSigTimeoutTime_ORC" SG_ 2654339083 StayActiveSource_FD03_TCM 0;
BA_ "GenSigTimeoutTime_PAM" SG_ 2654339083 StayActiveSource_FD03_TCM 0;
BA_ "GenSigTimeoutTime_SGW" SG_ 2654339083 StayActiveSource_FD03_TCM 0;
BA_ "GenSigTimeoutTime_TRSKM" SG_ 2654339083 StayActiveSource_FD03_TCM 0;
BA_ "GenSigTimeoutTime_BCM" SG_ 2654339083 WakeupSource_FD03_TCM 0;
BA_ "GenSigTimeoutTime_BSM2" SG_ 2654339083 WakeupSource_FD03_TCM 0;
BA_ "GenSigTimeoutTime_CADM2" SG_ 2654339083 WakeupSource_FD03_TCM 0;
BA_ "GenSigTimeoutTime_CVADAS" SG_ 2654339083 WakeupSource_FD03_TCM 0;
BA_ "GenSigTimeoutTime_EPS" SG_ 2654339083 WakeupSource_FD03_TCM 0;
BA_ "GenSigTimeoutTime_ORC" SG_ 2654339083 WakeupSource_FD03_TCM 0;
BA_ "GenSigTimeoutTime_PAM" SG_ 2654339083 WakeupSource_FD03_TCM 0;
BA_ "GenSigTimeoutTime_SGW" SG_ 2654339083 WakeupSource_FD03_TCM 0;
BA_ "GenSigTimeoutTime_TRSKM" SG_ 2654339083 WakeupSource_FD03_TCM 0;
BA_ "GenSigTimeoutTime_TRSKM" SG_ 2654339249 CurrentCanNMState_FD02_TRLR_REV 0;
BA_ "GenSigTimeoutTime_TRSKM" SG_ 2654339249 CurrentFailSts_FD02_TRLR_REV 0;
BA_ "GenSigTimeoutTime_TRSKM" SG_ 2654339249 DES_FD02_TRLR_REV 0;
BA_ "GenSigTimeoutTime_TRSKM" SG_ 2654339249 EOL_FD02_TRLR_REV 0;
BA_ "GenSigTimeoutTime_TRSKM" SG_ 2654339249 GenericFailSts_FD02_TRLR_REV 0;
BA_ "GenSigTimeoutTime_TRSKM" SG_ 2654339249 PreviousCanNMState_FD02_TRLR_REV 0;
BA_ "GenSigTimeoutTime_TRSKM" SG_ 2654339249 StayActiveSource_FD02_TRLR_REV 0;
BA_ "GenSigTimeoutTime_TRSKM" SG_ 2654339249 WakeupSource_FD02_TRLR_REV 0;
BA_ "GenSigTimeoutTime_BCM" SG_ 2654339258 CurrentCanNMState_FD13_UWBS1 0;
BA_ "GenSigTimeoutTime_BSM2" SG_ 2654339258 CurrentCanNMState_FD13_UWBS1 0;
BA_ "GenSigTimeoutTime_CADM2" SG_ 2654339258 CurrentCanNMState_FD13_UWBS1 0;
BA_ "GenSigTimeoutTime_CVADAS" SG_ 2654339258 CurrentCanNMState_FD13_UWBS1 0;
BA_ "GenSigTimeoutTime_EPS" SG_ 2654339258 CurrentCanNMState_FD13_UWBS1 0;
BA_ "GenSigTimeoutTime_ORC" SG_ 2654339258 CurrentCanNMState_FD13_UWBS1 0;
BA_ "GenSigTimeoutTime_PAM" SG_ 2654339258 CurrentCanNMState_FD13_UWBS1 0;
BA_ "GenSigTimeoutTime_SGW" SG_ 2654339258 CurrentCanNMState_FD13_UWBS1 0;
BA_ "GenSigTimeoutTime_TRSKM" SG_ 2654339258 CurrentCanNMState_FD13_UWBS1 0;
BA_ "GenSigTimeoutTime_BCM" SG_ 2654339258 CurrentFailSts_FD13_UWBS1 0;
BA_ "GenSigTimeoutTime_BSM2" SG_ 2654339258 CurrentFailSts_FD13_UWBS1 0;
BA_ "GenSigTimeoutTime_CADM2" SG_ 2654339258 CurrentFailSts_FD13_UWBS1 0;
BA_ "GenSigTimeoutTime_CVADAS" SG_ 2654339258 CurrentFailSts_FD13_UWBS1 0;
BA_ "GenSigTimeoutTime_EPS" SG_ 2654339258 CurrentFailSts_FD13_UWBS1 0;
BA_ "GenSigTimeoutTime_ORC" SG_ 2654339258 CurrentFailSts_FD13_UWBS1 0;
BA_ "GenSigTimeoutTime_PAM" SG_ 2654339258 CurrentFailSts_FD13_UWBS1 0;
BA_ "GenSigTimeoutTime_SGW" SG_ 2654339258 CurrentFailSts_FD13_UWBS1 0;
BA_ "GenSigTimeoutTime_TRSKM" SG_ 2654339258 CurrentFailSts_FD13_UWBS1 0;
BA_ "GenSigTimeoutTime_BCM" SG_ 2654339258 DES_FD13_UWBS1 0;
BA_ "GenSigTimeoutTime_BSM2" SG_ 2654339258 DES_FD13_UWBS1 0;
BA_ "GenSigTimeoutTime_CADM2" SG_ 2654339258 DES_FD13_UWBS1 0;
BA_ "GenSigTimeoutTime_CVADAS" SG_ 2654339258 DES_FD13_UWBS1 0;
BA_ "GenSigTimeoutTime_EPS" SG_ 2654339258 DES_FD13_UWBS1 0;
BA_ "GenSigTimeoutTime_ORC" SG_ 2654339258 DES_FD13_UWBS1 0;
BA_ "GenSigTimeoutTime_PAM" SG_ 2654339258 DES_FD13_UWBS1 0;
BA_ "GenSigTimeoutTime_SGW" SG_ 2654339258 DES_FD13_UWBS1 0;
BA_ "GenSigTimeoutTime_TRSKM" SG_ 2654339258 DES_FD13_UWBS1 0;
BA_ "GenSigTimeoutTime_BCM" SG_ 2654339258 EOL_FD13_UWBS1 0;
BA_ "GenSigTimeoutTime_BSM2" SG_ 2654339258 EOL_FD13_UWBS1 0;
BA_ "GenSigTimeoutTime_CADM2" SG_ 2654339258 EOL_FD13_UWBS1 0;
BA_ "GenSigTimeoutTime_CVADAS" SG_ 2654339258 EOL_FD13_UWBS1 0;
BA_ "GenSigTimeoutTime_EPS" SG_ 2654339258 EOL_FD13_UWBS1 0;
BA_ "GenSigTimeoutTime_ORC" SG_ 2654339258 EOL_FD13_UWBS1 0;
BA_ "GenSigTimeoutTime_PAM" SG_ 2654339258 EOL_FD13_UWBS1 0;
BA_ "GenSigTimeoutTime_SGW" SG_ 2654339258 EOL_FD13_UWBS1 0;
BA_ "GenSigTimeoutTime_TRSKM" SG_ 2654339258 EOL_FD13_UWBS1 0;
BA_ "GenSigTimeoutTime_BCM" SG_ 2654339258 GenericFailSts_FD13_UWBS1 0;
BA_ "GenSigTimeoutTime_BSM2" SG_ 2654339258 GenericFailSts_FD13_UWBS1 0;
BA_ "GenSigTimeoutTime_CADM2" SG_ 2654339258 GenericFailSts_FD13_UWBS1 0;
BA_ "GenSigTimeoutTime_CVADAS" SG_ 2654339258 GenericFailSts_FD13_UWBS1 0;
BA_ "GenSigTimeoutTime_EPS" SG_ 2654339258 GenericFailSts_FD13_UWBS1 0;
BA_ "GenSigTimeoutTime_ORC" SG_ 2654339258 GenericFailSts_FD13_UWBS1 0;
BA_ "GenSigTimeoutTime_PAM" SG_ 2654339258 GenericFailSts_FD13_UWBS1 0;
BA_ "GenSigTimeoutTime_SGW" SG_ 2654339258 GenericFailSts_FD13_UWBS1 0;
BA_ "GenSigTimeoutTime_TRSKM" SG_ 2654339258 GenericFailSts_FD13_UWBS1 0;
BA_ "GenSigTimeoutTime_BCM" SG_ 2654339258 PreviousCanNMState_FD13_UWBS1 0;
BA_ "GenSigTimeoutTime_BSM2" SG_ 2654339258 PreviousCanNMState_FD13_UWBS1 0;
BA_ "GenSigTimeoutTime_CADM2" SG_ 2654339258 PreviousCanNMState_FD13_UWBS1 0;
BA_ "GenSigTimeoutTime_CVADAS" SG_ 2654339258 PreviousCanNMState_FD13_UWBS1 0;
BA_ "GenSigTimeoutTime_EPS" SG_ 2654339258 PreviousCanNMState_FD13_UWBS1 0;
BA_ "GenSigTimeoutTime_ORC" SG_ 2654339258 PreviousCanNMState_FD13_UWBS1 0;
BA_ "GenSigTimeoutTime_PAM" SG_ 2654339258 PreviousCanNMState_FD13_UWBS1 0;
BA_ "GenSigTimeoutTime_SGW" SG_ 2654339258 PreviousCanNMState_FD13_UWBS1 0;
BA_ "GenSigTimeoutTime_TRSKM" SG_ 2654339258 PreviousCanNMState_FD13_UWBS1 0;
BA_ "GenSigTimeoutTime_BCM" SG_ 2654339258 StayActiveSource_FD13_UWBS1 0;
BA_ "GenSigTimeoutTime_BSM2" SG_ 2654339258 StayActiveSource_FD13_UWBS1 0;
BA_ "GenSigTimeoutTime_CADM2" SG_ 2654339258 StayActiveSource_FD13_UWBS1 0;
BA_ "GenSigTimeoutTime_CVADAS" SG_ 2654339258 StayActiveSource_FD13_UWBS1 0;
BA_ "GenSigTimeoutTime_EPS" SG_ 2654339258 StayActiveSource_FD13_UWBS1 0;
BA_ "GenSigTimeoutTime_ORC" SG_ 2654339258 StayActiveSource_FD13_UWBS1 0;
BA_ "GenSigTimeoutTime_PAM" SG_ 2654339258 StayActiveSource_FD13_UWBS1 0;
BA_ "GenSigTimeoutTime_SGW" SG_ 2654339258 StayActiveSource_FD13_UWBS1 0;
BA_ "GenSigTimeoutTime_TRSKM" SG_ 2654339258 StayActiveSource_FD13_UWBS1 0;
BA_ "GenSigTimeoutTime_BCM" SG_ 2654339258 WakeupSource_FD13_UWBS1 0;
BA_ "GenSigTimeoutTime_BSM2" SG_ 2654339258 WakeupSource_FD13_UWBS1 0;
BA_ "GenSigTimeoutTime_CADM2" SG_ 2654339258 WakeupSource_FD13_UWBS1 0;
BA_ "GenSigTimeoutTime_CVADAS" SG_ 2654339258 WakeupSource_FD13_UWBS1 0;
BA_ "GenSigTimeoutTime_EPS" SG_ 2654339258 WakeupSource_FD13_UWBS1 0;
BA_ "GenSigTimeoutTime_ORC" SG_ 2654339258 WakeupSource_FD13_UWBS1 0;
BA_ "GenSigTimeoutTime_PAM" SG_ 2654339258 WakeupSource_FD13_UWBS1 0;
BA_ "GenSigTimeoutTime_SGW" SG_ 2654339258 WakeupSource_FD13_UWBS1 0;
BA_ "GenSigTimeoutTime_TRSKM" SG_ 2654339258 WakeupSource_FD13_UWBS1 0;
BA_ "GenSigTimeoutTime_BCM" SG_ 2654339259 CurrentCanNMState_FD13_UWBS2 0;
BA_ "GenSigTimeoutTime_BSM2" SG_ 2654339259 CurrentCanNMState_FD13_UWBS2 0;
BA_ "GenSigTimeoutTime_CADM2" SG_ 2654339259 CurrentCanNMState_FD13_UWBS2 0;
BA_ "GenSigTimeoutTime_CVADAS" SG_ 2654339259 CurrentCanNMState_FD13_UWBS2 0;
BA_ "GenSigTimeoutTime_EPS" SG_ 2654339259 CurrentCanNMState_FD13_UWBS2 0;
BA_ "GenSigTimeoutTime_ORC" SG_ 2654339259 CurrentCanNMState_FD13_UWBS2 0;
BA_ "GenSigTimeoutTime_PAM" SG_ 2654339259 CurrentCanNMState_FD13_UWBS2 0;
BA_ "GenSigTimeoutTime_SGW" SG_ 2654339259 CurrentCanNMState_FD13_UWBS2 0;
BA_ "GenSigTimeoutTime_TRSKM" SG_ 2654339259 CurrentCanNMState_FD13_UWBS2 0;
BA_ "GenSigTimeoutTime_BCM" SG_ 2654339259 CurrentFailSts_FD13_UWBS2 0;
BA_ "GenSigTimeoutTime_BSM2" SG_ 2654339259 CurrentFailSts_FD13_UWBS2 0;
BA_ "GenSigTimeoutTime_CADM2" SG_ 2654339259 CurrentFailSts_FD13_UWBS2 0;
BA_ "GenSigTimeoutTime_CVADAS" SG_ 2654339259 CurrentFailSts_FD13_UWBS2 0;
BA_ "GenSigTimeoutTime_EPS" SG_ 2654339259 CurrentFailSts_FD13_UWBS2 0;
BA_ "GenSigTimeoutTime_ORC" SG_ 2654339259 CurrentFailSts_FD13_UWBS2 0;
BA_ "GenSigTimeoutTime_PAM" SG_ 2654339259 CurrentFailSts_FD13_UWBS2 0;
BA_ "GenSigTimeoutTime_SGW" SG_ 2654339259 CurrentFailSts_FD13_UWBS2 0;
BA_ "GenSigTimeoutTime_TRSKM" SG_ 2654339259 CurrentFailSts_FD13_UWBS2 0;
BA_ "GenSigTimeoutTime_BCM" SG_ 2654339259 DES_FD13_UWBS2 0;
BA_ "GenSigTimeoutTime_BSM2" SG_ 2654339259 DES_FD13_UWBS2 0;
BA_ "GenSigTimeoutTime_CADM2" SG_ 2654339259 DES_FD13_UWBS2 0;
BA_ "GenSigTimeoutTime_CVADAS" SG_ 2654339259 DES_FD13_UWBS2 0;
BA_ "GenSigTimeoutTime_EPS" SG_ 2654339259 DES_FD13_UWBS2 0;
BA_ "GenSigTimeoutTime_ORC" SG_ 2654339259 DES_FD13_UWBS2 0;
BA_ "GenSigTimeoutTime_PAM" SG_ 2654339259 DES_FD13_UWBS2 0;
BA_ "GenSigTimeoutTime_SGW" SG_ 2654339259 DES_FD13_UWBS2 0;
BA_ "GenSigTimeoutTime_TRSKM" SG_ 2654339259 DES_FD13_UWBS2 0;
BA_ "GenSigTimeoutTime_BCM" SG_ 2654339259 EOL_FD13_UWBS2 0;
BA_ "GenSigTimeoutTime_BSM2" SG_ 2654339259 EOL_FD13_UWBS2 0;
BA_ "GenSigTimeoutTime_CADM2" SG_ 2654339259 EOL_FD13_UWBS2 0;
BA_ "GenSigTimeoutTime_CVADAS" SG_ 2654339259 EOL_FD13_UWBS2 0;
BA_ "GenSigTimeoutTime_EPS" SG_ 2654339259 EOL_FD13_UWBS2 0;
BA_ "GenSigTimeoutTime_ORC" SG_ 2654339259 EOL_FD13_UWBS2 0;
BA_ "GenSigTimeoutTime_PAM" SG_ 2654339259 EOL_FD13_UWBS2 0;
BA_ "GenSigTimeoutTime_SGW" SG_ 2654339259 EOL_FD13_UWBS2 0;
BA_ "GenSigTimeoutTime_TRSKM" SG_ 2654339259 EOL_FD13_UWBS2 0;
BA_ "GenSigTimeoutTime_BCM" SG_ 2654339259 GenericFailSts_FD13_UWBS2 0;
BA_ "GenSigTimeoutTime_BSM2" SG_ 2654339259 GenericFailSts_FD13_UWBS2 0;
BA_ "GenSigTimeoutTime_CADM2" SG_ 2654339259 GenericFailSts_FD13_UWBS2 0;
BA_ "GenSigTimeoutTime_CVADAS" SG_ 2654339259 GenericFailSts_FD13_UWBS2 0;
BA_ "GenSigTimeoutTime_EPS" SG_ 2654339259 GenericFailSts_FD13_UWBS2 0;
BA_ "GenSigTimeoutTime_ORC" SG_ 2654339259 GenericFailSts_FD13_UWBS2 0;
BA_ "GenSigTimeoutTime_PAM" SG_ 2654339259 GenericFailSts_FD13_UWBS2 0;
BA_ "GenSigTimeoutTime_SGW" SG_ 2654339259 GenericFailSts_FD13_UWBS2 0;
BA_ "GenSigTimeoutTime_TRSKM" SG_ 2654339259 GenericFailSts_FD13_UWBS2 0;
BA_ "GenSigTimeoutTime_BCM" SG_ 2654339259 PreviousCanNMState_FD13_UWBS2 0;
BA_ "GenSigTimeoutTime_BSM2" SG_ 2654339259 PreviousCanNMState_FD13_UWBS2 0;
BA_ "GenSigTimeoutTime_CADM2" SG_ 2654339259 PreviousCanNMState_FD13_UWBS2 0;
BA_ "GenSigTimeoutTime_CVADAS" SG_ 2654339259 PreviousCanNMState_FD13_UWBS2 0;
BA_ "GenSigTimeoutTime_EPS" SG_ 2654339259 PreviousCanNMState_FD13_UWBS2 0;
BA_ "GenSigTimeoutTime_ORC" SG_ 2654339259 PreviousCanNMState_FD13_UWBS2 0;
BA_ "GenSigTimeoutTime_PAM" SG_ 2654339259 PreviousCanNMState_FD13_UWBS2 0;
BA_ "GenSigTimeoutTime_SGW" SG_ 2654339259 PreviousCanNMState_FD13_UWBS2 0;
BA_ "GenSigTimeoutTime_TRSKM" SG_ 2654339259 PreviousCanNMState_FD13_UWBS2 0;
BA_ "GenSigTimeoutTime_BCM" SG_ 2654339259 StayActiveSource_FD13_UWBS2 0;
BA_ "GenSigTimeoutTime_BSM2" SG_ 2654339259 StayActiveSource_FD13_UWBS2 0;
BA_ "GenSigTimeoutTime_CADM2" SG_ 2654339259 StayActiveSource_FD13_UWBS2 0;
BA_ "GenSigTimeoutTime_CVADAS" SG_ 2654339259 StayActiveSource_FD13_UWBS2 0;
BA_ "GenSigTimeoutTime_EPS" SG_ 2654339259 StayActiveSource_FD13_UWBS2 0;
BA_ "GenSigTimeoutTime_ORC" SG_ 2654339259 StayActiveSource_FD13_UWBS2 0;
BA_ "GenSigTimeoutTime_PAM" SG_ 2654339259 StayActiveSource_FD13_UWBS2 0;
BA_ "GenSigTimeoutTime_SGW" SG_ 2654339259 StayActiveSource_FD13_UWBS2 0;
BA_ "GenSigTimeoutTime_TRSKM" SG_ 2654339259 StayActiveSource_FD13_UWBS2 0;
BA_ "GenSigTimeoutTime_BCM" SG_ 2654339259 WakeupSource_FD13_UWBS2 0;
BA_ "GenSigTimeoutTime_BSM2" SG_ 2654339259 WakeupSource_FD13_UWBS2 0;
BA_ "GenSigTimeoutTime_CADM2" SG_ 2654339259 WakeupSource_FD13_UWBS2 0;
BA_ "GenSigTimeoutTime_CVADAS" SG_ 2654339259 WakeupSource_FD13_UWBS2 0;
BA_ "GenSigTimeoutTime_EPS" SG_ 2654339259 WakeupSource_FD13_UWBS2 0;
BA_ "GenSigTimeoutTime_ORC" SG_ 2654339259 WakeupSource_FD13_UWBS2 0;
BA_ "GenSigTimeoutTime_PAM" SG_ 2654339259 WakeupSource_FD13_UWBS2 0;
BA_ "GenSigTimeoutTime_SGW" SG_ 2654339259 WakeupSource_FD13_UWBS2 0;
BA_ "GenSigTimeoutTime_TRSKM" SG_ 2654339259 WakeupSource_FD13_UWBS2 0;
BA_ "GenSigTimeoutTime_BCM" SG_ 2654339260 CurrentCanNMState_FD13_UWBS3 0;
BA_ "GenSigTimeoutTime_BSM2" SG_ 2654339260 CurrentCanNMState_FD13_UWBS3 0;
BA_ "GenSigTimeoutTime_CADM2" SG_ 2654339260 CurrentCanNMState_FD13_UWBS3 0;
BA_ "GenSigTimeoutTime_CVADAS" SG_ 2654339260 CurrentCanNMState_FD13_UWBS3 0;
BA_ "GenSigTimeoutTime_EPS" SG_ 2654339260 CurrentCanNMState_FD13_UWBS3 0;
BA_ "GenSigTimeoutTime_ORC" SG_ 2654339260 CurrentCanNMState_FD13_UWBS3 0;
BA_ "GenSigTimeoutTime_PAM" SG_ 2654339260 CurrentCanNMState_FD13_UWBS3 0;
BA_ "GenSigTimeoutTime_SGW" SG_ 2654339260 CurrentCanNMState_FD13_UWBS3 0;
BA_ "GenSigTimeoutTime_TRSKM" SG_ 2654339260 CurrentCanNMState_FD13_UWBS3 0;
BA_ "GenSigTimeoutTime_BCM" SG_ 2654339260 CurrentFailSts_FD13_UWBS3 0;
BA_ "GenSigTimeoutTime_BSM2" SG_ 2654339260 CurrentFailSts_FD13_UWBS3 0;
BA_ "GenSigTimeoutTime_CADM2" SG_ 2654339260 CurrentFailSts_FD13_UWBS3 0;
BA_ "GenSigTimeoutTime_CVADAS" SG_ 2654339260 CurrentFailSts_FD13_UWBS3 0;
BA_ "GenSigTimeoutTime_EPS" SG_ 2654339260 CurrentFailSts_FD13_UWBS3 0;
BA_ "GenSigTimeoutTime_ORC" SG_ 2654339260 CurrentFailSts_FD13_UWBS3 0;
BA_ "GenSigTimeoutTime_PAM" SG_ 2654339260 CurrentFailSts_FD13_UWBS3 0;
BA_ "GenSigTimeoutTime_SGW" SG_ 2654339260 CurrentFailSts_FD13_UWBS3 0;
BA_ "GenSigTimeoutTime_TRSKM" SG_ 2654339260 CurrentFailSts_FD13_UWBS3 0;
BA_ "GenSigTimeoutTime_BCM" SG_ 2654339260 DES_FD13_UWBS3 0;
BA_ "GenSigTimeoutTime_BSM2" SG_ 2654339260 DES_FD13_UWBS3 0;
BA_ "GenSigTimeoutTime_CADM2" SG_ 2654339260 DES_FD13_UWBS3 0;
BA_ "GenSigTimeoutTime_CVADAS" SG_ 2654339260 DES_FD13_UWBS3 0;
BA_ "GenSigTimeoutTime_EPS" SG_ 2654339260 DES_FD13_UWBS3 0;
BA_ "GenSigTimeoutTime_ORC" SG_ 2654339260 DES_FD13_UWBS3 0;
BA_ "GenSigTimeoutTime_PAM" SG_ 2654339260 DES_FD13_UWBS3 0;
BA_ "GenSigTimeoutTime_SGW" SG_ 2654339260 DES_FD13_UWBS3 0;
BA_ "GenSigTimeoutTime_TRSKM" SG_ 2654339260 DES_FD13_UWBS3 0;
BA_ "GenSigTimeoutTime_BCM" SG_ 2654339260 EOL_FD13_UWBS3 0;
BA_ "GenSigTimeoutTime_BSM2" SG_ 2654339260 EOL_FD13_UWBS3 0;
BA_ "GenSigTimeoutTime_CADM2" SG_ 2654339260 EOL_FD13_UWBS3 0;
BA_ "GenSigTimeoutTime_CVADAS" SG_ 2654339260 EOL_FD13_UWBS3 0;
BA_ "GenSigTimeoutTime_EPS" SG_ 2654339260 EOL_FD13_UWBS3 0;
BA_ "GenSigTimeoutTime_ORC" SG_ 2654339260 EOL_FD13_UWBS3 0;
BA_ "GenSigTimeoutTime_PAM" SG_ 2654339260 EOL_FD13_UWBS3 0;
BA_ "GenSigTimeoutTime_SGW" SG_ 2654339260 EOL_FD13_UWBS3 0;
BA_ "GenSigTimeoutTime_TRSKM" SG_ 2654339260 EOL_FD13_UWBS3 0;
BA_ "GenSigTimeoutTime_BCM" SG_ 2654339260 GenericFailSts_FD13_UWBS3 0;
BA_ "GenSigTimeoutTime_BSM2" SG_ 2654339260 GenericFailSts_FD13_UWBS3 0;
BA_ "GenSigTimeoutTime_CADM2" SG_ 2654339260 GenericFailSts_FD13_UWBS3 0;
BA_ "GenSigTimeoutTime_CVADAS" SG_ 2654339260 GenericFailSts_FD13_UWBS3 0;
BA_ "GenSigTimeoutTime_EPS" SG_ 2654339260 GenericFailSts_FD13_UWBS3 0;
BA_ "GenSigTimeoutTime_ORC" SG_ 2654339260 GenericFailSts_FD13_UWBS3 0;
BA_ "GenSigTimeoutTime_PAM" SG_ 2654339260 GenericFailSts_FD13_UWBS3 0;
BA_ "GenSigTimeoutTime_SGW" SG_ 2654339260 GenericFailSts_FD13_UWBS3 0;
BA_ "GenSigTimeoutTime_TRSKM" SG_ 2654339260 GenericFailSts_FD13_UWBS3 0;
BA_ "GenSigTimeoutTime_BCM" SG_ 2654339260 PreviousCanNMState_FD13_UWBS3 0;
BA_ "GenSigTimeoutTime_BSM2" SG_ 2654339260 PreviousCanNMState_FD13_UWBS3 0;
BA_ "GenSigTimeoutTime_CADM2" SG_ 2654339260 PreviousCanNMState_FD13_UWBS3 0;
BA_ "GenSigTimeoutTime_CVADAS" SG_ 2654339260 PreviousCanNMState_FD13_UWBS3 0;
BA_ "GenSigTimeoutTime_EPS" SG_ 2654339260 PreviousCanNMState_FD13_UWBS3 0;
BA_ "GenSigTimeoutTime_ORC" SG_ 2654339260 PreviousCanNMState_FD13_UWBS3 0;
BA_ "GenSigTimeoutTime_PAM" SG_ 2654339260 PreviousCanNMState_FD13_UWBS3 0;
BA_ "GenSigTimeoutTime_SGW" SG_ 2654339260 PreviousCanNMState_FD13_UWBS3 0;
BA_ "GenSigTimeoutTime_TRSKM" SG_ 2654339260 PreviousCanNMState_FD13_UWBS3 0;
BA_ "GenSigTimeoutTime_BCM" SG_ 2654339260 StayActiveSource_FD13_UWBS3 0;
BA_ "GenSigTimeoutTime_BSM2" SG_ 2654339260 StayActiveSource_FD13_UWBS3 0;
BA_ "GenSigTimeoutTime_CADM2" SG_ 2654339260 StayActiveSource_FD13_UWBS3 0;
BA_ "GenSigTimeoutTime_CVADAS" SG_ 2654339260 StayActiveSource_FD13_UWBS3 0;
BA_ "GenSigTimeoutTime_EPS" SG_ 2654339260 StayActiveSource_FD13_UWBS3 0;
BA_ "GenSigTimeoutTime_ORC" SG_ 2654339260 StayActiveSource_FD13_UWBS3 0;
BA_ "GenSigTimeoutTime_PAM" SG_ 2654339260 StayActiveSource_FD13_UWBS3 0;
BA_ "GenSigTimeoutTime_SGW" SG_ 2654339260 StayActiveSource_FD13_UWBS3 0;
BA_ "GenSigTimeoutTime_TRSKM" SG_ 2654339260 StayActiveSource_FD13_UWBS3 0;
BA_ "GenSigTimeoutTime_BCM" SG_ 2654339260 WakeupSource_FD13_UWBS3 0;
BA_ "GenSigTimeoutTime_BSM2" SG_ 2654339260 WakeupSource_FD13_UWBS3 0;
BA_ "GenSigTimeoutTime_CADM2" SG_ 2654339260 WakeupSource_FD13_UWBS3 0;
BA_ "GenSigTimeoutTime_CVADAS" SG_ 2654339260 WakeupSource_FD13_UWBS3 0;
BA_ "GenSigTimeoutTime_EPS" SG_ 2654339260 WakeupSource_FD13_UWBS3 0;
BA_ "GenSigTimeoutTime_ORC" SG_ 2654339260 WakeupSource_FD13_UWBS3 0;
BA_ "GenSigTimeoutTime_PAM" SG_ 2654339260 WakeupSource_FD13_UWBS3 0;
BA_ "GenSigTimeoutTime_SGW" SG_ 2654339260 WakeupSource_FD13_UWBS3 0;
BA_ "GenSigTimeoutTime_TRSKM" SG_ 2654339260 WakeupSource_FD13_UWBS3 0;
BA_ "GenSigTimeoutTime_BCM" SG_ 2654339261 CurrentCanNMState_FD13_UWBS4 0;
BA_ "GenSigTimeoutTime_BSM2" SG_ 2654339261 CurrentCanNMState_FD13_UWBS4 0;
BA_ "GenSigTimeoutTime_CADM2" SG_ 2654339261 CurrentCanNMState_FD13_UWBS4 0;
BA_ "GenSigTimeoutTime_CVADAS" SG_ 2654339261 CurrentCanNMState_FD13_UWBS4 0;
BA_ "GenSigTimeoutTime_EPS" SG_ 2654339261 CurrentCanNMState_FD13_UWBS4 0;
BA_ "GenSigTimeoutTime_ORC" SG_ 2654339261 CurrentCanNMState_FD13_UWBS4 0;
BA_ "GenSigTimeoutTime_PAM" SG_ 2654339261 CurrentCanNMState_FD13_UWBS4 0;
BA_ "GenSigTimeoutTime_SGW" SG_ 2654339261 CurrentCanNMState_FD13_UWBS4 0;
BA_ "GenSigTimeoutTime_TRSKM" SG_ 2654339261 CurrentCanNMState_FD13_UWBS4 0;
BA_ "GenSigTimeoutTime_BCM" SG_ 2654339261 CurrentFailSts_FD13_UWBS4 0;
BA_ "GenSigTimeoutTime_BSM2" SG_ 2654339261 CurrentFailSts_FD13_UWBS4 0;
BA_ "GenSigTimeoutTime_CADM2" SG_ 2654339261 CurrentFailSts_FD13_UWBS4 0;
BA_ "GenSigTimeoutTime_CVADAS" SG_ 2654339261 CurrentFailSts_FD13_UWBS4 0;
BA_ "GenSigTimeoutTime_EPS" SG_ 2654339261 CurrentFailSts_FD13_UWBS4 0;
BA_ "GenSigTimeoutTime_ORC" SG_ 2654339261 CurrentFailSts_FD13_UWBS4 0;
BA_ "GenSigTimeoutTime_PAM" SG_ 2654339261 CurrentFailSts_FD13_UWBS4 0;
BA_ "GenSigTimeoutTime_SGW" SG_ 2654339261 CurrentFailSts_FD13_UWBS4 0;
BA_ "GenSigTimeoutTime_TRSKM" SG_ 2654339261 CurrentFailSts_FD13_UWBS4 0;
BA_ "GenSigTimeoutTime_BCM" SG_ 2654339261 DES_FD13_UWBS4 0;
BA_ "GenSigTimeoutTime_BSM2" SG_ 2654339261 DES_FD13_UWBS4 0;
BA_ "GenSigTimeoutTime_CADM2" SG_ 2654339261 DES_FD13_UWBS4 0;
BA_ "GenSigTimeoutTime_CVADAS" SG_ 2654339261 DES_FD13_UWBS4 0;
BA_ "GenSigTimeoutTime_EPS" SG_ 2654339261 DES_FD13_UWBS4 0;
BA_ "GenSigTimeoutTime_ORC" SG_ 2654339261 DES_FD13_UWBS4 0;
BA_ "GenSigTimeoutTime_PAM" SG_ 2654339261 DES_FD13_UWBS4 0;
BA_ "GenSigTimeoutTime_SGW" SG_ 2654339261 DES_FD13_UWBS4 0;
BA_ "GenSigTimeoutTime_TRSKM" SG_ 2654339261 DES_FD13_UWBS4 0;
BA_ "GenSigTimeoutTime_BCM" SG_ 2654339261 EOL_FD13_UWBS4 0;
BA_ "GenSigTimeoutTime_BSM2" SG_ 2654339261 EOL_FD13_UWBS4 0;
BA_ "GenSigTimeoutTime_CADM2" SG_ 2654339261 EOL_FD13_UWBS4 0;
BA_ "GenSigTimeoutTime_CVADAS" SG_ 2654339261 EOL_FD13_UWBS4 0;
BA_ "GenSigTimeoutTime_EPS" SG_ 2654339261 EOL_FD13_UWBS4 0;
BA_ "GenSigTimeoutTime_ORC" SG_ 2654339261 EOL_FD13_UWBS4 0;
BA_ "GenSigTimeoutTime_PAM" SG_ 2654339261 EOL_FD13_UWBS4 0;
BA_ "GenSigTimeoutTime_SGW" SG_ 2654339261 EOL_FD13_UWBS4 0;
BA_ "GenSigTimeoutTime_TRSKM" SG_ 2654339261 EOL_FD13_UWBS4 0;
BA_ "GenSigTimeoutTime_BCM" SG_ 2654339261 GenericFailSts_FD13_UWBS4 0;
BA_ "GenSigTimeoutTime_BSM2" SG_ 2654339261 GenericFailSts_FD13_UWBS4 0;
BA_ "GenSigTimeoutTime_CADM2" SG_ 2654339261 GenericFailSts_FD13_UWBS4 0;
BA_ "GenSigTimeoutTime_CVADAS" SG_ 2654339261 GenericFailSts_FD13_UWBS4 0;
BA_ "GenSigTimeoutTime_EPS" SG_ 2654339261 GenericFailSts_FD13_UWBS4 0;
BA_ "GenSigTimeoutTime_ORC" SG_ 2654339261 GenericFailSts_FD13_UWBS4 0;
BA_ "GenSigTimeoutTime_PAM" SG_ 2654339261 GenericFailSts_FD13_UWBS4 0;
BA_ "GenSigTimeoutTime_SGW" SG_ 2654339261 GenericFailSts_FD13_UWBS4 0;
BA_ "GenSigTimeoutTime_TRSKM" SG_ 2654339261 GenericFailSts_FD13_UWBS4 0;
BA_ "GenSigTimeoutTime_BCM" SG_ 2654339261 PreviousCanNMState_FD13_UWBS4 0;
BA_ "GenSigTimeoutTime_BSM2" SG_ 2654339261 PreviousCanNMState_FD13_UWBS4 0;
BA_ "GenSigTimeoutTime_CADM2" SG_ 2654339261 PreviousCanNMState_FD13_UWBS4 0;
BA_ "GenSigTimeoutTime_CVADAS" SG_ 2654339261 PreviousCanNMState_FD13_UWBS4 0;
BA_ "GenSigTimeoutTime_EPS" SG_ 2654339261 PreviousCanNMState_FD13_UWBS4 0;
BA_ "GenSigTimeoutTime_ORC" SG_ 2654339261 PreviousCanNMState_FD13_UWBS4 0;
BA_ "GenSigTimeoutTime_PAM" SG_ 2654339261 PreviousCanNMState_FD13_UWBS4 0;
BA_ "GenSigTimeoutTime_SGW" SG_ 2654339261 PreviousCanNMState_FD13_UWBS4 0;
BA_ "GenSigTimeoutTime_TRSKM" SG_ 2654339261 PreviousCanNMState_FD13_UWBS4 0;
BA_ "GenSigTimeoutTime_BCM" SG_ 2654339261 StayActiveSource_FD13_UWBS4 0;
BA_ "GenSigTimeoutTime_BSM2" SG_ 2654339261 StayActiveSource_FD13_UWBS4 0;
BA_ "GenSigTimeoutTime_CADM2" SG_ 2654339261 StayActiveSource_FD13_UWBS4 0;
BA_ "GenSigTimeoutTime_CVADAS" SG_ 2654339261 StayActiveSource_FD13_UWBS4 0;
BA_ "GenSigTimeoutTime_EPS" SG_ 2654339261 StayActiveSource_FD13_UWBS4 0;
BA_ "GenSigTimeoutTime_ORC" SG_ 2654339261 StayActiveSource_FD13_UWBS4 0;
BA_ "GenSigTimeoutTime_PAM" SG_ 2654339261 StayActiveSource_FD13_UWBS4 0;
BA_ "GenSigTimeoutTime_SGW" SG_ 2654339261 StayActiveSource_FD13_UWBS4 0;
BA_ "GenSigTimeoutTime_TRSKM" SG_ 2654339261 StayActiveSource_FD13_UWBS4 0;
BA_ "GenSigTimeoutTime_BCM" SG_ 2654339261 WakeupSource_FD13_UWBS4 0;
BA_ "GenSigTimeoutTime_BSM2" SG_ 2654339261 WakeupSource_FD13_UWBS4 0;
BA_ "GenSigTimeoutTime_CADM2" SG_ 2654339261 WakeupSource_FD13_UWBS4 0;
BA_ "GenSigTimeoutTime_CVADAS" SG_ 2654339261 WakeupSource_FD13_UWBS4 0;
BA_ "GenSigTimeoutTime_EPS" SG_ 2654339261 WakeupSource_FD13_UWBS4 0;
BA_ "GenSigTimeoutTime_ORC" SG_ 2654339261 WakeupSource_FD13_UWBS4 0;
BA_ "GenSigTimeoutTime_PAM" SG_ 2654339261 WakeupSource_FD13_UWBS4 0;
BA_ "GenSigTimeoutTime_SGW" SG_ 2654339261 WakeupSource_FD13_UWBS4 0;
BA_ "GenSigTimeoutTime_TRSKM" SG_ 2654339261 WakeupSource_FD13_UWBS4 0;
BA_ "GenSigTimeoutTime_BCM" SG_ 2654339262 CurrentCanNMState_FD13_UWBS5 0;
BA_ "GenSigTimeoutTime_BSM2" SG_ 2654339262 CurrentCanNMState_FD13_UWBS5 0;
BA_ "GenSigTimeoutTime_CADM2" SG_ 2654339262 CurrentCanNMState_FD13_UWBS5 0;
BA_ "GenSigTimeoutTime_CVADAS" SG_ 2654339262 CurrentCanNMState_FD13_UWBS5 0;
BA_ "GenSigTimeoutTime_EPS" SG_ 2654339262 CurrentCanNMState_FD13_UWBS5 0;
BA_ "GenSigTimeoutTime_ORC" SG_ 2654339262 CurrentCanNMState_FD13_UWBS5 0;
BA_ "GenSigTimeoutTime_PAM" SG_ 2654339262 CurrentCanNMState_FD13_UWBS5 0;
BA_ "GenSigTimeoutTime_SGW" SG_ 2654339262 CurrentCanNMState_FD13_UWBS5 0;
BA_ "GenSigTimeoutTime_TRSKM" SG_ 2654339262 CurrentCanNMState_FD13_UWBS5 0;
BA_ "GenSigTimeoutTime_BCM" SG_ 2654339262 CurrentFailSts_FD13_UWBS5 0;
BA_ "GenSigTimeoutTime_BSM2" SG_ 2654339262 CurrentFailSts_FD13_UWBS5 0;
BA_ "GenSigTimeoutTime_CADM2" SG_ 2654339262 CurrentFailSts_FD13_UWBS5 0;
BA_ "GenSigTimeoutTime_CVADAS" SG_ 2654339262 CurrentFailSts_FD13_UWBS5 0;
BA_ "GenSigTimeoutTime_EPS" SG_ 2654339262 CurrentFailSts_FD13_UWBS5 0;
BA_ "GenSigTimeoutTime_ORC" SG_ 2654339262 CurrentFailSts_FD13_UWBS5 0;
BA_ "GenSigTimeoutTime_PAM" SG_ 2654339262 CurrentFailSts_FD13_UWBS5 0;
BA_ "GenSigTimeoutTime_SGW" SG_ 2654339262 CurrentFailSts_FD13_UWBS5 0;
BA_ "GenSigTimeoutTime_TRSKM" SG_ 2654339262 CurrentFailSts_FD13_UWBS5 0;
BA_ "GenSigTimeoutTime_BCM" SG_ 2654339262 DES_FD13_UWBS5 0;
BA_ "GenSigTimeoutTime_BSM2" SG_ 2654339262 DES_FD13_UWBS5 0;
BA_ "GenSigTimeoutTime_CADM2" SG_ 2654339262 DES_FD13_UWBS5 0;
BA_ "GenSigTimeoutTime_CVADAS" SG_ 2654339262 DES_FD13_UWBS5 0;
BA_ "GenSigTimeoutTime_EPS" SG_ 2654339262 DES_FD13_UWBS5 0;
BA_ "GenSigTimeoutTime_ORC" SG_ 2654339262 DES_FD13_UWBS5 0;
BA_ "GenSigTimeoutTime_PAM" SG_ 2654339262 DES_FD13_UWBS5 0;
BA_ "GenSigTimeoutTime_SGW" SG_ 2654339262 DES_FD13_UWBS5 0;
BA_ "GenSigTimeoutTime_TRSKM" SG_ 2654339262 DES_FD13_UWBS5 0;
BA_ "GenSigTimeoutTime_BCM" SG_ 2654339262 EOL_FD13_UWBS5 0;
BA_ "GenSigTimeoutTime_BSM2" SG_ 2654339262 EOL_FD13_UWBS5 0;
BA_ "GenSigTimeoutTime_CADM2" SG_ 2654339262 EOL_FD13_UWBS5 0;
BA_ "GenSigTimeoutTime_CVADAS" SG_ 2654339262 EOL_FD13_UWBS5 0;
BA_ "GenSigTimeoutTime_EPS" SG_ 2654339262 EOL_FD13_UWBS5 0;
BA_ "GenSigTimeoutTime_ORC" SG_ 2654339262 EOL_FD13_UWBS5 0;
BA_ "GenSigTimeoutTime_PAM" SG_ 2654339262 EOL_FD13_UWBS5 0;
BA_ "GenSigTimeoutTime_SGW" SG_ 2654339262 EOL_FD13_UWBS5 0;
BA_ "GenSigTimeoutTime_TRSKM" SG_ 2654339262 EOL_FD13_UWBS5 0;
BA_ "GenSigTimeoutTime_BCM" SG_ 2654339262 GenericFailSts_FD13_UWBS5 0;
BA_ "GenSigTimeoutTime_BSM2" SG_ 2654339262 GenericFailSts_FD13_UWBS5 0;
BA_ "GenSigTimeoutTime_CADM2" SG_ 2654339262 GenericFailSts_FD13_UWBS5 0;
BA_ "GenSigTimeoutTime_CVADAS" SG_ 2654339262 GenericFailSts_FD13_UWBS5 0;
BA_ "GenSigTimeoutTime_EPS" SG_ 2654339262 GenericFailSts_FD13_UWBS5 0;
BA_ "GenSigTimeoutTime_ORC" SG_ 2654339262 GenericFailSts_FD13_UWBS5 0;
BA_ "GenSigTimeoutTime_PAM" SG_ 2654339262 GenericFailSts_FD13_UWBS5 0;
BA_ "GenSigTimeoutTime_SGW" SG_ 2654339262 GenericFailSts_FD13_UWBS5 0;
BA_ "GenSigTimeoutTime_TRSKM" SG_ 2654339262 GenericFailSts_FD13_UWBS5 0;
BA_ "GenSigTimeoutTime_BCM" SG_ 2654339262 PreviousCanNMState_FD13_UWBS5 0;
BA_ "GenSigTimeoutTime_BSM2" SG_ 2654339262 PreviousCanNMState_FD13_UWBS5 0;
BA_ "GenSigTimeoutTime_CADM2" SG_ 2654339262 PreviousCanNMState_FD13_UWBS5 0;
BA_ "GenSigTimeoutTime_CVADAS" SG_ 2654339262 PreviousCanNMState_FD13_UWBS5 0;
BA_ "GenSigTimeoutTime_EPS" SG_ 2654339262 PreviousCanNMState_FD13_UWBS5 0;
BA_ "GenSigTimeoutTime_ORC" SG_ 2654339262 PreviousCanNMState_FD13_UWBS5 0;
BA_ "GenSigTimeoutTime_PAM" SG_ 2654339262 PreviousCanNMState_FD13_UWBS5 0;
BA_ "GenSigTimeoutTime_SGW" SG_ 2654339262 PreviousCanNMState_FD13_UWBS5 0;
BA_ "GenSigTimeoutTime_TRSKM" SG_ 2654339262 PreviousCanNMState_FD13_UWBS5 0;
BA_ "GenSigTimeoutTime_BCM" SG_ 2654339262 StayActiveSource_FD13_UWBS5 0;
BA_ "GenSigTimeoutTime_BSM2" SG_ 2654339262 StayActiveSource_FD13_UWBS5 0;
BA_ "GenSigTimeoutTime_CADM2" SG_ 2654339262 StayActiveSource_FD13_UWBS5 0;
BA_ "GenSigTimeoutTime_CVADAS" SG_ 2654339262 StayActiveSource_FD13_UWBS5 0;
BA_ "GenSigTimeoutTime_EPS" SG_ 2654339262 StayActiveSource_FD13_UWBS5 0;
BA_ "GenSigTimeoutTime_ORC" SG_ 2654339262 StayActiveSource_FD13_UWBS5 0;
BA_ "GenSigTimeoutTime_PAM" SG_ 2654339262 StayActiveSource_FD13_UWBS5 0;
BA_ "GenSigTimeoutTime_SGW" SG_ 2654339262 StayActiveSource_FD13_UWBS5 0;
BA_ "GenSigTimeoutTime_TRSKM" SG_ 2654339262 StayActiveSource_FD13_UWBS5 0;
BA_ "GenSigTimeoutTime_BCM" SG_ 2654339262 WakeupSource_FD13_UWBS5 0;
BA_ "GenSigTimeoutTime_BSM2" SG_ 2654339262 WakeupSource_FD13_UWBS5 0;
BA_ "GenSigTimeoutTime_CADM2" SG_ 2654339262 WakeupSource_FD13_UWBS5 0;
BA_ "GenSigTimeoutTime_CVADAS" SG_ 2654339262 WakeupSource_FD13_UWBS5 0;
BA_ "GenSigTimeoutTime_EPS" SG_ 2654339262 WakeupSource_FD13_UWBS5 0;
BA_ "GenSigTimeoutTime_ORC" SG_ 2654339262 WakeupSource_FD13_UWBS5 0;
BA_ "GenSigTimeoutTime_PAM" SG_ 2654339262 WakeupSource_FD13_UWBS5 0;
BA_ "GenSigTimeoutTime_SGW" SG_ 2654339262 WakeupSource_FD13_UWBS5 0;
BA_ "GenSigTimeoutTime_TRSKM" SG_ 2654339262 WakeupSource_FD13_UWBS5 0;
BA_ "GenSigTimeoutTime_BCM" SG_ 2654339199 CurrentCanNMState_FD08_VRM 0;
BA_ "GenSigTimeoutTime_BSM2" SG_ 2654339199 CurrentCanNMState_FD08_VRM 0;
BA_ "GenSigTimeoutTime_CADM2" SG_ 2654339199 CurrentCanNMState_FD08_VRM 0;
BA_ "GenSigTimeoutTime_CVADAS" SG_ 2654339199 CurrentCanNMState_FD08_VRM 0;
BA_ "GenSigTimeoutTime_EPS" SG_ 2654339199 CurrentCanNMState_FD08_VRM 0;
BA_ "GenSigTimeoutTime_ORC" SG_ 2654339199 CurrentCanNMState_FD08_VRM 0;
BA_ "GenSigTimeoutTime_PAM" SG_ 2654339199 CurrentCanNMState_FD08_VRM 0;
BA_ "GenSigTimeoutTime_SGW" SG_ 2654339199 CurrentCanNMState_FD08_VRM 0;
BA_ "GenSigTimeoutTime_TRSKM" SG_ 2654339199 CurrentCanNMState_FD08_VRM 0;
BA_ "GenSigTimeoutTime_BCM" SG_ 2654339199 CurrentFailSts_FD08_VRM 0;
BA_ "GenSigTimeoutTime_BSM2" SG_ 2654339199 CurrentFailSts_FD08_VRM 0;
BA_ "GenSigTimeoutTime_CADM2" SG_ 2654339199 CurrentFailSts_FD08_VRM 0;
BA_ "GenSigTimeoutTime_CVADAS" SG_ 2654339199 CurrentFailSts_FD08_VRM 0;
BA_ "GenSigTimeoutTime_EPS" SG_ 2654339199 CurrentFailSts_FD08_VRM 0;
BA_ "GenSigTimeoutTime_ORC" SG_ 2654339199 CurrentFailSts_FD08_VRM 0;
BA_ "GenSigTimeoutTime_PAM" SG_ 2654339199 CurrentFailSts_FD08_VRM 0;
BA_ "GenSigTimeoutTime_SGW" SG_ 2654339199 CurrentFailSts_FD08_VRM 0;
BA_ "GenSigTimeoutTime_TRSKM" SG_ 2654339199 CurrentFailSts_FD08_VRM 0;
BA_ "GenSigTimeoutTime_BCM" SG_ 2654339199 DES_FD08_VRM 0;
BA_ "GenSigTimeoutTime_BSM2" SG_ 2654339199 DES_FD08_VRM 0;
BA_ "GenSigTimeoutTime_CADM2" SG_ 2654339199 DES_FD08_VRM 0;
BA_ "GenSigTimeoutTime_CVADAS" SG_ 2654339199 DES_FD08_VRM 0;
BA_ "GenSigTimeoutTime_EPS" SG_ 2654339199 DES_FD08_VRM 0;
BA_ "GenSigTimeoutTime_ORC" SG_ 2654339199 DES_FD08_VRM 0;
BA_ "GenSigTimeoutTime_PAM" SG_ 2654339199 DES_FD08_VRM 0;
BA_ "GenSigTimeoutTime_SGW" SG_ 2654339199 DES_FD08_VRM 0;
BA_ "GenSigTimeoutTime_TRSKM" SG_ 2654339199 DES_FD08_VRM 0;
BA_ "GenSigTimeoutTime_BCM" SG_ 2654339199 EOL_FD08_VRM 0;
BA_ "GenSigTimeoutTime_BSM2" SG_ 2654339199 EOL_FD08_VRM 0;
BA_ "GenSigTimeoutTime_CADM2" SG_ 2654339199 EOL_FD08_VRM 0;
BA_ "GenSigTimeoutTime_CVADAS" SG_ 2654339199 EOL_FD08_VRM 0;
BA_ "GenSigTimeoutTime_EPS" SG_ 2654339199 EOL_FD08_VRM 0;
BA_ "GenSigTimeoutTime_ORC" SG_ 2654339199 EOL_FD08_VRM 0;
BA_ "GenSigTimeoutTime_PAM" SG_ 2654339199 EOL_FD08_VRM 0;
BA_ "GenSigTimeoutTime_SGW" SG_ 2654339199 EOL_FD08_VRM 0;
BA_ "GenSigTimeoutTime_TRSKM" SG_ 2654339199 EOL_FD08_VRM 0;
BA_ "GenSigTimeoutTime_BCM" SG_ 2654339199 GenericFailSts_FD08_VRM 0;
BA_ "GenSigTimeoutTime_BSM2" SG_ 2654339199 GenericFailSts_FD08_VRM 0;
BA_ "GenSigTimeoutTime_CADM2" SG_ 2654339199 GenericFailSts_FD08_VRM 0;
BA_ "GenSigTimeoutTime_CVADAS" SG_ 2654339199 GenericFailSts_FD08_VRM 0;
BA_ "GenSigTimeoutTime_EPS" SG_ 2654339199 GenericFailSts_FD08_VRM 0;
BA_ "GenSigTimeoutTime_ORC" SG_ 2654339199 GenericFailSts_FD08_VRM 0;
BA_ "GenSigTimeoutTime_PAM" SG_ 2654339199 GenericFailSts_FD08_VRM 0;
BA_ "GenSigTimeoutTime_SGW" SG_ 2654339199 GenericFailSts_FD08_VRM 0;
BA_ "GenSigTimeoutTime_TRSKM" SG_ 2654339199 GenericFailSts_FD08_VRM 0;
BA_ "GenSigTimeoutTime_BCM" SG_ 2654339199 PreviousCanNMState_FD08_VRM 0;
BA_ "GenSigTimeoutTime_BSM2" SG_ 2654339199 PreviousCanNMState_FD08_VRM 0;
BA_ "GenSigTimeoutTime_CADM2" SG_ 2654339199 PreviousCanNMState_FD08_VRM 0;
BA_ "GenSigTimeoutTime_CVADAS" SG_ 2654339199 PreviousCanNMState_FD08_VRM 0;
BA_ "GenSigTimeoutTime_EPS" SG_ 2654339199 PreviousCanNMState_FD08_VRM 0;
BA_ "GenSigTimeoutTime_ORC" SG_ 2654339199 PreviousCanNMState_FD08_VRM 0;
BA_ "GenSigTimeoutTime_PAM" SG_ 2654339199 PreviousCanNMState_FD08_VRM 0;
BA_ "GenSigTimeoutTime_SGW" SG_ 2654339199 PreviousCanNMState_FD08_VRM 0;
BA_ "GenSigTimeoutTime_TRSKM" SG_ 2654339199 PreviousCanNMState_FD08_VRM 0;
BA_ "GenSigTimeoutTime_BCM" SG_ 2654339199 StayActiveSource_FD08_VRM 0;
BA_ "GenSigTimeoutTime_BSM2" SG_ 2654339199 StayActiveSource_FD08_VRM 0;
BA_ "GenSigTimeoutTime_CADM2" SG_ 2654339199 StayActiveSource_FD08_VRM 0;
BA_ "GenSigTimeoutTime_CVADAS" SG_ 2654339199 StayActiveSource_FD08_VRM 0;
BA_ "GenSigTimeoutTime_EPS" SG_ 2654339199 StayActiveSource_FD08_VRM 0;
BA_ "GenSigTimeoutTime_ORC" SG_ 2654339199 StayActiveSource_FD08_VRM 0;
BA_ "GenSigTimeoutTime_PAM" SG_ 2654339199 StayActiveSource_FD08_VRM 0;
BA_ "GenSigTimeoutTime_SGW" SG_ 2654339199 StayActiveSource_FD08_VRM 0;
BA_ "GenSigTimeoutTime_TRSKM" SG_ 2654339199 StayActiveSource_FD08_VRM 0;
BA_ "GenSigTimeoutTime_BCM" SG_ 2654339199 WakeupSource_FD08_VRM 0;
BA_ "GenSigTimeoutTime_BSM2" SG_ 2654339199 WakeupSource_FD08_VRM 0;
BA_ "GenSigTimeoutTime_CADM2" SG_ 2654339199 WakeupSource_FD08_VRM 0;
BA_ "GenSigTimeoutTime_CVADAS" SG_ 2654339199 WakeupSource_FD08_VRM 0;
BA_ "GenSigTimeoutTime_EPS" SG_ 2654339199 WakeupSource_FD08_VRM 0;
BA_ "GenSigTimeoutTime_ORC" SG_ 2654339199 WakeupSource_FD08_VRM 0;
BA_ "GenSigTimeoutTime_PAM" SG_ 2654339199 WakeupSource_FD08_VRM 0;
BA_ "GenSigTimeoutTime_SGW" SG_ 2654339199 WakeupSource_FD08_VRM 0;
BA_ "GenSigTimeoutTime_TRSKM" SG_ 2654339199 WakeupSource_FD08_VRM 0;
BA_ "GenSigTimeoutTime_BCM" SG_ 2654339257 CurrentCanNMState_FD09_WCPM2 0;
BA_ "GenSigTimeoutTime_BSM2" SG_ 2654339257 CurrentCanNMState_FD09_WCPM2 0;
BA_ "GenSigTimeoutTime_CADM2" SG_ 2654339257 CurrentCanNMState_FD09_WCPM2 0;
BA_ "GenSigTimeoutTime_CVADAS" SG_ 2654339257 CurrentCanNMState_FD09_WCPM2 0;
BA_ "GenSigTimeoutTime_EPS" SG_ 2654339257 CurrentCanNMState_FD09_WCPM2 0;
BA_ "GenSigTimeoutTime_ORC" SG_ 2654339257 CurrentCanNMState_FD09_WCPM2 0;
BA_ "GenSigTimeoutTime_PAM" SG_ 2654339257 CurrentCanNMState_FD09_WCPM2 0;
BA_ "GenSigTimeoutTime_SGW" SG_ 2654339257 CurrentCanNMState_FD09_WCPM2 0;
BA_ "GenSigTimeoutTime_TRSKM" SG_ 2654339257 CurrentCanNMState_FD09_WCPM2 0;
BA_ "GenSigTimeoutTime_BCM" SG_ 2654339257 CurrentFailSts_FD09_WCPM2 0;
BA_ "GenSigTimeoutTime_BSM2" SG_ 2654339257 CurrentFailSts_FD09_WCPM2 0;
BA_ "GenSigTimeoutTime_CADM2" SG_ 2654339257 CurrentFailSts_FD09_WCPM2 0;
BA_ "GenSigTimeoutTime_CVADAS" SG_ 2654339257 CurrentFailSts_FD09_WCPM2 0;
BA_ "GenSigTimeoutTime_EPS" SG_ 2654339257 CurrentFailSts_FD09_WCPM2 0;
BA_ "GenSigTimeoutTime_ORC" SG_ 2654339257 CurrentFailSts_FD09_WCPM2 0;
BA_ "GenSigTimeoutTime_PAM" SG_ 2654339257 CurrentFailSts_FD09_WCPM2 0;
BA_ "GenSigTimeoutTime_SGW" SG_ 2654339257 CurrentFailSts_FD09_WCPM2 0;
BA_ "GenSigTimeoutTime_TRSKM" SG_ 2654339257 CurrentFailSts_FD09_WCPM2 0;
BA_ "GenSigTimeoutTime_BCM" SG_ 2654339257 DES_FD09_WCPM2 0;
BA_ "GenSigTimeoutTime_BSM2" SG_ 2654339257 DES_FD09_WCPM2 0;
BA_ "GenSigTimeoutTime_CADM2" SG_ 2654339257 DES_FD09_WCPM2 0;
BA_ "GenSigTimeoutTime_CVADAS" SG_ 2654339257 DES_FD09_WCPM2 0;
BA_ "GenSigTimeoutTime_EPS" SG_ 2654339257 DES_FD09_WCPM2 0;
BA_ "GenSigTimeoutTime_ORC" SG_ 2654339257 DES_FD09_WCPM2 0;
BA_ "GenSigTimeoutTime_PAM" SG_ 2654339257 DES_FD09_WCPM2 0;
BA_ "GenSigTimeoutTime_SGW" SG_ 2654339257 DES_FD09_WCPM2 0;
BA_ "GenSigTimeoutTime_TRSKM" SG_ 2654339257 DES_FD09_WCPM2 0;
BA_ "GenSigTimeoutTime_BCM" SG_ 2654339257 EOL_FD09_WCPM2 0;
BA_ "GenSigTimeoutTime_BSM2" SG_ 2654339257 EOL_FD09_WCPM2 0;
BA_ "GenSigTimeoutTime_CADM2" SG_ 2654339257 EOL_FD09_WCPM2 0;
BA_ "GenSigTimeoutTime_CVADAS" SG_ 2654339257 EOL_FD09_WCPM2 0;
BA_ "GenSigTimeoutTime_EPS" SG_ 2654339257 EOL_FD09_WCPM2 0;
BA_ "GenSigTimeoutTime_ORC" SG_ 2654339257 EOL_FD09_WCPM2 0;
BA_ "GenSigTimeoutTime_PAM" SG_ 2654339257 EOL_FD09_WCPM2 0;
BA_ "GenSigTimeoutTime_SGW" SG_ 2654339257 EOL_FD09_WCPM2 0;
BA_ "GenSigTimeoutTime_TRSKM" SG_ 2654339257 EOL_FD09_WCPM2 0;
BA_ "GenSigTimeoutTime_BCM" SG_ 2654339257 GenericFailSts_FD09_WCPM2 0;
BA_ "GenSigTimeoutTime_BSM2" SG_ 2654339257 GenericFailSts_FD09_WCPM2 0;
BA_ "GenSigTimeoutTime_CADM2" SG_ 2654339257 GenericFailSts_FD09_WCPM2 0;
BA_ "GenSigTimeoutTime_CVADAS" SG_ 2654339257 GenericFailSts_FD09_WCPM2 0;
BA_ "GenSigTimeoutTime_EPS" SG_ 2654339257 GenericFailSts_FD09_WCPM2 0;
BA_ "GenSigTimeoutTime_ORC" SG_ 2654339257 GenericFailSts_FD09_WCPM2 0;
BA_ "GenSigTimeoutTime_PAM" SG_ 2654339257 GenericFailSts_FD09_WCPM2 0;
BA_ "GenSigTimeoutTime_SGW" SG_ 2654339257 GenericFailSts_FD09_WCPM2 0;
BA_ "GenSigTimeoutTime_TRSKM" SG_ 2654339257 GenericFailSts_FD09_WCPM2 0;
BA_ "GenSigTimeoutTime_BCM" SG_ 2654339257 PreviousCanNMState_FD09_WCPM2 0;
BA_ "GenSigTimeoutTime_BSM2" SG_ 2654339257 PreviousCanNMState_FD09_WCPM2 0;
BA_ "GenSigTimeoutTime_CADM2" SG_ 2654339257 PreviousCanNMState_FD09_WCPM2 0;
BA_ "GenSigTimeoutTime_CVADAS" SG_ 2654339257 PreviousCanNMState_FD09_WCPM2 0;
BA_ "GenSigTimeoutTime_EPS" SG_ 2654339257 PreviousCanNMState_FD09_WCPM2 0;
BA_ "GenSigTimeoutTime_ORC" SG_ 2654339257 PreviousCanNMState_FD09_WCPM2 0;
BA_ "GenSigTimeoutTime_PAM" SG_ 2654339257 PreviousCanNMState_FD09_WCPM2 0;
BA_ "GenSigTimeoutTime_SGW" SG_ 2654339257 PreviousCanNMState_FD09_WCPM2 0;
BA_ "GenSigTimeoutTime_TRSKM" SG_ 2654339257 PreviousCanNMState_FD09_WCPM2 0;
BA_ "GenSigTimeoutTime_BCM" SG_ 2654339257 StayActiveSource_FD09_WCPM2 0;
BA_ "GenSigTimeoutTime_BSM2" SG_ 2654339257 StayActiveSource_FD09_WCPM2 0;
BA_ "GenSigTimeoutTime_CADM2" SG_ 2654339257 StayActiveSource_FD09_WCPM2 0;
BA_ "GenSigTimeoutTime_CVADAS" SG_ 2654339257 StayActiveSource_FD09_WCPM2 0;
BA_ "GenSigTimeoutTime_EPS" SG_ 2654339257 StayActiveSource_FD09_WCPM2 0;
BA_ "GenSigTimeoutTime_ORC" SG_ 2654339257 StayActiveSource_FD09_WCPM2 0;
BA_ "GenSigTimeoutTime_PAM" SG_ 2654339257 StayActiveSource_FD09_WCPM2 0;
BA_ "GenSigTimeoutTime_SGW" SG_ 2654339257 StayActiveSource_FD09_WCPM2 0;
BA_ "GenSigTimeoutTime_TRSKM" SG_ 2654339257 StayActiveSource_FD09_WCPM2 0;
BA_ "GenSigTimeoutTime_BCM" SG_ 2654339257 WakeupSource_FD09_WCPM2 0;
BA_ "GenSigTimeoutTime_BSM2" SG_ 2654339257 WakeupSource_FD09_WCPM2 0;
BA_ "GenSigTimeoutTime_CADM2" SG_ 2654339257 WakeupSource_FD09_WCPM2 0;
BA_ "GenSigTimeoutTime_CVADAS" SG_ 2654339257 WakeupSource_FD09_WCPM2 0;
BA_ "GenSigTimeoutTime_EPS" SG_ 2654339257 WakeupSource_FD09_WCPM2 0;
BA_ "GenSigTimeoutTime_ORC" SG_ 2654339257 WakeupSource_FD09_WCPM2 0;
BA_ "GenSigTimeoutTime_PAM" SG_ 2654339257 WakeupSource_FD09_WCPM2 0;
BA_ "GenSigTimeoutTime_SGW" SG_ 2654339257 WakeupSource_FD09_WCPM2 0;
BA_ "GenSigTimeoutTime_TRSKM" SG_ 2654339257 WakeupSource_FD09_WCPM2 0;
BA_ "GenSigTimeoutTime_BCM" SG_ 255 ACC_NCC_TrqEnblRq_Allowed 0;
BA_ "GenSigTimeoutTime_BSM2" SG_ 255 ACC_NCC_TrqEnblRq_Allowed 0;
BA_ "GenSigTimeoutTime_CADM2" SG_ 255 ACC_NCC_TrqEnblRq_Allowed 0;
BA_ "GenSigTimeoutTime_CVADAS" SG_ 255 ACC_NCC_TrqEnblRq_Allowed 0;
BA_ "GenSigTimeoutTime_EPS" SG_ 255 ACC_NCC_TrqEnblRq_Allowed 0;
BA_ "GenSigTimeoutTime_PAM" SG_ 255 ACC_NCC_TrqEnblRq_Allowed 0;
BA_ "GenSigTimeoutTime_SGW" SG_ 255 ACC_NCC_TrqEnblRq_Allowed 0;
BA_ "GenSigTimeoutTime_TRSKM" SG_ 255 ACC_NCC_TrqEnblRq_Allowed 0;
BA_ "GenSigTimeoutTime_BCM" SG_ 255 Accel_Pedal_Override 0;
BA_ "GenSigTimeoutTime_CVADAS" SG_ 255 Accel_Pedal_Override 0;
BA_ "GenSigTimeoutTime_EPS" SG_ 255 Accel_Pedal_Override 0;
BA_ "GenSigTimeoutTime_ORC" SG_ 255 Accel_Pedal_Override 0;
BA_ "GenSigTimeoutTime_PAM" SG_ 255 Accel_Pedal_Override 0;
BA_ "GenSigTimeoutTime_SGW" SG_ 255 Accel_Pedal_Override 0;
BA_ "GenSigTimeoutTime_TRSKM" SG_ 255 Accel_Pedal_Override 0;
BA_ "GenSigTimeoutTime_BCM" SG_ 255 SumTorque_DrvReqMod 0;
BA_ "GenSigTimeoutTime_BSM2" SG_ 255 SumTorque_DrvReqMod 0;
BA_ "GenSigTimeoutTime_CADM2" SG_ 255 SumTorque_DrvReqMod 0;
BA_ "GenSigTimeoutTime_CVADAS" SG_ 255 SumTorque_DrvReqMod 0;
BA_ "GenSigTimeoutTime_EPS" SG_ 255 SumTorque_DrvReqMod 0;
BA_ "GenSigTimeoutTime_PAM" SG_ 255 SumTorque_DrvReqMod 0;
BA_ "GenSigTimeoutTime_SGW" SG_ 255 SumTorque_DrvReqMod 0;
BA_ "GenSigTimeoutTime_TRSKM" SG_ 255 SumTorque_DrvReqMod 0;
BA_ "GenSigStartValue" SG_ 255 Total_AxleTorque_Static 32767;
BA_ "GenSigTimeoutTime_BCM" SG_ 255 Total_AxleTorque_Static 0;
BA_ "GenSigTimeoutTime_BSM2" SG_ 255 Total_AxleTorque_Static 0;
BA_ "GenSigTimeoutTime_CADM2" SG_ 255 Total_AxleTorque_Static 0;
BA_ "GenSigTimeoutTime_CVADAS" SG_ 255 Total_AxleTorque_Static 0;
BA_ "GenSigTimeoutTime_EPS" SG_ 255 Total_AxleTorque_Static 0;
BA_ "GenSigTimeoutTime_PAM" SG_ 255 Total_AxleTorque_Static 0;
BA_ "GenSigTimeoutTime_SGW" SG_ 255 Total_AxleTorque_Static 0;
BA_ "GenSigTimeoutTime_TRSKM" SG_ 255 Total_AxleTorque_Static 0;
BA_ "GenSigSendType" SG_ 1876 InflationState_LHF_Tyre 4;
BA_ "GenSigTimeoutTime_BCM" SG_ 1876 InflationState_LHF_Tyre 0;
BA_ "GenSigTimeoutTime_BSM2" SG_ 1876 InflationState_LHF_Tyre 0;
BA_ "GenSigTimeoutTime_CADM2" SG_ 1876 InflationState_LHF_Tyre 0;
BA_ "GenSigTimeoutTime_CVADAS" SG_ 1876 InflationState_LHF_Tyre 0;
BA_ "GenSigTimeoutTime_EPS" SG_ 1876 InflationState_LHF_Tyre 0;
BA_ "GenSigTimeoutTime_PAM" SG_ 1876 InflationState_LHF_Tyre 0;
BA_ "GenSigTimeoutTime_SGW" SG_ 1876 InflationState_LHF_Tyre 0;
BA_ "GenSigTimeoutTime_TRSKM" SG_ 1876 InflationState_LHF_Tyre 0;
BA_ "GenSigSendType" SG_ 1876 InflationState_LHR_Tyre 4;
BA_ "GenSigTimeoutTime_BCM" SG_ 1876 InflationState_LHR_Tyre 0;
BA_ "GenSigTimeoutTime_BSM2" SG_ 1876 InflationState_LHR_Tyre 0;
BA_ "GenSigTimeoutTime_CADM2" SG_ 1876 InflationState_LHR_Tyre 0;
BA_ "GenSigTimeoutTime_CVADAS" SG_ 1876 InflationState_LHR_Tyre 0;
BA_ "GenSigTimeoutTime_EPS" SG_ 1876 InflationState_LHR_Tyre 0;
BA_ "GenSigTimeoutTime_PAM" SG_ 1876 InflationState_LHR_Tyre 0;
BA_ "GenSigTimeoutTime_SGW" SG_ 1876 InflationState_LHR_Tyre 0;
BA_ "GenSigTimeoutTime_TRSKM" SG_ 1876 InflationState_LHR_Tyre 0;
BA_ "GenSigSendType" SG_ 1876 InflationState_RHF_Tyre 4;
BA_ "GenSigTimeoutTime_BCM" SG_ 1876 InflationState_RHF_Tyre 0;
BA_ "GenSigTimeoutTime_BSM2" SG_ 1876 InflationState_RHF_Tyre 0;
BA_ "GenSigTimeoutTime_CADM2" SG_ 1876 InflationState_RHF_Tyre 0;
BA_ "GenSigTimeoutTime_CVADAS" SG_ 1876 InflationState_RHF_Tyre 0;
BA_ "GenSigTimeoutTime_EPS" SG_ 1876 InflationState_RHF_Tyre 0;
BA_ "GenSigTimeoutTime_PAM" SG_ 1876 InflationState_RHF_Tyre 0;
BA_ "GenSigTimeoutTime_SGW" SG_ 1876 InflationState_RHF_Tyre 0;
BA_ "GenSigTimeoutTime_TRSKM" SG_ 1876 InflationState_RHF_Tyre 0;
BA_ "GenSigSendType" SG_ 1876 InflationState_RHR_Tyre 4;
BA_ "GenSigTimeoutTime_BCM" SG_ 1876 InflationState_RHR_Tyre 0;
BA_ "GenSigTimeoutTime_BSM2" SG_ 1876 InflationState_RHR_Tyre 0;
BA_ "GenSigTimeoutTime_CADM2" SG_ 1876 InflationState_RHR_Tyre 0;
BA_ "GenSigTimeoutTime_CVADAS" SG_ 1876 InflationState_RHR_Tyre 0;
BA_ "GenSigTimeoutTime_EPS" SG_ 1876 InflationState_RHR_Tyre 0;
BA_ "GenSigTimeoutTime_PAM" SG_ 1876 InflationState_RHR_Tyre 0;
BA_ "GenSigTimeoutTime_SGW" SG_ 1876 InflationState_RHR_Tyre 0;
BA_ "GenSigTimeoutTime_TRSKM" SG_ 1876 InflationState_RHR_Tyre 0;
BA_ "GenSigTimeoutTime_BCM" SG_ 1876 PressureValue_LHF_Tyre 0;
BA_ "GenSigTimeoutTime_BSM2" SG_ 1876 PressureValue_LHF_Tyre 0;
BA_ "GenSigTimeoutTime_CADM2" SG_ 1876 PressureValue_LHF_Tyre 0;
BA_ "GenSigTimeoutTime_CVADAS" SG_ 1876 PressureValue_LHF_Tyre 0;
BA_ "GenSigTimeoutTime_EPS" SG_ 1876 PressureValue_LHF_Tyre 0;
BA_ "GenSigTimeoutTime_PAM" SG_ 1876 PressureValue_LHF_Tyre 0;
BA_ "GenSigTimeoutTime_SGW" SG_ 1876 PressureValue_LHF_Tyre 0;
BA_ "GenSigTimeoutTime_TRSKM" SG_ 1876 PressureValue_LHF_Tyre 0;
BA_ "GenSigTimeoutTime_BCM" SG_ 1876 PressureValue_LHR_Tyre 0;
BA_ "GenSigTimeoutTime_BSM2" SG_ 1876 PressureValue_LHR_Tyre 0;
BA_ "GenSigTimeoutTime_CADM2" SG_ 1876 PressureValue_LHR_Tyre 0;
BA_ "GenSigTimeoutTime_CVADAS" SG_ 1876 PressureValue_LHR_Tyre 0;
BA_ "GenSigTimeoutTime_EPS" SG_ 1876 PressureValue_LHR_Tyre 0;
BA_ "GenSigTimeoutTime_PAM" SG_ 1876 PressureValue_LHR_Tyre 0;
BA_ "GenSigTimeoutTime_SGW" SG_ 1876 PressureValue_LHR_Tyre 0;
BA_ "GenSigTimeoutTime_TRSKM" SG_ 1876 PressureValue_LHR_Tyre 0;
BA_ "GenSigTimeoutTime_BCM" SG_ 1876 PressureValue_RHF_Tyre 0;
BA_ "GenSigTimeoutTime_BSM2" SG_ 1876 PressureValue_RHF_Tyre 0;
BA_ "GenSigTimeoutTime_CADM2" SG_ 1876 PressureValue_RHF_Tyre 0;
BA_ "GenSigTimeoutTime_CVADAS" SG_ 1876 PressureValue_RHF_Tyre 0;
BA_ "GenSigTimeoutTime_EPS" SG_ 1876 PressureValue_RHF_Tyre 0;
BA_ "GenSigTimeoutTime_PAM" SG_ 1876 PressureValue_RHF_Tyre 0;
BA_ "GenSigTimeoutTime_SGW" SG_ 1876 PressureValue_RHF_Tyre 0;
BA_ "GenSigTimeoutTime_TRSKM" SG_ 1876 PressureValue_RHF_Tyre 0;
BA_ "GenSigTimeoutTime_BCM" SG_ 1876 PressureValue_RHR_Tyre 0;
BA_ "GenSigTimeoutTime_BSM2" SG_ 1876 PressureValue_RHR_Tyre 0;
BA_ "GenSigTimeoutTime_CADM2" SG_ 1876 PressureValue_RHR_Tyre 0;
BA_ "GenSigTimeoutTime_CVADAS" SG_ 1876 PressureValue_RHR_Tyre 0;
BA_ "GenSigTimeoutTime_EPS" SG_ 1876 PressureValue_RHR_Tyre 0;
BA_ "GenSigTimeoutTime_PAM" SG_ 1876 PressureValue_RHR_Tyre 0;
BA_ "GenSigTimeoutTime_SGW" SG_ 1876 PressureValue_RHR_Tyre 0;
BA_ "GenSigTimeoutTime_TRSKM" SG_ 1876 PressureValue_RHR_Tyre 0;
BA_ "GenSigSendType" SG_ 1876 TyrePressureSystemFailSts 4;
BA_ "GenSigTimeoutTime_BCM" SG_ 1876 TyrePressureSystemFailSts 0;
BA_ "GenSigTimeoutTime_BSM2" SG_ 1876 TyrePressureSystemFailSts 0;
BA_ "GenSigTimeoutTime_CADM2" SG_ 1876 TyrePressureSystemFailSts 0;
BA_ "GenSigTimeoutTime_CVADAS" SG_ 1876 TyrePressureSystemFailSts 0;
BA_ "GenSigTimeoutTime_EPS" SG_ 1876 TyrePressureSystemFailSts 0;
BA_ "GenSigTimeoutTime_PAM" SG_ 1876 TyrePressureSystemFailSts 0;
BA_ "GenSigTimeoutTime_SGW" SG_ 1876 TyrePressureSystemFailSts 0;
BA_ "GenSigTimeoutTime_TRSKM" SG_ 1876 TyrePressureSystemFailSts 0;
BA_ "GenSigStartValue" SG_ 151 CRC_SWSM_1 255;
BA_ "GenSigTimeoutTime_BCM" SG_ 151 CRC_SWSM_1 0;
BA_ "GenSigTimeoutTime_BSM2" SG_ 151 CRC_SWSM_1 0;
BA_ "GenSigTimeoutTime_CVADAS" SG_ 151 CRC_SWSM_1 0;
BA_ "GenSigTimeoutTime_EPS" SG_ 151 CRC_SWSM_1 0;
BA_ "GenSigTimeoutTime_ORC" SG_ 151 CRC_SWSM_1 0;
BA_ "GenSigTimeoutTime_PAM" SG_ 151 CRC_SWSM_1 0;
BA_ "GenSigTimeoutTime_SGW" SG_ 151 CRC_SWSM_1 0;
BA_ "GenSigTimeoutTime_TRSKM" SG_ 151 CRC_SWSM_1 0;
BA_ "GenSigSendType" SG_ 151 ERR_ST_HOD 1;
BA_ "GenSigTimeoutTime_BCM" SG_ 151 ERR_ST_HOD 0;
BA_ "GenSigTimeoutTime_BSM2" SG_ 151 ERR_ST_HOD 0;
BA_ "GenSigTimeoutTime_CVADAS" SG_ 151 ERR_ST_HOD 0;
BA_ "GenSigTimeoutTime_EPS" SG_ 151 ERR_ST_HOD 0;
BA_ "GenSigTimeoutTime_ORC" SG_ 151 ERR_ST_HOD 0;
BA_ "GenSigTimeoutTime_PAM" SG_ 151 ERR_ST_HOD 0;
BA_ "GenSigTimeoutTime_SGW" SG_ 151 ERR_ST_HOD 0;
BA_ "GenSigTimeoutTime_TRSKM" SG_ 151 ERR_ST_HOD 0;
BA_ "GenSigTimeoutTime_BCM" SG_ 151 HOFF_RCOG_SEN 0;
BA_ "GenSigTimeoutTime_BSM2" SG_ 151 HOFF_RCOG_SEN 0;
BA_ "GenSigTimeoutTime_CVADAS" SG_ 151 HOFF_RCOG_SEN 0;
BA_ "GenSigTimeoutTime_EPS" SG_ 151 HOFF_RCOG_SEN 0;
BA_ "GenSigTimeoutTime_PAM" SG_ 151 HOFF_RCOG_SEN 0;
BA_ "GenSigTimeoutTime_SGW" SG_ 151 HOFF_RCOG_SEN 0;
BA_ "GenSigTimeoutTime_TRSKM" SG_ 151 HOFF_RCOG_SEN 0;
BA_ "GenSigTimeoutTime_BCM" SG_ 151 MC_SWSM_1 0;
BA_ "GenSigTimeoutTime_BSM2" SG_ 151 MC_SWSM_1 0;
BA_ "GenSigTimeoutTime_CVADAS" SG_ 151 MC_SWSM_1 0;
BA_ "GenSigTimeoutTime_EPS" SG_ 151 MC_SWSM_1 0;
BA_ "GenSigTimeoutTime_ORC" SG_ 151 MC_SWSM_1 0;
BA_ "GenSigTimeoutTime_PAM" SG_ 151 MC_SWSM_1 0;
BA_ "GenSigTimeoutTime_SGW" SG_ 151 MC_SWSM_1 0;
BA_ "GenSigTimeoutTime_TRSKM" SG_ 151 MC_SWSM_1 0;
BA_ "GenSigTimeoutTime_BCM" SG_ 1585 WiFi_Client_Mode_Confirm 0;
BA_ "GenSigTimeoutTime_BSM2" SG_ 1585 WiFi_Client_Mode_Confirm 0;
BA_ "GenSigTimeoutTime_CVADAS" SG_ 1585 WiFi_Client_Mode_Confirm 0;
BA_ "GenSigTimeoutTime_EPS" SG_ 1585 WiFi_Client_Mode_Confirm 0;
BA_ "GenSigTimeoutTime_ORC" SG_ 1585 WiFi_Client_Mode_Confirm 0;
BA_ "GenSigTimeoutTime_PAM" SG_ 1585 WiFi_Client_Mode_Confirm 0;
BA_ "GenSigTimeoutTime_SGW" SG_ 1585 WiFi_Client_Mode_Confirm 0;
BA_ "GenSigTimeoutTime_TRSKM" SG_ 1585 WiFi_Client_Mode_Confirm 0;
BA_ "GenSigSendType" SG_ 1452 LTESts 3;
BA_ "GenSigTimeoutTime_BCM" SG_ 1452 LTESts 0;
BA_ "GenSigTimeoutTime_BSM2" SG_ 1452 LTESts 0;
BA_ "GenSigTimeoutTime_CVADAS" SG_ 1452 LTESts 0;
BA_ "GenSigTimeoutTime_EPS" SG_ 1452 LTESts 0;
BA_ "GenSigTimeoutTime_ORC" SG_ 1452 LTESts 0;
BA_ "GenSigTimeoutTime_PAM" SG_ 1452 LTESts 0;
BA_ "GenSigTimeoutTime_SGW" SG_ 1452 LTESts 0;
BA_ "GenSigTimeoutTime_TRSKM" SG_ 1452 LTESts 0;
BA_ "GenSigSendType" SG_ 1452 NetConnection 3;
BA_ "GenSigTimeoutTime_BCM" SG_ 1452 NetConnection 0;
BA_ "GenSigTimeoutTime_BSM2" SG_ 1452 NetConnection 0;
BA_ "GenSigTimeoutTime_CVADAS" SG_ 1452 NetConnection 0;
BA_ "GenSigTimeoutTime_EPS" SG_ 1452 NetConnection 0;
BA_ "GenSigTimeoutTime_ORC" SG_ 1452 NetConnection 0;
BA_ "GenSigTimeoutTime_PAM" SG_ 1452 NetConnection 0;
BA_ "GenSigTimeoutTime_SGW" SG_ 1452 NetConnection 0;
BA_ "GenSigTimeoutTime_TRSKM" SG_ 1452 NetConnection 0;
BA_ "GenSigSendType" SG_ 1452 PrivacyMode 3;
BA_ "GenSigTimeoutTime_BCM" SG_ 1452 PrivacyMode 0;
BA_ "GenSigTimeoutTime_BSM2" SG_ 1452 PrivacyMode 0;
BA_ "GenSigTimeoutTime_CVADAS" SG_ 1452 PrivacyMode 0;
BA_ "GenSigTimeoutTime_EPS" SG_ 1452 PrivacyMode 0;
BA_ "GenSigTimeoutTime_ORC" SG_ 1452 PrivacyMode 0;
BA_ "GenSigTimeoutTime_PAM" SG_ 1452 PrivacyMode 0;
BA_ "GenSigTimeoutTime_SGW" SG_ 1452 PrivacyMode 0;
BA_ "GenSigTimeoutTime_TRSKM" SG_ 1452 PrivacyMode 0;
BA_ "GenSigSendType" SG_ 1452 SignalStrength 3;
BA_ "GenSigTimeoutTime_BCM" SG_ 1452 SignalStrength 0;
BA_ "GenSigTimeoutTime_BSM2" SG_ 1452 SignalStrength 0;
BA_ "GenSigTimeoutTime_CVADAS" SG_ 1452 SignalStrength 0;
BA_ "GenSigTimeoutTime_EPS" SG_ 1452 SignalStrength 0;
BA_ "GenSigTimeoutTime_ORC" SG_ 1452 SignalStrength 0;
BA_ "GenSigTimeoutTime_PAM" SG_ 1452 SignalStrength 0;
BA_ "GenSigTimeoutTime_SGW" SG_ 1452 SignalStrength 0;
BA_ "GenSigTimeoutTime_TRSKM" SG_ 1452 SignalStrength 0;
BA_ "GenSigSendType" SG_ 1452 WiFiSts 3;
BA_ "GenSigTimeoutTime_BCM" SG_ 1452 WiFiSts 0;
BA_ "GenSigTimeoutTime_BSM2" SG_ 1452 WiFiSts 0;
BA_ "GenSigTimeoutTime_CVADAS" SG_ 1452 WiFiSts 0;
BA_ "GenSigTimeoutTime_EPS" SG_ 1452 WiFiSts 0;
BA_ "GenSigTimeoutTime_ORC" SG_ 1452 WiFiSts 0;
BA_ "GenSigTimeoutTime_PAM" SG_ 1452 WiFiSts 0;
BA_ "GenSigTimeoutTime_SGW" SG_ 1452 WiFiSts 0;
BA_ "GenSigTimeoutTime_TRSKM" SG_ 1452 WiFiSts 0;
BA_ "GenSigStartValue" SG_ 156 GPS_Date_Day 255;
BA_ "GenSigTimeoutTime_BCM" SG_ 156 GPS_Date_Day 0;
BA_ "GenSigTimeoutTime_BSM2" SG_ 156 GPS_Date_Day 0;
BA_ "GenSigTimeoutTime_CADM2" SG_ 156 GPS_Date_Day 0;
BA_ "GenSigTimeoutTime_CVADAS" SG_ 156 GPS_Date_Day 0;
BA_ "GenSigTimeoutTime_EPS" SG_ 156 GPS_Date_Day 0;
BA_ "GenSigTimeoutTime_PAM" SG_ 156 GPS_Date_Day 0;
BA_ "GenSigTimeoutTime_SGW" SG_ 156 GPS_Date_Day 0;
BA_ "GenSigTimeoutTime_TRSKM" SG_ 156 GPS_Date_Day 0;
BA_ "GenSigStartValue" SG_ 156 GPS_Date_Month 255;
BA_ "GenSigTimeoutTime_BCM" SG_ 156 GPS_Date_Month 0;
BA_ "GenSigTimeoutTime_BSM2" SG_ 156 GPS_Date_Month 0;
BA_ "GenSigTimeoutTime_CADM2" SG_ 156 GPS_Date_Month 0;
BA_ "GenSigTimeoutTime_CVADAS" SG_ 156 GPS_Date_Month 0;
BA_ "GenSigTimeoutTime_EPS" SG_ 156 GPS_Date_Month 0;
BA_ "GenSigTimeoutTime_PAM" SG_ 156 GPS_Date_Month 0;
BA_ "GenSigTimeoutTime_SGW" SG_ 156 GPS_Date_Month 0;
BA_ "GenSigTimeoutTime_TRSKM" SG_ 156 GPS_Date_Month 0;
BA_ "GenSigStartValue" SG_ 156 GPS_Date_Year 65535;
BA_ "GenSigTimeoutTime_BCM" SG_ 156 GPS_Date_Year 0;
BA_ "GenSigTimeoutTime_BSM2" SG_ 156 GPS_Date_Year 0;
BA_ "GenSigTimeoutTime_CADM2" SG_ 156 GPS_Date_Year 0;
BA_ "GenSigTimeoutTime_CVADAS" SG_ 156 GPS_Date_Year 0;
BA_ "GenSigTimeoutTime_EPS" SG_ 156 GPS_Date_Year 0;
BA_ "GenSigTimeoutTime_PAM" SG_ 156 GPS_Date_Year 0;
BA_ "GenSigTimeoutTime_SGW" SG_ 156 GPS_Date_Year 0;
BA_ "GenSigTimeoutTime_TRSKM" SG_ 156 GPS_Date_Year 0;
BA_ "GenSigStartValue" SG_ 156 GPS_UTC_Hour 255;
BA_ "GenSigTimeoutTime_BCM" SG_ 156 GPS_UTC_Hour 0;
BA_ "GenSigTimeoutTime_BSM2" SG_ 156 GPS_UTC_Hour 0;
BA_ "GenSigTimeoutTime_CADM2" SG_ 156 GPS_UTC_Hour 0;
BA_ "GenSigTimeoutTime_CVADAS" SG_ 156 GPS_UTC_Hour 0;
BA_ "GenSigTimeoutTime_EPS" SG_ 156 GPS_UTC_Hour 0;
BA_ "GenSigTimeoutTime_PAM" SG_ 156 GPS_UTC_Hour 0;
BA_ "GenSigTimeoutTime_SGW" SG_ 156 GPS_UTC_Hour 0;
BA_ "GenSigTimeoutTime_TRSKM" SG_ 156 GPS_UTC_Hour 0;
BA_ "GenSigStartValue" SG_ 156 GPS_UTC_Minute 255;
BA_ "GenSigTimeoutTime_BCM" SG_ 156 GPS_UTC_Minute 0;
BA_ "GenSigTimeoutTime_BSM2" SG_ 156 GPS_UTC_Minute 0;
BA_ "GenSigTimeoutTime_CADM2" SG_ 156 GPS_UTC_Minute 0;
BA_ "GenSigTimeoutTime_CVADAS" SG_ 156 GPS_UTC_Minute 0;
BA_ "GenSigTimeoutTime_EPS" SG_ 156 GPS_UTC_Minute 0;
BA_ "GenSigTimeoutTime_PAM" SG_ 156 GPS_UTC_Minute 0;
BA_ "GenSigTimeoutTime_SGW" SG_ 156 GPS_UTC_Minute 0;
BA_ "GenSigTimeoutTime_TRSKM" SG_ 156 GPS_UTC_Minute 0;
BA_ "GenSigStartValue" SG_ 156 GPS_UTC_Second 65535;
BA_ "GenSigTimeoutTime_BCM" SG_ 156 GPS_UTC_Second 0;
BA_ "GenSigTimeoutTime_BSM2" SG_ 156 GPS_UTC_Second 0;
BA_ "GenSigTimeoutTime_CADM2" SG_ 156 GPS_UTC_Second 0;
BA_ "GenSigTimeoutTime_CVADAS" SG_ 156 GPS_UTC_Second 0;
BA_ "GenSigTimeoutTime_EPS" SG_ 156 GPS_UTC_Second 0;
BA_ "GenSigTimeoutTime_PAM" SG_ 156 GPS_UTC_Second 0;
BA_ "GenSigTimeoutTime_SGW" SG_ 156 GPS_UTC_Second 0;
BA_ "GenSigTimeoutTime_TRSKM" SG_ 156 GPS_UTC_Second 0;
BA_ "GenSigTimeoutTime_BCM" SG_ 608 CRC_Telematic11 0;
BA_ "GenSigTimeoutTime_BSM2" SG_ 608 CRC_Telematic11 0;
BA_ "GenSigTimeoutTime_CADM2" SG_ 608 CRC_Telematic11 0;
BA_ "GenSigTimeoutTime_EPS" SG_ 608 CRC_Telematic11 0;
BA_ "GenSigTimeoutTime_ORC" SG_ 608 CRC_Telematic11 0;
BA_ "GenSigTimeoutTime_PAM" SG_ 608 CRC_Telematic11 0;
BA_ "GenSigTimeoutTime_SGW" SG_ 608 CRC_Telematic11 0;
BA_ "GenSigTimeoutTime_TRSKM" SG_ 608 CRC_Telematic11 0;
BA_ "GenSigSendType" SG_ 608 HU_TRSC_EnableBtn_Sts 3;
BA_ "GenSigTimeoutTime_BCM" SG_ 608 HU_TRSC_EnableBtn_Sts 0;
BA_ "GenSigTimeoutTime_BSM2" SG_ 608 HU_TRSC_EnableBtn_Sts 0;
BA_ "GenSigTimeoutTime_CADM2" SG_ 608 HU_TRSC_EnableBtn_Sts 0;
BA_ "GenSigTimeoutTime_EPS" SG_ 608 HU_TRSC_EnableBtn_Sts 0;
BA_ "GenSigTimeoutTime_ORC" SG_ 608 HU_TRSC_EnableBtn_Sts 0;
BA_ "GenSigTimeoutTime_PAM" SG_ 608 HU_TRSC_EnableBtn_Sts 0;
BA_ "GenSigTimeoutTime_SGW" SG_ 608 HU_TRSC_EnableBtn_Sts 0;
BA_ "GenSigTimeoutTime_TRSKM" SG_ 608 HU_TRSC_EnableBtn_Sts 0;
BA_ "GenSigTimeoutTime_BCM" SG_ 608 MessageCounter_Telematic11 0;
BA_ "GenSigTimeoutTime_BSM2" SG_ 608 MessageCounter_Telematic11 0;
BA_ "GenSigTimeoutTime_CADM2" SG_ 608 MessageCounter_Telematic11 0;
BA_ "GenSigTimeoutTime_EPS" SG_ 608 MessageCounter_Telematic11 0;
BA_ "GenSigTimeoutTime_ORC" SG_ 608 MessageCounter_Telematic11 0;
BA_ "GenSigTimeoutTime_PAM" SG_ 608 MessageCounter_Telematic11 0;
BA_ "GenSigTimeoutTime_SGW" SG_ 608 MessageCounter_Telematic11 0;
BA_ "GenSigTimeoutTime_TRSKM" SG_ 608 MessageCounter_Telematic11 0;
BA_ "GenSigTimeoutTime_BCM" SG_ 1465 CRC_Telematic14 0;
BA_ "GenSigTimeoutTime_BSM2" SG_ 1465 CRC_Telematic14 0;
BA_ "GenSigTimeoutTime_CADM2" SG_ 1465 CRC_Telematic14 0;
BA_ "GenSigTimeoutTime_EPS" SG_ 1465 CRC_Telematic14 0;
BA_ "GenSigTimeoutTime_ORC" SG_ 1465 CRC_Telematic14 0;
BA_ "GenSigTimeoutTime_PAM" SG_ 1465 CRC_Telematic14 0;
BA_ "GenSigTimeoutTime_SGW" SG_ 1465 CRC_Telematic14 0;
BA_ "GenSigTimeoutTime_TRSKM" SG_ 1465 CRC_Telematic14 0;
BA_ "GenSigTimeoutTime_BCM" SG_ 1465 MessageCounter_Telematic14 0;
BA_ "GenSigTimeoutTime_BSM2" SG_ 1465 MessageCounter_Telematic14 0;
BA_ "GenSigTimeoutTime_CADM2" SG_ 1465 MessageCounter_Telematic14 0;
BA_ "GenSigTimeoutTime_EPS" SG_ 1465 MessageCounter_Telematic14 0;
BA_ "GenSigTimeoutTime_ORC" SG_ 1465 MessageCounter_Telematic14 0;
BA_ "GenSigTimeoutTime_PAM" SG_ 1465 MessageCounter_Telematic14 0;
BA_ "GenSigTimeoutTime_SGW" SG_ 1465 MessageCounter_Telematic14 0;
BA_ "GenSigTimeoutTime_TRSKM" SG_ 1465 MessageCounter_Telematic14 0;
BA_ "GenSigSendType" SG_ 1465 TGW_CAMERA_DISP_STAT 3;
BA_ "GenSigTimeoutTime_BCM" SG_ 1465 TGW_CAMERA_DISP_STAT 0;
BA_ "GenSigTimeoutTime_BSM2" SG_ 1465 TGW_CAMERA_DISP_STAT 0;
BA_ "GenSigTimeoutTime_CADM2" SG_ 1465 TGW_CAMERA_DISP_STAT 0;
BA_ "GenSigTimeoutTime_EPS" SG_ 1465 TGW_CAMERA_DISP_STAT 0;
BA_ "GenSigTimeoutTime_ORC" SG_ 1465 TGW_CAMERA_DISP_STAT 0;
BA_ "GenSigTimeoutTime_PAM" SG_ 1465 TGW_CAMERA_DISP_STAT 0;
BA_ "GenSigTimeoutTime_SGW" SG_ 1465 TGW_CAMERA_DISP_STAT 0;
BA_ "GenSigTimeoutTime_TRSKM" SG_ 1465 TGW_CAMERA_DISP_STAT 0;
BA_ "GenSigSendType" SG_ 1428 CameraDisplaySts2 3;
BA_ "GenSigTimeoutTime_BCM" SG_ 1428 CameraDisplaySts2 0;
BA_ "GenSigTimeoutTime_BSM2" SG_ 1428 CameraDisplaySts2 0;
BA_ "GenSigTimeoutTime_CADM2" SG_ 1428 CameraDisplaySts2 0;
BA_ "GenSigTimeoutTime_EPS" SG_ 1428 CameraDisplaySts2 0;
BA_ "GenSigTimeoutTime_ORC" SG_ 1428 CameraDisplaySts2 0;
BA_ "GenSigTimeoutTime_PAM" SG_ 1428 CameraDisplaySts2 0;
BA_ "GenSigTimeoutTime_SGW" SG_ 1428 CameraDisplaySts2 0;
BA_ "GenSigTimeoutTime_TRSKM" SG_ 1428 CameraDisplaySts2 0;
BA_ "GenSigSendType" SG_ 1428 CM_TCH_STAT 3;
BA_ "GenSigTimeoutTime_BCM" SG_ 1428 CM_TCH_STAT 0;
BA_ "GenSigTimeoutTime_BSM2" SG_ 1428 CM_TCH_STAT 0;
BA_ "GenSigTimeoutTime_CADM2" SG_ 1428 CM_TCH_STAT 0;
BA_ "GenSigTimeoutTime_EPS" SG_ 1428 CM_TCH_STAT 0;
BA_ "GenSigTimeoutTime_ORC" SG_ 1428 CM_TCH_STAT 0;
BA_ "GenSigTimeoutTime_PAM" SG_ 1428 CM_TCH_STAT 0;
BA_ "GenSigTimeoutTime_SGW" SG_ 1428 CM_TCH_STAT 0;
BA_ "GenSigTimeoutTime_TRSKM" SG_ 1428 CM_TCH_STAT 0;
BA_ "GenSigSendType" SG_ 1428 CM_TCH_X_COORD 3;
BA_ "GenSigTimeoutTime_BCM" SG_ 1428 CM_TCH_X_COORD 0;
BA_ "GenSigTimeoutTime_BSM2" SG_ 1428 CM_TCH_X_COORD 0;
BA_ "GenSigTimeoutTime_CADM2" SG_ 1428 CM_TCH_X_COORD 0;
BA_ "GenSigTimeoutTime_EPS" SG_ 1428 CM_TCH_X_COORD 0;
BA_ "GenSigTimeoutTime_ORC" SG_ 1428 CM_TCH_X_COORD 0;
BA_ "GenSigTimeoutTime_PAM" SG_ 1428 CM_TCH_X_COORD 0;
BA_ "GenSigTimeoutTime_SGW" SG_ 1428 CM_TCH_X_COORD 0;
BA_ "GenSigTimeoutTime_TRSKM" SG_ 1428 CM_TCH_X_COORD 0;
BA_ "GenSigSendType" SG_ 1428 CM_TCH_Y_COORD 3;
BA_ "GenSigTimeoutTime_BCM" SG_ 1428 CM_TCH_Y_COORD 0;
BA_ "GenSigTimeoutTime_BSM2" SG_ 1428 CM_TCH_Y_COORD 0;
BA_ "GenSigTimeoutTime_CADM2" SG_ 1428 CM_TCH_Y_COORD 0;
BA_ "GenSigTimeoutTime_EPS" SG_ 1428 CM_TCH_Y_COORD 0;
BA_ "GenSigTimeoutTime_ORC" SG_ 1428 CM_TCH_Y_COORD 0;
BA_ "GenSigTimeoutTime_PAM" SG_ 1428 CM_TCH_Y_COORD 0;
BA_ "GenSigTimeoutTime_SGW" SG_ 1428 CM_TCH_Y_COORD 0;
BA_ "GenSigTimeoutTime_TRSKM" SG_ 1428 CM_TCH_Y_COORD 0;
BA_ "GenSigTimeoutTime_BCM" SG_ 1428 CRC_Telematic5 0;
BA_ "GenSigTimeoutTime_BSM2" SG_ 1428 CRC_Telematic5 0;
BA_ "GenSigTimeoutTime_CADM2" SG_ 1428 CRC_Telematic5 0;
BA_ "GenSigTimeoutTime_EPS" SG_ 1428 CRC_Telematic5 0;
BA_ "GenSigTimeoutTime_ORC" SG_ 1428 CRC_Telematic5 0;
BA_ "GenSigTimeoutTime_PAM" SG_ 1428 CRC_Telematic5 0;
BA_ "GenSigTimeoutTime_SGW" SG_ 1428 CRC_Telematic5 0;
BA_ "GenSigTimeoutTime_TRSKM" SG_ 1428 CRC_Telematic5 0;
BA_ "GenSigTimeoutTime_BCM" SG_ 1428 MessageCounter_Telematic5 0;
BA_ "GenSigTimeoutTime_BSM2" SG_ 1428 MessageCounter_Telematic5 0;
BA_ "GenSigTimeoutTime_CADM2" SG_ 1428 MessageCounter_Telematic5 0;
BA_ "GenSigTimeoutTime_EPS" SG_ 1428 MessageCounter_Telematic5 0;
BA_ "GenSigTimeoutTime_ORC" SG_ 1428 MessageCounter_Telematic5 0;
BA_ "GenSigTimeoutTime_PAM" SG_ 1428 MessageCounter_Telematic5 0;
BA_ "GenSigTimeoutTime_SGW" SG_ 1428 MessageCounter_Telematic5 0;
BA_ "GenSigTimeoutTime_TRSKM" SG_ 1428 MessageCounter_Telematic5 0;
BA_ "GenSigTimeoutTime_BCM" SG_ 278 CRC_TRANSM1 0;
BA_ "GenSigTimeoutTime_BSM2" SG_ 278 CRC_TRANSM1 0;
BA_ "GenSigTimeoutTime_EPS" SG_ 278 CRC_TRANSM1 0;
BA_ "GenSigTimeoutTime_ORC" SG_ 278 CRC_TRANSM1 0;
BA_ "GenSigTimeoutTime_PAM" SG_ 278 CRC_TRANSM1 0;
BA_ "GenSigTimeoutTime_SGW" SG_ 278 CRC_TRANSM1 0;
BA_ "GenSigTimeoutTime_TRSKM" SG_ 278 CRC_TRANSM1 0;
BA_ "GenSigTimeoutTime_BCM" SG_ 278 MessageCounter_TRANSM1 0;
BA_ "GenSigTimeoutTime_BSM2" SG_ 278 MessageCounter_TRANSM1 0;
BA_ "GenSigTimeoutTime_EPS" SG_ 278 MessageCounter_TRANSM1 0;
BA_ "GenSigTimeoutTime_ORC" SG_ 278 MessageCounter_TRANSM1 0;
BA_ "GenSigTimeoutTime_PAM" SG_ 278 MessageCounter_TRANSM1 0;
BA_ "GenSigTimeoutTime_SGW" SG_ 278 MessageCounter_TRANSM1 0;
BA_ "GenSigTimeoutTime_TRSKM" SG_ 278 MessageCounter_TRANSM1 0;
BA_ "GenSigStartValue" SG_ 278 TargetGear 15;
BA_ "GenSigTimeoutTime_BCM" SG_ 278 TargetGear 0;
BA_ "GenSigTimeoutTime_BSM2" SG_ 278 TargetGear 0;
BA_ "GenSigTimeoutTime_ORC" SG_ 278 TargetGear 0;
BA_ "GenSigTimeoutTime_SGW" SG_ 278 TargetGear 0;
BA_ "GenSigTimeoutTime_TRSKM" SG_ 278 TargetGear 0;
BA_ "GenSigTimeoutTime_BCM" SG_ 278 TRANS_ADAS_Inhibit 0;
BA_ "GenSigTimeoutTime_BSM2" SG_ 278 TRANS_ADAS_Inhibit 0;
BA_ "GenSigTimeoutTime_CADM2" SG_ 278 TRANS_ADAS_Inhibit 0;
BA_ "GenSigTimeoutTime_EPS" SG_ 278 TRANS_ADAS_Inhibit 0;
BA_ "GenSigTimeoutTime_ORC" SG_ 278 TRANS_ADAS_Inhibit 0;
BA_ "GenSigTimeoutTime_PAM" SG_ 278 TRANS_ADAS_Inhibit 0;
BA_ "GenSigTimeoutTime_SGW" SG_ 278 TRANS_ADAS_Inhibit 0;
BA_ "GenSigTimeoutTime_TRSKM" SG_ 278 TRANS_ADAS_Inhibit 0;
BA_ "GenSigTimeoutTime_BCM" SG_ 278 TransmissionSailingSts 0;
BA_ "GenSigTimeoutTime_BSM2" SG_ 278 TransmissionSailingSts 0;
BA_ "GenSigTimeoutTime_EPS" SG_ 278 TransmissionSailingSts 0;
BA_ "GenSigTimeoutTime_SGW" SG_ 278 TransmissionSailingSts 0;
BA_ "GenSigTimeoutTime_TRSKM" SG_ 278 TransmissionSailingSts 0;
BA_ "GenSigTimeoutTime_BCM" SG_ 520 CRC_TRANSM2 0;
BA_ "GenSigTimeoutTime_BSM2" SG_ 520 CRC_TRANSM2 0;
BA_ "GenSigTimeoutTime_EPS" SG_ 520 CRC_TRANSM2 0;
BA_ "GenSigTimeoutTime_ORC" SG_ 520 CRC_TRANSM2 0;
BA_ "GenSigTimeoutTime_PAM" SG_ 520 CRC_TRANSM2 0;
BA_ "GenSigTimeoutTime_SGW" SG_ 520 CRC_TRANSM2 0;
BA_ "GenSigTimeoutTime_TRSKM" SG_ 520 CRC_TRANSM2 0;
BA_ "GenSigStartValue" SG_ 520 GearEngagedForDisplay 31;
BA_ "GenSigTimeoutTime_BCM" SG_ 520 GearEngagedForDisplay 0;
BA_ "GenSigTimeoutTime_BSM2" SG_ 520 GearEngagedForDisplay 0;
BA_ "GenSigTimeoutTime_PAM" SG_ 520 GearEngagedForDisplay 0;
BA_ "GenSigTimeoutTime_SGW" SG_ 520 GearEngagedForDisplay 0;
BA_ "GenSigTimeoutTime_TRSKM" SG_ 520 GearEngagedForDisplay 0;
BA_ "GenSigTimeoutTime_BCM" SG_ 520 MessageCounter_TRANSM2 0;
BA_ "GenSigTimeoutTime_BSM2" SG_ 520 MessageCounter_TRANSM2 0;
BA_ "GenSigTimeoutTime_EPS" SG_ 520 MessageCounter_TRANSM2 0;
BA_ "GenSigTimeoutTime_ORC" SG_ 520 MessageCounter_TRANSM2 0;
BA_ "GenSigTimeoutTime_PAM" SG_ 520 MessageCounter_TRANSM2 0;
BA_ "GenSigTimeoutTime_SGW" SG_ 520 MessageCounter_TRANSM2 0;
BA_ "GenSigTimeoutTime_TRSKM" SG_ 520 MessageCounter_TRANSM2 0;
BA_ "GenSigTimeoutTime_BCM" SG_ 520 TransReadyForESS 0;
BA_ "GenSigTimeoutTime_BSM2" SG_ 520 TransReadyForESS 0;
BA_ "GenSigTimeoutTime_CADM2" SG_ 520 TransReadyForESS 0;
BA_ "GenSigTimeoutTime_CVADAS" SG_ 520 TransReadyForESS 0;
BA_ "GenSigTimeoutTime_EPS" SG_ 520 TransReadyForESS 0;
BA_ "GenSigTimeoutTime_PAM" SG_ 520 TransReadyForESS 0;
BA_ "GenSigTimeoutTime_SGW" SG_ 520 TransReadyForESS 0;
BA_ "GenSigTimeoutTime_TRSKM" SG_ 520 TransReadyForESS 0;
BA_ "GenSigTimeoutTime_BCM" SG_ 1450 CRC_TRANSM4 0;
BA_ "GenSigTimeoutTime_CVADAS" SG_ 1450 CRC_TRANSM4 0;
BA_ "GenSigTimeoutTime_PAM" SG_ 1450 CRC_TRANSM4 0;
BA_ "GenSigTimeoutTime_SGW" SG_ 1450 CRC_TRANSM4 0;
BA_ "GenSigTimeoutTime_TRSKM" SG_ 1450 CRC_TRANSM4 0;
BA_ "GenSigSendType" SG_ 1450 DriveModeSts 3;
BA_ "GenSigTimeoutTime_BCM" SG_ 1450 DriveModeSts 0;
BA_ "GenSigTimeoutTime_BSM2" SG_ 1450 DriveModeSts 0;
BA_ "GenSigTimeoutTime_CADM2" SG_ 1450 DriveModeSts 0;
BA_ "GenSigTimeoutTime_CVADAS" SG_ 1450 DriveModeSts 0;
BA_ "GenSigTimeoutTime_EPS" SG_ 1450 DriveModeSts 0;
BA_ "GenSigTimeoutTime_PAM" SG_ 1450 DriveModeSts 0;
BA_ "GenSigTimeoutTime_SGW" SG_ 1450 DriveModeSts 0;
BA_ "GenSigTimeoutTime_TRSKM" SG_ 1450 DriveModeSts 0;
BA_ "GenSigSendType" SG_ 1450 GearDisplayForCluster 3;
BA_ "GenSigTimeoutTime_BCM" SG_ 1450 GearDisplayForCluster 0;
BA_ "GenSigTimeoutTime_BSM2" SG_ 1450 GearDisplayForCluster 0;
BA_ "GenSigTimeoutTime_CVADAS" SG_ 1450 GearDisplayForCluster 0;
BA_ "GenSigTimeoutTime_EPS" SG_ 1450 GearDisplayForCluster 0;
BA_ "GenSigTimeoutTime_ORC" SG_ 1450 GearDisplayForCluster 0;
BA_ "GenSigTimeoutTime_PAM" SG_ 1450 GearDisplayForCluster 0;
BA_ "GenSigTimeoutTime_SGW" SG_ 1450 GearDisplayForCluster 0;
BA_ "GenSigTimeoutTime_TRSKM" SG_ 1450 GearDisplayForCluster 0;
BA_ "GenSigSendType" SG_ 1450 GearEngaged 3;
BA_ "GenSigTimeoutTime_BCM" SG_ 1450 GearEngaged 0;
BA_ "GenSigTimeoutTime_PAM" SG_ 1450 GearEngaged 0;
BA_ "GenSigTimeoutTime_SGW" SG_ 1450 GearEngaged 0;
BA_ "GenSigTimeoutTime_TRSKM" SG_ 1450 GearEngaged 0;
BA_ "GenSigSendType" SG_ 1450 HAS_SoH_TCM 3;
BA_ "GenSigTimeoutTime_BCM" SG_ 1450 HAS_SoH_TCM 0;
BA_ "GenSigTimeoutTime_BSM2" SG_ 1450 HAS_SoH_TCM 0;
BA_ "GenSigTimeoutTime_CVADAS" SG_ 1450 HAS_SoH_TCM 0;
BA_ "GenSigTimeoutTime_EPS" SG_ 1450 HAS_SoH_TCM 0;
BA_ "GenSigTimeoutTime_ORC" SG_ 1450 HAS_SoH_TCM 0;
BA_ "GenSigTimeoutTime_PAM" SG_ 1450 HAS_SoH_TCM 0;
BA_ "GenSigTimeoutTime_SGW" SG_ 1450 HAS_SoH_TCM 0;
BA_ "GenSigTimeoutTime_TRSKM" SG_ 1450 HAS_SoH_TCM 0;
BA_ "GenSigSendType" SG_ 1450 LimpHomeSts 3;
BA_ "GenSigTimeoutTime_BCM" SG_ 1450 LimpHomeSts 0;
BA_ "GenSigTimeoutTime_BSM2" SG_ 1450 LimpHomeSts 0;
BA_ "GenSigTimeoutTime_CADM2" SG_ 1450 LimpHomeSts 0;
BA_ "GenSigTimeoutTime_CVADAS" SG_ 1450 LimpHomeSts 0;
BA_ "GenSigTimeoutTime_EPS" SG_ 1450 LimpHomeSts 0;
BA_ "GenSigTimeoutTime_PAM" SG_ 1450 LimpHomeSts 0;
BA_ "GenSigTimeoutTime_SGW" SG_ 1450 LimpHomeSts 0;
BA_ "GenSigTimeoutTime_TRSKM" SG_ 1450 LimpHomeSts 0;
BA_ "GenSigTimeoutTime_BCM" SG_ 1450 MessageCounter_TRANSM4 0;
BA_ "GenSigTimeoutTime_CVADAS" SG_ 1450 MessageCounter_TRANSM4 0;
BA_ "GenSigTimeoutTime_PAM" SG_ 1450 MessageCounter_TRANSM4 0;
BA_ "GenSigTimeoutTime_SGW" SG_ 1450 MessageCounter_TRANSM4 0;
BA_ "GenSigTimeoutTime_TRSKM" SG_ 1450 MessageCounter_TRANSM4 0;
BA_ "GenSigSendType" SG_ 1450 ShiftLeverPosition 3;
BA_ "GenSigTimeoutTime_BCM" SG_ 1450 ShiftLeverPosition 0;
BA_ "GenSigTimeoutTime_BSM2" SG_ 1450 ShiftLeverPosition 0;
BA_ "GenSigTimeoutTime_CADM2" SG_ 1450 ShiftLeverPosition 0;
BA_ "GenSigTimeoutTime_PAM" SG_ 1450 ShiftLeverPosition 0;
BA_ "GenSigTimeoutTime_SGW" SG_ 1450 ShiftLeverPosition 0;
BA_ "GenSigTimeoutTime_TRSKM" SG_ 1450 ShiftLeverPosition 0;
BA_ "GenSigSendType" SG_ 1450 TransmissionFailSts 3;
BA_ "GenSigTimeoutTime_BCM" SG_ 1450 TransmissionFailSts 0;
BA_ "GenSigTimeoutTime_BSM2" SG_ 1450 TransmissionFailSts 0;
BA_ "GenSigTimeoutTime_CADM2" SG_ 1450 TransmissionFailSts 0;
BA_ "GenSigTimeoutTime_CVADAS" SG_ 1450 TransmissionFailSts 0;
BA_ "GenSigTimeoutTime_EPS" SG_ 1450 TransmissionFailSts 0;
BA_ "GenSigTimeoutTime_PAM" SG_ 1450 TransmissionFailSts 0;
BA_ "GenSigTimeoutTime_SGW" SG_ 1450 TransmissionFailSts 0;
BA_ "GenSigTimeoutTime_TRSKM" SG_ 1450 TransmissionFailSts 0;
BA_ "GenSigSendType" SG_ 1450 TransmissionWarnings 3;
BA_ "GenSigTimeoutTime_BCM" SG_ 1450 TransmissionWarnings 0;
BA_ "GenSigTimeoutTime_BSM2" SG_ 1450 TransmissionWarnings 0;
BA_ "GenSigTimeoutTime_CADM2" SG_ 1450 TransmissionWarnings 0;
BA_ "GenSigTimeoutTime_CVADAS" SG_ 1450 TransmissionWarnings 0;
BA_ "GenSigTimeoutTime_EPS" SG_ 1450 TransmissionWarnings 0;
BA_ "GenSigTimeoutTime_PAM" SG_ 1450 TransmissionWarnings 0;
BA_ "GenSigTimeoutTime_SGW" SG_ 1450 TransmissionWarnings 0;
BA_ "GenSigTimeoutTime_TRSKM" SG_ 1450 TransmissionWarnings 0;
BA_ "GenSigTimeoutTime_BSM2" SG_ 1472 CRC_TRSCM1 0;
BA_ "GenSigTimeoutTime_CADM2" SG_ 1472 CRC_TRSCM1 0;
BA_ "GenSigTimeoutTime_CVADAS" SG_ 1472 CRC_TRSCM1 0;
BA_ "GenSigTimeoutTime_ORC" SG_ 1472 CRC_TRSCM1 0;
BA_ "GenSigTimeoutTime_PAM" SG_ 1472 CRC_TRSCM1 0;
BA_ "GenSigTimeoutTime_SGW" SG_ 1472 CRC_TRSCM1 0;
BA_ "GenSigTimeoutTime_TRSKM" SG_ 1472 CRC_TRSCM1 0;
BA_ "GenSigTimeoutTime_BSM2" SG_ 1472 MessageCounter_TRSCM1 0;
BA_ "GenSigTimeoutTime_CADM2" SG_ 1472 MessageCounter_TRSCM1 0;
BA_ "GenSigTimeoutTime_CVADAS" SG_ 1472 MessageCounter_TRSCM1 0;
BA_ "GenSigTimeoutTime_ORC" SG_ 1472 MessageCounter_TRSCM1 0;
BA_ "GenSigTimeoutTime_PAM" SG_ 1472 MessageCounter_TRSCM1 0;
BA_ "GenSigTimeoutTime_SGW" SG_ 1472 MessageCounter_TRSCM1 0;
BA_ "GenSigTimeoutTime_TRSKM" SG_ 1472 MessageCounter_TRSCM1 0;
BA_ "GenSigSendType" SG_ 1472 THA_EPB_Req 4;
BA_ "GenSigTimeoutTime_BSM2" SG_ 1472 THA_EPB_Req 0;
BA_ "GenSigTimeoutTime_CADM2" SG_ 1472 THA_EPB_Req 0;
BA_ "GenSigTimeoutTime_CVADAS" SG_ 1472 THA_EPB_Req 0;
BA_ "GenSigTimeoutTime_EPS" SG_ 1472 THA_EPB_Req 0;
BA_ "GenSigTimeoutTime_ORC" SG_ 1472 THA_EPB_Req 0;
BA_ "GenSigTimeoutTime_PAM" SG_ 1472 THA_EPB_Req 0;
BA_ "GenSigTimeoutTime_SGW" SG_ 1472 THA_EPB_Req 0;
BA_ "GenSigTimeoutTime_TRSKM" SG_ 1472 THA_EPB_Req 0;
BA_ "GenSigSendType" SG_ 1472 THA_Speed_Limit 4;
BA_ "GenSigTimeoutTime_BSM2" SG_ 1472 THA_Speed_Limit 0;
BA_ "GenSigTimeoutTime_CADM2" SG_ 1472 THA_Speed_Limit 0;
BA_ "GenSigTimeoutTime_CVADAS" SG_ 1472 THA_Speed_Limit 0;
BA_ "GenSigTimeoutTime_ORC" SG_ 1472 THA_Speed_Limit 0;
BA_ "GenSigTimeoutTime_PAM" SG_ 1472 THA_Speed_Limit 0;
BA_ "GenSigTimeoutTime_SGW" SG_ 1472 THA_Speed_Limit 0;
BA_ "GenSigTimeoutTime_TRSKM" SG_ 1472 THA_Speed_Limit 0;
BA_ "GenSigSendType" SG_ 1472 THA_SpeedLimit_Req 4;
BA_ "GenSigTimeoutTime_BSM2" SG_ 1472 THA_SpeedLimit_Req 0;
BA_ "GenSigTimeoutTime_CADM2" SG_ 1472 THA_SpeedLimit_Req 0;
BA_ "GenSigTimeoutTime_CVADAS" SG_ 1472 THA_SpeedLimit_Req 0;
BA_ "GenSigTimeoutTime_EPS" SG_ 1472 THA_SpeedLimit_Req 0;
BA_ "GenSigTimeoutTime_ORC" SG_ 1472 THA_SpeedLimit_Req 0;
BA_ "GenSigTimeoutTime_PAM" SG_ 1472 THA_SpeedLimit_Req 0;
BA_ "GenSigTimeoutTime_SGW" SG_ 1472 THA_SpeedLimit_Req 0;
BA_ "GenSigTimeoutTime_TRSKM" SG_ 1472 THA_SpeedLimit_Req 0;
BA_ "GenSigSendType" SG_ 1472 THA_STAT 4;
BA_ "GenSigTimeoutTime_BSM2" SG_ 1472 THA_STAT 0;
BA_ "GenSigTimeoutTime_CADM2" SG_ 1472 THA_STAT 0;
BA_ "GenSigTimeoutTime_CVADAS" SG_ 1472 THA_STAT 0;
BA_ "GenSigTimeoutTime_ORC" SG_ 1472 THA_STAT 0;
BA_ "GenSigTimeoutTime_PAM" SG_ 1472 THA_STAT 0;
BA_ "GenSigTimeoutTime_TRSKM" SG_ 1472 THA_STAT 0;
BA_ "GenSigStartValue" SG_ 1472 THA_SteeringDamping 100;
BA_ "GenSigSendType" SG_ 1472 THA_SteeringDamping 3;
BA_ "GenSigTimeoutTime_BCM" SG_ 1472 THA_SteeringDamping 0;
BA_ "GenSigTimeoutTime_BSM2" SG_ 1472 THA_SteeringDamping 0;
BA_ "GenSigTimeoutTime_CADM2" SG_ 1472 THA_SteeringDamping 0;
BA_ "GenSigTimeoutTime_CVADAS" SG_ 1472 THA_SteeringDamping 0;
BA_ "GenSigTimeoutTime_ORC" SG_ 1472 THA_SteeringDamping 0;
BA_ "GenSigTimeoutTime_PAM" SG_ 1472 THA_SteeringDamping 0;
BA_ "GenSigTimeoutTime_SGW" SG_ 1472 THA_SteeringDamping 0;
BA_ "GenSigTimeoutTime_TRSKM" SG_ 1472 THA_SteeringDamping 0;
BA_ "GenSigStartValue" SG_ 1472 THA_SteeringTorqueInfo 1024;
BA_ "GenSigSendType" SG_ 1472 THA_SteeringTorqueInfo 3;
BA_ "GenSigTimeoutTime_BCM" SG_ 1472 THA_SteeringTorqueInfo 0;
BA_ "GenSigTimeoutTime_BSM2" SG_ 1472 THA_SteeringTorqueInfo 0;
BA_ "GenSigTimeoutTime_CADM2" SG_ 1472 THA_SteeringTorqueInfo 0;
BA_ "GenSigTimeoutTime_CVADAS" SG_ 1472 THA_SteeringTorqueInfo 0;
BA_ "GenSigTimeoutTime_ORC" SG_ 1472 THA_SteeringTorqueInfo 0;
BA_ "GenSigTimeoutTime_PAM" SG_ 1472 THA_SteeringTorqueInfo 0;
BA_ "GenSigTimeoutTime_SGW" SG_ 1472 THA_SteeringTorqueInfo 0;
BA_ "GenSigTimeoutTime_TRSKM" SG_ 1472 THA_SteeringTorqueInfo 0;
BA_ "GenSigSendType" SG_ 1472 THA_SteeringTorqueReq 4;
BA_ "GenSigTimeoutTime_BCM" SG_ 1472 THA_SteeringTorqueReq 0;
BA_ "GenSigTimeoutTime_BSM2" SG_ 1472 THA_SteeringTorqueReq 0;
BA_ "GenSigTimeoutTime_CADM2" SG_ 1472 THA_SteeringTorqueReq 0;
BA_ "GenSigTimeoutTime_CVADAS" SG_ 1472 THA_SteeringTorqueReq 0;
BA_ "GenSigTimeoutTime_ORC" SG_ 1472 THA_SteeringTorqueReq 0;
BA_ "GenSigTimeoutTime_PAM" SG_ 1472 THA_SteeringTorqueReq 0;
BA_ "GenSigTimeoutTime_SGW" SG_ 1472 THA_SteeringTorqueReq 0;
BA_ "GenSigTimeoutTime_TRSKM" SG_ 1472 THA_SteeringTorqueReq 0;
BA_ "GenSigTimeoutTime_BCM" SG_ 1472 Trailer_Angle 0;
BA_ "GenSigTimeoutTime_BSM2" SG_ 1472 Trailer_Angle 0;
BA_ "GenSigTimeoutTime_CADM2" SG_ 1472 Trailer_Angle 0;
BA_ "GenSigTimeoutTime_CVADAS" SG_ 1472 Trailer_Angle 0;
BA_ "GenSigTimeoutTime_EPS" SG_ 1472 Trailer_Angle 0;
BA_ "GenSigTimeoutTime_ORC" SG_ 1472 Trailer_Angle 0;
BA_ "GenSigTimeoutTime_PAM" SG_ 1472 Trailer_Angle 0;
BA_ "GenSigTimeoutTime_TRSKM" SG_ 1472 Trailer_Angle 0;
BA_ "GenSigSendType" SG_ 1472 Trailer_Angle_Sign 3;
BA_ "GenSigTimeoutTime_BCM" SG_ 1472 Trailer_Angle_Sign 0;
BA_ "GenSigTimeoutTime_BSM2" SG_ 1472 Trailer_Angle_Sign 0;
BA_ "GenSigTimeoutTime_CADM2" SG_ 1472 Trailer_Angle_Sign 0;
BA_ "GenSigTimeoutTime_CVADAS" SG_ 1472 Trailer_Angle_Sign 0;
BA_ "GenSigTimeoutTime_EPS" SG_ 1472 Trailer_Angle_Sign 0;
BA_ "GenSigTimeoutTime_ORC" SG_ 1472 Trailer_Angle_Sign 0;
BA_ "GenSigTimeoutTime_PAM" SG_ 1472 Trailer_Angle_Sign 0;
BA_ "GenSigTimeoutTime_TRSKM" SG_ 1472 Trailer_Angle_Sign 0;
BA_ "GenSigSendType" SG_ 1472 Trailer_Calibration 4;
BA_ "GenSigTimeoutTime_BCM" SG_ 1472 Trailer_Calibration 0;
BA_ "GenSigTimeoutTime_BSM2" SG_ 1472 Trailer_Calibration 0;
BA_ "GenSigTimeoutTime_CADM2" SG_ 1472 Trailer_Calibration 0;
BA_ "GenSigTimeoutTime_CVADAS" SG_ 1472 Trailer_Calibration 0;
BA_ "GenSigTimeoutTime_EPS" SG_ 1472 Trailer_Calibration 0;
BA_ "GenSigTimeoutTime_ORC" SG_ 1472 Trailer_Calibration 0;
BA_ "GenSigTimeoutTime_PAM" SG_ 1472 Trailer_Calibration 0;
BA_ "GenSigTimeoutTime_TRSKM" SG_ 1472 Trailer_Calibration 0;
BA_ "GenSigSendType" SG_ 1472 TrlrHitchLight_Cntrl 3;
BA_ "GenSigTimeoutTime_BSM2" SG_ 1472 TrlrHitchLight_Cntrl 0;
BA_ "GenSigTimeoutTime_CADM2" SG_ 1472 TrlrHitchLight_Cntrl 0;
BA_ "GenSigTimeoutTime_CVADAS" SG_ 1472 TrlrHitchLight_Cntrl 0;
BA_ "GenSigTimeoutTime_EPS" SG_ 1472 TrlrHitchLight_Cntrl 0;
BA_ "GenSigTimeoutTime_ORC" SG_ 1472 TrlrHitchLight_Cntrl 0;
BA_ "GenSigTimeoutTime_PAM" SG_ 1472 TrlrHitchLight_Cntrl 0;
BA_ "GenSigTimeoutTime_SGW" SG_ 1472 TrlrHitchLight_Cntrl 0;
BA_ "GenSigTimeoutTime_TRSKM" SG_ 1472 TrlrHitchLight_Cntrl 0;
BA_ "GenSigSendType" SG_ 1472 TRSC_PopupDisp_Info 3;
BA_ "GenSigTimeoutTime_BSM2" SG_ 1472 TRSC_PopupDisp_Info 0;
BA_ "GenSigTimeoutTime_CADM2" SG_ 1472 TRSC_PopupDisp_Info 0;
BA_ "GenSigTimeoutTime_CVADAS" SG_ 1472 TRSC_PopupDisp_Info 0;
BA_ "GenSigTimeoutTime_EPS" SG_ 1472 TRSC_PopupDisp_Info 0;
BA_ "GenSigTimeoutTime_ORC" SG_ 1472 TRSC_PopupDisp_Info 0;
BA_ "GenSigTimeoutTime_PAM" SG_ 1472 TRSC_PopupDisp_Info 0;
BA_ "GenSigTimeoutTime_SGW" SG_ 1472 TRSC_PopupDisp_Info 0;
BA_ "GenSigTimeoutTime_TRSKM" SG_ 1472 TRSC_PopupDisp_Info 0;
BA_ "GenSigSendType" SG_ 1472 TRSC_SpeedLimit_Req 3;
BA_ "GenSigTimeoutTime_BSM2" SG_ 1472 TRSC_SpeedLimit_Req 0;
BA_ "GenSigTimeoutTime_CADM2" SG_ 1472 TRSC_SpeedLimit_Req 0;
BA_ "GenSigTimeoutTime_CVADAS" SG_ 1472 TRSC_SpeedLimit_Req 0;
BA_ "GenSigTimeoutTime_EPS" SG_ 1472 TRSC_SpeedLimit_Req 0;
BA_ "GenSigTimeoutTime_ORC" SG_ 1472 TRSC_SpeedLimit_Req 0;
BA_ "GenSigTimeoutTime_PAM" SG_ 1472 TRSC_SpeedLimit_Req 0;
BA_ "GenSigTimeoutTime_SGW" SG_ 1472 TRSC_SpeedLimit_Req 0;
BA_ "GenSigTimeoutTime_TRSKM" SG_ 1472 TRSC_SpeedLimit_Req 0;
BA_ "GenSigStartValue" SG_ 1472 TRSC_STAT 1;
BA_ "GenSigSendType" SG_ 1472 TRSC_STAT 3;
BA_ "GenSigTimeoutTime_BSM2" SG_ 1472 TRSC_STAT 0;
BA_ "GenSigTimeoutTime_CADM2" SG_ 1472 TRSC_STAT 0;
BA_ "GenSigTimeoutTime_CVADAS" SG_ 1472 TRSC_STAT 0;
BA_ "GenSigTimeoutTime_EPS" SG_ 1472 TRSC_STAT 0;
BA_ "GenSigTimeoutTime_ORC" SG_ 1472 TRSC_STAT 0;
BA_ "GenSigTimeoutTime_PAM" SG_ 1472 TRSC_STAT 0;
BA_ "GenSigTimeoutTime_TRSKM" SG_ 1472 TRSC_STAT 0;
BA_ "GenSigStartValue" SG_ 1472 TRSC_SteeringDamping 100;
BA_ "GenSigTimeoutTime_BCM" SG_ 1472 TRSC_SteeringDamping 0;
BA_ "GenSigTimeoutTime_BSM2" SG_ 1472 TRSC_SteeringDamping 0;
BA_ "GenSigTimeoutTime_CADM2" SG_ 1472 TRSC_SteeringDamping 0;
BA_ "GenSigTimeoutTime_CVADAS" SG_ 1472 TRSC_SteeringDamping 0;
BA_ "GenSigTimeoutTime_ORC" SG_ 1472 TRSC_SteeringDamping 0;
BA_ "GenSigTimeoutTime_PAM" SG_ 1472 TRSC_SteeringDamping 0;
BA_ "GenSigTimeoutTime_SGW" SG_ 1472 TRSC_SteeringDamping 0;
BA_ "GenSigTimeoutTime_TRSKM" SG_ 1472 TRSC_SteeringDamping 0;
BA_ "GenSigStartValue" SG_ 1472 TRSC_SteeringTorqueInfo 1024;
BA_ "GenSigSendType" SG_ 1472 TRSC_SteeringTorqueInfo 3;
BA_ "GenSigTimeoutTime_BCM" SG_ 1472 TRSC_SteeringTorqueInfo 0;
BA_ "GenSigTimeoutTime_BSM2" SG_ 1472 TRSC_SteeringTorqueInfo 0;
BA_ "GenSigTimeoutTime_CADM2" SG_ 1472 TRSC_SteeringTorqueInfo 0;
BA_ "GenSigTimeoutTime_CVADAS" SG_ 1472 TRSC_SteeringTorqueInfo 0;
BA_ "GenSigTimeoutTime_ORC" SG_ 1472 TRSC_SteeringTorqueInfo 0;
BA_ "GenSigTimeoutTime_PAM" SG_ 1472 TRSC_SteeringTorqueInfo 0;
BA_ "GenSigTimeoutTime_TRSKM" SG_ 1472 TRSC_SteeringTorqueInfo 0;
BA_ "GenSigSendType" SG_ 1472 TRSC_SteeringTorqueReq 3;
BA_ "GenSigTimeoutTime_BCM" SG_ 1472 TRSC_SteeringTorqueReq 0;
BA_ "GenSigTimeoutTime_BSM2" SG_ 1472 TRSC_SteeringTorqueReq 0;
BA_ "GenSigTimeoutTime_CADM2" SG_ 1472 TRSC_SteeringTorqueReq 0;
BA_ "GenSigTimeoutTime_CVADAS" SG_ 1472 TRSC_SteeringTorqueReq 0;
BA_ "GenSigTimeoutTime_ORC" SG_ 1472 TRSC_SteeringTorqueReq 0;
BA_ "GenSigTimeoutTime_PAM" SG_ 1472 TRSC_SteeringTorqueReq 0;
BA_ "GenSigTimeoutTime_SGW" SG_ 1472 TRSC_SteeringTorqueReq 0;
BA_ "GenSigTimeoutTime_TRSKM" SG_ 1472 TRSC_SteeringTorqueReq 0;
BA_ "GenSigStartValue" SG_ 1472 TRSC_VehicleStop_Req 3;
BA_ "GenSigSendType" SG_ 1472 TRSC_VehicleStop_Req 3;
BA_ "GenSigTimeoutTime_BSM2" SG_ 1472 TRSC_VehicleStop_Req 0;
BA_ "GenSigTimeoutTime_CADM2" SG_ 1472 TRSC_VehicleStop_Req 0;
BA_ "GenSigTimeoutTime_CVADAS" SG_ 1472 TRSC_VehicleStop_Req 0;
BA_ "GenSigTimeoutTime_EPS" SG_ 1472 TRSC_VehicleStop_Req 0;
BA_ "GenSigTimeoutTime_ORC" SG_ 1472 TRSC_VehicleStop_Req 0;
BA_ "GenSigTimeoutTime_PAM" SG_ 1472 TRSC_VehicleStop_Req 0;
BA_ "GenSigTimeoutTime_SGW" SG_ 1472 TRSC_VehicleStop_Req 0;
BA_ "GenSigTimeoutTime_TRSKM" SG_ 1472 TRSC_VehicleStop_Req 0;
BA_ "GenSigSendType" SG_ 1472 TRSCMoreCamRQSts 3;
BA_ "GenSigTimeoutTime_BSM2" SG_ 1472 TRSCMoreCamRQSts 0;
BA_ "GenSigTimeoutTime_CADM2" SG_ 1472 TRSCMoreCamRQSts 0;
BA_ "GenSigTimeoutTime_CVADAS" SG_ 1472 TRSCMoreCamRQSts 0;
BA_ "GenSigTimeoutTime_EPS" SG_ 1472 TRSCMoreCamRQSts 0;
BA_ "GenSigTimeoutTime_ORC" SG_ 1472 TRSCMoreCamRQSts 0;
BA_ "GenSigTimeoutTime_PAM" SG_ 1472 TRSCMoreCamRQSts 0;
BA_ "GenSigTimeoutTime_TRSKM" SG_ 1472 TRSCMoreCamRQSts 0;
BA_ "GenSigTimeoutTime_BCM" SG_ 1476 CRC_TRSKM_FD_1 0;
BA_ "GenSigTimeoutTime_BSM2" SG_ 1476 CRC_TRSKM_FD_1 0;
BA_ "GenSigTimeoutTime_CADM2" SG_ 1476 CRC_TRSKM_FD_1 0;
BA_ "GenSigTimeoutTime_EPS" SG_ 1476 CRC_TRSKM_FD_1 0;
BA_ "GenSigTimeoutTime_ORC" SG_ 1476 CRC_TRSKM_FD_1 0;
BA_ "GenSigTimeoutTime_PAM" SG_ 1476 CRC_TRSKM_FD_1 0;
BA_ "GenSigTimeoutTime_SGW" SG_ 1476 CRC_TRSKM_FD_1 0;
BA_ "GenSigTimeoutTime_TRSKM" SG_ 1476 CRC_TRSKM_FD_1 0;
BA_ "GenSigTimeoutTime_BCM" SG_ 1476 MessageCounter_TRSKM_FD_1 0;
BA_ "GenSigTimeoutTime_BSM2" SG_ 1476 MessageCounter_TRSKM_FD_1 0;
BA_ "GenSigTimeoutTime_CADM2" SG_ 1476 MessageCounter_TRSKM_FD_1 0;
BA_ "GenSigTimeoutTime_EPS" SG_ 1476 MessageCounter_TRSKM_FD_1 0;
BA_ "GenSigTimeoutTime_ORC" SG_ 1476 MessageCounter_TRSKM_FD_1 0;
BA_ "GenSigTimeoutTime_PAM" SG_ 1476 MessageCounter_TRSKM_FD_1 0;
BA_ "GenSigTimeoutTime_SGW" SG_ 1476 MessageCounter_TRSKM_FD_1 0;
BA_ "GenSigTimeoutTime_TRSKM" SG_ 1476 MessageCounter_TRSKM_FD_1 0;
BA_ "GenSigSendType" SG_ 1476 TRSC_CenterBtn_Sts 4;
BA_ "GenSigTimeoutTime_BCM" SG_ 1476 TRSC_CenterBtn_Sts 0;
BA_ "GenSigTimeoutTime_BSM2" SG_ 1476 TRSC_CenterBtn_Sts 0;
BA_ "GenSigTimeoutTime_CADM2" SG_ 1476 TRSC_CenterBtn_Sts 0;
BA_ "GenSigTimeoutTime_EPS" SG_ 1476 TRSC_CenterBtn_Sts 0;
BA_ "GenSigTimeoutTime_ORC" SG_ 1476 TRSC_CenterBtn_Sts 0;
BA_ "GenSigTimeoutTime_PAM" SG_ 1476 TRSC_CenterBtn_Sts 0;
BA_ "GenSigTimeoutTime_SGW" SG_ 1476 TRSC_CenterBtn_Sts 0;
BA_ "GenSigTimeoutTime_TRSKM" SG_ 1476 TRSC_CenterBtn_Sts 0;
BA_ "GenSigSendType" SG_ 1476 TRSC_EnableBtn_Sts 4;
BA_ "GenSigTimeoutTime_BCM" SG_ 1476 TRSC_EnableBtn_Sts 0;
BA_ "GenSigTimeoutTime_BSM2" SG_ 1476 TRSC_EnableBtn_Sts 0;
BA_ "GenSigTimeoutTime_CADM2" SG_ 1476 TRSC_EnableBtn_Sts 0;
BA_ "GenSigTimeoutTime_EPS" SG_ 1476 TRSC_EnableBtn_Sts 0;
BA_ "GenSigTimeoutTime_ORC" SG_ 1476 TRSC_EnableBtn_Sts 0;
BA_ "GenSigTimeoutTime_PAM" SG_ 1476 TRSC_EnableBtn_Sts 0;
BA_ "GenSigTimeoutTime_SGW" SG_ 1476 TRSC_EnableBtn_Sts 0;
BA_ "GenSigTimeoutTime_TRSKM" SG_ 1476 TRSC_EnableBtn_Sts 0;
BA_ "GenSigSendType" SG_ 1476 TRSC_RawKnob 4;
BA_ "GenSigTimeoutTime_BCM" SG_ 1476 TRSC_RawKnob 0;
BA_ "GenSigTimeoutTime_BSM2" SG_ 1476 TRSC_RawKnob 0;
BA_ "GenSigTimeoutTime_CADM2" SG_ 1476 TRSC_RawKnob 0;
BA_ "GenSigTimeoutTime_EPS" SG_ 1476 TRSC_RawKnob 0;
BA_ "GenSigTimeoutTime_ORC" SG_ 1476 TRSC_RawKnob 0;
BA_ "GenSigTimeoutTime_PAM" SG_ 1476 TRSC_RawKnob 0;
BA_ "GenSigTimeoutTime_SGW" SG_ 1476 TRSC_RawKnob 0;
BA_ "GenSigTimeoutTime_TRSKM" SG_ 1476 TRSC_RawKnob 0;
BA_ "GenSigTimeoutTime_BCM" SG_ 1053 VIN_DATA 0;
BA_ "GenSigTimeoutTime_SGW" SG_ 1053 VIN_DATA 0;
BA_ "GenSigStartValue" SG_ 1053 VIN_MSG 3;
BA_ "GenSigTimeoutTime_BCM" SG_ 1053 VIN_MSG 0;
BA_ "GenSigTimeoutTime_SGW" SG_ 1053 VIN_MSG 0;
VAL_ 2654339184 CurrentCanNMState_FD01_SGW 0 "Uninitialized State" 1 "Bus-Sleep State" 2 "Prepare-Bus State" 3 "Ready-Sleep State" 4 "Normal Operation State" 5 "Repeat Message State" 6 "Synchronize State" 7 "Offline State" ;
VAL_ 2654339184 CurrentCanNMState_FD02_SGW 0 "Uninitialized State" 1 "Bus-Sleep State" 2 "Prepare-Bus State" 3 "Ready-Sleep State" 4 "Normal Operation State" 5 "Repeat Message State" 6 "Synchronize State" 7 "Offline State" ;
VAL_ 2654339184 CurrentCanNMState_FD03_SGW 0 "Uninitialized State" 1 "Bus-Sleep State" 2 "Prepare-Bus State" 3 "Ready-Sleep State" 4 "Normal Operation State" 5 "Repeat Message State" 6 "Synchronize State" 7 "Offline State" ;
VAL_ 2654339184 CurrentCanNMState_FD08_SGW 0 "Uninitialized State" 1 "Bus-Sleep State" 2 "Prepare-Bus State" 3 "Ready-Sleep State" 4 "Normal Operation State" 5 "Repeat Message State" 6 "Synchronize State" 7 "Offline State" ;
VAL_ 2654339184 CurrentCanNMState_FD11_SGW 0 "Uninitialized State" 1 "Bus-Sleep State" 2 "Prepare-Bus State" 3 "Ready-Sleep State" 4 "Normal Operation State" 5 "Repeat Message State" 6 "Synchronize State" 7 "Offline State" ;
VAL_ 2654339184 CurrentFailSts_FD01_SGW 0 "No_Fail_Present" 1 "Fail_Present" ;
VAL_ 2654339184 CurrentFailSts_FD02_SGW 0 "No_Fail_Present" 1 "Fail_Present" ;
VAL_ 2654339184 CurrentFailSts_FD03_SGW 0 "No_Fail_Present" 1 "Fail_Present" ;
VAL_ 2654339184 CurrentFailSts_FD08_SGW 0 "No_Fail_Present" 1 "Fail_Present" ;
VAL_ 2654339184 CurrentFailSts_FD11_SGW 0 "No_Fail_Present" 1 "Fail_Present" ;
VAL_ 2654339184 DES_FD01_SGW 0 "Error_Active_state" 1 "Error_passive_warning_state" 2 "Bus_off_state" 3 "Not_used" ;
VAL_ 2654339184 DES_FD02_SGW 0 "Error_Active_state" 1 "Error_passive_warning_state" 2 "Bus_off_state" 3 "Not_used" ;
VAL_ 2654339184 DES_FD03_SGW 0 "Error_Active_state" 1 "Error_passive_warning_state" 2 "Bus_off_state" 3 "Not_used" ;
VAL_ 2654339184 DES_FD08_SGW 0 "Error_Active_state" 1 "Error_passive_warning_state" 2 "Bus_off_state" 3 "Not_used" ;
VAL_ 2654339184 DES_FD11_SGW 0 "Error_Active_state" 1 "Error_passive_warning_state" 2 "Bus_off_state" 3 "Not_used" ;
VAL_ 2654339184 EOL_FD01_SGW 0 "No_EOL_Programming" 1 "EOL_Programming" ;
VAL_ 2654339184 EOL_FD02_SGW 0 "No_EOL_Programming" 1 "EOL_Programming" ;
VAL_ 2654339184 EOL_FD03_SGW 0 "No_EOL_Programming" 1 "EOL_Programming" ;
VAL_ 2654339184 EOL_FD08_SGW 0 "No_EOL_Programming" 1 "EOL_Programming" ;
VAL_ 2654339184 EOL_FD11_SGW 0 "No_EOL_Programming" 1 "EOL_Programming" ;
VAL_ 2654339184 GenericFailSts_FD01_SGW 0 "No_Fail_Present" 1 "Fail_Present" ;
VAL_ 2654339184 GenericFailSts_FD02_SGW 0 "No_Fail_Present" 1 "Fail_Present" ;
VAL_ 2654339184 GenericFailSts_FD03_SGW 0 "No_Fail_Present" 1 "Fail_Present" ;
VAL_ 2654339184 GenericFailSts_FD08_SGW 0 "No_Fail_Present" 1 "Fail_Present" ;
VAL_ 2654339184 GenericFailSts_FD11_SGW 0 "No_Fail_Present" 1 "Fail_Present" ;
VAL_ 2654339184 PreviousCanNMState_FD01_SGW 0 "Uninitialized State" 1 "Bus-Sleep State" 2 "Prepare-Bus State" 3 "Ready-Sleep State" 4 "Normal Operation State" 5 "Repeat Message State" 6 "Synchronize State" 7 "Offline State" ;
VAL_ 2654339184 PreviousCanNMState_FD02_SGW 0 "Uninitialized State" 1 "Bus-Sleep State" 2 "Prepare-Bus State" 3 "Ready-Sleep State" 4 "Normal Operation State" 5 "Repeat Message State" 6 "Synchronize State" 7 "Offline State" ;
VAL_ 2654339184 PreviousCanNMState_FD03_SGW 0 "Uninitialized State" 1 "Bus-Sleep State" 2 "Prepare-Bus State" 3 "Ready-Sleep State" 4 "Normal Operation State" 5 "Repeat Message State" 6 "Synchronize State" 7 "Offline State" ;
VAL_ 2654339184 PreviousCanNMState_FD08_SGW 0 "Uninitialized State" 1 "Bus-Sleep State" 2 "Prepare-Bus State" 3 "Ready-Sleep State" 4 "Normal Operation State" 5 "Repeat Message State" 6 "Synchronize State" 7 "Offline State" ;
VAL_ 2654339184 PreviousCanNMState_FD11_SGW 0 "Uninitialized State" 1 "Bus-Sleep State" 2 "Prepare-Bus State" 3 "Ready-Sleep State" 4 "Normal Operation State" 5 "Repeat Message State" 6 "Synchronize State" 7 "Offline State" ;
VAL_ 2654339184 StayActiveSource_FD01_SGW 0 "CANNM_Ready_Sleep" 1 "IGN_ON" 2 "NonDefault_Diag" 4 "ING_OFF_NormSt_RptSt" ;
VAL_ 2654339184 StayActiveSource_FD02_SGW 0 "CANNM_Ready_Sleep" 1 "IGN_ON" 2 "NonDefault_Diag" 4 "ING_OFF_NormSt_RptSt" ;
VAL_ 2654339184 StayActiveSource_FD03_SGW 0 "CANNM_Ready_Sleep" 1 "IGN_ON" 2 "NonDefault_Diag" 4 "ING_OFF_NormSt_RptSt" ;
VAL_ 2654339184 StayActiveSource_FD08_SGW 0 "CANNM_Ready_Sleep" 1 "IGN_ON" 2 "NonDefault_Diag" 4 "ING_OFF_NormSt_RptSt" ;
VAL_ 2654339184 StayActiveSource_FD11_SGW 0 "CANNM_Ready_Sleep" 1 "IGN_ON" 2 "NonDefault_Diag" 4 "ING_OFF_NormSt_RptSt" ;
VAL_ 2654339184 WakeupSource_FD01_SGW 0 "No_Wakeup" 1 "IGN_ON" 129 "FD1_Psv_WU" 130 "FD2_Psv_WU" 131 "FD3_Psv_WU" 132 "FD4_Psv_WU" 133 "FD5_Psv_WU" 134 "FD6_Psv_WU" 135 "FD7_Psv_WU" 136 "FD8_Psv_WU" 137 "FD9_Psv_WU" 138 "FD10_Psv_WU" 139 "FD11_Psv_WU" 140 "FD12_Psv_WU" 141 "FD13_Psv_WU" 142 "FD14_Psv_WU" 143 "FD15_Psv_WU" 144 "FD16_Psv_WU" 145 "FD17_Psv_WU" 146 "FD18_Psv_WU" 147 "FD19_Psv_WU" 148 "FD20_Psv_WU" 149 "FD21_Psv_WU" 150 "FD22_Psv_WU" 151 "FD23_Psv_WU" 152 "FD24_Psv_WU" 153 "FD25_Psv_WU" 154 "FD26_Psv_WU" 155 "FD27_Psv_WU" 156 "FD28_Psv_WU" 157 "FD29_Psv_WU" 158 "BHCAN_Psv_WU" 159 "CCAN_Psv_WU" ;
VAL_ 2654339184 WakeupSource_FD02_SGW 0 "No_Wakeup" 1 "IGN_ON" 129 "FD1_Psv_WU" 130 "FD2_Psv_WU" 131 "FD3_Psv_WU" 132 "FD4_Psv_WU" 133 "FD5_Psv_WU" 134 "FD6_Psv_WU" 135 "FD7_Psv_WU" 136 "FD8_Psv_WU" 137 "FD9_Psv_WU" 138 "FD10_Psv_WU" 139 "FD11_Psv_WU" 140 "FD12_Psv_WU" 141 "FD13_Psv_WU" 142 "FD14_Psv_WU" 143 "FD15_Psv_WU" 144 "FD16_Psv_WU" 145 "FD17_Psv_WU" 146 "FD18_Psv_WU" 147 "FD19_Psv_WU" 148 "FD20_Psv_WU" 149 "FD21_Psv_WU" 150 "FD22_Psv_WU" 151 "FD23_Psv_WU" 152 "FD24_Psv_WU" 153 "FD25_Psv_WU" 154 "FD26_Psv_WU" 155 "FD27_Psv_WU" 156 "FD28_Psv_WU" 157 "FD29_Psv_WU" 158 "BHCAN_Psv_WU" 159 "CCAN_Psv_WU" ;
VAL_ 2654339184 WakeupSource_FD03_SGW 0 "No_Wakeup" 1 "IGN_ON" 129 "FD1_Psv_WU" 130 "FD2_Psv_WU" 131 "FD3_Psv_WU" 132 "FD4_Psv_WU" 133 "FD5_Psv_WU" 134 "FD6_Psv_WU" 135 "FD7_Psv_WU" 136 "FD8_Psv_WU" 137 "FD9_Psv_WU" 138 "FD10_Psv_WU" 139 "FD11_Psv_WU" 140 "FD12_Psv_WU" 141 "FD13_Psv_WU" 142 "FD14_Psv_WU" 143 "FD15_Psv_WU" 144 "FD16_Psv_WU" 145 "FD17_Psv_WU" 146 "FD18_Psv_WU" 147 "FD19_Psv_WU" 148 "FD20_Psv_WU" 149 "FD21_Psv_WU" 150 "FD22_Psv_WU" 151 "FD23_Psv_WU" 152 "FD24_Psv_WU" 153 "FD25_Psv_WU" 154 "FD26_Psv_WU" 155 "FD27_Psv_WU" 156 "FD28_Psv_WU" 157 "FD29_Psv_WU" 158 "BHCAN_Psv_WU" 159 "CCAN_Psv_WU" ;
VAL_ 2654339184 WakeupSource_FD08_SGW 0 "No_Wakeup" 1 "IGN_ON" 129 "FD1_Psv_WU" 130 "FD2_Psv_WU" 131 "FD3_Psv_WU" 132 "FD4_Psv_WU" 133 "FD5_Psv_WU" 134 "FD6_Psv_WU" 135 "FD7_Psv_WU" 136 "FD8_Psv_WU" 137 "FD9_Psv_WU" 138 "FD10_Psv_WU" 139 "FD11_Psv_WU" 140 "FD12_Psv_WU" 141 "FD13_Psv_WU" 142 "FD14_Psv_WU" 143 "FD15_Psv_WU" 144 "FD16_Psv_WU" 145 "FD17_Psv_WU" 146 "FD18_Psv_WU" 147 "FD19_Psv_WU" 148 "FD20_Psv_WU" 149 "FD21_Psv_WU" 150 "FD22_Psv_WU" 151 "FD23_Psv_WU" 152 "FD24_Psv_WU" 153 "FD25_Psv_WU" 154 "FD26_Psv_WU" 155 "FD27_Psv_WU" 156 "FD28_Psv_WU" 157 "FD29_Psv_WU" 158 "BHCAN_Psv_WU" 159 "CCAN_Psv_WU" ;
VAL_ 2654339184 WakeupSource_FD11_SGW 0 "No_Wakeup" 1 "IGN_ON" 129 "FD1_Psv_WU" 130 "FD2_Psv_WU" 131 "FD3_Psv_WU" 132 "FD4_Psv_WU" 133 "FD5_Psv_WU" 134 "FD6_Psv_WU" 135 "FD7_Psv_WU" 136 "FD8_Psv_WU" 137 "FD9_Psv_WU" 138 "FD10_Psv_WU" 139 "FD11_Psv_WU" 140 "FD12_Psv_WU" 141 "FD13_Psv_WU" 142 "FD14_Psv_WU" 143 "FD15_Psv_WU" 144 "FD16_Psv_WU" 145 "FD17_Psv_WU" 146 "FD18_Psv_WU" 147 "FD19_Psv_WU" 148 "FD20_Psv_WU" 149 "FD21_Psv_WU" 150 "FD22_Psv_WU" 151 "FD23_Psv_WU" 152 "FD24_Psv_WU" 153 "FD25_Psv_WU" 154 "FD26_Psv_WU" 155 "FD27_Psv_WU" 156 "FD28_Psv_WU" 157 "FD29_Psv_WU" 158 "BHCAN_Psv_WU" 159 "CCAN_Psv_WU" ;
VAL_ 2654339101 CurrentCanNMState_FD04_SLML 0 "Uninitialized State" 1 "Bus-Sleep State" 2 "Prepare-Bus State" 3 "Ready-Sleep State" 4 "Normal Operation State" 5 "Repeat Message State" 6 "Synchronize State" 7 "Offline State" ;
VAL_ 2654339101 CurrentFailSts_FD04_SLML 0 "No_Fail_Present" 1 "Fail_Present" ;
VAL_ 2654339101 DES_FD04_SLML 0 "Error_Active_state" 1 "Error_passive_warning_state" 2 "Bus_off_state" 3 "Not_used" ;
VAL_ 2654339101 EOL_FD04_SLML 0 "No_EOL_Programming" 1 "EOL_Programming" ;
VAL_ 2654339101 GenericFailSts_FD04_SLML 0 "No_Fail_Present" 1 "Fail_Present" ;
VAL_ 2654339101 PreviousCanNMState_FD04_SLML 0 "Uninitialized State" 1 "Bus-Sleep State" 2 "Prepare-Bus State" 3 "Ready-Sleep State" 4 "Normal Operation State" 5 "Repeat Message State" 6 "Synchronize State" 7 "Offline State" ;
VAL_ 2654339101 StayActiveSource_FD04_SLML 0 "CANNM_Ready_Sleep" 1 "IGN_ON" 2 "NonDefault_Diag" 4 "ING_OFF_NormSt_RptSt" ;
VAL_ 2654339101 WakeupSource_FD04_SLML 0 "No_Wakeup" 1 "IGN_ON" 129 "FD1_Psv_WU" 130 "FD2_Psv_WU" 131 "FD3_Psv_WU" 132 "FD4_Psv_WU" 133 "FD5_Psv_WU" 134 "FD6_Psv_WU" 135 "FD7_Psv_WU" 136 "FD8_Psv_WU" 137 "FD9_Psv_WU" 138 "FD10_Psv_WU" 139 "FD11_Psv_WU" 140 "FD12_Psv_WU" 141 "FD13_Psv_WU" 142 "FD14_Psv_WU" 143 "FD15_Psv_WU" 144 "FD16_Psv_WU" 145 "FD17_Psv_WU" 146 "FD18_Psv_WU" 147 "FD19_Psv_WU" 148 "FD20_Psv_WU" 149 "FD21_Psv_WU" 150 "FD22_Psv_WU" 151 "FD23_Psv_WU" 152 "FD24_Psv_WU" 153 "FD25_Psv_WU" 154 "FD26_Psv_WU" 155 "FD27_Psv_WU" 156 "FD28_Psv_WU" 157 "FD29_Psv_WU" 158 "BHCAN_Psv_WU" 159 "CCAN_Psv_WU" ;
VAL_ 2654339198 CurrentCanNMState_FD04_SLMR 0 "Uninitialized State" 1 "Bus-Sleep State" 2 "Prepare-Bus State" 3 "Ready-Sleep State" 4 "Normal Operation State" 5 "Repeat Message State" 6 "Synchronize State" 7 "Offline State" ;
VAL_ 2654339198 CurrentFailSts_FD04_SLMR 0 "No_Fail_Present" 1 "Fail_Present" ;
VAL_ 2654339198 DES_FD04_SLMR 0 "Error_Active_state" 1 "Error_passive_warning_state" 2 "Bus_off_state" 3 "Not_used" ;
VAL_ 2654339198 EOL_FD04_SLMR 0 "No_EOL_Programming" 1 "EOL_Programming" ;
VAL_ 2654339198 GenericFailSts_FD04_SLMR 0 "No_Fail_Present" 1 "Fail_Present" ;
VAL_ 2654339198 PreviousCanNMState_FD04_SLMR 0 "Uninitialized State" 1 "Bus-Sleep State" 2 "Prepare-Bus State" 3 "Ready-Sleep State" 4 "Normal Operation State" 5 "Repeat Message State" 6 "Synchronize State" 7 "Offline State" ;
VAL_ 2654339198 StayActiveSource_FD04_SLMR 0 "CANNM_Ready_Sleep" 1 "IGN_ON" 2 "NonDefault_Diag" 4 "ING_OFF_NormSt_RptSt" ;
VAL_ 2654339198 WakeupSource_FD04_SLMR 0 "No_Wakeup" 1 "IGN_ON" 129 "FD1_Psv_WU" 130 "FD2_Psv_WU" 131 "FD3_Psv_WU" 132 "FD4_Psv_WU" 133 "FD5_Psv_WU" 134 "FD6_Psv_WU" 135 "FD7_Psv_WU" 136 "FD8_Psv_WU" 137 "FD9_Psv_WU" 138 "FD10_Psv_WU" 139 "FD11_Psv_WU" 140 "FD12_Psv_WU" 141 "FD13_Psv_WU" 142 "FD14_Psv_WU" 143 "FD15_Psv_WU" 144 "FD16_Psv_WU" 145 "FD17_Psv_WU" 146 "FD18_Psv_WU" 147 "FD19_Psv_WU" 148 "FD20_Psv_WU" 149 "FD21_Psv_WU" 150 "FD22_Psv_WU" 151 "FD23_Psv_WU" 152 "FD24_Psv_WU" 153 "FD25_Psv_WU" 154 "FD26_Psv_WU" 155 "FD27_Psv_WU" 156 "FD28_Psv_WU" 157 "FD29_Psv_WU" 158 "BHCAN_Psv_WU" 159 "CCAN_Psv_WU" ;
VAL_ 2654339250 CurrentCanNMState_FD01_SPAAK 0 "Uninitialized State" 1 "Bus-Sleep State" 2 "Prepare-Bus State" 3 "Ready-Sleep State" 4 "Normal Operation State" 5 "Repeat Message State" 6 "Synchronize State" 7 "Offline State" ;
VAL_ 2654339250 CurrentFailSts_FD01_SPAAK 0 "No_Fail_Present" 1 "Fail_Present" ;
VAL_ 2654339250 DES_FD01_SPAAK 0 "Error_Active_state" 1 "Error_passive_warning_state" 2 "Bus_off_state" 3 "Not_used" ;
VAL_ 2654339250 EOL_FD01_SPAAK 0 "No_EOL_Programming" 1 "EOL_Programming" ;
VAL_ 2654339250 GenericFailSts_FD01_SPAAK 0 "No_Fail_Present" 1 "Fail_Present" ;
VAL_ 2654339250 PreviousCanNMState_FD01_SPAAK 0 "Uninitialized State" 1 "Bus-Sleep State" 2 "Prepare-Bus State" 3 "Ready-Sleep State" 4 "Normal Operation State" 5 "Repeat Message State" 6 "Synchronize State" 7 "Offline State" ;
VAL_ 2654339250 WakeupSource_FD01_SPAAK 0 "No_Wakeup" ;
VAL_ 2654339107 CurrentCanNMState_FD08_TBM 0 "Uninitialized State" 1 "Bus-Sleep State" 2 "Prepare-Bus State" 3 "Ready-Sleep State" 4 "Normal Operation State" 5 "Repeat Message State" 6 "Synchronize State" 7 "Offline State" ;
VAL_ 2654339107 CurrentFailSts_FD08_TBM 0 "No_Fail_Present" 1 "Fail_Present" ;
VAL_ 2654339107 DES_FD08_TBM 0 "Error_Active_state" 1 "Error_passive_warning_state" 2 "Bus_off_state" 3 "Not_used" ;
VAL_ 2654339107 EOL_FD08_TBM 0 "No_EOL_Programming" 1 "EOL_Programming" ;
VAL_ 2654339107 GenericFailSts_FD08_TBM 0 "No_Fail_Present" 1 "Fail_Present" ;
VAL_ 2654339107 PreviousCanNMState_FD08_TBM 0 "Uninitialized State" 1 "Bus-Sleep State" 2 "Prepare-Bus State" 3 "Ready-Sleep State" 4 "Normal Operation State" 5 "Repeat Message State" 6 "Synchronize State" 7 "Offline State" ;
VAL_ 2654339107 StayActiveSource_FD08_TBM 0 "CANNM_Ready_Sleep" 1 "IGN_ON" 2 "NonDefault_Diag" 4 "ING_OFF_NormSt_RptSt" ;
VAL_ 2654339107 WakeupSource_FD08_TBM 0 "No_Wakeup" 1 "IGN_ON" 129 "FD1_Psv_WU" 130 "FD2_Psv_WU" 131 "FD3_Psv_WU" 132 "FD4_Psv_WU" 133 "FD5_Psv_WU" 134 "FD6_Psv_WU" 135 "FD7_Psv_WU" 136 "FD8_Psv_WU" 137 "FD9_Psv_WU" 138 "FD10_Psv_WU" 139 "FD11_Psv_WU" 140 "FD12_Psv_WU" 141 "FD13_Psv_WU" 142 "FD14_Psv_WU" 143 "FD15_Psv_WU" 144 "FD16_Psv_WU" 145 "FD17_Psv_WU" 146 "FD18_Psv_WU" 147 "FD19_Psv_WU" 148 "FD20_Psv_WU" 149 "FD21_Psv_WU" 150 "FD22_Psv_WU" 151 "FD23_Psv_WU" 152 "FD24_Psv_WU" 153 "FD25_Psv_WU" 154 "FD26_Psv_WU" 155 "FD27_Psv_WU" 156 "FD28_Psv_WU" 157 "FD29_Psv_WU" 158 "BHCAN_Psv_WU" 159 "CCAN_Psv_WU" ;
VAL_ 2654339083 CurrentCanNMState_FD03_TCM 0 "Uninitialized State" 1 "Bus-Sleep State" 2 "Prepare-Bus State" 3 "Ready-Sleep State" 4 "Normal Operation State" 5 "Repeat Message State" 6 "Synchronize State" 7 "Offline State" ;
VAL_ 2654339083 CurrentFailSts_FD03_TCM 0 "No_Fail_Present" 1 "Fail_Present" ;
VAL_ 2654339083 DES_FD03_TCM 0 "Error_Active_state" 1 "Error_passive_warning_state" 2 "Bus_off_state" 3 "Not_used" ;
VAL_ 2654339083 EOL_FD03_TCM 0 "No_EOL_Programming" 1 "EOL_Programming" ;
VAL_ 2654339083 GenericFailSts_FD03_TCM 0 "No_Fail_Present" 1 "Fail_Present" ;
VAL_ 2654339083 PreviousCanNMState_FD03_TCM 0 "Uninitialized State" 1 "Bus-Sleep State" 2 "Prepare-Bus State" 3 "Ready-Sleep State" 4 "Normal Operation State" 5 "Repeat Message State" 6 "Synchronize State" 7 "Offline State" ;
VAL_ 2654339083 WakeupSource_FD03_TCM 0 "No_Wakeup" ;
VAL_ 2654339249 CurrentCanNMState_FD02_TRLR_REV 0 "Uninitialized State" 1 "Bus-Sleep State" 2 "Prepare-Bus State" 3 "Ready-Sleep State" 4 "Normal Operation State" 5 "Repeat Message State" 6 "Synchronize State" 7 "Offline State" ;
VAL_ 2654339249 CurrentFailSts_FD02_TRLR_REV 0 "No_Fail_Present" 1 "Fail_Present" ;
VAL_ 2654339249 DES_FD02_TRLR_REV 0 "Error_Active_state" 1 "Error_passive_warning_state" 2 "Bus_off_state" 3 "Not_used" ;
VAL_ 2654339249 EOL_FD02_TRLR_REV 0 "No_EOL_Programming" 1 "EOL_Programming" ;
VAL_ 2654339249 GenericFailSts_FD02_TRLR_REV 0 "No_Fail_Present" 1 "Fail_Present" ;
VAL_ 2654339249 PreviousCanNMState_FD02_TRLR_REV 0 "Uninitialized State" 1 "Bus-Sleep State" 2 "Prepare-Bus State" 3 "Ready-Sleep State" 4 "Normal Operation State" 5 "Repeat Message State" 6 "Synchronize State" 7 "Offline State" ;
VAL_ 2654339249 WakeupSource_FD02_TRLR_REV 0 "No_Wakeup" ;
VAL_ 2654339258 CurrentCanNMState_FD13_UWBS1 0 "Uninitialized State" 1 "Bus-Sleep State" 2 "Prepare-Bus State" 3 "Ready-Sleep State" 4 "Normal Operation State" 5 "Repeat Message State" 6 "Synchronize State" 7 "Offline State" ;
VAL_ 2654339258 CurrentFailSts_FD13_UWBS1 0 "No_Fail_Present" 1 "Fail_Present" ;
VAL_ 2654339258 DES_FD13_UWBS1 0 "Error_Active_state" 1 "Error_passive_warning_state" 2 "Bus_off_state" 3 "Not_used" ;
VAL_ 2654339258 EOL_FD13_UWBS1 0 "No_EOL_Programming" 1 "EOL_Programming" ;
VAL_ 2654339258 GenericFailSts_FD13_UWBS1 0 "No_Fail_Present" 1 "Fail_Present" ;
VAL_ 2654339258 PreviousCanNMState_FD13_UWBS1 0 "Uninitialized State" 1 "Bus-Sleep State" 2 "Prepare-Bus State" 3 "Ready-Sleep State" 4 "Normal Operation State" 5 "Repeat Message State" 6 "Synchronize State" 7 "Offline State" ;
VAL_ 2654339258 StayActiveSource_FD13_UWBS1 0 "CANNM_Ready_Sleep" 1 "IGN_ON" 2 "NonDefault_Diag" 4 "ING_OFF_NormSt_RptSt" ;
VAL_ 2654339258 WakeupSource_FD13_UWBS1 0 "No_Wakeup" 1 "IGN_ON" 129 "FD1_Psv_WU" 130 "FD2_Psv_WU" 131 "FD3_Psv_WU" 132 "FD4_Psv_WU" 133 "FD5_Psv_WU" 134 "FD6_Psv_WU" 135 "FD7_Psv_WU" 136 "FD8_Psv_WU" 137 "FD9_Psv_WU" 138 "FD10_Psv_WU" 139 "FD11_Psv_WU" 140 "FD12_Psv_WU" 141 "FD13_Psv_WU" 142 "FD14_Psv_WU" 143 "FD15_Psv_WU" 144 "FD16_Psv_WU" 145 "FD17_Psv_WU" 146 "FD18_Psv_WU" 147 "FD19_Psv_WU" 148 "FD20_Psv_WU" 149 "FD21_Psv_WU" 150 "FD22_Psv_WU" 151 "FD23_Psv_WU" 152 "FD24_Psv_WU" 153 "FD25_Psv_WU" 154 "FD26_Psv_WU" 155 "FD27_Psv_WU" 156 "FD28_Psv_WU" 157 "FD29_Psv_WU" 158 "BHCAN_Psv_WU" 159 "CCAN_Psv_WU" ;
VAL_ 2654339259 CurrentCanNMState_FD13_UWBS2 0 "Uninitialized State" 1 "Bus-Sleep State" 2 "Prepare-Bus State" 3 "Ready-Sleep State" 4 "Normal Operation State" 5 "Repeat Message State" 6 "Synchronize State" 7 "Offline State" ;
VAL_ 2654339259 CurrentFailSts_FD13_UWBS2 0 "No_Fail_Present" 1 "Fail_Present" ;
VAL_ 2654339259 DES_FD13_UWBS2 0 "Error_Active_state" 1 "Error_passive_warning_state" 2 "Bus_off_state" 3 "Not_used" ;
VAL_ 2654339259 EOL_FD13_UWBS2 0 "No_EOL_Programming" 1 "EOL_Programming" ;
VAL_ 2654339259 GenericFailSts_FD13_UWBS2 0 "No_Fail_Present" 1 "Fail_Present" ;
VAL_ 2654339259 PreviousCanNMState_FD13_UWBS2 0 "Uninitialized State" 1 "Bus-Sleep State" 2 "Prepare-Bus State" 3 "Ready-Sleep State" 4 "Normal Operation State" 5 "Repeat Message State" 6 "Synchronize State" 7 "Offline State" ;
VAL_ 2654339259 StayActiveSource_FD13_UWBS2 0 "CANNM_Ready_Sleep" 1 "IGN_ON" 2 "NonDefault_Diag" 4 "ING_OFF_NormSt_RptSt" ;
VAL_ 2654339259 WakeupSource_FD13_UWBS2 0 "No_Wakeup" 1 "IGN_ON" 129 "FD1_Psv_WU" 130 "FD2_Psv_WU" 131 "FD3_Psv_WU" 132 "FD4_Psv_WU" 133 "FD5_Psv_WU" 134 "FD6_Psv_WU" 135 "FD7_Psv_WU" 136 "FD8_Psv_WU" 137 "FD9_Psv_WU" 138 "FD10_Psv_WU" 139 "FD11_Psv_WU" 140 "FD12_Psv_WU" 141 "FD13_Psv_WU" 142 "FD14_Psv_WU" 143 "FD15_Psv_WU" 144 "FD16_Psv_WU" 145 "FD17_Psv_WU" 146 "FD18_Psv_WU" 147 "FD19_Psv_WU" 148 "FD20_Psv_WU" 149 "FD21_Psv_WU" 150 "FD22_Psv_WU" 151 "FD23_Psv_WU" 152 "FD24_Psv_WU" 153 "FD25_Psv_WU" 154 "FD26_Psv_WU" 155 "FD27_Psv_WU" 156 "FD28_Psv_WU" 157 "FD29_Psv_WU" 158 "BHCAN_Psv_WU" 159 "CCAN_Psv_WU" ;
VAL_ 2654339260 CurrentCanNMState_FD13_UWBS3 0 "Uninitialized State" 1 "Bus-Sleep State" 2 "Prepare-Bus State" 3 "Ready-Sleep State" 4 "Normal Operation State" 5 "Repeat Message State" 6 "Synchronize State" 7 "Offline State" ;
VAL_ 2654339260 CurrentFailSts_FD13_UWBS3 0 "No_Fail_Present" 1 "Fail_Present" ;
VAL_ 2654339260 DES_FD13_UWBS3 0 "Error_Active_state" 1 "Error_passive_warning_state" 2 "Bus_off_state" 3 "Not_used" ;
VAL_ 2654339260 EOL_FD13_UWBS3 0 "No_EOL_Programming" 1 "EOL_Programming" ;
VAL_ 2654339260 GenericFailSts_FD13_UWBS3 0 "No_Fail_Present" 1 "Fail_Present" ;
VAL_ 2654339260 PreviousCanNMState_FD13_UWBS3 0 "Uninitialized State" 1 "Bus-Sleep State" 2 "Prepare-Bus State" 3 "Ready-Sleep State" 4 "Normal Operation State" 5 "Repeat Message State" 6 "Synchronize State" 7 "Offline State" ;
VAL_ 2654339260 StayActiveSource_FD13_UWBS3 0 "CANNM_Ready_Sleep" 1 "IGN_ON" 2 "NonDefault_Diag" 4 "ING_OFF_NormSt_RptSt" ;
VAL_ 2654339260 WakeupSource_FD13_UWBS3 0 "No_Wakeup" 1 "IGN_ON" 129 "FD1_Psv_WU" 130 "FD2_Psv_WU" 131 "FD3_Psv_WU" 132 "FD4_Psv_WU" 133 "FD5_Psv_WU" 134 "FD6_Psv_WU" 135 "FD7_Psv_WU" 136 "FD8_Psv_WU" 137 "FD9_Psv_WU" 138 "FD10_Psv_WU" 139 "FD11_Psv_WU" 140 "FD12_Psv_WU" 141 "FD13_Psv_WU" 142 "FD14_Psv_WU" 143 "FD15_Psv_WU" 144 "FD16_Psv_WU" 145 "FD17_Psv_WU" 146 "FD18_Psv_WU" 147 "FD19_Psv_WU" 148 "FD20_Psv_WU" 149 "FD21_Psv_WU" 150 "FD22_Psv_WU" 151 "FD23_Psv_WU" 152 "FD24_Psv_WU" 153 "FD25_Psv_WU" 154 "FD26_Psv_WU" 155 "FD27_Psv_WU" 156 "FD28_Psv_WU" 157 "FD29_Psv_WU" 158 "BHCAN_Psv_WU" 159 "CCAN_Psv_WU" ;
VAL_ 2654339261 CurrentCanNMState_FD13_UWBS4 0 "Uninitialized State" 1 "Bus-Sleep State" 2 "Prepare-Bus State" 3 "Ready-Sleep State" 4 "Normal Operation State" 5 "Repeat Message State" 6 "Synchronize State" 7 "Offline State" ;
VAL_ 2654339261 CurrentFailSts_FD13_UWBS4 0 "No_Fail_Present" 1 "Fail_Present" ;
VAL_ 2654339261 DES_FD13_UWBS4 0 "Error_Active_state" 1 "Error_passive_warning_state" 2 "Bus_off_state" 3 "Not_used" ;
VAL_ 2654339261 EOL_FD13_UWBS4 0 "No_EOL_Programming" 1 "EOL_Programming" ;
VAL_ 2654339261 GenericFailSts_FD13_UWBS4 0 "No_Fail_Present" 1 "Fail_Present" ;
VAL_ 2654339261 PreviousCanNMState_FD13_UWBS4 0 "Uninitialized State" 1 "Bus-Sleep State" 2 "Prepare-Bus State" 3 "Ready-Sleep State" 4 "Normal Operation State" 5 "Repeat Message State" 6 "Synchronize State" 7 "Offline State" ;
VAL_ 2654339261 StayActiveSource_FD13_UWBS4 0 "CANNM_Ready_Sleep" 1 "IGN_ON" 2 "NonDefault_Diag" 4 "ING_OFF_NormSt_RptSt" ;
VAL_ 2654339261 WakeupSource_FD13_UWBS4 0 "No_Wakeup" 1 "IGN_ON" 129 "FD1_Psv_WU" 130 "FD2_Psv_WU" 131 "FD3_Psv_WU" 132 "FD4_Psv_WU" 133 "FD5_Psv_WU" 134 "FD6_Psv_WU" 135 "FD7_Psv_WU" 136 "FD8_Psv_WU" 137 "FD9_Psv_WU" 138 "FD10_Psv_WU" 139 "FD11_Psv_WU" 140 "FD12_Psv_WU" 141 "FD13_Psv_WU" 142 "FD14_Psv_WU" 143 "FD15_Psv_WU" 144 "FD16_Psv_WU" 145 "FD17_Psv_WU" 146 "FD18_Psv_WU" 147 "FD19_Psv_WU" 148 "FD20_Psv_WU" 149 "FD21_Psv_WU" 150 "FD22_Psv_WU" 151 "FD23_Psv_WU" 152 "FD24_Psv_WU" 153 "FD25_Psv_WU" 154 "FD26_Psv_WU" 155 "FD27_Psv_WU" 156 "FD28_Psv_WU" 157 "FD29_Psv_WU" 158 "BHCAN_Psv_WU" 159 "CCAN_Psv_WU" ;
VAL_ 2654339262 CurrentCanNMState_FD13_UWBS5 0 "Uninitialized State" 1 "Bus-Sleep State" 2 "Prepare-Bus State" 3 "Ready-Sleep State" 4 "Normal Operation State" 5 "Repeat Message State" 6 "Synchronize State" 7 "Offline State" ;
VAL_ 2654339262 CurrentFailSts_FD13_UWBS5 0 "No_Fail_Present" 1 "Fail_Present" ;
VAL_ 2654339262 DES_FD13_UWBS5 0 "Error_Active_state" 1 "Error_passive_warning_state" 2 "Bus_off_state" 3 "Not_used" ;
VAL_ 2654339262 EOL_FD13_UWBS5 0 "No_EOL_Programming" 1 "EOL_Programming" ;
VAL_ 2654339262 GenericFailSts_FD13_UWBS5 0 "No_Fail_Present" 1 "Fail_Present" ;
VAL_ 2654339262 PreviousCanNMState_FD13_UWBS5 0 "Uninitialized State" 1 "Bus-Sleep State" 2 "Prepare-Bus State" 3 "Ready-Sleep State" 4 "Normal Operation State" 5 "Repeat Message State" 6 "Synchronize State" 7 "Offline State" ;
VAL_ 2654339262 StayActiveSource_FD13_UWBS5 0 "CANNM_Ready_Sleep" 1 "IGN_ON" 2 "NonDefault_Diag" 4 "ING_OFF_NormSt_RptSt" ;
VAL_ 2654339262 WakeupSource_FD13_UWBS5 0 "No_Wakeup" 1 "IGN_ON" 129 "FD1_Psv_WU" 130 "FD2_Psv_WU" 131 "FD3_Psv_WU" 132 "FD4_Psv_WU" 133 "FD5_Psv_WU" 134 "FD6_Psv_WU" 135 "FD7_Psv_WU" 136 "FD8_Psv_WU" 137 "FD9_Psv_WU" 138 "FD10_Psv_WU" 139 "FD11_Psv_WU" 140 "FD12_Psv_WU" 141 "FD13_Psv_WU" 142 "FD14_Psv_WU" 143 "FD15_Psv_WU" 144 "FD16_Psv_WU" 145 "FD17_Psv_WU" 146 "FD18_Psv_WU" 147 "FD19_Psv_WU" 148 "FD20_Psv_WU" 149 "FD21_Psv_WU" 150 "FD22_Psv_WU" 151 "FD23_Psv_WU" 152 "FD24_Psv_WU" 153 "FD25_Psv_WU" 154 "FD26_Psv_WU" 155 "FD27_Psv_WU" 156 "FD28_Psv_WU" 157 "FD29_Psv_WU" 158 "BHCAN_Psv_WU" 159 "CCAN_Psv_WU" ;
VAL_ 2654339199 CurrentCanNMState_FD08_VRM 0 "Uninitialized State" 1 "Bus-Sleep State" 2 "Prepare-Bus State" 3 "Ready-Sleep State" 4 "Normal Operation State" 5 "Repeat Message State" 6 "Synchronize State" 7 "Offline State" ;
VAL_ 2654339199 CurrentFailSts_FD08_VRM 0 "No_Fail_Present" 1 "Fail_Present" ;
VAL_ 2654339199 DES_FD08_VRM 0 "Error_Active_state" 1 "Error_passive_warning_state" 2 "Bus_off_state" 3 "Not_used" ;
VAL_ 2654339199 EOL_FD08_VRM 0 "No_EOL_Programming" 1 "EOL_Programming" ;
VAL_ 2654339199 GenericFailSts_FD08_VRM 0 "No_Fail_Present" 1 "Fail_Present" ;
VAL_ 2654339199 PreviousCanNMState_FD08_VRM 0 "Uninitialized State" 1 "Bus-Sleep State" 2 "Prepare-Bus State" 3 "Ready-Sleep State" 4 "Normal Operation State" 5 "Repeat Message State" 6 "Synchronize State" 7 "Offline State" ;
VAL_ 2654339199 WakeupSource_FD08_VRM 0 "No_Wakeup" ;
VAL_ 2654339257 CurrentCanNMState_FD09_WCPM2 0 "Uninitialized State" 1 "Bus-Sleep State" 2 "Prepare-Bus State" 3 "Ready-Sleep State" 4 "Normal Operation State" 5 "Repeat Message State" 6 "Synchronize State" 7 "Offline State" ;
VAL_ 2654339257 CurrentFailSts_FD09_WCPM2 0 "No_Fail_Present" 1 "Fail_Present" ;
VAL_ 2654339257 DES_FD09_WCPM2 0 "Error_Active_state" 1 "Error_passive_warning_state" 2 "Bus_off_state" 3 "Not_used" ;
VAL_ 2654339257 EOL_FD09_WCPM2 0 "No_EOL_Programming" 1 "EOL_Programming" ;
VAL_ 2654339257 GenericFailSts_FD09_WCPM2 0 "No_Fail_Present" 1 "Fail_Present" ;
VAL_ 2654339257 PreviousCanNMState_FD09_WCPM2 0 "Uninitialized State" 1 "Bus-Sleep State" 2 "Prepare-Bus State" 3 "Ready-Sleep State" 4 "Normal Operation State" 5 "Repeat Message State" 6 "Synchronize State" 7 "Offline State" ;
VAL_ 2654339257 StayActiveSource_FD09_WCPM2 0 "CANNM_Ready_Sleep" 1 "IGN_ON" 2 "NonDefault_Diag" 4 "ING_OFF_NormSt_RptSt" ;
VAL_ 2654339257 WakeupSource_FD09_WCPM2 0 "No_Wakeup" 1 "IGN_ON" 129 "FD1_Psv_WU" 130 "FD2_Psv_WU" 131 "FD3_Psv_WU" 132 "FD4_Psv_WU" 133 "FD5_Psv_WU" 134 "FD6_Psv_WU" 135 "FD7_Psv_WU" 136 "FD8_Psv_WU" 137 "FD9_Psv_WU" 138 "FD10_Psv_WU" 139 "FD11_Psv_WU" 140 "FD12_Psv_WU" 141 "FD13_Psv_WU" 142 "FD14_Psv_WU" 143 "FD15_Psv_WU" 144 "FD16_Psv_WU" 145 "FD17_Psv_WU" 146 "FD18_Psv_WU" 147 "FD19_Psv_WU" 148 "FD20_Psv_WU" 149 "FD21_Psv_WU" 150 "FD22_Psv_WU" 151 "FD23_Psv_WU" 152 "FD24_Psv_WU" 153 "FD25_Psv_WU" 154 "FD26_Psv_WU" 155 "FD27_Psv_WU" 156 "FD28_Psv_WU" 157 "FD29_Psv_WU" 158 "BHCAN_Psv_WU" 159 "CCAN_Psv_WU" ;
VAL_ 255 ACC_NCC_TrqEnblRq_Allowed 0 "FALSE" 1 "TRUE" ;
VAL_ 255 Accel_Pedal_Override 0 "FALSE" 1 "TRUE" ;
VAL_ 255 SumTorque_DrvReqMod 8191 "SNA" ;
VAL_ 255 Total_AxleTorque_Static 65535 "SNA" ;
VAL_ 1876 InflationState_LHF_Tyre 0 "Normal_Tyre_Pressure" 1 "Under_Inflated_Tyre" 2 "SignificantlyUnderInflatedTyre" 3 "Over_Inflated_Tyre" 4 "Sensor_Missing" ;
VAL_ 1876 InflationState_LHR_Tyre 0 "Normal_Tyre_Pressure" 1 "Under_Inflated_Tyre" 2 "SignificantlyUnderInflatedTyre" 3 "Over_Inflated_Tyre" 4 "Sensor_Missing" ;
VAL_ 1876 InflationState_RHF_Tyre 0 "Normal_Tyre_Pressure" 1 "Under_Inflated_Tyre" 2 "SignificantlyUnderInflatedTyre" 3 "Over_Inflated_Tyre" 4 "Sensor_Missing" ;
VAL_ 1876 InflationState_RHR_Tyre 0 "Normal_Tyre_Pressure" 1 "Under_Inflated_Tyre" 2 "SignificantlyUnderInflatedTyre" 3 "Over_Inflated_Tyre" 4 "Sensor_Missing" ;
VAL_ 1876 PressureValue_LHF_Tyre 255 "SNA" ;
VAL_ 1876 PressureValue_LHR_Tyre 255 "SNA" ;
VAL_ 1876 PressureValue_RHF_Tyre 255 "SNA" ;
VAL_ 1876 PressureValue_RHR_Tyre 255 "SNA" ;
VAL_ 1876 TyrePressureSystemFailSts 0 "Fail_Not_Present" 1 "Fail_Present" ;
VAL_ 151 ERR_ST_HOD 0 "NO_ERROR" 1 "HOD_EEPROM_ERROR" 2 "HOD_ROM_ERROR" 3 "HOD_WATCHDOG_ERROR" 4 "HOD_CPU_ERROR" 5 "HOD_GUARD_INTERRUPTION_ERROR" 6 "HOD_SENSE_INTERRUPTION_ERROR" 7 "HOD_CPU_DEFECT_OR_MAT_SHORTAGE" 8 "UNDERVOLTAGE_ERROR" 9 "OVERVOLTAGE_ERROR" 10 "HOD_CODING_ERROR" 11 "HOD_GENERIC_SYSTEM_ERROR" 15 "SNA" ;
VAL_ 151 HOFF_RCOG_SEN 0 "HANDS_OFF_DETECTED" 1 "ENERGY_SAVING_MODE" 2 "HANDS_OFF_NOT_DETECTED" 3 "HANDS_NOT_AVAILABLE" 4 "HANDS_OFF_ERROR" 15 "SNA" ;
VAL_ 1585 WiFi_Client_Mode_Confirm 0 "Off" 1 "On" 3 "SNA" ;
VAL_ 1452 LTESts 0 "No_Network" 1 "2G" 2 "3G" 3 "4G" 4 "E" 5 "H_Plus" 6 "Unknown" ;
VAL_ 1452 NetConnection 0 "Not_Connected" 1 "Connected" 2 "Connection_Ongoing" 3 "Connection_Failed" ;
VAL_ 1452 PrivacyMode 0 "Not_Active" 1 "Active" ;
VAL_ 1452 SignalStrength 0 "0" 1 "1" 2 "2" 3 "3" 4 "4" 5 "5" 7 "SNA" ;
VAL_ 1452 WiFiSts 0 "OFF" 1 "ON" 3 "SNA" ;
VAL_ 156 GPS_Date_Day 255 "SNA" ;
VAL_ 156 GPS_Date_Month 255 "SNA" ;
VAL_ 156 GPS_Date_Year 65535 "SNA" ;
VAL_ 156 GPS_UTC_Hour 255 "SNA" ;
VAL_ 156 GPS_UTC_Minute 255 "SNA" ;
VAL_ 156 GPS_UTC_Second 65535 "SNA" ;
VAL_ 608 HU_TRSC_EnableBtn_Sts 0 "Not Pressed" 1 "Pressed" 2 "SNA" ;
VAL_ 1465 TGW_CAMERA_DISP_STAT 0 "DISP_NON_CAMERA" 1 "DISP_DIGITAL_RVC_CAMERA" 2 "DISP_ANALOG_RVC_CAMERA" 3 "DISP_ANALOG_CHMSL_CAMERA" 4 "DISP_SURROUND_VIEW_CAMERA" 5 "DISP_TRAILER_CAMERA" 6 "DISP_WIRLESS_CAMERA" 7 "DISP_SVS_MORECAMS_POPUP" 8 "DISP_INTERIOR_CAMERA" 15 "SNA" ;
VAL_ 1428 CameraDisplaySts2 0 "Default" 1 "View_1" 2 "View_2" 3 "View_3" 4 "View_4" 5 "View_5" 6 "View_6" 7 "View_7" 8 "View_8" 9 "View_9" 10 "View_10" 11 "View_11" 12 "View_12" 13 "View_13" 14 "View_14" 15 "View_15" ;
VAL_ 1428 CM_TCH_STAT 0 "TCH_NOT_PSD" 1 "TCH_PSD" 2 "TCH_PS_CAN" 3 "Not_Used" 4 "TCH_CFG_RES" 5 "TCH_CFG_OFFSET" 6 "TCH_CFG_MAX" 7 "SNA" ;
VAL_ 278 TargetGear 0 "Neutral" 1 "ForwardGear_1" 2 "ForwardGear_2" 3 "ForwardGear_3" 4 "ForwardGear_4" 5 "ForwardGear_5" 6 "ForwardGear_6" 7 "ForwardGear_7" 8 "ForwardGear_8" 9 "ForwardGear_9" 13 "Parking" 14 "ReverseGear" 15 "SNA" ;
VAL_ 278 TRANS_ADAS_Inhibit 0 "Faulted" 1 "Available" ;
VAL_ 278 TransmissionSailingSts 0 "Sailing_Not Possible" 1 "Sailing_Possible_Passive" 2 "Transition_To_Sailing" 3 "Sailing_Active" 4 "Transition_Out_Of_Sailing" 5 "Sailing_Not_Available" 15 "SNA" ;
VAL_ 520 GearEngagedForDisplay 0 "Initialize" 1 "1st_gear" 2 "2nd_gear" 3 "3rd_gear" 4 "4th_gear" 5 "5th_gear" 6 "6th_gear" 7 "7th_gear" 8 "8th_gear " 9 "9th_gear" 10 "Not_used1" 11 "Not_Used2" 12 "P" 13 "N" 14 "R" 15 "D" 16 "L" 17 "M" 18 "S" 31 "SNA" ;
VAL_ 520 TransReadyForESS 0 "Not_Ready" 1 "Ready" ;
VAL_ 1450 DriveModeSts 0 "No_programs_available_selected" 1 "Eco" 2 "Sport" 3 "Valet" 4 "Ice_Winter" 5 "Tow_Haul" 6 "Track" 7 "4LowMode" 8 "HDC/SSC" 9 "Rock" 10 "Sand" 11 "Mud" 12 "Normal" 13 "Mud_Sand" 14 "not_used" 15 "not_used" ;
VAL_ 1450 GearDisplayForCluster 0 "Blank" 1 "Current_gear_1" 2 "Current_gear_2" 3 "Current_gear_3" 4 "Current_gear_4" 5 "Current_gear_5" 6 "Current_gear_6" 7 "Current_gear_7" 8 "Current_gear_8" 9 "Current_gear_9" 10 "Current_gear_P" 11 "Current_gear_N" 12 "Current_gear_R" 15 "SNA" ;
VAL_ 1450 GearEngaged 0 "Neutral" 1 "ForwardGear_1" 2 "ForwardGear_2" 3 "ForwardGear_3" 4 "ForwardGear_4" 5 "ForwardGear_5" 6 "ForwardGear_6" 7 "ForwardGear_7" 8 "ForwardGear_8" 9 "ForwardGear_9" 13 "Parking" 14 "ReverseGear" 15 "SNA" ;
VAL_ 1450 HAS_SoH_TCM 0 "No Fault" 1 "Fault" ;
VAL_ 1450 LimpHomeSts 0 "NotActive" 1 "Active" ;
VAL_ 1450 ShiftLeverPosition 0 "No_Selection_Active_Or_Available" 1 "P" 2 "R" 3 "N" 4 "D" 5 "L" 6 "TIP_Autostick" 7 "Plus" 8 "Minus" 9 "Sport" 10 "Not_Used" 11 "Not_Used" 12 "Not_Used" 13 "Not_Used" 14 "Not_Used" 15 "SNA" ;
VAL_ 1450 TransmissionFailSts 0 "Fail_not_present" 1 "Fail_present" ;
VAL_ 1450 TransmissionWarnings 0 "No_Warning" 1 "Press_Brake_Pedal" 2 "Tip_Not_Available" 3 "Lower_Gear_Shifts" 4 "Manual_Mode_Not_Available" 5 "Insert_N" 6 "Automatic_Mode_Not_Available" 7 "Press_Brake_Delayed_Startup_Warning" 8 "Clutch_Overtemperature" 9 "Manoeuvre_Not_Allowed" 10 "Press_Brake_Pedal_Repeat" 11 "Gear_Not_Available" 12 "Shift_Not_Allowed" 13 "Shift_to_Neutral_Then_DR" 14 "Reduce_Gear_Changes" 15 "Clutch_Overheater_Must_Cool" 16 "Service_Transmission" 17 "Service_Shifter" 18 "Engage_Park_Brake" 19 "Trans_Too_Cold_Pls_Wait" 20 "Push_Button_to_Shift" 21 "Return_Shifter_To_Home" 22 "Press_Brake_Push_Button_Shift" 23 "Service_Trans_Shut_Off" 24 "Already_in_Des_Gear" 25 "Start_Engine_to_Shift" 26 "Service_Trans_Use_Pk_Brk" 27 "Vehicle_Speed_Too_High" 28 "Tow_Haul_Not_available" 29 "Tow_Haul_Disengaged" 30 "Trans_Cool_Ready_to_Drive" 31 "Vehicle_Speed_Too_High_to_Shift_P" 32 "Vehicle_Speed_Too_High_to_Shift_R" 33 "Vehicle_Speed_Too_High_to_Shift_D" 34 "Manual_Shift_Temp_Not_Available" 35 "Vehicle_Speed_Too_High_to_Shift_L/S" 36 "Shift_to_Park_to_ obtain_drivability" 37 "Shift_to_Park_to_Start" 38 "APCM_in_Progress" 39 "Stop Vehicle to Shift" 40 "Service Transmission_Stop Vehicle to Shift " 41 "Service Transmission__Stop Vehicle_Restart Vehicle in P to Continue Driving" 42 "Service Transmission_Stop Vehicle to Shift _Restart Vehicle in P to Continue Driving" 43 "Press Brake To Prevent Vehicle From Rolling" 44 "Clutch_Too_Hot_Performance_Limited_Part_1" 45 "Trans_Recover_Mode_Warning" 46 "Press_Brake_To_Start" 47 "Unintentional park disengagement" 48 "paddles_shift_not_available " 49 "manual_mode_exit_hold_right_paddles" 50 "Vehicle_Speed_Too_High_to_Shift_Manual_gate" 51 "Manual_Mode_Active_Hold_Plus_to_Exit" 52 "Paddles_Disabled_by_User_Selection" 53 "Launch_Clutch_Over_Temp" 54 "Pull_Over_Safely" 55 "Clutch_Too_Hot_Performance_Limited_Part_2" ;
VAL_ 1472 THA_EPB_Req 0 "No_Request" 1 "EPB_Requested" 3 "SNA" ;
VAL_ 1472 THA_Speed_Limit 0 "No_Request" 1 "kph_1" 2 "kph_2" 3 "kph_3" 4 "kph_4" 5 "kph_5" 6 "kph_6" 7 "kph_7" 8 "kph_8" 9 "kph_9" 10 "kph_10" 31 "SNA" ;
VAL_ 1472 THA_SpeedLimit_Req 0 "No_Request" 1 "Requested" 3 "SNA" ;
VAL_ 1472 THA_STAT 0 "Initial" 1 "Idle" 2 "Enabled" 3 "Engaged" 4 "Complete" 5 "Faulted " 7 "SNA" ;
VAL_ 1472 THA_SteeringTorqueReq 0 "False" 1 "True" 3 "SNA" ;
VAL_ 1472 Trailer_Angle_Sign 0 "None" 1 "Positive" 2 "Negative" 3 "SNA" ;
VAL_ 1472 Trailer_Calibration 0 "Not_Calibrated" 1 "Calibrated" 2 "SNA" ;
VAL_ 1472 TrlrHitchLight_Cntrl 0 "ON" 1 "OFF" 3 "SNA" ;
VAL_ 1472 TRSC_PopupDisp_Info 0 "DISP_0" 1 "DISP_1" 2 "DISP_2" 3 "DISP_3" 4 "DISP_4" 5 "DISP_5" 6 "DISP_6" 7 "DISP_7" 8 "DISP_8" 9 "DISP_9" 10 "DISP_10" 11 "DISP_11" 12 "DISP_12" 13 "DISP_13" 14 "DISP_14" 15 "SNA" ;
VAL_ 1472 TRSC_SpeedLimit_Req 0 "Not_Limiting" 1 "SPD_4" 2 "SPD_5" 3 "SPD_6" 4 "SPD_7" 5 "SPD_8" 6 "SPD_9" 7 "SPD_10" 15 "SNA" ;
VAL_ 1472 TRSC_STAT 0 "Standby" 1 "Calibrating" 2 "PreActive" 3 "Active" 4 "OFF" 7 "SNA" ;
VAL_ 1472 TRSC_SteeringDamping 255 "SNA" ;
VAL_ 1472 TRSC_SteeringTorqueReq 0 "False" 1 "True" 3 "SNA" ;
VAL_ 1472 TRSC_VehicleStop_Req 0 "False" 1 "True" 3 "SNA" ;
VAL_ 1472 TRSCMoreCamRQSts 0 "Not_Pressed" 1 "Pressed" ;
VAL_ 1476 TRSC_CenterBtn_Sts 0 "NOT_Pressed" 1 "Pressed" 3 "SNA" ;
VAL_ 1476 TRSC_EnableBtn_Sts 0 "NOT_Pressed" 1 "Pressed" 3 "SNA" ;
VAL_ 1053 VIN_MSG 0 "VIN_LO" 1 "VIN_MID" 2 "VIN_HI" 3 "SNA" ;
