VERSION ""

NS_ :

BS_:

BU_: BCM BSM2 CADM2 CVADAS EPS ORC PAM SGW TRSKM

BO_ 1954 ORC_FD_2: 32 ORC
 SG_ CRC_ORC2 : 191|8@0+ (1,0) [0|255] "-"  BCM,BSM2
 SG_ DrvSbltUnFltr_1 : 119|8@0+ (0.1,0) [0|25.5] "mA"  BCM
 SG_ MessageCounter_ORC2 : 179|4@0+ (1,0) [0|15] "-"  BCM,BSM2
 SG_ ORCIdentification : 87|32@0+ (1,0) [0|4294967295] "-"  BSM2
 SG_ SBR1RowPsngrSeatPPDSts : 127|2@0+ (1,0) [0|0] "-"  BCM,SGW

BO_ 274 ORC_FD_3: 32 ORC
 SG_ CRC_ORC3 : 191|8@0+ (1,0) [0|255] "-"  BCM,BSM2,CADM2
 SG_ InternalError : 165|1@0+ (1,0) [0|1] "-"  BSM2,CADM2
 SG_ LatAcceleration : 147|12@0+ (0.02,-40.96) [-40.96|40.92] "m/s^2"  BCM,BSM2,CADM2
 SG_ LatAccelerationFailSts : 182|1@0+ (1,0) [0|1] "-"  BCM,BSM2,CADM2
 SG_ LongAcceleration : 131|12@0+ (0.02,-40.96) [-40.96|40.92] "m/s^2"  BCM,BSM2,CADM2
 SG_ LongAccelerationFailSts : 183|1@0+ (1,0) [0|1] "-"  BCM,BSM2,CADM2
 SG_ MessageCounter_ORC3 : 179|4@0+ (1,0) [0|15] "-"  BCM,BSM2,CADM2
 SG_ YawRate : 163|12@0+ (0.08,-163.84) [-163.84|163.68] "deg/s"  BCM,BSM2,CADM2
 SG_ YawRate_HR : 10|3@0+ (0.02,0) [0|0.06] "deg/s"  CADM2
 SG_ YawRate_HR_Sign : 7|1@0+ (1,0) [0|1] "deg/s"  CADM2
 SG_ YawRateFailSts : 181|1@0+ (1,0) [0|1] "-"  BCM,BSM2,CADM2

BO_ 2654339109 PDC_INFO_FD_ADCM: 12 BCM
 SG_ CurrentCanNMState_FD01_ADCM : 15|4@0+ (1,0) [0|15] "" Vector__XXX
 SG_ CurrentFailSts_FD01_ADCM : 6|1@0+ (1,0) [0|1] "" Vector__XXX
 SG_ DES_FD01_ADCM : 4|2@0+ (1,0) [0|3] "" Vector__XXX
 SG_ EOL_FD01_ADCM : 7|1@0+ (1,0) [0|1] "-" Vector__XXX
 SG_ GenericFailSts_FD01_ADCM : 5|1@0+ (1,0) [0|1] "" Vector__XXX
 SG_ PreviousCanNMState_FD01_ADCM : 11|4@0+ (1,0) [0|15] "" Vector__XXX
 SG_ StayActiveSource_FD01_ADCM : 31|64@0+ (1,0) [0|1.84467440737096E+019] "" Vector__XXX
 SG_ WakeupSource_FD01_ADCM : 23|8@0+ (1,0) [0|255] ""  BSM2,CADM2,CVADAS,EPS,ORC,PAM

BO_ 2654339094 PDC_INFO_FD_AGSM: 12 BCM
 SG_ CurrentCanNMState_FD03_AGSM : 15|4@0+ (1,0) [0|15] "" Vector__XXX
 SG_ CurrentFailSts_FD03_AGSM : 6|1@0+ (1,0) [0|1] "" Vector__XXX
 SG_ DES_FD03_AGSM : 4|2@0+ (1,0) [0|3] "" Vector__XXX
 SG_ EOL_FD03_AGSM : 7|1@0+ (1,0) [0|1] "-" Vector__XXX
 SG_ GenericFailSts_FD03_AGSM : 5|1@0+ (1,0) [0|1] "" Vector__XXX
 SG_ PreviousCanNMState_FD03_AGSM : 11|4@0+ (1,0) [0|15] "" Vector__XXX
 SG_ StayActiveSource_FD03_AGSM : 31|64@0+ (1,0) [0|1.84467440737096E+019] "" Vector__XXX
 SG_ WakeupSource_FD03_AGSM : 23|8@0+ (1,0) [0|255] "" Vector__XXX

BO_ 2654339099 PDC_INFO_FD_ASCM: 12 BCM
 SG_ CurrentCanNMState_FD01_ASCM : 15|4@0+ (1,0) [0|15] "" Vector__XXX
 SG_ CurrentFailSts_FD01_ASCM : 6|1@0+ (1,0) [0|1] "" Vector__XXX
 SG_ DES_FD01_ASCM : 4|2@0+ (1,0) [0|3] "" Vector__XXX
 SG_ EOL_FD01_ASCM : 7|1@0+ (1,0) [0|1] "-" Vector__XXX
 SG_ GenericFailSts_FD01_ASCM : 5|1@0+ (1,0) [0|1] "" Vector__XXX
 SG_ PreviousCanNMState_FD01_ASCM : 11|4@0+ (1,0) [0|15] "" Vector__XXX
 SG_ StayActiveSource_FD01_ASCM : 31|64@0+ (1,0) [0|1.84467440737096E+019] "" Vector__XXX
 SG_ WakeupSource_FD01_ASCM : 23|8@0+ (1,0) [0|255] "" Vector__XXX

BO_ 2654339072 PDC_INFO_FD_BCM: 48 BCM
 SG_ CurrentCanNMState_FD01_BCM : 15|4@0+ (1,0) [0|15] ""  BSM2,CADM2,CVADAS,EPS,ORC,PAM,TRSKM
 SG_ CurrentCanNMState_FD02_BCM : 103|4@0+ (1,0) [0|15] ""  BSM2,CADM2,CVADAS,EPS,ORC,PAM,TRSKM
 SG_ CurrentCanNMState_FD03_BCM : 191|4@0+ (1,0) [0|15] ""  BSM2,CADM2,CVADAS,EPS,ORC,PAM,TRSKM
 SG_ CurrentCanNMState_FD04_BCM : 279|4@0+ (1,0) [0|15] ""  BSM2,CADM2,CVADAS,EPS,ORC,PAM,TRSKM
 SG_ CurrentFailSts_FD01_BCM : 6|1@0+ (1,0) [0|1] ""  BSM2,CADM2,CVADAS,EPS,ORC,PAM,TRSKM
 SG_ CurrentFailSts_FD02_BCM : 94|1@0+ (1,0) [0|1] ""  BSM2,CADM2,CVADAS,EPS,ORC,PAM,TRSKM
 SG_ CurrentFailSts_FD03_BCM : 182|1@0+ (1,0) [0|1] ""  BSM2,CADM2,CVADAS,EPS,ORC,PAM,TRSKM
 SG_ CurrentFailSts_FD04_BCM : 270|1@0+ (1,0) [0|1] ""  BSM2,CADM2,CVADAS,EPS,ORC,PAM,TRSKM
 SG_ DES_FD01_BCM : 4|2@0+ (1,0) [0|3] ""  BSM2,CADM2,CVADAS,EPS,ORC,PAM,TRSKM
 SG_ DES_FD02_BCM : 92|2@0+ (1,0) [0|3] ""  BSM2,CADM2,CVADAS,EPS,ORC,PAM,TRSKM
 SG_ DES_FD03_BCM : 180|2@0+ (1,0) [0|3] ""  BSM2,CADM2,CVADAS,EPS,ORC,PAM,TRSKM
 SG_ DES_FD04_BCM : 268|2@0+ (1,0) [0|3] ""  BSM2,CADM2,CVADAS,EPS,ORC,PAM,TRSKM
 SG_ EOL_FD01_BCM : 7|1@0+ (1,0) [0|1] "-"  BSM2,CADM2,CVADAS,EPS,ORC,PAM,TRSKM
 SG_ EOL_FD02_BCM : 95|1@0+ (1,0) [0|1] "-"  BSM2,CADM2,CVADAS,EPS,ORC,PAM,TRSKM
 SG_ EOL_FD03_BCM : 183|1@0+ (1,0) [0|1] "-"  BSM2,CADM2,CVADAS,EPS,ORC,PAM,TRSKM
 SG_ EOL_FD04_BCM : 271|1@0+ (1,0) [0|1] "-"  BSM2,CADM2,CVADAS,EPS,ORC,PAM,TRSKM
 SG_ GenericFailSts_FD01_BCM : 5|1@0+ (1,0) [0|1] ""  BSM2,CADM2,CVADAS,EPS,ORC,PAM,TRSKM
 SG_ GenericFailSts_FD02_BCM : 93|1@0+ (1,0) [0|1] ""  BSM2,CADM2,CVADAS,EPS,ORC,PAM,TRSKM
 SG_ GenericFailSts_FD03_BCM : 181|1@0+ (1,0) [0|1] ""  BSM2,CADM2,CVADAS,EPS,ORC,PAM,TRSKM
 SG_ GenericFailSts_FD04_BCM : 269|1@0+ (1,0) [0|1] ""  BSM2,CADM2,CVADAS,EPS,ORC,PAM,TRSKM
 SG_ PreviousCanNMState_FD01_BCM : 11|4@0+ (1,0) [0|15] ""  BSM2,CADM2,CVADAS,EPS,ORC,PAM,TRSKM
 SG_ PreviousCanNMState_FD02_BCM : 99|4@0+ (1,0) [0|15] ""  BSM2,CADM2,CVADAS,EPS,ORC,PAM,TRSKM
 SG_ PreviousCanNMState_FD03_BCM : 187|4@0+ (1,0) [0|15] ""  BSM2,CADM2,CVADAS,EPS,ORC,PAM,TRSKM
 SG_ PreviousCanNMState_FD04_BCM : 275|4@0+ (1,0) [0|15] ""  BSM2,CADM2,CVADAS,EPS,ORC,PAM,TRSKM
 SG_ StayActiveSource_FD01_BCM : 31|64@0+ (1,0) [0|1.84467440737096E+019] ""  BSM2,CADM2,CVADAS,EPS,ORC,PAM,TRSKM
 SG_ StayActiveSource_FD02_BCM : 119|64@0+ (1,0) [0|1.84467440737096E+019] ""  BSM2,CADM2,CVADAS,EPS,ORC,PAM,TRSKM
 SG_ StayActiveSource_FD03_BCM : 207|64@0+ (1,0) [0|1.84467440737096E+019] ""  BSM2,CADM2,CVADAS,EPS,ORC,PAM,TRSKM
 SG_ StayActiveSource_FD04_BCM : 295|64@0+ (1,0) [0|1.84467440737096E+019] ""  BSM2,CADM2,CVADAS,EPS,ORC,PAM,TRSKM
 SG_ WakeupSource_FD01_BCM : 23|8@0+ (1,0) [0|255] ""  BSM2,CADM2,CVADAS,EPS,ORC,PAM,TRSKM
 SG_ WakeupSource_FD02_BCM : 111|8@0+ (1,0) [0|255] ""  BSM2,CADM2,CVADAS,EPS,ORC,PAM,TRSKM
 SG_ WakeupSource_FD03_BCM : 199|8@0+ (1,0) [0|255] ""  BSM2,CADM2,CVADAS,EPS,ORC,PAM,TRSKM
 SG_ WakeupSource_FD04_BCM : 287|8@0+ (1,0) [0|255] ""  BSM2,CADM2,CVADAS,EPS,ORC,PAM,TRSKM

BO_ 2654339142 PDC_INFO_FD_BPCM: 12 BCM
 SG_ CurrentCanNMState_FD11_BPCM : 15|4@0+ (1,0) [0|15] "" Vector__XXX
 SG_ CurrentFailSts_FD11_BPCM : 6|1@0+ (1,0) [0|1] "" Vector__XXX
 SG_ DES_FD11_BPCM : 4|2@0+ (1,0) [0|3] "" Vector__XXX
 SG_ EOL_FD11_BPCM : 7|1@0+ (1,0) [0|1] "-" Vector__XXX
 SG_ GenericFailSts_FD11_BPCM : 5|1@0+ (1,0) [0|1] "" Vector__XXX
 SG_ PreviousCanNMState_FD11_BPCM : 11|4@0+ (1,0) [0|15] "" Vector__XXX
 SG_ StayActiveSource_FD11_BPCM : 31|64@0+ (1,0) [0|1.84467440737096E+019] "" Vector__XXX
 SG_ WakeupSource_FD11_BPCM : 23|8@0+ (1,0) [0|255] "" Vector__XXX

BO_ 2654339078 PDC_INFO_FD_BSM: 12 BCM
 SG_ CurrentCanNMState_FD03_BSM : 15|4@0+ (1,0) [0|15] "" Vector__XXX
 SG_ CurrentFailSts_FD03_BSM : 6|1@0+ (1,0) [0|1] "" Vector__XXX
 SG_ DES_FD03_BSM : 4|2@0+ (1,0) [0|1] "" Vector__XXX
 SG_ EOL_FD03_BSM : 7|1@0+ (1,0) [0|1] "-" Vector__XXX
 SG_ GenericFailSts_FD03_BSM : 5|1@0+ (1,0) [0|1] "" Vector__XXX
 SG_ PreviousCanNMState_FD03_BSM : 11|4@0+ (1,0) [0|15] "" Vector__XXX
 SG_ StayActiveSource_FD03_BSM : 31|64@0+ (1,0) [0|1.84467440737096E+019] "" Vector__XXX
 SG_ WakeupSource_FD03_BSM : 23|8@0+ (1,0) [0|255] "" Vector__XXX

BO_ 2654339220 PDC_INFO_FD_BSM2: 12 BSM2
 SG_ CurrentCanNMState_FD02_BSM2 : 15|4@0+ (1,0) [0|15] ""  BCM,CADM2,CVADAS,EPS,ORC,PAM,SGW,TRSKM
 SG_ CurrentFailSts_FD02_BSM2 : 6|1@0+ (1,0) [0|1] ""  BCM,CADM2,CVADAS,EPS,ORC,PAM,SGW,TRSKM
 SG_ DES_FD02_BSM2 : 4|2@0+ (1,0) [0|3] ""  BCM,CADM2,CVADAS,EPS,ORC,PAM,SGW,TRSKM
 SG_ EOL_FD02_BSM2 : 7|1@0+ (1,0) [0|1] "-"  BCM,CADM2,CVADAS,EPS,ORC,PAM,SGW,TRSKM
 SG_ GenericFailSts_FD02_BSM2 : 5|1@0+ (1,0) [0|1] ""  BCM,CADM2,CVADAS,EPS,ORC,PAM,SGW,TRSKM
 SG_ PreviousCanNMState_FD02_BSM2 : 11|4@0+ (1,0) [0|15] ""  BCM,CADM2,CVADAS,EPS,ORC,PAM,SGW,TRSKM
 SG_ StayActiveSource_FD02_BSM2 : 31|64@0+ (1,0) [0|1.84467440737096E+019] ""  BCM,CADM2,CVADAS,EPS,ORC,PAM,SGW,TRSKM
 SG_ WakeupSource_FD02_BSM2 : 23|8@0+ (1,0) [0|255] ""  BCM,CADM2,CVADAS,EPS,ORC,PAM,SGW,TRSKM

BO_ 2654339213 PDC_INFO_FD_CADM: 12 BCM
 SG_ CurrentCanNMState_FD03_CADM : 15|4@0+ (1,0) [0|15] "" Vector__XXX
 SG_ CurrentFailSts_FD03_CADM : 6|1@0+ (1,0) [0|1] "" Vector__XXX
 SG_ DES_FD03_CADM : 4|2@0+ (1,0) [0|3] "" Vector__XXX
 SG_ EOL_FD03_CADM : 7|1@0+ (1,0) [0|1] "-" Vector__XXX
 SG_ GenericFailSts_FD03_CADM : 5|1@0+ (1,0) [0|1] "" Vector__XXX
 SG_ PreviousCanNMState_FD03_CADM : 11|4@0+ (1,0) [0|15] "" Vector__XXX
 SG_ StayActiveSource_FD03_CADM : 31|64@0+ (1,0) [0|1.84467440737096E+019] "" Vector__XXX
 SG_ WakeupSource_FD03_CADM : 23|8@0+ (1,0) [0|255] "" Vector__XXX

BO_ 2654339214 PDC_INFO_FD_CADM2: 12 CADM2
 SG_ CurrentCanNMState_FD02_CADM2 : 15|4@0+ (1,0) [0|15] ""  BCM,BSM2,CVADAS,EPS,ORC,PAM,SGW,TRSKM
 SG_ CurrentFailSts_FD02_CADM2 : 6|1@0+ (1,0) [0|1] ""  BCM,BSM2,CVADAS,EPS,ORC,PAM,SGW,TRSKM
 SG_ DES_FD02_CADM2 : 4|2@0+ (1,0) [0|3] ""  BCM,BSM2,CVADAS,EPS,ORC,PAM,SGW,TRSKM
 SG_ EOL_FD02_CADM2 : 7|1@0+ (1,0) [0|1] "-"  BCM,BSM2,CVADAS,EPS,ORC,PAM,SGW,TRSKM
 SG_ GenericFailSts_FD02_CADM2 : 5|1@0+ (1,0) [0|1] ""  BCM,BSM2,CVADAS,EPS,ORC,PAM,SGW,TRSKM
 SG_ PreviousCanNMState_FD02_CADM2 : 11|4@0+ (1,0) [0|15] ""  BCM,BSM2,CVADAS,EPS,ORC,PAM,SGW,TRSKM
 SG_ StayActiveSource_FD02_CADM2 : 31|64@0+ (1,0) [0|1.84467440737096E+019] ""  BCM,BSM2,CVADAS,EPS,ORC,PAM,SGW,TRSKM
 SG_ WakeupSource_FD02_CADM2 : 23|8@0+ (1,0) [0|255] ""  BCM,BSM2,CVADAS,EPS,ORC,PAM,SGW,TRSKM

BO_ 2654339225 PDC_INFO_FD_DMSM: 12 BCM
 SG_ CurrentCanNMState_FD03_DMSM : 15|4@0+ (1,0) [0|15] "" Vector__XXX
 SG_ CurrentFailSts_FD03_DMSM : 6|1@0+ (1,0) [0|1] "" Vector__XXX
 SG_ DES_FD03_DMSM : 4|2@0+ (1,0) [0|3] "" Vector__XXX
 SG_ EOL_FD03_DMSM : 7|1@0+ (1,0) [0|1] "-" Vector__XXX
 SG_ GenericFailSts_FD03_DMSM : 5|1@0+ (1,0) [0|1] "" Vector__XXX
 SG_ PreviousCanNMState_FD03_DMSM : 11|4@0+ (1,0) [0|15] "" Vector__XXX
 SG_ StayActiveSource_FD03_DMSM : 31|64@0+ (1,0) [0|1.84467440737096E+019] "" Vector__XXX
 SG_ WakeupSource_FD03_DMSM : 23|8@0+ (1,0) [0|255] "" Vector__XXX

BO_ 2654339139 PDC_INFO_FD_DTCM: 12 BCM
 SG_ CurrentCanNMState_FD03_DTCM : 15|4@0+ (1,0) [0|15] "" Vector__XXX
 SG_ CurrentFailSts_FD03_DTCM : 6|1@0+ (1,0) [0|1] "" Vector__XXX
 SG_ DES_FD03_DTCM : 4|2@0+ (1,0) [0|3] "" Vector__XXX
 SG_ EOL_FD03_DTCM : 7|1@0+ (1,0) [0|1] "-" Vector__XXX
 SG_ GenericFailSts_FD03_DTCM : 5|1@0+ (1,0) [0|1] "" Vector__XXX
 SG_ PreviousCanNMState_FD03_DTCM : 11|4@0+ (1,0) [0|15] "" Vector__XXX
 SG_ StayActiveSource_FD03_DTCM : 31|64@0+ (1,0) [0|1.84467440737096E+019] "" Vector__XXX
 SG_ WakeupSource_FD03_DTCM : 23|8@0+ (1,0) [0|255] "" Vector__XXX

BO_ 2654339073 PDC_INFO_FD_ECM: 12 BCM
 SG_ CurrentCanNMState_FD03_ECM : 15|4@0+ (1,0) [0|15] "" Vector__XXX
 SG_ CurrentFailSts_FD03_ECM : 6|1@0+ (1,0) [0|1] "" Vector__XXX
 SG_ DES_FD03_ECM : 4|2@0+ (1,0) [0|1] "" Vector__XXX
 SG_ EOL_FD03_ECM : 7|1@0+ (1,0) [0|1] "-" Vector__XXX
 SG_ GenericFailSts_FD03_ECM : 5|1@0+ (1,0) [0|1] "" Vector__XXX
 SG_ PreviousCanNMState_FD03_ECM : 11|4@0+ (1,0) [0|15] "" Vector__XXX
 SG_ StayActiveSource_FD03_ECM : 31|64@0+ (1,0) [0|1.84467440737096E+019] "" Vector__XXX
 SG_ WakeupSource_FD03_ECM : 23|8@0+ (1,0) [0|255] "" Vector__XXX

BO_ 2654339074 PDC_INFO_FD_EPS: 12 EPS
 SG_ CurrentCanNMState_FD02_EPS : 15|4@0+ (1,0) [0|15] ""  BCM,BSM2,CADM2,CVADAS,ORC,PAM,SGW,TRSKM
 SG_ CurrentFailSts_FD02_EPS : 6|1@0+ (1,0) [0|1] ""  BCM,BSM2,CADM2,CVADAS,ORC,PAM,SGW,TRSKM
 SG_ DES_FD02_EPS : 4|2@0+ (1,0) [0|3] ""  BCM,BSM2,CADM2,CVADAS,ORC,PAM,SGW,TRSKM
 SG_ EOL_FD02_EPS : 7|1@0+ (1,0) [0|1] "-"  BCM,BSM2,CADM2,CVADAS,ORC,PAM,SGW,TRSKM
 SG_ GenericFailSts_FD02_EPS : 5|1@0+ (1,0) [0|1] ""  BCM,BSM2,CADM2,CVADAS,ORC,PAM,SGW,TRSKM
 SG_ PreviousCanNMState_FD02_EPS : 11|4@0+ (1,0) [0|15] ""  BCM,BSM2,CADM2,CVADAS,ORC,PAM,SGW,TRSKM
 SG_ StayActiveSource_FD02_EPS : 31|64@0+ (1,0) [0|1.84467440737096E+019] ""  BCM,BSM2,CADM2,CVADAS,ORC,PAM,SGW,TRSKM
 SG_ WakeupSource_FD02_EPS : 23|8@0+ (1,0) [0|255] ""  BCM,BSM2,CADM2,CVADAS,ORC,PAM,SGW,TRSKM

BO_ 2654339108 PDC_INFO_FD_ETM: 12 SGW
 SG_ CurrentCanNMState_FD08_ETM : 15|4@0+ (1,0) [0|15] "" Vector__XXX
 SG_ CurrentFailSts_FD08_ETM : 6|1@0+ (1,0) [0|1] "" Vector__XXX
 SG_ DES_FD08_ETM : 4|2@0+ (1,0) [0|3] "" Vector__XXX
 SG_ EOL_FD08_ETM : 7|1@0+ (1,0) [0|1] "-" Vector__XXX
 SG_ GenericFailSts_FD08_ETM : 5|1@0+ (1,0) [0|1] "" Vector__XXX
 SG_ PreviousCanNMState_FD08_ETM : 11|4@0+ (1,0) [0|15] "" Vector__XXX
 SG_ StayActiveSource_FD08_ETM : 31|64@0+ (1,0) [0|1.84467440737096E+019] "" Vector__XXX
 SG_ WakeupSource_FD08_ETM : 23|8@0+ (1,0) [0|255] "" Vector__XXX

BO_ 2654339256 PDC_INFO_FD_FLDHM: 12 BCM
 SG_ CurrentCanNMState_FD09_FLDHM : 15|4@0+ (1,0) [0|15] "" Vector__XXX
 SG_ CurrentFailSts_FD09_FLDHM : 6|1@0+ (1,0) [0|1] "" Vector__XXX
 SG_ DES_FD09_FLDHM : 4|2@0+ (1,0) [0|3] "" Vector__XXX
 SG_ EOL_FD09_FLDHM : 7|1@0+ (1,0) [0|1] "-" Vector__XXX
 SG_ GenericFailSts_FD09_FLDHM : 5|1@0+ (1,0) [0|1] "" Vector__XXX
 SG_ PreviousCanNMState_FD09_FLDHM : 11|4@0+ (1,0) [0|15] "" Vector__XXX
 SG_ StayActiveSource_FD09_FLDHM : 31|64@0+ (1,0) [0|1.84467440737096E+019] "" Vector__XXX
 SG_ WakeupSource_FD09_FLDHM : 23|8@0+ (1,0) [0|255] "" Vector__XXX

BO_ 2654339255 PDC_INFO_FD_FRDHM: 12 BCM
 SG_ CurrentCanNMState_FD09_FRDHM : 15|4@0+ (1,0) [0|15] "" Vector__XXX
 SG_ CurrentFailSts_FD09_FRDHM : 6|1@0+ (1,0) [0|1] "" Vector__XXX
 SG_ DES_FD09_FRDHM : 4|2@0+ (1,0) [0|3] "" Vector__XXX
 SG_ EOL_FD09_FRDHM : 7|1@0+ (1,0) [0|1] "-" Vector__XXX
 SG_ GenericFailSts_FD09_FRDHM : 5|1@0+ (1,0) [0|1] "" Vector__XXX
 SG_ PreviousCanNMState_FD09_FRDHM : 11|4@0+ (1,0) [0|15] "" Vector__XXX
 SG_ StayActiveSource_FD09_FRDHM : 31|64@0+ (1,0) [0|1.84467440737096E+019] "" Vector__XXX
 SG_ WakeupSource_FD09_FRDHM : 23|8@0+ (1,0) [0|255] "" Vector__XXX

BO_ 2654339216 PDC_INFO_FD_GNMM: 12 BCM
 SG_ CurrentCanNMState_FD03_GNMM : 15|4@0+ (1,0) [0|3] "" Vector__XXX
 SG_ CurrentFailSts_FD03_GNMM : 6|1@0+ (1,0) [0|1] "" Vector__XXX
 SG_ DES_FD03_GNMM : 4|2@0+ (1,0) [0|3] "" Vector__XXX
 SG_ EOL_FD03_GNMM : 7|1@0+ (1,0) [0|1] "-" Vector__XXX
 SG_ GenericFailSts_FD03_GNMM : 5|1@0+ (1,0) [0|1] "" Vector__XXX
 SG_ PreviousCanNMState_FD03_GNMM : 11|4@0+ (1,0) [0|15] "" Vector__XXX
 SG_ StayActiveSource_FD03_GNMM : 31|64@0+ (1,0) [0|1.84467440737096E+019] "" Vector__XXX
 SG_ WakeupSource_FD03_GNMM : 23|8@0+ (1,0) [0|255] "" Vector__XXX

BO_ 2654339170 PDC_INFO_FD_HCP: 12 BCM
 SG_ CurrentCanNMState_FD03_HCP : 15|4@0+ (1,0) [0|15] "" Vector__XXX
 SG_ CurrentFailSts_FD03_HCP : 6|1@0+ (1,0) [0|1] "" Vector__XXX
 SG_ DES_FD03_HCP : 4|2@0+ (1,0) [0|3] "" Vector__XXX
 SG_ EOL_FD03_HCP : 7|1@0+ (1,0) [0|1] "-" Vector__XXX
 SG_ GenericFailSts_FD03_HCP : 5|1@0+ (1,0) [0|1] "" Vector__XXX
 SG_ PreviousCanNMState_FD03_HCP : 11|4@0+ (1,0) [0|15] "" Vector__XXX
 SG_ StayActiveSource_FD03_HCP : 31|64@0+ (1,0) [0|1.84467440737096E+019] "" Vector__XXX
 SG_ WakeupSource_FD03_HCP : 23|8@0+ (1,0) [0|255] "" Vector__XXX

BO_ 2654339075 PDC_INFO_FD_IPC: 12 BCM
 SG_ CurrentCanNMState_FD03_IPC : 15|4@0+ (1,0) [0|15] "" Vector__XXX
 SG_ CurrentFailSts_FD03_IPC : 6|1@0+ (1,0) [0|1] "" Vector__XXX
 SG_ DES_FD03_IPC : 4|2@0+ (1,0) [0|3] "" Vector__XXX
 SG_ EOL_FD03_IPC : 7|1@0+ (1,0) [0|1] "-" Vector__XXX
 SG_ GenericFailSts_FD03_IPC : 5|1@0+ (1,0) [0|1] "" Vector__XXX
 SG_ PreviousCanNMState_FD03_IPC : 11|4@0+ (1,0) [0|15] "" Vector__XXX
 SG_ StayActiveSource_FD03_IPC : 31|64@0+ (1,0) [0|1.84467440737096E+019] "" Vector__XXX
 SG_ WakeupSource_FD03_IPC : 23|8@0+ (1,0) [0|255] "" Vector__XXX

BO_ 2654339098 PDC_INFO_FD_ORC: 12 ORC
 SG_ CurrentCanNMState_FD02_ORC : 15|4@0+ (1,0) [0|15] ""  BCM,BSM2,CADM2,CVADAS,EPS,PAM,SGW,TRSKM
 SG_ CurrentFailSts_FD02_ORC : 6|1@0+ (1,0) [0|1] ""  BCM,BSM2,CADM2,CVADAS,EPS,PAM,SGW,TRSKM
 SG_ DES_FD02_ORC : 4|2@0+ (1,0) [0|1] ""  BCM,BSM2,CADM2,CVADAS,EPS,PAM,SGW,TRSKM
 SG_ EOL_FD02_ORC : 7|1@0+ (1,0) [0|1] "-"  BCM,BSM2,CADM2,CVADAS,EPS,PAM,SGW,TRSKM
 SG_ GenericFailSts_FD02_ORC : 5|1@0+ (1,0) [0|1] ""  BCM,BSM2,CADM2,CVADAS,EPS,PAM,SGW,TRSKM
 SG_ PreviousCanNMState_FD02_ORC : 11|4@0+ (1,0) [0|15] ""  BCM,BSM2,CADM2,CVADAS,EPS,PAM,SGW,TRSKM
 SG_ StayActiveSource_FD02_ORC : 31|64@0+ (1,0) [0|1.84467440737096E+019] ""  BCM,BSM2,CADM2,CVADAS,EPS,PAM,SGW,TRSKM
 SG_ WakeupSource_FD02_ORC : 23|8@0+ (1,0) [0|255] ""  BCM,BSM2,CADM2,CVADAS,EPS,PAM,SGW,TRSKM

BO_ 2654339096 PDC_INFO_FD_PAM: 12 CVADAS
 SG_ CurrentCanNMState_FD02_PAM : 15|4@0+ (1,0) [0|15] ""  BCM,BSM2,CADM2,EPS,ORC,SGW,TRSKM
 SG_ CurrentFailSts_FD02_PAM : 6|1@0+ (1,0) [0|1] ""  BCM,BSM2,CADM2,EPS,ORC,SGW,TRSKM
 SG_ DES_FD02_PAM : 4|2@0+ (1,0) [0|3] ""  BCM,BSM2,CADM2,EPS,ORC,SGW,TRSKM
 SG_ EOL_FD02_PAM : 7|1@0+ (1,0) [0|1] "-"  BCM,BSM2,CADM2,EPS,ORC,SGW,TRSKM
 SG_ GenericFailSts_FD02_PAM : 5|1@0+ (1,0) [0|1] ""  BCM,BSM2,CADM2,EPS,ORC,SGW,TRSKM
 SG_ PreviousCanNMState_FD02_PAM : 11|4@0+ (1,0) [0|15] ""  BCM,BSM2,CADM2,EPS,ORC,SGW,TRSKM
 SG_ StayActiveSource_FD02_PAM : 31|64@0+ (1,0) [0|0] ""  BCM,BSM2,CADM2,EPS,ORC,SGW,TRSKM
 SG_ WakeupSource_FD02_PAM : 23|8@0+ (1,0) [0|255] ""  BCM,BSM2,CADM2,EPS,ORC,SGW,TRSKM

BO_ 2654339137 PDC_INFO_FD_RFHM: 12 BCM
 SG_ CurrentCanNMState_FD03_RFHM : 15|4@0+ (1,0) [0|15] "" Vector__XXX
 SG_ CurrentFailSts_FD03_RFHM : 6|1@0+ (1,0) [0|1] "" Vector__XXX
 SG_ DES_FD03_RFHM : 4|2@0+ (1,0) [0|3] "" Vector__XXX
 SG_ EOL_FD03_RFHM : 7|1@0+ (1,0) [0|1] "-" Vector__XXX
 SG_ GenericFailSts_FD03_RFHM : 5|1@0+ (1,0) [0|1] "" Vector__XXX
 SG_ PreviousCanNMState_FD03_RFHM : 11|4@0+ (1,0) [0|15] "" Vector__XXX
 SG_ StayActiveSource_FD03_RFHM : 31|64@0+ (1,0) [0|1.84467440737096E+019] "" Vector__XXX
 SG_ WakeupSource_FD03_RFHM : 23|8@0+ (1,0) [0|255] "" Vector__XXX

BO_TX_BU_ 2654339096 : CVADAS,PAM;
CM_ SG_ 1954 CRC_ORC2 "CRC according to SAE J1850 standard at each frame transmission.";
CM_ SG_ 1954 DrvSbltUnFltr_1 "Driver seatbelt fault status - unfiltered";
CM_ SG_ 1954 MessageCounter_ORC2 "This signal is a counter used for safety checks strategies. This counter is incremented of 1 (one) unit at each frame transmission.";
CM_ SG_ 1954 ORCIdentification "ORC identification number.";
CM_ SG_ 1954 SBR1RowPsngrSeatPPDSts "Passenger Occupant Detection Sensor Status";
CM_ SG_ 274 CRC_ORC3 "CRC according to SAE J1850 standard at each frame transmission.";
CM_ SG_ 274 InternalError "This signal indicates if an internal error has been processed";
CM_ SG_ 274 LatAcceleration "This signal indicates the Lateral Acceleration Value";
CM_ SG_ 274 LatAccelerationFailSts "This signal indicates the status of Lateral Acceleration Signal";
CM_ SG_ 274 LongAcceleration "This signal indicates the Longitudinal Acceleration Value";
CM_ SG_ 274 LongAccelerationFailSts "This signal indicates the status of Longitudinal acceleration signal";
CM_ SG_ 274 MessageCounter_ORC3 "This signal is a counter used for safety checks strategies. This counter is incremented of 1 (one) unit at each frame transmission.";
CM_ SG_ 274 YawRate "This signal indicates the Yaw Rate Value";
CM_ SG_ 274 YawRate_HR "Yaw Rate Additional signal for high resolution.";
CM_ SG_ 274 YawRate_HR_Sign "Sign of High resolution Yaw Rate signal. 0 = Negative [-]. 1 = Positive [+].";
CM_ SG_ 274 YawRateFailSts "This signal indicates the Status of Yaw Rate Signal";
CM_ SG_ 2654339109 CurrentCanNMState_FD01_ADCM "Indicates that CanNM state the ECU is currently executing";
CM_ SG_ 2654339109 CurrentFailSts_FD01_ADCM "Indicates the presence/absence of at least one DTC with DTCStatus = present in the System Memory";
CM_ SG_ 2654339109 DES_FD01_ADCM "Indicates whether the ECU?s CAN cell is in either ErrorActive, or ErrorPassive state OR has just now recovered from a BusOff condition";
CM_ SG_ 2654339109 EOL_FD01_ADCM "Indicates if the ECU requires configuration data at the assembly plant End Of Line";
CM_ SG_ 2654339109 GenericFailSts_FD01_ADCM "Indicates the presence/absent of at least one DTC in the System Memory";
CM_ SG_ 2654339109 PreviousCanNMState_FD01_ADCM "Indicates the last CanNM state that the ECU existed in";
CM_ SG_ 2654339109 StayActiveSource_FD01_ADCM "Indicates the source that requests the ECU to stay active";
CM_ SG_ 2654339109 WakeupSource_FD01_ADCM "Indicates the reason the ECU was most recently awakened";
CM_ SG_ 2654339094 CurrentCanNMState_FD03_AGSM "Indicates that CanNM state the ECU is currently executing";
CM_ SG_ 2654339094 CurrentFailSts_FD03_AGSM "Indicates the presence/absence of at least one DTC with DTCStatus = present in the System Memory";
CM_ SG_ 2654339094 DES_FD03_AGSM "Indicates whether the ECU?s CAN cell is in either ErrorActive, or ErrorPassive state OR has just now recovered from a BusOff condition";
CM_ SG_ 2654339094 EOL_FD03_AGSM "Indicates if the ECU requires configuration data at the assembly plant End Of Line";
CM_ SG_ 2654339094 GenericFailSts_FD03_AGSM "Indicates the presence/absent of at least one DTC in the System Memory";
CM_ SG_ 2654339094 PreviousCanNMState_FD03_AGSM "Indicates the last CanNM state that the ECU existed in";
CM_ SG_ 2654339094 StayActiveSource_FD03_AGSM "Indicates the source that requests the ECU to stay active";
CM_ SG_ 2654339094 WakeupSource_FD03_AGSM "Indicates the reason the ECU was most recently awakened";
CM_ SG_ 2654339099 CurrentCanNMState_FD01_ASCM "Indicates that CanNM state the ECU is currently executing";
CM_ SG_ 2654339099 CurrentFailSts_FD01_ASCM "Indicates the presence/absence of at least one DTC with DTCStatus = present in the System Memory";
CM_ SG_ 2654339099 DES_FD01_ASCM "Indicates whether the ECU?s CAN cell is in either ErrorActive, or ErrorPassive state OR has just now recovered from a BusOff condition";
CM_ SG_ 2654339099 EOL_FD01_ASCM "Indicates if the ECU requires configuration data at the assembly plant End Of Line";
CM_ SG_ 2654339099 GenericFailSts_FD01_ASCM "Indicates the presence/absent of at least one DTC in the System Memory";
CM_ SG_ 2654339099 PreviousCanNMState_FD01_ASCM "Indicates the last CanNM state that the ECU existed in";
CM_ SG_ 2654339099 StayActiveSource_FD01_ASCM "Indicates the source that requests the ECU to stay active";
CM_ SG_ 2654339099 WakeupSource_FD01_ASCM "Indicates the reason the ECU was most recently awakened";
CM_ SG_ 2654339072 CurrentCanNMState_FD01_BCM "Indicates that CanNM state the ECU is currently executing";
CM_ SG_ 2654339072 CurrentCanNMState_FD02_BCM "Indicates that CanNM state the ECU is currently executing";
CM_ SG_ 2654339072 CurrentCanNMState_FD03_BCM "Indicates that CanNM state the ECU is currently executing";
CM_ SG_ 2654339072 CurrentCanNMState_FD04_BCM "Indicates that CanNM state the ECU is currently executing";
CM_ SG_ 2654339072 CurrentFailSts_FD01_BCM "Indicates the presence/absence of at least one DTC with DTCStatus = present in the System Memory";
CM_ SG_ 2654339072 CurrentFailSts_FD02_BCM "Indicates the presence/absence of at least one DTC with DTCStatus = present in the System Memory";
CM_ SG_ 2654339072 CurrentFailSts_FD03_BCM "Indicates the presence/absence of at least one DTC with DTCStatus = present in the System Memory";
CM_ SG_ 2654339072 CurrentFailSts_FD04_BCM "Indicates the presence/absence of at least one DTC with DTCStatus = present in the System Memory";
CM_ SG_ 2654339072 DES_FD01_BCM "Indicates whether the ECU?s CAN cell is in either ErrorActive, or ErrorPassive state OR has just now recovered from a BusOff condition";
CM_ SG_ 2654339072 DES_FD02_BCM "Indicates whether the ECU?s CAN cell is in either ErrorActive, or ErrorPassive state OR has just now recovered from a BusOff condition";
CM_ SG_ 2654339072 DES_FD03_BCM "Indicates whether the ECU?s CAN cell is in either ErrorActive, or ErrorPassive state OR has just now recovered from a BusOff condition";
CM_ SG_ 2654339072 DES_FD04_BCM "Indicates whether the ECU?s CAN cell is in either ErrorActive, or ErrorPassive state OR has just now recovered from a BusOff condition";
CM_ SG_ 2654339072 EOL_FD01_BCM "Indicates if the ECU requires configuration data at the assembly plant End Of Line";
CM_ SG_ 2654339072 EOL_FD02_BCM "Indicates if the ECU requires configuration data at the assembly plant End Of Line";
CM_ SG_ 2654339072 EOL_FD03_BCM "Indicates if the ECU requires configuration data at the assembly plant End Of Line";
CM_ SG_ 2654339072 EOL_FD04_BCM "Indicates if the ECU requires configuration data at the assembly plant End Of Line";
CM_ SG_ 2654339072 GenericFailSts_FD01_BCM "Indicates the presence/absent of at least one DTC in the System Memory";
CM_ SG_ 2654339072 GenericFailSts_FD02_BCM "Indicates the presence/absent of at least one DTC in the System Memory";
CM_ SG_ 2654339072 GenericFailSts_FD03_BCM "Indicates the presence/absent of at least one DTC in the System Memory";
CM_ SG_ 2654339072 GenericFailSts_FD04_BCM "Indicates the presence/absent of at least one DTC in the System Memory";
CM_ SG_ 2654339072 PreviousCanNMState_FD01_BCM "Indicates the last CanNM state that the ECU existed in";
CM_ SG_ 2654339072 PreviousCanNMState_FD02_BCM "Indicates the last CanNM state that the ECU existed in";
CM_ SG_ 2654339072 PreviousCanNMState_FD03_BCM "Indicates the last CanNM state that the ECU existed in";
CM_ SG_ 2654339072 PreviousCanNMState_FD04_BCM "Indicates the last CanNM state that the ECU existed in";
CM_ SG_ 2654339072 StayActiveSource_FD01_BCM "Indicates the source that requests the ECU to stay active";
CM_ SG_ 2654339072 StayActiveSource_FD02_BCM "Indicates the source that requests the ECU to stay active";
CM_ SG_ 2654339072 StayActiveSource_FD03_BCM "Indicates the source that requests the ECU to stay active";
CM_ SG_ 2654339072 StayActiveSource_FD04_BCM "Indicates the source that requests the ECU to stay active";
CM_ SG_ 2654339072 WakeupSource_FD01_BCM "Indicates the reason the ECU was most recently awakened";
CM_ SG_ 2654339072 WakeupSource_FD02_BCM "Indicates the reason the ECU was most recently awakened";
CM_ SG_ 2654339072 WakeupSource_FD03_BCM "Indicates the reason the ECU was most recently awakened";
CM_ SG_ 2654339072 WakeupSource_FD04_BCM "Indicates the reason the ECU was most recently awakened";
CM_ SG_ 2654339142 CurrentCanNMState_FD11_BPCM "Indicates that CanNM state the ECU is currently executing";
CM_ SG_ 2654339142 CurrentFailSts_FD11_BPCM "Indicates the presence/absence of at least one DTC with DTCStatus = present in the System Memory";
CM_ SG_ 2654339142 DES_FD11_BPCM "Indicates whether the ECU?s CAN cell is in either ErrorActive, or ErrorPassive state OR has just now recovered from a BusOff condition";
CM_ SG_ 2654339142 EOL_FD11_BPCM "Indicates if the ECU requires configuration data at the assembly plant End Of Line";
CM_ SG_ 2654339142 GenericFailSts_FD11_BPCM "Indicates the presence/absent of at least one DTC in the System Memory";
CM_ SG_ 2654339142 PreviousCanNMState_FD11_BPCM "Indicates the last CanNM state that the ECU existed in";
CM_ SG_ 2654339142 StayActiveSource_FD11_BPCM "Indicates the source that requests the ECU to stay active";
CM_ SG_ 2654339142 WakeupSource_FD11_BPCM "Indicates the reason the ECU was most recently awakened";
CM_ SG_ 2654339078 CurrentCanNMState_FD03_BSM "Indicates that CanNM state the ECU is currently executing";
CM_ SG_ 2654339078 CurrentFailSts_FD03_BSM "Indicates the presence/absence of at least one DTC with DTCStatus = present in the System Memory";
CM_ SG_ 2654339078 DES_FD03_BSM "Indicates whether the ECU?s CAN cell is in either ErrorActive, or ErrorPassive state OR has just now recovered from a BusOff condition";
CM_ SG_ 2654339078 EOL_FD03_BSM "Indicates if the ECU requires configuration data at the assembly plant End Of Line";
CM_ SG_ 2654339078 GenericFailSts_FD03_BSM "Indicates the presence/absent of at least one DTC in the System Memory";
CM_ SG_ 2654339078 PreviousCanNMState_FD03_BSM "Indicates the last CanNM state that the ECU existed in";
CM_ SG_ 2654339078 StayActiveSource_FD03_BSM "Indicates the source that requests the ECU to stay active";
CM_ SG_ 2654339078 WakeupSource_FD03_BSM "Indicates the reason the ECU was most recently awakened";
CM_ SG_ 2654339220 CurrentCanNMState_FD02_BSM2 "Indicates that CanNM state the ECU is currently executing";
CM_ SG_ 2654339220 CurrentFailSts_FD02_BSM2 "Indicates the presence/absence of at least one DTC with DTCStatus = present in the System Memory";
CM_ SG_ 2654339220 DES_FD02_BSM2 "Indicates whether the ECU?s CAN cell is in either ErrorActive, or ErrorPassive state OR has just now recovered from a BusOff condition";
CM_ SG_ 2654339220 EOL_FD02_BSM2 "Indicates if the ECU requires configuration data at the assembly plant End Of Line";
CM_ SG_ 2654339220 GenericFailSts_FD02_BSM2 "Indicates the presence/absent of at least one DTC in the System Memory";
CM_ SG_ 2654339220 PreviousCanNMState_FD02_BSM2 "Indicates the last CanNM state that the ECU existed in";
CM_ SG_ 2654339220 StayActiveSource_FD02_BSM2 "Indicates the source that requests the ECU to stay active";
CM_ SG_ 2654339220 WakeupSource_FD02_BSM2 "Indicates the reason the ECU was most recently awakened";
CM_ SG_ 2654339213 CurrentCanNMState_FD03_CADM "Indicates that CanNM state the ECU is currently executing";
CM_ SG_ 2654339213 CurrentFailSts_FD03_CADM "Indicates the presence/absence of at least one DTC with DTCStatus = present in the System Memory";
CM_ SG_ 2654339213 DES_FD03_CADM "Indicates whether the ECU?s CAN cell is in either ErrorActive, or ErrorPassive state OR has just now recovered from a BusOff condition";
CM_ SG_ 2654339213 EOL_FD03_CADM "Indicates if the ECU requires configuration data at the assembly plant End Of Line";
CM_ SG_ 2654339213 GenericFailSts_FD03_CADM "Indicates the presence/absent of at least one DTC in the System Memory";
CM_ SG_ 2654339213 PreviousCanNMState_FD03_CADM "Indicates the last CanNM state that the ECU existed in";
CM_ SG_ 2654339213 StayActiveSource_FD03_CADM "Indicates the source that requests the ECU to stay active";
CM_ SG_ 2654339213 WakeupSource_FD03_CADM "Indicates the reason the ECU was most recently awakened";
CM_ SG_ 2654339214 CurrentCanNMState_FD02_CADM2 "Indicates that CanNM state the ECU is currently executing";
CM_ SG_ 2654339214 CurrentFailSts_FD02_CADM2 "Indicates the presence/absence of at least one DTC with DTCStatus = present in the System Memory";
CM_ SG_ 2654339214 DES_FD02_CADM2 "Indicates whether the ECU?s CAN cell is in either ErrorActive, or ErrorPassive state OR has just now recovered from a BusOff condition";
CM_ SG_ 2654339214 EOL_FD02_CADM2 "Indicates if the ECU requires configuration data at the assembly plant End Of Line";
CM_ SG_ 2654339214 GenericFailSts_FD02_CADM2 "Indicates the presence/absent of at least one DTC in the System Memory";
CM_ SG_ 2654339214 PreviousCanNMState_FD02_CADM2 "Indicates the last CanNM state that the ECU existed in";
CM_ SG_ 2654339214 StayActiveSource_FD02_CADM2 "Indicates the source that requests the ECU to stay active";
CM_ SG_ 2654339214 WakeupSource_FD02_CADM2 "Indicates the reason the ECU was most recently awakened";
CM_ SG_ 2654339225 CurrentCanNMState_FD03_DMSM "Indicates that CanNM state the ECU is currently executing";
CM_ SG_ 2654339225 CurrentFailSts_FD03_DMSM "Indicates the presence/absence of at least one DTC with DTCStatus = present in the System Memory";
CM_ SG_ 2654339225 DES_FD03_DMSM "Indicates whether the ECU?s CAN cell is in either ErrorActive, or ErrorPassive state OR has just now recovered from a BusOff condition";
CM_ SG_ 2654339225 EOL_FD03_DMSM "Indicates if the ECU requires configuration data at the assembly plant End Of Line";
CM_ SG_ 2654339225 GenericFailSts_FD03_DMSM "Indicates the presence/absent of at least one DTC in the System Memory";
CM_ SG_ 2654339225 PreviousCanNMState_FD03_DMSM "Indicates the last CanNM state that the ECU existed in";
CM_ SG_ 2654339225 StayActiveSource_FD03_DMSM "Indicates the source that requests the ECU to stay active";
CM_ SG_ 2654339225 WakeupSource_FD03_DMSM "Indicates the reason the ECU was most recently awakened";
CM_ SG_ 2654339139 CurrentCanNMState_FD03_DTCM "Indicates that CanNM state the ECU is currently executing";
CM_ SG_ 2654339139 CurrentFailSts_FD03_DTCM "Indicates the presence/absence of at least one DTC with DTCStatus = present in the System Memory";
CM_ SG_ 2654339139 DES_FD03_DTCM "Indicates whether the ECU?s CAN cell is in either ErrorActive, or ErrorPassive state OR has just now recovered from a BusOff condition";
CM_ SG_ 2654339139 EOL_FD03_DTCM "Indicates if the ECU requires configuration data at the assembly plant End Of Line";
CM_ SG_ 2654339139 GenericFailSts_FD03_DTCM "Indicates the presence/absent of at least one DTC in the System Memory";
CM_ SG_ 2654339139 PreviousCanNMState_FD03_DTCM "Indicates the last CanNM state that the ECU existed in";
CM_ SG_ 2654339139 StayActiveSource_FD03_DTCM "Indicates the source that requests the ECU to stay active";
CM_ SG_ 2654339139 WakeupSource_FD03_DTCM "Indicates the reason the ECU was most recently awakened";
CM_ SG_ 2654339073 CurrentCanNMState_FD03_ECM "Indicates that CanNM state the ECU is currently executing";
CM_ SG_ 2654339073 CurrentFailSts_FD03_ECM "Indicates the presence/absence of at least one DTC with DTCStatus = present in the System Memory";
CM_ SG_ 2654339073 DES_FD03_ECM "Indicates whether the ECU?s CAN cell is in either ErrorActive, or ErrorPassive state OR has just now recovered from a BusOff condition";
CM_ SG_ 2654339073 EOL_FD03_ECM "Indicates if the ECU requires configuration data at the assembly plant End Of Line";
CM_ SG_ 2654339073 GenericFailSts_FD03_ECM "Indicates the presence/absent of at least one DTC in the System Memory";
CM_ SG_ 2654339073 PreviousCanNMState_FD03_ECM "Indicates the last CanNM state that the ECU existed in";
CM_ SG_ 2654339073 StayActiveSource_FD03_ECM "Indicates the source that requests the ECU to stay active";
CM_ SG_ 2654339073 WakeupSource_FD03_ECM "Indicates the reason the ECU was most recently awakened";
CM_ SG_ 2654339074 CurrentCanNMState_FD02_EPS "Indicates that CanNM state the ECU is currently executing";
CM_ SG_ 2654339074 CurrentFailSts_FD02_EPS "Indicates the presence/absence of at least one DTC with DTCStatus = present in the System Memory";
CM_ SG_ 2654339074 DES_FD02_EPS "Indicates whether the ECU?s CAN cell is in either ErrorActive, or ErrorPassive state OR has just now recovered from a BusOff condition";
CM_ SG_ 2654339074 EOL_FD02_EPS "Indicates if the ECU requires configuration data at the assembly plant End Of Line";
CM_ SG_ 2654339074 GenericFailSts_FD02_EPS "Indicates the presence/absent of at least one DTC in the System Memory";
CM_ SG_ 2654339074 PreviousCanNMState_FD02_EPS "Indicates the last CanNM state that the ECU existed in";
CM_ SG_ 2654339074 StayActiveSource_FD02_EPS "Indicates the source that requests the ECU to stay active";
CM_ SG_ 2654339074 WakeupSource_FD02_EPS "Indicates the reason the ECU was most recently awakened";
CM_ SG_ 2654339108 CurrentCanNMState_FD08_ETM "Indicates that CanNM state the ECU is currently executing";
CM_ SG_ 2654339108 CurrentFailSts_FD08_ETM "Indicates the presence/absence of at least one DTC with DTCStatus = present in the System Memory";
CM_ SG_ 2654339108 DES_FD08_ETM "Indicates whether the ECU?s CAN cell is in either ErrorActive, or ErrorPassive state OR has just now recovered from a BusOff condition";
CM_ SG_ 2654339108 EOL_FD08_ETM "Indicates if the ECU requires configuration data at the assembly plant End Of Line";
CM_ SG_ 2654339108 GenericFailSts_FD08_ETM "Indicates the presence/absent of at least one DTC in the System Memory";
CM_ SG_ 2654339108 PreviousCanNMState_FD08_ETM "Indicates the last CanNM state that the ECU existed in";
CM_ SG_ 2654339108 StayActiveSource_FD08_ETM "Indicates the source that requests the ECU to stay active";
CM_ SG_ 2654339108 WakeupSource_FD08_ETM "Indicates the reason the ECU was most recently awakened";
CM_ SG_ 2654339256 CurrentCanNMState_FD09_FLDHM "Indicates that CanNM state the ECU is currently executing";
CM_ SG_ 2654339256 CurrentFailSts_FD09_FLDHM "Indicates the presence/absence of at least one DTC with DTCStatus = present in the System Memory";
CM_ SG_ 2654339256 DES_FD09_FLDHM "Indicates whether the ECU?s CAN cell is in either ErrorActive, or ErrorPassive state OR has just now recovered from a BusOff condition";
CM_ SG_ 2654339256 EOL_FD09_FLDHM "Indicates if the ECU requires configuration data at the assembly plant End Of Line";
CM_ SG_ 2654339256 GenericFailSts_FD09_FLDHM "Indicates the presence/absent of at least one DTC in the System Memory";
CM_ SG_ 2654339256 PreviousCanNMState_FD09_FLDHM "Indicates the last CanNM state that the ECU existed in";
CM_ SG_ 2654339256 StayActiveSource_FD09_FLDHM "Indicates the source that requests the ECU to stay active";
CM_ SG_ 2654339256 WakeupSource_FD09_FLDHM "Indicates the reason the ECU was most recently awakened";
CM_ SG_ 2654339255 CurrentCanNMState_FD09_FRDHM "Indicates that CanNM state the ECU is currently executing";
CM_ SG_ 2654339255 CurrentFailSts_FD09_FRDHM "Indicates the presence/absence of at least one DTC with DTCStatus = present in the System Memory";
CM_ SG_ 2654339255 DES_FD09_FRDHM "Indicates whether the ECU?s CAN cell is in either ErrorActive, or ErrorPassive state OR has just now recovered from a BusOff condition";
CM_ SG_ 2654339255 EOL_FD09_FRDHM "Indicates if the ECU requires configuration data at the assembly plant End Of Line";
CM_ SG_ 2654339255 GenericFailSts_FD09_FRDHM "Indicates the presence/absent of at least one DTC in the System Memory";
CM_ SG_ 2654339255 PreviousCanNMState_FD09_FRDHM "Indicates the last CanNM state that the ECU existed in";
CM_ SG_ 2654339255 StayActiveSource_FD09_FRDHM "Indicates the source that requests the ECU to stay active";
CM_ SG_ 2654339255 WakeupSource_FD09_FRDHM "Indicates the reason the ECU was most recently awakened";
CM_ SG_ 2654339216 CurrentCanNMState_FD03_GNMM "Indicates that CanNM state the ECU is currently executing";
CM_ SG_ 2654339216 CurrentFailSts_FD03_GNMM "Indicates the presence/absence of at least one DTC with DTCStatus = present in the System Memory";
CM_ SG_ 2654339216 DES_FD03_GNMM "Indicates whether the ECU?s CAN cell is in either ErrorActive, or ErrorPassive state OR has just now recovered from a BusOff condition";
CM_ SG_ 2654339216 EOL_FD03_GNMM "Indicates if the ECU requires configuration data at the assembly plant End Of Line";
CM_ SG_ 2654339216 GenericFailSts_FD03_GNMM "Indicates the presence/absent of at least one DTC in the System Memory";
CM_ SG_ 2654339216 PreviousCanNMState_FD03_GNMM "Indicates the last CanNM state that the ECU existed in";
CM_ SG_ 2654339216 StayActiveSource_FD03_GNMM "Indicates the source that requests the ECU to stay active";
CM_ SG_ 2654339216 WakeupSource_FD03_GNMM "Indicates the reason the ECU was most recently awakened";
CM_ SG_ 2654339170 CurrentCanNMState_FD03_HCP "Indicates that CanNM state the ECU is currently executing";
CM_ SG_ 2654339170 CurrentFailSts_FD03_HCP "Indicates the presence/absence of at least one DTC with DTCStatus = present in the System Memory";
CM_ SG_ 2654339170 DES_FD03_HCP "Indicates whether the ECU?s CAN cell is in either ErrorActive, or ErrorPassive state OR has just now recovered from a BusOff condition";
CM_ SG_ 2654339170 EOL_FD03_HCP "Indicates if the ECU requires configuration data at the assembly plant End Of Line";
CM_ SG_ 2654339170 GenericFailSts_FD03_HCP "Indicates the presence/absent of at least one DTC in the System Memory";
CM_ SG_ 2654339170 PreviousCanNMState_FD03_HCP "Indicates the last CanNM state that the ECU existed in";
CM_ SG_ 2654339170 StayActiveSource_FD03_HCP "Indicates the source that requests the ECU to stay active";
CM_ SG_ 2654339170 WakeupSource_FD03_HCP "Indicates the reason the ECU was most recently awakened";
CM_ SG_ 2654339075 CurrentCanNMState_FD03_IPC "Indicates that CanNM state the ECU is currently executing";
CM_ SG_ 2654339075 CurrentFailSts_FD03_IPC "Indicates the presence/absence of at least one DTC with DTCStatus = present in the System Memory";
CM_ SG_ 2654339075 DES_FD03_IPC "Indicates whether the ECU?s CAN cell is in either ErrorActive, or ErrorPassive state OR has just now recovered from a BusOff condition";
CM_ SG_ 2654339075 EOL_FD03_IPC "Indicates if the ECU requires configuration data at the assembly plant End Of Line";
CM_ SG_ 2654339075 GenericFailSts_FD03_IPC "Indicates the presence/absent of at least one DTC in the System Memory";
CM_ SG_ 2654339075 PreviousCanNMState_FD03_IPC "Indicates the last CanNM state that the ECU existed in";
CM_ SG_ 2654339075 StayActiveSource_FD03_IPC "Indicates the source that requests the ECU to stay active";
CM_ SG_ 2654339075 WakeupSource_FD03_IPC "Indicates the reason the ECU was most recently awakened";
CM_ SG_ 2654339098 CurrentCanNMState_FD02_ORC "Indicates that CanNM state the ECU is currently executing";
CM_ SG_ 2654339098 CurrentFailSts_FD02_ORC "Indicates the presence/absence of at least one DTC with DTCStatus = present in the System Memory";
CM_ SG_ 2654339098 DES_FD02_ORC "Indicates whether the ECU?s CAN cell is in either ErrorActive, or ErrorPassive state OR has just now recovered from a BusOff condition";
CM_ SG_ 2654339098 EOL_FD02_ORC "Indicates if the ECU requires configuration data at the assembly plant End Of Line";
CM_ SG_ 2654339098 GenericFailSts_FD02_ORC "Indicates the presence/absent of at least one DTC in the System Memory";
CM_ SG_ 2654339098 PreviousCanNMState_FD02_ORC "Indicates the last CanNM state that the ECU existed in";
CM_ SG_ 2654339098 StayActiveSource_FD02_ORC "Indicates the source that requests the ECU to stay active";
CM_ SG_ 2654339098 WakeupSource_FD02_ORC "Indicates the reason the ECU was most recently awakened";
CM_ SG_ 2654339096 CurrentCanNMState_FD02_PAM "Indicates that CanNM state the ECU is currently executing";
CM_ SG_ 2654339096 CurrentFailSts_FD02_PAM "Indicates the presence/absence of at least one DTC with DTCStatus = present in the System Memory";
CM_ SG_ 2654339096 DES_FD02_PAM "Indicates whether the ECU?s CAN cell is in either ErrorActive, or ErrorPassive state OR has just now recovered from a BusOff condition";
CM_ SG_ 2654339096 EOL_FD02_PAM "Indicates if the ECU requires configuration data at the assembly plant End Of Line";
CM_ SG_ 2654339096 GenericFailSts_FD02_PAM "Indicates the presence/absent of at least one DTC in the System Memory";
CM_ SG_ 2654339096 PreviousCanNMState_FD02_PAM "Indicates the last CanNM state that the ECU existed in";
CM_ SG_ 2654339096 StayActiveSource_FD02_PAM "Indicates the source that requests the ECU to stay active";
CM_ SG_ 2654339096 WakeupSource_FD02_PAM "Indicates the reason the ECU was most recently awakened";
CM_ SG_ 2654339137 CurrentCanNMState_FD03_RFHM "Indicates that CanNM state the ECU is currently executing";
CM_ SG_ 2654339137 CurrentFailSts_FD03_RFHM "Indicates the presence/absence of at least one DTC with DTCStatus = present in the System Memory";
CM_ SG_ 2654339137 DES_FD03_RFHM "Indicates whether the ECU?s CAN cell is in either ErrorActive, or ErrorPassive state OR has just now recovered from a BusOff condition";
CM_ SG_ 2654339137 EOL_FD03_RFHM "Indicates if the ECU requires configuration data at the assembly plant End Of Line";
CM_ SG_ 2654339137 GenericFailSts_FD03_RFHM "Indicates the presence/absent of at least one DTC in the System Memory";
CM_ SG_ 2654339137 PreviousCanNMState_FD03_RFHM "Indicates the last CanNM state that the ECU existed in";
CM_ SG_ 2654339137 StayActiveSource_FD03_RFHM "Indicates the source that requests the ECU to stay active";
CM_ SG_ 2654339137 WakeupSource_FD03_RFHM "Indicates the reason the ECU was most recently awakened";
BA_DEF_ SG_  "GenSigStartValue" INT 0 2147483647;
BA_DEF_ SG_  "GenSigInactiveValue" INT 0 2147483647;
BA_DEF_ SG_  "GenSigSendType" ENUM  "NotUsed","OnWrite","OnWriteWithRepetition","OnChange","OnChangeWithRepetition","IfActive","IfActiveWithRepetition","NoSigSendType";
BA_DEF_ SG_  "GenSigTimeoutTime_BCM" INT 0 65535;
BA_DEF_ SG_  "GenSigTimeoutTime_BSM2" INT 0 65535;
BA_DEF_ SG_  "GenSigTimeoutTime_CADM2" INT 0 65535;
BA_DEF_ SG_  "GenSigTimeoutTime_CVADAS" INT 0 65535;
BA_DEF_ SG_  "GenSigTimeoutTime_EPS" INT 0 65535;
BA_DEF_ SG_  "GenSigTimeoutTime_ORC" INT 0 65535;
BA_DEF_ SG_  "GenSigTimeoutTime_PAM" INT 0 65535;
BA_DEF_ SG_  "GenSigTimeoutTime_SGW" INT 0 65535;
BA_DEF_ SG_  "GenSigTimeoutTime_TRSKM" INT 0 65535;
BA_DEF_ BO_  "DiagRequest" ENUM  "No","Yes";
BA_DEF_ BO_  "Type" ENUM  "P","C","PE","COC","PE_Cntrl","E","E_Cntrl","OC","S","BAF","DC","EM","MM","ISO-TP","-";
BA_DEF_ BO_  "DiagResponse" ENUM  "No","Yes";
BA_DEF_ BO_  "NmMessage" ENUM  "No","Yes";
BA_DEF_ BO_  "GenMsgSendType" ENUM  "Cyclic","NotUsed","NotUsed","NotUsed","NotUsed","NotUsed","NotUsed","NotUsed","NoMsgSendType";
BA_DEF_ BO_  "GenMsgNrOfRepetition" INT 0 255;
BA_DEF_ BO_  "GenMsgILSupport" ENUM  "No","Yes";
BA_DEF_ BO_  "GenMsgStartDelayTime" INT 0 65535;
BA_DEF_ BO_  "GenMsgCycleTimeFast" INT 0 65535;
BA_DEF_ BO_  "GenMsgCycleTime" INT 0 65535;
BA_DEF_ BO_  "GenMsgDelayTime" INT 0 65535;
BA_DEF_ BO_  "NmAsrMessage" ENUM  "No","Yes";
BA_DEF_ BO_  "DiagState" ENUM  "No","Yes";
BA_DEF_ BO_  "DiagConnection" HEX 0 65535;
BA_DEF_ BO_  "VFrameFormat" ENUM  "StandardCAN","ExtendedCAN","reserved","reserved","reserved","reserved","reserved","reserved","reserved","reserved","reserved","reserved","reserved","reserved","StandardCAN_FD","ExtendedCAN_FD";
BA_DEF_ BO_  "CANFD_BRS" INT 0 1;
BA_DEF_DEF_  "GenSigStartValue" 0;
BA_DEF_DEF_  "GenSigInactiveValue" 0;
BA_DEF_DEF_  "GenSigSendType" "NoSigSendType";
BA_DEF_DEF_  "GenSigTimeoutTime_BCM" 2500;
BA_DEF_DEF_  "GenSigTimeoutTime_BSM2" 2500;
BA_DEF_DEF_  "GenSigTimeoutTime_CADM2" 2500;
BA_DEF_DEF_  "GenSigTimeoutTime_CVADAS" 2500;
BA_DEF_DEF_  "GenSigTimeoutTime_EPS" 2500;
BA_DEF_DEF_  "GenSigTimeoutTime_ORC" 2500;
BA_DEF_DEF_  "GenSigTimeoutTime_PAM" 2500;
BA_DEF_DEF_  "GenSigTimeoutTime_SGW" 2500;
BA_DEF_DEF_  "GenSigTimeoutTime_TRSKM" 2500;
BA_DEF_DEF_  "DiagRequest" "No";
BA_DEF_DEF_  "Type" "-";
BA_DEF_DEF_  "DiagResponse" "No";
BA_DEF_DEF_  "NmMessage" "No";
BA_DEF_DEF_  "GenMsgSendType" "NoMsgSendType";
BA_DEF_DEF_  "GenMsgNrOfRepetition" 0;
BA_DEF_DEF_  "GenMsgILSupport" "No";
BA_DEF_DEF_  "GenMsgStartDelayTime" 0;
BA_DEF_DEF_  "GenMsgCycleTimeFast" 0;
BA_DEF_DEF_  "GenMsgCycleTime" 0;
BA_DEF_DEF_  "GenMsgDelayTime" 0;
BA_DEF_DEF_  "NmAsrMessage" "No";
BA_DEF_DEF_  "DiagState" "No";
BA_DEF_DEF_  "DiagConnection" 0;
BA_DEF_DEF_  "VFrameFormat" "StandardCAN_FD";
BA_DEF_DEF_  "CANFD_BRS" 0;
BA_ "Type" BO_ 1954 3;
BA_ "GenMsgSendType" BO_ 1954 0;
BA_ "GenMsgILSupport" BO_ 1954 1;
BA_ "GenMsgCycleTime" BO_ 1954 1000;
BA_ "CANFD_BRS" BO_ 1954 1;
BA_ "Type" BO_ 274 1;
BA_ "GenMsgSendType" BO_ 274 0;
BA_ "GenMsgILSupport" BO_ 274 1;
BA_ "GenMsgCycleTime" BO_ 274 10;
BA_ "CANFD_BRS" BO_ 274 1;
BA_ "Type" BO_ 2654339109 1;
BA_ "GenMsgSendType" BO_ 2654339109 0;
BA_ "GenMsgILSupport" BO_ 2654339109 1;
BA_ "GenMsgCycleTime" BO_ 2654339109 1000;
BA_ "CANFD_BRS" BO_ 2654339109 1;
BA_ "VFrameFormat" BO_ 2654339109 15;
BA_ "Type" BO_ 2654339094 1;
BA_ "GenMsgSendType" BO_ 2654339094 0;
BA_ "GenMsgILSupport" BO_ 2654339094 1;
BA_ "GenMsgStartDelayTime" BO_ 2654339094 235;
BA_ "GenMsgCycleTime" BO_ 2654339094 1000;
BA_ "CANFD_BRS" BO_ 2654339094 1;
BA_ "VFrameFormat" BO_ 2654339094 15;
BA_ "Type" BO_ 2654339099 1;
BA_ "GenMsgSendType" BO_ 2654339099 0;
BA_ "GenMsgILSupport" BO_ 2654339099 1;
BA_ "GenMsgStartDelayTime" BO_ 2654339099 250;
BA_ "GenMsgCycleTime" BO_ 2654339099 1000;
BA_ "CANFD_BRS" BO_ 2654339099 1;
BA_ "VFrameFormat" BO_ 2654339099 15;
BA_ "Type" BO_ 2654339072 1;
BA_ "GenMsgSendType" BO_ 2654339072 0;
BA_ "GenMsgILSupport" BO_ 2654339072 1;
BA_ "GenMsgStartDelayTime" BO_ 2654339072 255;
BA_ "GenMsgCycleTime" BO_ 2654339072 1000;
BA_ "CANFD_BRS" BO_ 2654339072 1;
BA_ "VFrameFormat" BO_ 2654339072 15;
BA_ "Type" BO_ 2654339142 1;
BA_ "GenMsgSendType" BO_ 2654339142 0;
BA_ "GenMsgILSupport" BO_ 2654339142 1;
BA_ "GenMsgStartDelayTime" BO_ 2654339142 260;
BA_ "GenMsgCycleTime" BO_ 2654339142 1000;
BA_ "CANFD_BRS" BO_ 2654339142 1;
BA_ "VFrameFormat" BO_ 2654339142 15;
BA_ "Type" BO_ 2654339078 1;
BA_ "GenMsgSendType" BO_ 2654339078 0;
BA_ "GenMsgILSupport" BO_ 2654339078 1;
BA_ "GenMsgStartDelayTime" BO_ 2654339078 265;
BA_ "GenMsgCycleTime" BO_ 2654339078 1000;
BA_ "CANFD_BRS" BO_ 2654339078 1;
BA_ "VFrameFormat" BO_ 2654339078 15;
BA_ "Type" BO_ 2654339220 1;
BA_ "GenMsgSendType" BO_ 2654339220 0;
BA_ "GenMsgILSupport" BO_ 2654339220 1;
BA_ "GenMsgCycleTime" BO_ 2654339220 1000;
BA_ "CANFD_BRS" BO_ 2654339220 1;
BA_ "VFrameFormat" BO_ 2654339220 15;
BA_ "Type" BO_ 2654339213 1;
BA_ "GenMsgSendType" BO_ 2654339213 0;
BA_ "GenMsgILSupport" BO_ 2654339213 1;
BA_ "GenMsgStartDelayTime" BO_ 2654339213 270;
BA_ "GenMsgCycleTime" BO_ 2654339213 1000;
BA_ "CANFD_BRS" BO_ 2654339213 1;
BA_ "VFrameFormat" BO_ 2654339213 15;
BA_ "Type" BO_ 2654339214 1;
BA_ "GenMsgSendType" BO_ 2654339214 0;
BA_ "GenMsgILSupport" BO_ 2654339214 1;
BA_ "GenMsgCycleTime" BO_ 2654339214 1000;
BA_ "CANFD_BRS" BO_ 2654339214 1;
BA_ "VFrameFormat" BO_ 2654339214 15;
BA_ "Type" BO_ 2654339225 1;
BA_ "GenMsgSendType" BO_ 2654339225 0;
BA_ "GenMsgILSupport" BO_ 2654339225 1;
BA_ "GenMsgCycleTime" BO_ 2654339225 1000;
BA_ "CANFD_BRS" BO_ 2654339225 1;
BA_ "VFrameFormat" BO_ 2654339225 15;
BA_ "Type" BO_ 2654339139 1;
BA_ "GenMsgSendType" BO_ 2654339139 0;
BA_ "GenMsgILSupport" BO_ 2654339139 1;
BA_ "GenMsgStartDelayTime" BO_ 2654339139 280;
BA_ "GenMsgCycleTime" BO_ 2654339139 1000;
BA_ "CANFD_BRS" BO_ 2654339139 1;
BA_ "VFrameFormat" BO_ 2654339139 15;
BA_ "Type" BO_ 2654339073 1;
BA_ "GenMsgSendType" BO_ 2654339073 0;
BA_ "GenMsgILSupport" BO_ 2654339073 1;
BA_ "GenMsgStartDelayTime" BO_ 2654339073 290;
BA_ "GenMsgCycleTime" BO_ 2654339073 1000;
BA_ "CANFD_BRS" BO_ 2654339073 1;
BA_ "VFrameFormat" BO_ 2654339073 15;
BA_ "Type" BO_ 2654339074 1;
BA_ "GenMsgSendType" BO_ 2654339074 0;
BA_ "GenMsgILSupport" BO_ 2654339074 1;
BA_ "GenMsgCycleTime" BO_ 2654339074 1000;
BA_ "CANFD_BRS" BO_ 2654339074 1;
BA_ "VFrameFormat" BO_ 2654339074 15;
BA_ "Type" BO_ 2654339108 1;
BA_ "GenMsgSendType" BO_ 2654339108 0;
BA_ "GenMsgILSupport" BO_ 2654339108 1;
BA_ "GenMsgStartDelayTime" BO_ 2654339108 305;
BA_ "GenMsgCycleTime" BO_ 2654339108 1000;
BA_ "CANFD_BRS" BO_ 2654339108 1;
BA_ "VFrameFormat" BO_ 2654339108 15;
BA_ "Type" BO_ 2654339256 1;
BA_ "GenMsgSendType" BO_ 2654339256 0;
BA_ "GenMsgILSupport" BO_ 2654339256 1;
BA_ "GenMsgCycleTime" BO_ 2654339256 1000;
BA_ "CANFD_BRS" BO_ 2654339256 1;
BA_ "VFrameFormat" BO_ 2654339256 15;
BA_ "Type" BO_ 2654339255 1;
BA_ "GenMsgSendType" BO_ 2654339255 0;
BA_ "GenMsgILSupport" BO_ 2654339255 1;
BA_ "GenMsgCycleTime" BO_ 2654339255 1000;
BA_ "CANFD_BRS" BO_ 2654339255 1;
BA_ "VFrameFormat" BO_ 2654339255 15;
BA_ "Type" BO_ 2654339216 1;
BA_ "GenMsgSendType" BO_ 2654339216 0;
BA_ "GenMsgILSupport" BO_ 2654339216 1;
BA_ "GenMsgStartDelayTime" BO_ 2654339216 310;
BA_ "GenMsgCycleTime" BO_ 2654339216 1000;
BA_ "CANFD_BRS" BO_ 2654339216 1;
BA_ "VFrameFormat" BO_ 2654339216 15;
BA_ "Type" BO_ 2654339170 1;
BA_ "GenMsgSendType" BO_ 2654339170 0;
BA_ "GenMsgILSupport" BO_ 2654339170 1;
BA_ "GenMsgStartDelayTime" BO_ 2654339170 315;
BA_ "GenMsgCycleTime" BO_ 2654339170 1000;
BA_ "CANFD_BRS" BO_ 2654339170 1;
BA_ "VFrameFormat" BO_ 2654339170 15;
BA_ "Type" BO_ 2654339075 1;
BA_ "GenMsgSendType" BO_ 2654339075 0;
BA_ "GenMsgILSupport" BO_ 2654339075 1;
BA_ "GenMsgStartDelayTime" BO_ 2654339075 325;
BA_ "GenMsgCycleTime" BO_ 2654339075 1000;
BA_ "CANFD_BRS" BO_ 2654339075 1;
BA_ "VFrameFormat" BO_ 2654339075 15;
BA_ "Type" BO_ 2654339098 1;
BA_ "GenMsgSendType" BO_ 2654339098 0;
BA_ "GenMsgILSupport" BO_ 2654339098 1;
BA_ "GenMsgCycleTime" BO_ 2654339098 1000;
BA_ "CANFD_BRS" BO_ 2654339098 1;
BA_ "VFrameFormat" BO_ 2654339098 15;
BA_ "Type" BO_ 2654339096 1;
BA_ "GenMsgSendType" BO_ 2654339096 0;
BA_ "GenMsgILSupport" BO_ 2654339096 1;
BA_ "GenMsgCycleTime" BO_ 2654339096 1000;
BA_ "CANFD_BRS" BO_ 2654339096 1;
BA_ "VFrameFormat" BO_ 2654339096 15;
BA_ "Type" BO_ 2654339137 1;
BA_ "GenMsgSendType" BO_ 2654339137 0;
BA_ "GenMsgILSupport" BO_ 2654339137 1;
BA_ "GenMsgStartDelayTime" BO_ 2654339137 330;
BA_ "GenMsgCycleTime" BO_ 2654339137 1000;
BA_ "CANFD_BRS" BO_ 2654339137 1;
BA_ "VFrameFormat" BO_ 2654339137 15;
BA_ "GenSigTimeoutTime_CADM2" SG_ 1954 CRC_ORC2 0;
BA_ "GenSigTimeoutTime_CVADAS" SG_ 1954 CRC_ORC2 0;
BA_ "GenSigTimeoutTime_EPS" SG_ 1954 CRC_ORC2 0;
BA_ "GenSigTimeoutTime_ORC" SG_ 1954 CRC_ORC2 0;
BA_ "GenSigTimeoutTime_PAM" SG_ 1954 CRC_ORC2 0;
BA_ "GenSigTimeoutTime_SGW" SG_ 1954 CRC_ORC2 0;
BA_ "GenSigTimeoutTime_TRSKM" SG_ 1954 CRC_ORC2 0;
BA_ "GenSigTimeoutTime_BSM2" SG_ 1954 DrvSbltUnFltr_1 0;
BA_ "GenSigTimeoutTime_CADM2" SG_ 1954 DrvSbltUnFltr_1 0;
BA_ "GenSigTimeoutTime_CVADAS" SG_ 1954 DrvSbltUnFltr_1 0;
BA_ "GenSigTimeoutTime_EPS" SG_ 1954 DrvSbltUnFltr_1 0;
BA_ "GenSigTimeoutTime_ORC" SG_ 1954 DrvSbltUnFltr_1 0;
BA_ "GenSigTimeoutTime_PAM" SG_ 1954 DrvSbltUnFltr_1 0;
BA_ "GenSigTimeoutTime_SGW" SG_ 1954 DrvSbltUnFltr_1 0;
BA_ "GenSigTimeoutTime_TRSKM" SG_ 1954 DrvSbltUnFltr_1 0;
BA_ "GenSigTimeoutTime_CADM2" SG_ 1954 MessageCounter_ORC2 0;
BA_ "GenSigTimeoutTime_CVADAS" SG_ 1954 MessageCounter_ORC2 0;
BA_ "GenSigTimeoutTime_EPS" SG_ 1954 MessageCounter_ORC2 0;
BA_ "GenSigTimeoutTime_ORC" SG_ 1954 MessageCounter_ORC2 0;
BA_ "GenSigTimeoutTime_PAM" SG_ 1954 MessageCounter_ORC2 0;
BA_ "GenSigTimeoutTime_SGW" SG_ 1954 MessageCounter_ORC2 0;
BA_ "GenSigTimeoutTime_TRSKM" SG_ 1954 MessageCounter_ORC2 0;
BA_ "GenSigTimeoutTime_BCM" SG_ 1954 ORCIdentification 0;
BA_ "GenSigTimeoutTime_CADM2" SG_ 1954 ORCIdentification 0;
BA_ "GenSigTimeoutTime_CVADAS" SG_ 1954 ORCIdentification 0;
BA_ "GenSigTimeoutTime_EPS" SG_ 1954 ORCIdentification 0;
BA_ "GenSigTimeoutTime_ORC" SG_ 1954 ORCIdentification 0;
BA_ "GenSigTimeoutTime_PAM" SG_ 1954 ORCIdentification 0;
BA_ "GenSigTimeoutTime_SGW" SG_ 1954 ORCIdentification 0;
BA_ "GenSigTimeoutTime_TRSKM" SG_ 1954 ORCIdentification 0;
BA_ "GenSigStartValue" SG_ 1954 SBR1RowPsngrSeatPPDSts 3;
BA_ "GenSigSendType" SG_ 1954 SBR1RowPsngrSeatPPDSts 3;
BA_ "GenSigTimeoutTime_BSM2" SG_ 1954 SBR1RowPsngrSeatPPDSts 0;
BA_ "GenSigTimeoutTime_CADM2" SG_ 1954 SBR1RowPsngrSeatPPDSts 0;
BA_ "GenSigTimeoutTime_CVADAS" SG_ 1954 SBR1RowPsngrSeatPPDSts 0;
BA_ "GenSigTimeoutTime_EPS" SG_ 1954 SBR1RowPsngrSeatPPDSts 0;
BA_ "GenSigTimeoutTime_ORC" SG_ 1954 SBR1RowPsngrSeatPPDSts 0;
BA_ "GenSigTimeoutTime_PAM" SG_ 1954 SBR1RowPsngrSeatPPDSts 0;
BA_ "GenSigTimeoutTime_TRSKM" SG_ 1954 SBR1RowPsngrSeatPPDSts 0;
BA_ "GenSigTimeoutTime_CVADAS" SG_ 274 CRC_ORC3 0;
BA_ "GenSigTimeoutTime_EPS" SG_ 274 CRC_ORC3 0;
BA_ "GenSigTimeoutTime_ORC" SG_ 274 CRC_ORC3 0;
BA_ "GenSigTimeoutTime_PAM" SG_ 274 CRC_ORC3 0;
BA_ "GenSigTimeoutTime_SGW" SG_ 274 CRC_ORC3 0;
BA_ "GenSigTimeoutTime_TRSKM" SG_ 274 CRC_ORC3 0;
BA_ "GenSigTimeoutTime_BCM" SG_ 274 InternalError 0;
BA_ "GenSigTimeoutTime_CVADAS" SG_ 274 InternalError 0;
BA_ "GenSigTimeoutTime_EPS" SG_ 274 InternalError 0;
BA_ "GenSigTimeoutTime_ORC" SG_ 274 InternalError 0;
BA_ "GenSigTimeoutTime_PAM" SG_ 274 InternalError 0;
BA_ "GenSigTimeoutTime_SGW" SG_ 274 InternalError 0;
BA_ "GenSigTimeoutTime_TRSKM" SG_ 274 InternalError 0;
BA_ "GenSigStartValue" SG_ 274 LatAcceleration 4095;
BA_ "GenSigTimeoutTime_CVADAS" SG_ 274 LatAcceleration 0;
BA_ "GenSigTimeoutTime_EPS" SG_ 274 LatAcceleration 0;
BA_ "GenSigTimeoutTime_ORC" SG_ 274 LatAcceleration 0;
BA_ "GenSigTimeoutTime_PAM" SG_ 274 LatAcceleration 0;
BA_ "GenSigTimeoutTime_SGW" SG_ 274 LatAcceleration 0;
BA_ "GenSigTimeoutTime_TRSKM" SG_ 274 LatAcceleration 0;
BA_ "GenSigTimeoutTime_CVADAS" SG_ 274 LatAccelerationFailSts 0;
BA_ "GenSigTimeoutTime_EPS" SG_ 274 LatAccelerationFailSts 0;
BA_ "GenSigTimeoutTime_ORC" SG_ 274 LatAccelerationFailSts 0;
BA_ "GenSigTimeoutTime_PAM" SG_ 274 LatAccelerationFailSts 0;
BA_ "GenSigTimeoutTime_SGW" SG_ 274 LatAccelerationFailSts 0;
BA_ "GenSigTimeoutTime_TRSKM" SG_ 274 LatAccelerationFailSts 0;
BA_ "GenSigStartValue" SG_ 274 LongAcceleration 4095;
BA_ "GenSigTimeoutTime_CVADAS" SG_ 274 LongAcceleration 0;
BA_ "GenSigTimeoutTime_EPS" SG_ 274 LongAcceleration 0;
BA_ "GenSigTimeoutTime_ORC" SG_ 274 LongAcceleration 0;
BA_ "GenSigTimeoutTime_PAM" SG_ 274 LongAcceleration 0;
BA_ "GenSigTimeoutTime_SGW" SG_ 274 LongAcceleration 0;
BA_ "GenSigTimeoutTime_TRSKM" SG_ 274 LongAcceleration 0;
BA_ "GenSigTimeoutTime_CVADAS" SG_ 274 LongAccelerationFailSts 0;
BA_ "GenSigTimeoutTime_EPS" SG_ 274 LongAccelerationFailSts 0;
BA_ "GenSigTimeoutTime_ORC" SG_ 274 LongAccelerationFailSts 0;
BA_ "GenSigTimeoutTime_PAM" SG_ 274 LongAccelerationFailSts 0;
BA_ "GenSigTimeoutTime_SGW" SG_ 274 LongAccelerationFailSts 0;
BA_ "GenSigTimeoutTime_TRSKM" SG_ 274 LongAccelerationFailSts 0;
BA_ "GenSigTimeoutTime_CVADAS" SG_ 274 MessageCounter_ORC3 0;
BA_ "GenSigTimeoutTime_EPS" SG_ 274 MessageCounter_ORC3 0;
BA_ "GenSigTimeoutTime_ORC" SG_ 274 MessageCounter_ORC3 0;
BA_ "GenSigTimeoutTime_PAM" SG_ 274 MessageCounter_ORC3 0;
BA_ "GenSigTimeoutTime_SGW" SG_ 274 MessageCounter_ORC3 0;
BA_ "GenSigTimeoutTime_TRSKM" SG_ 274 MessageCounter_ORC3 0;
BA_ "GenSigStartValue" SG_ 274 YawRate 4095;
BA_ "GenSigTimeoutTime_CVADAS" SG_ 274 YawRate 0;
BA_ "GenSigTimeoutTime_EPS" SG_ 274 YawRate 0;
BA_ "GenSigTimeoutTime_ORC" SG_ 274 YawRate 0;
BA_ "GenSigTimeoutTime_PAM" SG_ 274 YawRate 0;
BA_ "GenSigTimeoutTime_SGW" SG_ 274 YawRate 0;
BA_ "GenSigTimeoutTime_TRSKM" SG_ 274 YawRate 0;
BA_ "GenSigTimeoutTime_BCM" SG_ 274 YawRate_HR 0;
BA_ "GenSigTimeoutTime_BSM2" SG_ 274 YawRate_HR 0;
BA_ "GenSigTimeoutTime_CVADAS" SG_ 274 YawRate_HR 0;
BA_ "GenSigTimeoutTime_EPS" SG_ 274 YawRate_HR 0;
BA_ "GenSigTimeoutTime_ORC" SG_ 274 YawRate_HR 0;
BA_ "GenSigTimeoutTime_PAM" SG_ 274 YawRate_HR 0;
BA_ "GenSigTimeoutTime_SGW" SG_ 274 YawRate_HR 0;
BA_ "GenSigTimeoutTime_TRSKM" SG_ 274 YawRate_HR 0;
BA_ "GenSigTimeoutTime_BCM" SG_ 274 YawRate_HR_Sign 0;
BA_ "GenSigTimeoutTime_BSM2" SG_ 274 YawRate_HR_Sign 0;
BA_ "GenSigTimeoutTime_CVADAS" SG_ 274 YawRate_HR_Sign 0;
BA_ "GenSigTimeoutTime_EPS" SG_ 274 YawRate_HR_Sign 0;
BA_ "GenSigTimeoutTime_ORC" SG_ 274 YawRate_HR_Sign 0;
BA_ "GenSigTimeoutTime_PAM" SG_ 274 YawRate_HR_Sign 0;
BA_ "GenSigTimeoutTime_SGW" SG_ 274 YawRate_HR_Sign 0;
BA_ "GenSigTimeoutTime_TRSKM" SG_ 274 YawRate_HR_Sign 0;
BA_ "GenSigTimeoutTime_CVADAS" SG_ 274 YawRateFailSts 0;
BA_ "GenSigTimeoutTime_EPS" SG_ 274 YawRateFailSts 0;
BA_ "GenSigTimeoutTime_ORC" SG_ 274 YawRateFailSts 0;
BA_ "GenSigTimeoutTime_PAM" SG_ 274 YawRateFailSts 0;
BA_ "GenSigTimeoutTime_SGW" SG_ 274 YawRateFailSts 0;
BA_ "GenSigTimeoutTime_TRSKM" SG_ 274 YawRateFailSts 0;
BA_ "GenSigTimeoutTime_BCM" SG_ 2654339109 CurrentCanNMState_FD01_ADCM 0;
BA_ "GenSigTimeoutTime_BSM2" SG_ 2654339109 CurrentCanNMState_FD01_ADCM 0;
BA_ "GenSigTimeoutTime_CADM2" SG_ 2654339109 CurrentCanNMState_FD01_ADCM 0;
BA_ "GenSigTimeoutTime_CVADAS" SG_ 2654339109 CurrentCanNMState_FD01_ADCM 0;
BA_ "GenSigTimeoutTime_EPS" SG_ 2654339109 CurrentCanNMState_FD01_ADCM 0;
BA_ "GenSigTimeoutTime_ORC" SG_ 2654339109 CurrentCanNMState_FD01_ADCM 0;
BA_ "GenSigTimeoutTime_PAM" SG_ 2654339109 CurrentCanNMState_FD01_ADCM 0;
BA_ "GenSigTimeoutTime_SGW" SG_ 2654339109 CurrentCanNMState_FD01_ADCM 0;
BA_ "GenSigTimeoutTime_TRSKM" SG_ 2654339109 CurrentCanNMState_FD01_ADCM 0;
BA_ "GenSigTimeoutTime_BCM" SG_ 2654339109 CurrentFailSts_FD01_ADCM 0;
BA_ "GenSigTimeoutTime_BSM2" SG_ 2654339109 CurrentFailSts_FD01_ADCM 0;
BA_ "GenSigTimeoutTime_CADM2" SG_ 2654339109 CurrentFailSts_FD01_ADCM 0;
BA_ "GenSigTimeoutTime_CVADAS" SG_ 2654339109 CurrentFailSts_FD01_ADCM 0;
BA_ "GenSigTimeoutTime_EPS" SG_ 2654339109 CurrentFailSts_FD01_ADCM 0;
BA_ "GenSigTimeoutTime_ORC" SG_ 2654339109 CurrentFailSts_FD01_ADCM 0;
BA_ "GenSigTimeoutTime_PAM" SG_ 2654339109 CurrentFailSts_FD01_ADCM 0;
BA_ "GenSigTimeoutTime_SGW" SG_ 2654339109 CurrentFailSts_FD01_ADCM 0;
BA_ "GenSigTimeoutTime_TRSKM" SG_ 2654339109 CurrentFailSts_FD01_ADCM 0;
BA_ "GenSigTimeoutTime_BCM" SG_ 2654339109 DES_FD01_ADCM 0;
BA_ "GenSigTimeoutTime_BSM2" SG_ 2654339109 DES_FD01_ADCM 0;
BA_ "GenSigTimeoutTime_CADM2" SG_ 2654339109 DES_FD01_ADCM 0;
BA_ "GenSigTimeoutTime_CVADAS" SG_ 2654339109 DES_FD01_ADCM 0;
BA_ "GenSigTimeoutTime_EPS" SG_ 2654339109 DES_FD01_ADCM 0;
BA_ "GenSigTimeoutTime_ORC" SG_ 2654339109 DES_FD01_ADCM 0;
BA_ "GenSigTimeoutTime_PAM" SG_ 2654339109 DES_FD01_ADCM 0;
BA_ "GenSigTimeoutTime_SGW" SG_ 2654339109 DES_FD01_ADCM 0;
BA_ "GenSigTimeoutTime_TRSKM" SG_ 2654339109 DES_FD01_ADCM 0;
BA_ "GenSigTimeoutTime_BCM" SG_ 2654339109 EOL_FD01_ADCM 0;
BA_ "GenSigTimeoutTime_BSM2" SG_ 2654339109 EOL_FD01_ADCM 0;
BA_ "GenSigTimeoutTime_CADM2" SG_ 2654339109 EOL_FD01_ADCM 0;
BA_ "GenSigTimeoutTime_CVADAS" SG_ 2654339109 EOL_FD01_ADCM 0;
BA_ "GenSigTimeoutTime_EPS" SG_ 2654339109 EOL_FD01_ADCM 0;
BA_ "GenSigTimeoutTime_ORC" SG_ 2654339109 EOL_FD01_ADCM 0;
BA_ "GenSigTimeoutTime_PAM" SG_ 2654339109 EOL_FD01_ADCM 0;
BA_ "GenSigTimeoutTime_SGW" SG_ 2654339109 EOL_FD01_ADCM 0;
BA_ "GenSigTimeoutTime_TRSKM" SG_ 2654339109 EOL_FD01_ADCM 0;
BA_ "GenSigTimeoutTime_BCM" SG_ 2654339109 GenericFailSts_FD01_ADCM 0;
BA_ "GenSigTimeoutTime_BSM2" SG_ 2654339109 GenericFailSts_FD01_ADCM 0;
BA_ "GenSigTimeoutTime_CADM2" SG_ 2654339109 GenericFailSts_FD01_ADCM 0;
BA_ "GenSigTimeoutTime_CVADAS" SG_ 2654339109 GenericFailSts_FD01_ADCM 0;
BA_ "GenSigTimeoutTime_EPS" SG_ 2654339109 GenericFailSts_FD01_ADCM 0;
BA_ "GenSigTimeoutTime_ORC" SG_ 2654339109 GenericFailSts_FD01_ADCM 0;
BA_ "GenSigTimeoutTime_PAM" SG_ 2654339109 GenericFailSts_FD01_ADCM 0;
BA_ "GenSigTimeoutTime_SGW" SG_ 2654339109 GenericFailSts_FD01_ADCM 0;
BA_ "GenSigTimeoutTime_TRSKM" SG_ 2654339109 GenericFailSts_FD01_ADCM 0;
BA_ "GenSigTimeoutTime_BCM" SG_ 2654339109 PreviousCanNMState_FD01_ADCM 0;
BA_ "GenSigTimeoutTime_BSM2" SG_ 2654339109 PreviousCanNMState_FD01_ADCM 0;
BA_ "GenSigTimeoutTime_CADM2" SG_ 2654339109 PreviousCanNMState_FD01_ADCM 0;
BA_ "GenSigTimeoutTime_CVADAS" SG_ 2654339109 PreviousCanNMState_FD01_ADCM 0;
BA_ "GenSigTimeoutTime_EPS" SG_ 2654339109 PreviousCanNMState_FD01_ADCM 0;
BA_ "GenSigTimeoutTime_ORC" SG_ 2654339109 PreviousCanNMState_FD01_ADCM 0;
BA_ "GenSigTimeoutTime_PAM" SG_ 2654339109 PreviousCanNMState_FD01_ADCM 0;
BA_ "GenSigTimeoutTime_SGW" SG_ 2654339109 PreviousCanNMState_FD01_ADCM 0;
BA_ "GenSigTimeoutTime_TRSKM" SG_ 2654339109 PreviousCanNMState_FD01_ADCM 0;
BA_ "GenSigTimeoutTime_BCM" SG_ 2654339109 StayActiveSource_FD01_ADCM 0;
BA_ "GenSigTimeoutTime_BSM2" SG_ 2654339109 StayActiveSource_FD01_ADCM 0;
BA_ "GenSigTimeoutTime_CADM2" SG_ 2654339109 StayActiveSource_FD01_ADCM 0;
BA_ "GenSigTimeoutTime_CVADAS" SG_ 2654339109 StayActiveSource_FD01_ADCM 0;
BA_ "GenSigTimeoutTime_EPS" SG_ 2654339109 StayActiveSource_FD01_ADCM 0;
BA_ "GenSigTimeoutTime_ORC" SG_ 2654339109 StayActiveSource_FD01_ADCM 0;
BA_ "GenSigTimeoutTime_PAM" SG_ 2654339109 StayActiveSource_FD01_ADCM 0;
BA_ "GenSigTimeoutTime_SGW" SG_ 2654339109 StayActiveSource_FD01_ADCM 0;
BA_ "GenSigTimeoutTime_TRSKM" SG_ 2654339109 StayActiveSource_FD01_ADCM 0;
BA_ "GenSigTimeoutTime_BCM" SG_ 2654339109 WakeupSource_FD01_ADCM 0;
BA_ "GenSigTimeoutTime_SGW" SG_ 2654339109 WakeupSource_FD01_ADCM 0;
BA_ "GenSigTimeoutTime_TRSKM" SG_ 2654339109 WakeupSource_FD01_ADCM 0;
BA_ "GenSigTimeoutTime_BCM" SG_ 2654339094 CurrentCanNMState_FD03_AGSM 0;
BA_ "GenSigTimeoutTime_BSM2" SG_ 2654339094 CurrentCanNMState_FD03_AGSM 0;
BA_ "GenSigTimeoutTime_CADM2" SG_ 2654339094 CurrentCanNMState_FD03_AGSM 0;
BA_ "GenSigTimeoutTime_CVADAS" SG_ 2654339094 CurrentCanNMState_FD03_AGSM 0;
BA_ "GenSigTimeoutTime_EPS" SG_ 2654339094 CurrentCanNMState_FD03_AGSM 0;
BA_ "GenSigTimeoutTime_ORC" SG_ 2654339094 CurrentCanNMState_FD03_AGSM 0;
BA_ "GenSigTimeoutTime_PAM" SG_ 2654339094 CurrentCanNMState_FD03_AGSM 0;
BA_ "GenSigTimeoutTime_SGW" SG_ 2654339094 CurrentCanNMState_FD03_AGSM 0;
BA_ "GenSigTimeoutTime_TRSKM" SG_ 2654339094 CurrentCanNMState_FD03_AGSM 0;
BA_ "GenSigTimeoutTime_BCM" SG_ 2654339094 CurrentFailSts_FD03_AGSM 0;
BA_ "GenSigTimeoutTime_BSM2" SG_ 2654339094 CurrentFailSts_FD03_AGSM 0;
BA_ "GenSigTimeoutTime_CADM2" SG_ 2654339094 CurrentFailSts_FD03_AGSM 0;
BA_ "GenSigTimeoutTime_CVADAS" SG_ 2654339094 CurrentFailSts_FD03_AGSM 0;
BA_ "GenSigTimeoutTime_EPS" SG_ 2654339094 CurrentFailSts_FD03_AGSM 0;
BA_ "GenSigTimeoutTime_ORC" SG_ 2654339094 CurrentFailSts_FD03_AGSM 0;
BA_ "GenSigTimeoutTime_PAM" SG_ 2654339094 CurrentFailSts_FD03_AGSM 0;
BA_ "GenSigTimeoutTime_SGW" SG_ 2654339094 CurrentFailSts_FD03_AGSM 0;
BA_ "GenSigTimeoutTime_TRSKM" SG_ 2654339094 CurrentFailSts_FD03_AGSM 0;
BA_ "GenSigTimeoutTime_BCM" SG_ 2654339094 DES_FD03_AGSM 0;
BA_ "GenSigTimeoutTime_BSM2" SG_ 2654339094 DES_FD03_AGSM 0;
BA_ "GenSigTimeoutTime_CADM2" SG_ 2654339094 DES_FD03_AGSM 0;
BA_ "GenSigTimeoutTime_CVADAS" SG_ 2654339094 DES_FD03_AGSM 0;
BA_ "GenSigTimeoutTime_EPS" SG_ 2654339094 DES_FD03_AGSM 0;
BA_ "GenSigTimeoutTime_ORC" SG_ 2654339094 DES_FD03_AGSM 0;
BA_ "GenSigTimeoutTime_PAM" SG_ 2654339094 DES_FD03_AGSM 0;
BA_ "GenSigTimeoutTime_SGW" SG_ 2654339094 DES_FD03_AGSM 0;
BA_ "GenSigTimeoutTime_TRSKM" SG_ 2654339094 DES_FD03_AGSM 0;
BA_ "GenSigTimeoutTime_BCM" SG_ 2654339094 EOL_FD03_AGSM 0;
BA_ "GenSigTimeoutTime_BSM2" SG_ 2654339094 EOL_FD03_AGSM 0;
BA_ "GenSigTimeoutTime_CADM2" SG_ 2654339094 EOL_FD03_AGSM 0;
BA_ "GenSigTimeoutTime_CVADAS" SG_ 2654339094 EOL_FD03_AGSM 0;
BA_ "GenSigTimeoutTime_EPS" SG_ 2654339094 EOL_FD03_AGSM 0;
BA_ "GenSigTimeoutTime_ORC" SG_ 2654339094 EOL_FD03_AGSM 0;
BA_ "GenSigTimeoutTime_PAM" SG_ 2654339094 EOL_FD03_AGSM 0;
BA_ "GenSigTimeoutTime_SGW" SG_ 2654339094 EOL_FD03_AGSM 0;
BA_ "GenSigTimeoutTime_TRSKM" SG_ 2654339094 EOL_FD03_AGSM 0;
BA_ "GenSigTimeoutTime_BCM" SG_ 2654339094 GenericFailSts_FD03_AGSM 0;
BA_ "GenSigTimeoutTime_BSM2" SG_ 2654339094 GenericFailSts_FD03_AGSM 0;
BA_ "GenSigTimeoutTime_CADM2" SG_ 2654339094 GenericFailSts_FD03_AGSM 0;
BA_ "GenSigTimeoutTime_CVADAS" SG_ 2654339094 GenericFailSts_FD03_AGSM 0;
BA_ "GenSigTimeoutTime_EPS" SG_ 2654339094 GenericFailSts_FD03_AGSM 0;
BA_ "GenSigTimeoutTime_ORC" SG_ 2654339094 GenericFailSts_FD03_AGSM 0;
BA_ "GenSigTimeoutTime_PAM" SG_ 2654339094 GenericFailSts_FD03_AGSM 0;
BA_ "GenSigTimeoutTime_SGW" SG_ 2654339094 GenericFailSts_FD03_AGSM 0;
BA_ "GenSigTimeoutTime_TRSKM" SG_ 2654339094 GenericFailSts_FD03_AGSM 0;
BA_ "GenSigTimeoutTime_BCM" SG_ 2654339094 PreviousCanNMState_FD03_AGSM 0;
BA_ "GenSigTimeoutTime_BSM2" SG_ 2654339094 PreviousCanNMState_FD03_AGSM 0;
BA_ "GenSigTimeoutTime_CADM2" SG_ 2654339094 PreviousCanNMState_FD03_AGSM 0;
BA_ "GenSigTimeoutTime_CVADAS" SG_ 2654339094 PreviousCanNMState_FD03_AGSM 0;
BA_ "GenSigTimeoutTime_EPS" SG_ 2654339094 PreviousCanNMState_FD03_AGSM 0;
BA_ "GenSigTimeoutTime_ORC" SG_ 2654339094 PreviousCanNMState_FD03_AGSM 0;
BA_ "GenSigTimeoutTime_PAM" SG_ 2654339094 PreviousCanNMState_FD03_AGSM 0;
BA_ "GenSigTimeoutTime_SGW" SG_ 2654339094 PreviousCanNMState_FD03_AGSM 0;
BA_ "GenSigTimeoutTime_TRSKM" SG_ 2654339094 PreviousCanNMState_FD03_AGSM 0;
BA_ "GenSigTimeoutTime_BCM" SG_ 2654339094 StayActiveSource_FD03_AGSM 0;
BA_ "GenSigTimeoutTime_BSM2" SG_ 2654339094 StayActiveSource_FD03_AGSM 0;
BA_ "GenSigTimeoutTime_CADM2" SG_ 2654339094 StayActiveSource_FD03_AGSM 0;
BA_ "GenSigTimeoutTime_CVADAS" SG_ 2654339094 StayActiveSource_FD03_AGSM 0;
BA_ "GenSigTimeoutTime_EPS" SG_ 2654339094 StayActiveSource_FD03_AGSM 0;
BA_ "GenSigTimeoutTime_ORC" SG_ 2654339094 StayActiveSource_FD03_AGSM 0;
BA_ "GenSigTimeoutTime_PAM" SG_ 2654339094 StayActiveSource_FD03_AGSM 0;
BA_ "GenSigTimeoutTime_SGW" SG_ 2654339094 StayActiveSource_FD03_AGSM 0;
BA_ "GenSigTimeoutTime_TRSKM" SG_ 2654339094 StayActiveSource_FD03_AGSM 0;
BA_ "GenSigTimeoutTime_BCM" SG_ 2654339094 WakeupSource_FD03_AGSM 0;
BA_ "GenSigTimeoutTime_BSM2" SG_ 2654339094 WakeupSource_FD03_AGSM 0;
BA_ "GenSigTimeoutTime_CADM2" SG_ 2654339094 WakeupSource_FD03_AGSM 0;
BA_ "GenSigTimeoutTime_CVADAS" SG_ 2654339094 WakeupSource_FD03_AGSM 0;
BA_ "GenSigTimeoutTime_EPS" SG_ 2654339094 WakeupSource_FD03_AGSM 0;
BA_ "GenSigTimeoutTime_ORC" SG_ 2654339094 WakeupSource_FD03_AGSM 0;
BA_ "GenSigTimeoutTime_PAM" SG_ 2654339094 WakeupSource_FD03_AGSM 0;
BA_ "GenSigTimeoutTime_SGW" SG_ 2654339094 WakeupSource_FD03_AGSM 0;
BA_ "GenSigTimeoutTime_TRSKM" SG_ 2654339094 WakeupSource_FD03_AGSM 0;
BA_ "GenSigTimeoutTime_BCM" SG_ 2654339099 CurrentCanNMState_FD01_ASCM 0;
BA_ "GenSigTimeoutTime_BSM2" SG_ 2654339099 CurrentCanNMState_FD01_ASCM 0;
BA_ "GenSigTimeoutTime_CADM2" SG_ 2654339099 CurrentCanNMState_FD01_ASCM 0;
BA_ "GenSigTimeoutTime_CVADAS" SG_ 2654339099 CurrentCanNMState_FD01_ASCM 0;
BA_ "GenSigTimeoutTime_EPS" SG_ 2654339099 CurrentCanNMState_FD01_ASCM 0;
BA_ "GenSigTimeoutTime_ORC" SG_ 2654339099 CurrentCanNMState_FD01_ASCM 0;
BA_ "GenSigTimeoutTime_PAM" SG_ 2654339099 CurrentCanNMState_FD01_ASCM 0;
BA_ "GenSigTimeoutTime_SGW" SG_ 2654339099 CurrentCanNMState_FD01_ASCM 0;
BA_ "GenSigTimeoutTime_TRSKM" SG_ 2654339099 CurrentCanNMState_FD01_ASCM 0;
BA_ "GenSigTimeoutTime_BCM" SG_ 2654339099 CurrentFailSts_FD01_ASCM 0;
BA_ "GenSigTimeoutTime_BSM2" SG_ 2654339099 CurrentFailSts_FD01_ASCM 0;
BA_ "GenSigTimeoutTime_CADM2" SG_ 2654339099 CurrentFailSts_FD01_ASCM 0;
BA_ "GenSigTimeoutTime_CVADAS" SG_ 2654339099 CurrentFailSts_FD01_ASCM 0;
BA_ "GenSigTimeoutTime_EPS" SG_ 2654339099 CurrentFailSts_FD01_ASCM 0;
BA_ "GenSigTimeoutTime_ORC" SG_ 2654339099 CurrentFailSts_FD01_ASCM 0;
BA_ "GenSigTimeoutTime_PAM" SG_ 2654339099 CurrentFailSts_FD01_ASCM 0;
BA_ "GenSigTimeoutTime_SGW" SG_ 2654339099 CurrentFailSts_FD01_ASCM 0;
BA_ "GenSigTimeoutTime_TRSKM" SG_ 2654339099 CurrentFailSts_FD01_ASCM 0;
BA_ "GenSigTimeoutTime_BCM" SG_ 2654339099 DES_FD01_ASCM 0;
BA_ "GenSigTimeoutTime_BSM2" SG_ 2654339099 DES_FD01_ASCM 0;
BA_ "GenSigTimeoutTime_CADM2" SG_ 2654339099 DES_FD01_ASCM 0;
BA_ "GenSigTimeoutTime_CVADAS" SG_ 2654339099 DES_FD01_ASCM 0;
BA_ "GenSigTimeoutTime_EPS" SG_ 2654339099 DES_FD01_ASCM 0;
BA_ "GenSigTimeoutTime_ORC" SG_ 2654339099 DES_FD01_ASCM 0;
BA_ "GenSigTimeoutTime_PAM" SG_ 2654339099 DES_FD01_ASCM 0;
BA_ "GenSigTimeoutTime_SGW" SG_ 2654339099 DES_FD01_ASCM 0;
BA_ "GenSigTimeoutTime_TRSKM" SG_ 2654339099 DES_FD01_ASCM 0;
BA_ "GenSigTimeoutTime_BCM" SG_ 2654339099 EOL_FD01_ASCM 0;
BA_ "GenSigTimeoutTime_BSM2" SG_ 2654339099 EOL_FD01_ASCM 0;
BA_ "GenSigTimeoutTime_CADM2" SG_ 2654339099 EOL_FD01_ASCM 0;
BA_ "GenSigTimeoutTime_CVADAS" SG_ 2654339099 EOL_FD01_ASCM 0;
BA_ "GenSigTimeoutTime_EPS" SG_ 2654339099 EOL_FD01_ASCM 0;
BA_ "GenSigTimeoutTime_ORC" SG_ 2654339099 EOL_FD01_ASCM 0;
BA_ "GenSigTimeoutTime_PAM" SG_ 2654339099 EOL_FD01_ASCM 0;
BA_ "GenSigTimeoutTime_SGW" SG_ 2654339099 EOL_FD01_ASCM 0;
BA_ "GenSigTimeoutTime_TRSKM" SG_ 2654339099 EOL_FD01_ASCM 0;
BA_ "GenSigTimeoutTime_BCM" SG_ 2654339099 GenericFailSts_FD01_ASCM 0;
BA_ "GenSigTimeoutTime_BSM2" SG_ 2654339099 GenericFailSts_FD01_ASCM 0;
BA_ "GenSigTimeoutTime_CADM2" SG_ 2654339099 GenericFailSts_FD01_ASCM 0;
BA_ "GenSigTimeoutTime_CVADAS" SG_ 2654339099 GenericFailSts_FD01_ASCM 0;
BA_ "GenSigTimeoutTime_EPS" SG_ 2654339099 GenericFailSts_FD01_ASCM 0;
BA_ "GenSigTimeoutTime_ORC" SG_ 2654339099 GenericFailSts_FD01_ASCM 0;
BA_ "GenSigTimeoutTime_PAM" SG_ 2654339099 GenericFailSts_FD01_ASCM 0;
BA_ "GenSigTimeoutTime_SGW" SG_ 2654339099 GenericFailSts_FD01_ASCM 0;
BA_ "GenSigTimeoutTime_TRSKM" SG_ 2654339099 GenericFailSts_FD01_ASCM 0;
BA_ "GenSigTimeoutTime_BCM" SG_ 2654339099 PreviousCanNMState_FD01_ASCM 0;
BA_ "GenSigTimeoutTime_BSM2" SG_ 2654339099 PreviousCanNMState_FD01_ASCM 0;
BA_ "GenSigTimeoutTime_CADM2" SG_ 2654339099 PreviousCanNMState_FD01_ASCM 0;
BA_ "GenSigTimeoutTime_CVADAS" SG_ 2654339099 PreviousCanNMState_FD01_ASCM 0;
BA_ "GenSigTimeoutTime_EPS" SG_ 2654339099 PreviousCanNMState_FD01_ASCM 0;
BA_ "GenSigTimeoutTime_ORC" SG_ 2654339099 PreviousCanNMState_FD01_ASCM 0;
BA_ "GenSigTimeoutTime_PAM" SG_ 2654339099 PreviousCanNMState_FD01_ASCM 0;
BA_ "GenSigTimeoutTime_SGW" SG_ 2654339099 PreviousCanNMState_FD01_ASCM 0;
BA_ "GenSigTimeoutTime_TRSKM" SG_ 2654339099 PreviousCanNMState_FD01_ASCM 0;
BA_ "GenSigTimeoutTime_BCM" SG_ 2654339099 StayActiveSource_FD01_ASCM 0;
BA_ "GenSigTimeoutTime_BSM2" SG_ 2654339099 StayActiveSource_FD01_ASCM 0;
BA_ "GenSigTimeoutTime_CADM2" SG_ 2654339099 StayActiveSource_FD01_ASCM 0;
BA_ "GenSigTimeoutTime_CVADAS" SG_ 2654339099 StayActiveSource_FD01_ASCM 0;
BA_ "GenSigTimeoutTime_EPS" SG_ 2654339099 StayActiveSource_FD01_ASCM 0;
BA_ "GenSigTimeoutTime_ORC" SG_ 2654339099 StayActiveSource_FD01_ASCM 0;
BA_ "GenSigTimeoutTime_PAM" SG_ 2654339099 StayActiveSource_FD01_ASCM 0;
BA_ "GenSigTimeoutTime_SGW" SG_ 2654339099 StayActiveSource_FD01_ASCM 0;
BA_ "GenSigTimeoutTime_TRSKM" SG_ 2654339099 StayActiveSource_FD01_ASCM 0;
BA_ "GenSigTimeoutTime_BCM" SG_ 2654339099 WakeupSource_FD01_ASCM 0;
BA_ "GenSigTimeoutTime_BSM2" SG_ 2654339099 WakeupSource_FD01_ASCM 0;
BA_ "GenSigTimeoutTime_CADM2" SG_ 2654339099 WakeupSource_FD01_ASCM 0;
BA_ "GenSigTimeoutTime_CVADAS" SG_ 2654339099 WakeupSource_FD01_ASCM 0;
BA_ "GenSigTimeoutTime_EPS" SG_ 2654339099 WakeupSource_FD01_ASCM 0;
BA_ "GenSigTimeoutTime_ORC" SG_ 2654339099 WakeupSource_FD01_ASCM 0;
BA_ "GenSigTimeoutTime_PAM" SG_ 2654339099 WakeupSource_FD01_ASCM 0;
BA_ "GenSigTimeoutTime_SGW" SG_ 2654339099 WakeupSource_FD01_ASCM 0;
BA_ "GenSigTimeoutTime_TRSKM" SG_ 2654339099 WakeupSource_FD01_ASCM 0;
BA_ "GenSigTimeoutTime_BCM" SG_ 2654339072 CurrentCanNMState_FD01_BCM 0;
BA_ "GenSigTimeoutTime_SGW" SG_ 2654339072 CurrentCanNMState_FD01_BCM 0;
BA_ "GenSigTimeoutTime_BCM" SG_ 2654339072 CurrentCanNMState_FD02_BCM 0;
BA_ "GenSigTimeoutTime_SGW" SG_ 2654339072 CurrentCanNMState_FD02_BCM 0;
BA_ "GenSigTimeoutTime_BCM" SG_ 2654339072 CurrentCanNMState_FD03_BCM 0;
BA_ "GenSigTimeoutTime_SGW" SG_ 2654339072 CurrentCanNMState_FD03_BCM 0;
BA_ "GenSigTimeoutTime_BCM" SG_ 2654339072 CurrentCanNMState_FD04_BCM 0;
BA_ "GenSigTimeoutTime_SGW" SG_ 2654339072 CurrentCanNMState_FD04_BCM 0;
BA_ "GenSigTimeoutTime_BCM" SG_ 2654339072 CurrentFailSts_FD01_BCM 0;
BA_ "GenSigTimeoutTime_SGW" SG_ 2654339072 CurrentFailSts_FD01_BCM 0;
BA_ "GenSigTimeoutTime_BCM" SG_ 2654339072 CurrentFailSts_FD02_BCM 0;
BA_ "GenSigTimeoutTime_SGW" SG_ 2654339072 CurrentFailSts_FD02_BCM 0;
BA_ "GenSigTimeoutTime_BCM" SG_ 2654339072 CurrentFailSts_FD03_BCM 0;
BA_ "GenSigTimeoutTime_SGW" SG_ 2654339072 CurrentFailSts_FD03_BCM 0;
BA_ "GenSigTimeoutTime_BCM" SG_ 2654339072 CurrentFailSts_FD04_BCM 0;
BA_ "GenSigTimeoutTime_SGW" SG_ 2654339072 CurrentFailSts_FD04_BCM 0;
BA_ "GenSigTimeoutTime_BCM" SG_ 2654339072 DES_FD01_BCM 0;
BA_ "GenSigTimeoutTime_SGW" SG_ 2654339072 DES_FD01_BCM 0;
BA_ "GenSigTimeoutTime_BCM" SG_ 2654339072 DES_FD02_BCM 0;
BA_ "GenSigTimeoutTime_SGW" SG_ 2654339072 DES_FD02_BCM 0;
BA_ "GenSigTimeoutTime_BCM" SG_ 2654339072 DES_FD03_BCM 0;
BA_ "GenSigTimeoutTime_SGW" SG_ 2654339072 DES_FD03_BCM 0;
BA_ "GenSigTimeoutTime_BCM" SG_ 2654339072 DES_FD04_BCM 0;
BA_ "GenSigTimeoutTime_SGW" SG_ 2654339072 DES_FD04_BCM 0;
BA_ "GenSigTimeoutTime_BCM" SG_ 2654339072 EOL_FD01_BCM 0;
BA_ "GenSigTimeoutTime_SGW" SG_ 2654339072 EOL_FD01_BCM 0;
BA_ "GenSigTimeoutTime_BCM" SG_ 2654339072 EOL_FD02_BCM 0;
BA_ "GenSigTimeoutTime_SGW" SG_ 2654339072 EOL_FD02_BCM 0;
BA_ "GenSigTimeoutTime_BCM" SG_ 2654339072 EOL_FD03_BCM 0;
BA_ "GenSigTimeoutTime_SGW" SG_ 2654339072 EOL_FD03_BCM 0;
BA_ "GenSigTimeoutTime_BCM" SG_ 2654339072 EOL_FD04_BCM 0;
BA_ "GenSigTimeoutTime_SGW" SG_ 2654339072 EOL_FD04_BCM 0;
BA_ "GenSigTimeoutTime_BCM" SG_ 2654339072 GenericFailSts_FD01_BCM 0;
BA_ "GenSigTimeoutTime_SGW" SG_ 2654339072 GenericFailSts_FD01_BCM 0;
BA_ "GenSigTimeoutTime_BCM" SG_ 2654339072 GenericFailSts_FD02_BCM 0;
BA_ "GenSigTimeoutTime_SGW" SG_ 2654339072 GenericFailSts_FD02_BCM 0;
BA_ "GenSigTimeoutTime_BCM" SG_ 2654339072 GenericFailSts_FD03_BCM 0;
BA_ "GenSigTimeoutTime_SGW" SG_ 2654339072 GenericFailSts_FD03_BCM 0;
BA_ "GenSigTimeoutTime_BCM" SG_ 2654339072 GenericFailSts_FD04_BCM 0;
BA_ "GenSigTimeoutTime_SGW" SG_ 2654339072 GenericFailSts_FD04_BCM 0;
BA_ "GenSigTimeoutTime_BCM" SG_ 2654339072 PreviousCanNMState_FD01_BCM 0;
BA_ "GenSigTimeoutTime_SGW" SG_ 2654339072 PreviousCanNMState_FD01_BCM 0;
BA_ "GenSigTimeoutTime_BCM" SG_ 2654339072 PreviousCanNMState_FD02_BCM 0;
BA_ "GenSigTimeoutTime_SGW" SG_ 2654339072 PreviousCanNMState_FD02_BCM 0;
BA_ "GenSigTimeoutTime_BCM" SG_ 2654339072 PreviousCanNMState_FD03_BCM 0;
BA_ "GenSigTimeoutTime_SGW" SG_ 2654339072 PreviousCanNMState_FD03_BCM 0;
BA_ "GenSigTimeoutTime_BCM" SG_ 2654339072 PreviousCanNMState_FD04_BCM 0;
BA_ "GenSigTimeoutTime_SGW" SG_ 2654339072 PreviousCanNMState_FD04_BCM 0;
BA_ "GenSigTimeoutTime_BCM" SG_ 2654339072 StayActiveSource_FD01_BCM 0;
BA_ "GenSigTimeoutTime_SGW" SG_ 2654339072 StayActiveSource_FD01_BCM 0;
BA_ "GenSigTimeoutTime_BCM" SG_ 2654339072 StayActiveSource_FD02_BCM 0;
BA_ "GenSigTimeoutTime_SGW" SG_ 2654339072 StayActiveSource_FD02_BCM 0;
BA_ "GenSigTimeoutTime_BCM" SG_ 2654339072 StayActiveSource_FD03_BCM 0;
BA_ "GenSigTimeoutTime_SGW" SG_ 2654339072 StayActiveSource_FD03_BCM 0;
BA_ "GenSigTimeoutTime_BCM" SG_ 2654339072 StayActiveSource_FD04_BCM 0;
BA_ "GenSigTimeoutTime_SGW" SG_ 2654339072 StayActiveSource_FD04_BCM 0;
BA_ "GenSigTimeoutTime_BCM" SG_ 2654339072 WakeupSource_FD01_BCM 0;
BA_ "GenSigTimeoutTime_SGW" SG_ 2654339072 WakeupSource_FD01_BCM 0;
BA_ "GenSigTimeoutTime_BCM" SG_ 2654339072 WakeupSource_FD02_BCM 0;
BA_ "GenSigTimeoutTime_SGW" SG_ 2654339072 WakeupSource_FD02_BCM 0;
BA_ "GenSigTimeoutTime_BCM" SG_ 2654339072 WakeupSource_FD03_BCM 0;
BA_ "GenSigTimeoutTime_SGW" SG_ 2654339072 WakeupSource_FD03_BCM 0;
BA_ "GenSigTimeoutTime_BCM" SG_ 2654339072 WakeupSource_FD04_BCM 0;
BA_ "GenSigTimeoutTime_SGW" SG_ 2654339072 WakeupSource_FD04_BCM 0;
BA_ "GenSigTimeoutTime_BCM" SG_ 2654339142 CurrentCanNMState_FD11_BPCM 0;
BA_ "GenSigTimeoutTime_BSM2" SG_ 2654339142 CurrentCanNMState_FD11_BPCM 0;
BA_ "GenSigTimeoutTime_CADM2" SG_ 2654339142 CurrentCanNMState_FD11_BPCM 0;
BA_ "GenSigTimeoutTime_CVADAS" SG_ 2654339142 CurrentCanNMState_FD11_BPCM 0;
BA_ "GenSigTimeoutTime_EPS" SG_ 2654339142 CurrentCanNMState_FD11_BPCM 0;
BA_ "GenSigTimeoutTime_ORC" SG_ 2654339142 CurrentCanNMState_FD11_BPCM 0;
BA_ "GenSigTimeoutTime_PAM" SG_ 2654339142 CurrentCanNMState_FD11_BPCM 0;
BA_ "GenSigTimeoutTime_SGW" SG_ 2654339142 CurrentCanNMState_FD11_BPCM 0;
BA_ "GenSigTimeoutTime_TRSKM" SG_ 2654339142 CurrentCanNMState_FD11_BPCM 0;
BA_ "GenSigTimeoutTime_BCM" SG_ 2654339142 CurrentFailSts_FD11_BPCM 0;
BA_ "GenSigTimeoutTime_BSM2" SG_ 2654339142 CurrentFailSts_FD11_BPCM 0;
BA_ "GenSigTimeoutTime_CADM2" SG_ 2654339142 CurrentFailSts_FD11_BPCM 0;
BA_ "GenSigTimeoutTime_CVADAS" SG_ 2654339142 CurrentFailSts_FD11_BPCM 0;
BA_ "GenSigTimeoutTime_EPS" SG_ 2654339142 CurrentFailSts_FD11_BPCM 0;
BA_ "GenSigTimeoutTime_ORC" SG_ 2654339142 CurrentFailSts_FD11_BPCM 0;
BA_ "GenSigTimeoutTime_PAM" SG_ 2654339142 CurrentFailSts_FD11_BPCM 0;
BA_ "GenSigTimeoutTime_SGW" SG_ 2654339142 CurrentFailSts_FD11_BPCM 0;
BA_ "GenSigTimeoutTime_TRSKM" SG_ 2654339142 CurrentFailSts_FD11_BPCM 0;
BA_ "GenSigTimeoutTime_BCM" SG_ 2654339142 DES_FD11_BPCM 0;
BA_ "GenSigTimeoutTime_BSM2" SG_ 2654339142 DES_FD11_BPCM 0;
BA_ "GenSigTimeoutTime_CADM2" SG_ 2654339142 DES_FD11_BPCM 0;
BA_ "GenSigTimeoutTime_CVADAS" SG_ 2654339142 DES_FD11_BPCM 0;
BA_ "GenSigTimeoutTime_EPS" SG_ 2654339142 DES_FD11_BPCM 0;
BA_ "GenSigTimeoutTime_ORC" SG_ 2654339142 DES_FD11_BPCM 0;
BA_ "GenSigTimeoutTime_PAM" SG_ 2654339142 DES_FD11_BPCM 0;
BA_ "GenSigTimeoutTime_SGW" SG_ 2654339142 DES_FD11_BPCM 0;
BA_ "GenSigTimeoutTime_TRSKM" SG_ 2654339142 DES_FD11_BPCM 0;
BA_ "GenSigTimeoutTime_BCM" SG_ 2654339142 EOL_FD11_BPCM 0;
BA_ "GenSigTimeoutTime_BSM2" SG_ 2654339142 EOL_FD11_BPCM 0;
BA_ "GenSigTimeoutTime_CADM2" SG_ 2654339142 EOL_FD11_BPCM 0;
BA_ "GenSigTimeoutTime_CVADAS" SG_ 2654339142 EOL_FD11_BPCM 0;
BA_ "GenSigTimeoutTime_EPS" SG_ 2654339142 EOL_FD11_BPCM 0;
BA_ "GenSigTimeoutTime_ORC" SG_ 2654339142 EOL_FD11_BPCM 0;
BA_ "GenSigTimeoutTime_PAM" SG_ 2654339142 EOL_FD11_BPCM 0;
BA_ "GenSigTimeoutTime_SGW" SG_ 2654339142 EOL_FD11_BPCM 0;
BA_ "GenSigTimeoutTime_TRSKM" SG_ 2654339142 EOL_FD11_BPCM 0;
BA_ "GenSigTimeoutTime_BCM" SG_ 2654339142 GenericFailSts_FD11_BPCM 0;
BA_ "GenSigTimeoutTime_BSM2" SG_ 2654339142 GenericFailSts_FD11_BPCM 0;
BA_ "GenSigTimeoutTime_CADM2" SG_ 2654339142 GenericFailSts_FD11_BPCM 0;
BA_ "GenSigTimeoutTime_CVADAS" SG_ 2654339142 GenericFailSts_FD11_BPCM 0;
BA_ "GenSigTimeoutTime_EPS" SG_ 2654339142 GenericFailSts_FD11_BPCM 0;
BA_ "GenSigTimeoutTime_ORC" SG_ 2654339142 GenericFailSts_FD11_BPCM 0;
BA_ "GenSigTimeoutTime_PAM" SG_ 2654339142 GenericFailSts_FD11_BPCM 0;
BA_ "GenSigTimeoutTime_SGW" SG_ 2654339142 GenericFailSts_FD11_BPCM 0;
BA_ "GenSigTimeoutTime_TRSKM" SG_ 2654339142 GenericFailSts_FD11_BPCM 0;
BA_ "GenSigTimeoutTime_BCM" SG_ 2654339142 PreviousCanNMState_FD11_BPCM 0;
BA_ "GenSigTimeoutTime_BSM2" SG_ 2654339142 PreviousCanNMState_FD11_BPCM 0;
BA_ "GenSigTimeoutTime_CADM2" SG_ 2654339142 PreviousCanNMState_FD11_BPCM 0;
BA_ "GenSigTimeoutTime_CVADAS" SG_ 2654339142 PreviousCanNMState_FD11_BPCM 0;
BA_ "GenSigTimeoutTime_EPS" SG_ 2654339142 PreviousCanNMState_FD11_BPCM 0;
BA_ "GenSigTimeoutTime_ORC" SG_ 2654339142 PreviousCanNMState_FD11_BPCM 0;
BA_ "GenSigTimeoutTime_PAM" SG_ 2654339142 PreviousCanNMState_FD11_BPCM 0;
BA_ "GenSigTimeoutTime_SGW" SG_ 2654339142 PreviousCanNMState_FD11_BPCM 0;
BA_ "GenSigTimeoutTime_TRSKM" SG_ 2654339142 PreviousCanNMState_FD11_BPCM 0;
BA_ "GenSigTimeoutTime_BCM" SG_ 2654339142 StayActiveSource_FD11_BPCM 0;
BA_ "GenSigTimeoutTime_BSM2" SG_ 2654339142 StayActiveSource_FD11_BPCM 0;
BA_ "GenSigTimeoutTime_CADM2" SG_ 2654339142 StayActiveSource_FD11_BPCM 0;
BA_ "GenSigTimeoutTime_CVADAS" SG_ 2654339142 StayActiveSource_FD11_BPCM 0;
BA_ "GenSigTimeoutTime_EPS" SG_ 2654339142 StayActiveSource_FD11_BPCM 0;
BA_ "GenSigTimeoutTime_ORC" SG_ 2654339142 StayActiveSource_FD11_BPCM 0;
BA_ "GenSigTimeoutTime_PAM" SG_ 2654339142 StayActiveSource_FD11_BPCM 0;
BA_ "GenSigTimeoutTime_SGW" SG_ 2654339142 StayActiveSource_FD11_BPCM 0;
BA_ "GenSigTimeoutTime_TRSKM" SG_ 2654339142 StayActiveSource_FD11_BPCM 0;
BA_ "GenSigTimeoutTime_BCM" SG_ 2654339142 WakeupSource_FD11_BPCM 0;
BA_ "GenSigTimeoutTime_BSM2" SG_ 2654339142 WakeupSource_FD11_BPCM 0;
BA_ "GenSigTimeoutTime_CADM2" SG_ 2654339142 WakeupSource_FD11_BPCM 0;
BA_ "GenSigTimeoutTime_CVADAS" SG_ 2654339142 WakeupSource_FD11_BPCM 0;
BA_ "GenSigTimeoutTime_EPS" SG_ 2654339142 WakeupSource_FD11_BPCM 0;
BA_ "GenSigTimeoutTime_ORC" SG_ 2654339142 WakeupSource_FD11_BPCM 0;
BA_ "GenSigTimeoutTime_PAM" SG_ 2654339142 WakeupSource_FD11_BPCM 0;
BA_ "GenSigTimeoutTime_SGW" SG_ 2654339142 WakeupSource_FD11_BPCM 0;
BA_ "GenSigTimeoutTime_TRSKM" SG_ 2654339142 WakeupSource_FD11_BPCM 0;
BA_ "GenSigTimeoutTime_BCM" SG_ 2654339078 CurrentCanNMState_FD03_BSM 0;
BA_ "GenSigTimeoutTime_BSM2" SG_ 2654339078 CurrentCanNMState_FD03_BSM 0;
BA_ "GenSigTimeoutTime_CADM2" SG_ 2654339078 CurrentCanNMState_FD03_BSM 0;
BA_ "GenSigTimeoutTime_CVADAS" SG_ 2654339078 CurrentCanNMState_FD03_BSM 0;
BA_ "GenSigTimeoutTime_EPS" SG_ 2654339078 CurrentCanNMState_FD03_BSM 0;
BA_ "GenSigTimeoutTime_ORC" SG_ 2654339078 CurrentCanNMState_FD03_BSM 0;
BA_ "GenSigTimeoutTime_PAM" SG_ 2654339078 CurrentCanNMState_FD03_BSM 0;
BA_ "GenSigTimeoutTime_SGW" SG_ 2654339078 CurrentCanNMState_FD03_BSM 0;
BA_ "GenSigTimeoutTime_TRSKM" SG_ 2654339078 CurrentCanNMState_FD03_BSM 0;
BA_ "GenSigTimeoutTime_BCM" SG_ 2654339078 CurrentFailSts_FD03_BSM 0;
BA_ "GenSigTimeoutTime_BSM2" SG_ 2654339078 CurrentFailSts_FD03_BSM 0;
BA_ "GenSigTimeoutTime_CADM2" SG_ 2654339078 CurrentFailSts_FD03_BSM 0;
BA_ "GenSigTimeoutTime_CVADAS" SG_ 2654339078 CurrentFailSts_FD03_BSM 0;
BA_ "GenSigTimeoutTime_EPS" SG_ 2654339078 CurrentFailSts_FD03_BSM 0;
BA_ "GenSigTimeoutTime_ORC" SG_ 2654339078 CurrentFailSts_FD03_BSM 0;
BA_ "GenSigTimeoutTime_PAM" SG_ 2654339078 CurrentFailSts_FD03_BSM 0;
BA_ "GenSigTimeoutTime_SGW" SG_ 2654339078 CurrentFailSts_FD03_BSM 0;
BA_ "GenSigTimeoutTime_TRSKM" SG_ 2654339078 CurrentFailSts_FD03_BSM 0;
BA_ "GenSigTimeoutTime_BCM" SG_ 2654339078 DES_FD03_BSM 0;
BA_ "GenSigTimeoutTime_BSM2" SG_ 2654339078 DES_FD03_BSM 0;
BA_ "GenSigTimeoutTime_CADM2" SG_ 2654339078 DES_FD03_BSM 0;
BA_ "GenSigTimeoutTime_CVADAS" SG_ 2654339078 DES_FD03_BSM 0;
BA_ "GenSigTimeoutTime_EPS" SG_ 2654339078 DES_FD03_BSM 0;
BA_ "GenSigTimeoutTime_ORC" SG_ 2654339078 DES_FD03_BSM 0;
BA_ "GenSigTimeoutTime_PAM" SG_ 2654339078 DES_FD03_BSM 0;
BA_ "GenSigTimeoutTime_SGW" SG_ 2654339078 DES_FD03_BSM 0;
BA_ "GenSigTimeoutTime_TRSKM" SG_ 2654339078 DES_FD03_BSM 0;
BA_ "GenSigTimeoutTime_BCM" SG_ 2654339078 EOL_FD03_BSM 0;
BA_ "GenSigTimeoutTime_BSM2" SG_ 2654339078 EOL_FD03_BSM 0;
BA_ "GenSigTimeoutTime_CADM2" SG_ 2654339078 EOL_FD03_BSM 0;
BA_ "GenSigTimeoutTime_CVADAS" SG_ 2654339078 EOL_FD03_BSM 0;
BA_ "GenSigTimeoutTime_EPS" SG_ 2654339078 EOL_FD03_BSM 0;
BA_ "GenSigTimeoutTime_ORC" SG_ 2654339078 EOL_FD03_BSM 0;
BA_ "GenSigTimeoutTime_PAM" SG_ 2654339078 EOL_FD03_BSM 0;
BA_ "GenSigTimeoutTime_SGW" SG_ 2654339078 EOL_FD03_BSM 0;
BA_ "GenSigTimeoutTime_TRSKM" SG_ 2654339078 EOL_FD03_BSM 0;
BA_ "GenSigTimeoutTime_BCM" SG_ 2654339078 GenericFailSts_FD03_BSM 0;
BA_ "GenSigTimeoutTime_BSM2" SG_ 2654339078 GenericFailSts_FD03_BSM 0;
BA_ "GenSigTimeoutTime_CADM2" SG_ 2654339078 GenericFailSts_FD03_BSM 0;
BA_ "GenSigTimeoutTime_CVADAS" SG_ 2654339078 GenericFailSts_FD03_BSM 0;
BA_ "GenSigTimeoutTime_EPS" SG_ 2654339078 GenericFailSts_FD03_BSM 0;
BA_ "GenSigTimeoutTime_ORC" SG_ 2654339078 GenericFailSts_FD03_BSM 0;
BA_ "GenSigTimeoutTime_PAM" SG_ 2654339078 GenericFailSts_FD03_BSM 0;
BA_ "GenSigTimeoutTime_SGW" SG_ 2654339078 GenericFailSts_FD03_BSM 0;
BA_ "GenSigTimeoutTime_TRSKM" SG_ 2654339078 GenericFailSts_FD03_BSM 0;
BA_ "GenSigTimeoutTime_BCM" SG_ 2654339078 PreviousCanNMState_FD03_BSM 0;
BA_ "GenSigTimeoutTime_BSM2" SG_ 2654339078 PreviousCanNMState_FD03_BSM 0;
BA_ "GenSigTimeoutTime_CADM2" SG_ 2654339078 PreviousCanNMState_FD03_BSM 0;
BA_ "GenSigTimeoutTime_CVADAS" SG_ 2654339078 PreviousCanNMState_FD03_BSM 0;
BA_ "GenSigTimeoutTime_EPS" SG_ 2654339078 PreviousCanNMState_FD03_BSM 0;
BA_ "GenSigTimeoutTime_ORC" SG_ 2654339078 PreviousCanNMState_FD03_BSM 0;
BA_ "GenSigTimeoutTime_PAM" SG_ 2654339078 PreviousCanNMState_FD03_BSM 0;
BA_ "GenSigTimeoutTime_SGW" SG_ 2654339078 PreviousCanNMState_FD03_BSM 0;
BA_ "GenSigTimeoutTime_TRSKM" SG_ 2654339078 PreviousCanNMState_FD03_BSM 0;
BA_ "GenSigTimeoutTime_BCM" SG_ 2654339078 StayActiveSource_FD03_BSM 0;
BA_ "GenSigTimeoutTime_BSM2" SG_ 2654339078 StayActiveSource_FD03_BSM 0;
BA_ "GenSigTimeoutTime_CADM2" SG_ 2654339078 StayActiveSource_FD03_BSM 0;
BA_ "GenSigTimeoutTime_CVADAS" SG_ 2654339078 StayActiveSource_FD03_BSM 0;
BA_ "GenSigTimeoutTime_EPS" SG_ 2654339078 StayActiveSource_FD03_BSM 0;
BA_ "GenSigTimeoutTime_ORC" SG_ 2654339078 StayActiveSource_FD03_BSM 0;
BA_ "GenSigTimeoutTime_PAM" SG_ 2654339078 StayActiveSource_FD03_BSM 0;
BA_ "GenSigTimeoutTime_SGW" SG_ 2654339078 StayActiveSource_FD03_BSM 0;
BA_ "GenSigTimeoutTime_TRSKM" SG_ 2654339078 StayActiveSource_FD03_BSM 0;
BA_ "GenSigTimeoutTime_BCM" SG_ 2654339078 WakeupSource_FD03_BSM 0;
BA_ "GenSigTimeoutTime_BSM2" SG_ 2654339078 WakeupSource_FD03_BSM 0;
BA_ "GenSigTimeoutTime_CADM2" SG_ 2654339078 WakeupSource_FD03_BSM 0;
BA_ "GenSigTimeoutTime_CVADAS" SG_ 2654339078 WakeupSource_FD03_BSM 0;
BA_ "GenSigTimeoutTime_EPS" SG_ 2654339078 WakeupSource_FD03_BSM 0;
BA_ "GenSigTimeoutTime_ORC" SG_ 2654339078 WakeupSource_FD03_BSM 0;
BA_ "GenSigTimeoutTime_PAM" SG_ 2654339078 WakeupSource_FD03_BSM 0;
BA_ "GenSigTimeoutTime_SGW" SG_ 2654339078 WakeupSource_FD03_BSM 0;
BA_ "GenSigTimeoutTime_TRSKM" SG_ 2654339078 WakeupSource_FD03_BSM 0;
BA_ "GenSigTimeoutTime_BSM2" SG_ 2654339220 CurrentCanNMState_FD02_BSM2 0;
BA_ "GenSigTimeoutTime_BSM2" SG_ 2654339220 CurrentFailSts_FD02_BSM2 0;
BA_ "GenSigTimeoutTime_BSM2" SG_ 2654339220 DES_FD02_BSM2 0;
BA_ "GenSigTimeoutTime_BSM2" SG_ 2654339220 EOL_FD02_BSM2 0;
BA_ "GenSigTimeoutTime_BSM2" SG_ 2654339220 GenericFailSts_FD02_BSM2 0;
BA_ "GenSigTimeoutTime_BSM2" SG_ 2654339220 PreviousCanNMState_FD02_BSM2 0;
BA_ "GenSigTimeoutTime_BSM2" SG_ 2654339220 StayActiveSource_FD02_BSM2 0;
BA_ "GenSigTimeoutTime_BSM2" SG_ 2654339220 WakeupSource_FD02_BSM2 0;
BA_ "GenSigTimeoutTime_BCM" SG_ 2654339213 CurrentCanNMState_FD03_CADM 0;
BA_ "GenSigTimeoutTime_BSM2" SG_ 2654339213 CurrentCanNMState_FD03_CADM 0;
BA_ "GenSigTimeoutTime_CADM2" SG_ 2654339213 CurrentCanNMState_FD03_CADM 0;
BA_ "GenSigTimeoutTime_CVADAS" SG_ 2654339213 CurrentCanNMState_FD03_CADM 0;
BA_ "GenSigTimeoutTime_EPS" SG_ 2654339213 CurrentCanNMState_FD03_CADM 0;
BA_ "GenSigTimeoutTime_ORC" SG_ 2654339213 CurrentCanNMState_FD03_CADM 0;
BA_ "GenSigTimeoutTime_PAM" SG_ 2654339213 CurrentCanNMState_FD03_CADM 0;
BA_ "GenSigTimeoutTime_SGW" SG_ 2654339213 CurrentCanNMState_FD03_CADM 0;
BA_ "GenSigTimeoutTime_TRSKM" SG_ 2654339213 CurrentCanNMState_FD03_CADM 0;
BA_ "GenSigTimeoutTime_BCM" SG_ 2654339213 CurrentFailSts_FD03_CADM 0;
BA_ "GenSigTimeoutTime_BSM2" SG_ 2654339213 CurrentFailSts_FD03_CADM 0;
BA_ "GenSigTimeoutTime_CADM2" SG_ 2654339213 CurrentFailSts_FD03_CADM 0;
BA_ "GenSigTimeoutTime_CVADAS" SG_ 2654339213 CurrentFailSts_FD03_CADM 0;
BA_ "GenSigTimeoutTime_EPS" SG_ 2654339213 CurrentFailSts_FD03_CADM 0;
BA_ "GenSigTimeoutTime_ORC" SG_ 2654339213 CurrentFailSts_FD03_CADM 0;
BA_ "GenSigTimeoutTime_PAM" SG_ 2654339213 CurrentFailSts_FD03_CADM 0;
BA_ "GenSigTimeoutTime_SGW" SG_ 2654339213 CurrentFailSts_FD03_CADM 0;
BA_ "GenSigTimeoutTime_TRSKM" SG_ 2654339213 CurrentFailSts_FD03_CADM 0;
BA_ "GenSigTimeoutTime_BCM" SG_ 2654339213 DES_FD03_CADM 0;
BA_ "GenSigTimeoutTime_BSM2" SG_ 2654339213 DES_FD03_CADM 0;
BA_ "GenSigTimeoutTime_CADM2" SG_ 2654339213 DES_FD03_CADM 0;
BA_ "GenSigTimeoutTime_CVADAS" SG_ 2654339213 DES_FD03_CADM 0;
BA_ "GenSigTimeoutTime_EPS" SG_ 2654339213 DES_FD03_CADM 0;
BA_ "GenSigTimeoutTime_ORC" SG_ 2654339213 DES_FD03_CADM 0;
BA_ "GenSigTimeoutTime_PAM" SG_ 2654339213 DES_FD03_CADM 0;
BA_ "GenSigTimeoutTime_SGW" SG_ 2654339213 DES_FD03_CADM 0;
BA_ "GenSigTimeoutTime_TRSKM" SG_ 2654339213 DES_FD03_CADM 0;
BA_ "GenSigTimeoutTime_BCM" SG_ 2654339213 EOL_FD03_CADM 0;
BA_ "GenSigTimeoutTime_BSM2" SG_ 2654339213 EOL_FD03_CADM 0;
BA_ "GenSigTimeoutTime_CADM2" SG_ 2654339213 EOL_FD03_CADM 0;
BA_ "GenSigTimeoutTime_CVADAS" SG_ 2654339213 EOL_FD03_CADM 0;
BA_ "GenSigTimeoutTime_EPS" SG_ 2654339213 EOL_FD03_CADM 0;
BA_ "GenSigTimeoutTime_ORC" SG_ 2654339213 EOL_FD03_CADM 0;
BA_ "GenSigTimeoutTime_PAM" SG_ 2654339213 EOL_FD03_CADM 0;
BA_ "GenSigTimeoutTime_SGW" SG_ 2654339213 EOL_FD03_CADM 0;
BA_ "GenSigTimeoutTime_TRSKM" SG_ 2654339213 EOL_FD03_CADM 0;
BA_ "GenSigTimeoutTime_BCM" SG_ 2654339213 GenericFailSts_FD03_CADM 0;
BA_ "GenSigTimeoutTime_BSM2" SG_ 2654339213 GenericFailSts_FD03_CADM 0;
BA_ "GenSigTimeoutTime_CADM2" SG_ 2654339213 GenericFailSts_FD03_CADM 0;
BA_ "GenSigTimeoutTime_CVADAS" SG_ 2654339213 GenericFailSts_FD03_CADM 0;
BA_ "GenSigTimeoutTime_EPS" SG_ 2654339213 GenericFailSts_FD03_CADM 0;
BA_ "GenSigTimeoutTime_ORC" SG_ 2654339213 GenericFailSts_FD03_CADM 0;
BA_ "GenSigTimeoutTime_PAM" SG_ 2654339213 GenericFailSts_FD03_CADM 0;
BA_ "GenSigTimeoutTime_SGW" SG_ 2654339213 GenericFailSts_FD03_CADM 0;
BA_ "GenSigTimeoutTime_TRSKM" SG_ 2654339213 GenericFailSts_FD03_CADM 0;
BA_ "GenSigTimeoutTime_BCM" SG_ 2654339213 PreviousCanNMState_FD03_CADM 0;
BA_ "GenSigTimeoutTime_BSM2" SG_ 2654339213 PreviousCanNMState_FD03_CADM 0;
BA_ "GenSigTimeoutTime_CADM2" SG_ 2654339213 PreviousCanNMState_FD03_CADM 0;
BA_ "GenSigTimeoutTime_CVADAS" SG_ 2654339213 PreviousCanNMState_FD03_CADM 0;
BA_ "GenSigTimeoutTime_EPS" SG_ 2654339213 PreviousCanNMState_FD03_CADM 0;
BA_ "GenSigTimeoutTime_ORC" SG_ 2654339213 PreviousCanNMState_FD03_CADM 0;
BA_ "GenSigTimeoutTime_PAM" SG_ 2654339213 PreviousCanNMState_FD03_CADM 0;
BA_ "GenSigTimeoutTime_SGW" SG_ 2654339213 PreviousCanNMState_FD03_CADM 0;
BA_ "GenSigTimeoutTime_TRSKM" SG_ 2654339213 PreviousCanNMState_FD03_CADM 0;
BA_ "GenSigTimeoutTime_BCM" SG_ 2654339213 StayActiveSource_FD03_CADM 0;
BA_ "GenSigTimeoutTime_BSM2" SG_ 2654339213 StayActiveSource_FD03_CADM 0;
BA_ "GenSigTimeoutTime_CADM2" SG_ 2654339213 StayActiveSource_FD03_CADM 0;
BA_ "GenSigTimeoutTime_CVADAS" SG_ 2654339213 StayActiveSource_FD03_CADM 0;
BA_ "GenSigTimeoutTime_EPS" SG_ 2654339213 StayActiveSource_FD03_CADM 0;
BA_ "GenSigTimeoutTime_ORC" SG_ 2654339213 StayActiveSource_FD03_CADM 0;
BA_ "GenSigTimeoutTime_PAM" SG_ 2654339213 StayActiveSource_FD03_CADM 0;
BA_ "GenSigTimeoutTime_SGW" SG_ 2654339213 StayActiveSource_FD03_CADM 0;
BA_ "GenSigTimeoutTime_TRSKM" SG_ 2654339213 StayActiveSource_FD03_CADM 0;
BA_ "GenSigTimeoutTime_BCM" SG_ 2654339213 WakeupSource_FD03_CADM 0;
BA_ "GenSigTimeoutTime_BSM2" SG_ 2654339213 WakeupSource_FD03_CADM 0;
BA_ "GenSigTimeoutTime_CADM2" SG_ 2654339213 WakeupSource_FD03_CADM 0;
BA_ "GenSigTimeoutTime_CVADAS" SG_ 2654339213 WakeupSource_FD03_CADM 0;
BA_ "GenSigTimeoutTime_EPS" SG_ 2654339213 WakeupSource_FD03_CADM 0;
BA_ "GenSigTimeoutTime_ORC" SG_ 2654339213 WakeupSource_FD03_CADM 0;
BA_ "GenSigTimeoutTime_PAM" SG_ 2654339213 WakeupSource_FD03_CADM 0;
BA_ "GenSigTimeoutTime_SGW" SG_ 2654339213 WakeupSource_FD03_CADM 0;
BA_ "GenSigTimeoutTime_TRSKM" SG_ 2654339213 WakeupSource_FD03_CADM 0;
BA_ "GenSigTimeoutTime_CADM2" SG_ 2654339214 CurrentCanNMState_FD02_CADM2 0;
BA_ "GenSigTimeoutTime_CADM2" SG_ 2654339214 CurrentFailSts_FD02_CADM2 0;
BA_ "GenSigTimeoutTime_CADM2" SG_ 2654339214 DES_FD02_CADM2 0;
BA_ "GenSigTimeoutTime_CADM2" SG_ 2654339214 EOL_FD02_CADM2 0;
BA_ "GenSigTimeoutTime_CADM2" SG_ 2654339214 GenericFailSts_FD02_CADM2 0;
BA_ "GenSigTimeoutTime_CADM2" SG_ 2654339214 PreviousCanNMState_FD02_CADM2 0;
BA_ "GenSigTimeoutTime_CADM2" SG_ 2654339214 StayActiveSource_FD02_CADM2 0;
BA_ "GenSigTimeoutTime_CADM2" SG_ 2654339214 WakeupSource_FD02_CADM2 0;
BA_ "GenSigTimeoutTime_BCM" SG_ 2654339225 CurrentCanNMState_FD03_DMSM 0;
BA_ "GenSigTimeoutTime_BSM2" SG_ 2654339225 CurrentCanNMState_FD03_DMSM 0;
BA_ "GenSigTimeoutTime_CADM2" SG_ 2654339225 CurrentCanNMState_FD03_DMSM 0;
BA_ "GenSigTimeoutTime_CVADAS" SG_ 2654339225 CurrentCanNMState_FD03_DMSM 0;
BA_ "GenSigTimeoutTime_EPS" SG_ 2654339225 CurrentCanNMState_FD03_DMSM 0;
BA_ "GenSigTimeoutTime_ORC" SG_ 2654339225 CurrentCanNMState_FD03_DMSM 0;
BA_ "GenSigTimeoutTime_PAM" SG_ 2654339225 CurrentCanNMState_FD03_DMSM 0;
BA_ "GenSigTimeoutTime_SGW" SG_ 2654339225 CurrentCanNMState_FD03_DMSM 0;
BA_ "GenSigTimeoutTime_TRSKM" SG_ 2654339225 CurrentCanNMState_FD03_DMSM 0;
BA_ "GenSigTimeoutTime_BCM" SG_ 2654339225 CurrentFailSts_FD03_DMSM 0;
BA_ "GenSigTimeoutTime_BSM2" SG_ 2654339225 CurrentFailSts_FD03_DMSM 0;
BA_ "GenSigTimeoutTime_CADM2" SG_ 2654339225 CurrentFailSts_FD03_DMSM 0;
BA_ "GenSigTimeoutTime_CVADAS" SG_ 2654339225 CurrentFailSts_FD03_DMSM 0;
BA_ "GenSigTimeoutTime_EPS" SG_ 2654339225 CurrentFailSts_FD03_DMSM 0;
BA_ "GenSigTimeoutTime_ORC" SG_ 2654339225 CurrentFailSts_FD03_DMSM 0;
BA_ "GenSigTimeoutTime_PAM" SG_ 2654339225 CurrentFailSts_FD03_DMSM 0;
BA_ "GenSigTimeoutTime_SGW" SG_ 2654339225 CurrentFailSts_FD03_DMSM 0;
BA_ "GenSigTimeoutTime_TRSKM" SG_ 2654339225 CurrentFailSts_FD03_DMSM 0;
BA_ "GenSigTimeoutTime_BCM" SG_ 2654339225 DES_FD03_DMSM 0;
BA_ "GenSigTimeoutTime_BSM2" SG_ 2654339225 DES_FD03_DMSM 0;
BA_ "GenSigTimeoutTime_CADM2" SG_ 2654339225 DES_FD03_DMSM 0;
BA_ "GenSigTimeoutTime_CVADAS" SG_ 2654339225 DES_FD03_DMSM 0;
BA_ "GenSigTimeoutTime_EPS" SG_ 2654339225 DES_FD03_DMSM 0;
BA_ "GenSigTimeoutTime_ORC" SG_ 2654339225 DES_FD03_DMSM 0;
BA_ "GenSigTimeoutTime_PAM" SG_ 2654339225 DES_FD03_DMSM 0;
BA_ "GenSigTimeoutTime_SGW" SG_ 2654339225 DES_FD03_DMSM 0;
BA_ "GenSigTimeoutTime_TRSKM" SG_ 2654339225 DES_FD03_DMSM 0;
BA_ "GenSigTimeoutTime_BCM" SG_ 2654339225 EOL_FD03_DMSM 0;
BA_ "GenSigTimeoutTime_BSM2" SG_ 2654339225 EOL_FD03_DMSM 0;
BA_ "GenSigTimeoutTime_CADM2" SG_ 2654339225 EOL_FD03_DMSM 0;
BA_ "GenSigTimeoutTime_CVADAS" SG_ 2654339225 EOL_FD03_DMSM 0;
BA_ "GenSigTimeoutTime_EPS" SG_ 2654339225 EOL_FD03_DMSM 0;
BA_ "GenSigTimeoutTime_ORC" SG_ 2654339225 EOL_FD03_DMSM 0;
BA_ "GenSigTimeoutTime_PAM" SG_ 2654339225 EOL_FD03_DMSM 0;
BA_ "GenSigTimeoutTime_SGW" SG_ 2654339225 EOL_FD03_DMSM 0;
BA_ "GenSigTimeoutTime_TRSKM" SG_ 2654339225 EOL_FD03_DMSM 0;
BA_ "GenSigTimeoutTime_BCM" SG_ 2654339225 GenericFailSts_FD03_DMSM 0;
BA_ "GenSigTimeoutTime_BSM2" SG_ 2654339225 GenericFailSts_FD03_DMSM 0;
BA_ "GenSigTimeoutTime_CADM2" SG_ 2654339225 GenericFailSts_FD03_DMSM 0;
BA_ "GenSigTimeoutTime_CVADAS" SG_ 2654339225 GenericFailSts_FD03_DMSM 0;
BA_ "GenSigTimeoutTime_EPS" SG_ 2654339225 GenericFailSts_FD03_DMSM 0;
BA_ "GenSigTimeoutTime_ORC" SG_ 2654339225 GenericFailSts_FD03_DMSM 0;
BA_ "GenSigTimeoutTime_PAM" SG_ 2654339225 GenericFailSts_FD03_DMSM 0;
BA_ "GenSigTimeoutTime_SGW" SG_ 2654339225 GenericFailSts_FD03_DMSM 0;
BA_ "GenSigTimeoutTime_TRSKM" SG_ 2654339225 GenericFailSts_FD03_DMSM 0;
BA_ "GenSigTimeoutTime_BCM" SG_ 2654339225 PreviousCanNMState_FD03_DMSM 0;
BA_ "GenSigTimeoutTime_BSM2" SG_ 2654339225 PreviousCanNMState_FD03_DMSM 0;
BA_ "GenSigTimeoutTime_CADM2" SG_ 2654339225 PreviousCanNMState_FD03_DMSM 0;
BA_ "GenSigTimeoutTime_CVADAS" SG_ 2654339225 PreviousCanNMState_FD03_DMSM 0;
BA_ "GenSigTimeoutTime_EPS" SG_ 2654339225 PreviousCanNMState_FD03_DMSM 0;
BA_ "GenSigTimeoutTime_ORC" SG_ 2654339225 PreviousCanNMState_FD03_DMSM 0;
BA_ "GenSigTimeoutTime_PAM" SG_ 2654339225 PreviousCanNMState_FD03_DMSM 0;
BA_ "GenSigTimeoutTime_SGW" SG_ 2654339225 PreviousCanNMState_FD03_DMSM 0;
BA_ "GenSigTimeoutTime_TRSKM" SG_ 2654339225 PreviousCanNMState_FD03_DMSM 0;
BA_ "GenSigTimeoutTime_BCM" SG_ 2654339225 StayActiveSource_FD03_DMSM 0;
BA_ "GenSigTimeoutTime_BSM2" SG_ 2654339225 StayActiveSource_FD03_DMSM 0;
BA_ "GenSigTimeoutTime_CADM2" SG_ 2654339225 StayActiveSource_FD03_DMSM 0;
BA_ "GenSigTimeoutTime_CVADAS" SG_ 2654339225 StayActiveSource_FD03_DMSM 0;
BA_ "GenSigTimeoutTime_EPS" SG_ 2654339225 StayActiveSource_FD03_DMSM 0;
BA_ "GenSigTimeoutTime_ORC" SG_ 2654339225 StayActiveSource_FD03_DMSM 0;
BA_ "GenSigTimeoutTime_PAM" SG_ 2654339225 StayActiveSource_FD03_DMSM 0;
BA_ "GenSigTimeoutTime_SGW" SG_ 2654339225 StayActiveSource_FD03_DMSM 0;
BA_ "GenSigTimeoutTime_TRSKM" SG_ 2654339225 StayActiveSource_FD03_DMSM 0;
BA_ "GenSigTimeoutTime_BCM" SG_ 2654339225 WakeupSource_FD03_DMSM 0;
BA_ "GenSigTimeoutTime_BSM2" SG_ 2654339225 WakeupSource_FD03_DMSM 0;
BA_ "GenSigTimeoutTime_CADM2" SG_ 2654339225 WakeupSource_FD03_DMSM 0;
BA_ "GenSigTimeoutTime_CVADAS" SG_ 2654339225 WakeupSource_FD03_DMSM 0;
BA_ "GenSigTimeoutTime_EPS" SG_ 2654339225 WakeupSource_FD03_DMSM 0;
BA_ "GenSigTimeoutTime_ORC" SG_ 2654339225 WakeupSource_FD03_DMSM 0;
BA_ "GenSigTimeoutTime_PAM" SG_ 2654339225 WakeupSource_FD03_DMSM 0;
BA_ "GenSigTimeoutTime_SGW" SG_ 2654339225 WakeupSource_FD03_DMSM 0;
BA_ "GenSigTimeoutTime_TRSKM" SG_ 2654339225 WakeupSource_FD03_DMSM 0;
BA_ "GenSigTimeoutTime_BCM" SG_ 2654339139 CurrentCanNMState_FD03_DTCM 0;
BA_ "GenSigTimeoutTime_BSM2" SG_ 2654339139 CurrentCanNMState_FD03_DTCM 0;
BA_ "GenSigTimeoutTime_CADM2" SG_ 2654339139 CurrentCanNMState_FD03_DTCM 0;
BA_ "GenSigTimeoutTime_CVADAS" SG_ 2654339139 CurrentCanNMState_FD03_DTCM 0;
BA_ "GenSigTimeoutTime_EPS" SG_ 2654339139 CurrentCanNMState_FD03_DTCM 0;
BA_ "GenSigTimeoutTime_ORC" SG_ 2654339139 CurrentCanNMState_FD03_DTCM 0;
BA_ "GenSigTimeoutTime_PAM" SG_ 2654339139 CurrentCanNMState_FD03_DTCM 0;
BA_ "GenSigTimeoutTime_SGW" SG_ 2654339139 CurrentCanNMState_FD03_DTCM 0;
BA_ "GenSigTimeoutTime_TRSKM" SG_ 2654339139 CurrentCanNMState_FD03_DTCM 0;
BA_ "GenSigTimeoutTime_BCM" SG_ 2654339139 CurrentFailSts_FD03_DTCM 0;
BA_ "GenSigTimeoutTime_BSM2" SG_ 2654339139 CurrentFailSts_FD03_DTCM 0;
BA_ "GenSigTimeoutTime_CADM2" SG_ 2654339139 CurrentFailSts_FD03_DTCM 0;
BA_ "GenSigTimeoutTime_CVADAS" SG_ 2654339139 CurrentFailSts_FD03_DTCM 0;
BA_ "GenSigTimeoutTime_EPS" SG_ 2654339139 CurrentFailSts_FD03_DTCM 0;
BA_ "GenSigTimeoutTime_ORC" SG_ 2654339139 CurrentFailSts_FD03_DTCM 0;
BA_ "GenSigTimeoutTime_PAM" SG_ 2654339139 CurrentFailSts_FD03_DTCM 0;
BA_ "GenSigTimeoutTime_SGW" SG_ 2654339139 CurrentFailSts_FD03_DTCM 0;
BA_ "GenSigTimeoutTime_TRSKM" SG_ 2654339139 CurrentFailSts_FD03_DTCM 0;
BA_ "GenSigTimeoutTime_BCM" SG_ 2654339139 DES_FD03_DTCM 0;
BA_ "GenSigTimeoutTime_BSM2" SG_ 2654339139 DES_FD03_DTCM 0;
BA_ "GenSigTimeoutTime_CADM2" SG_ 2654339139 DES_FD03_DTCM 0;
BA_ "GenSigTimeoutTime_CVADAS" SG_ 2654339139 DES_FD03_DTCM 0;
BA_ "GenSigTimeoutTime_EPS" SG_ 2654339139 DES_FD03_DTCM 0;
BA_ "GenSigTimeoutTime_ORC" SG_ 2654339139 DES_FD03_DTCM 0;
BA_ "GenSigTimeoutTime_PAM" SG_ 2654339139 DES_FD03_DTCM 0;
BA_ "GenSigTimeoutTime_SGW" SG_ 2654339139 DES_FD03_DTCM 0;
BA_ "GenSigTimeoutTime_TRSKM" SG_ 2654339139 DES_FD03_DTCM 0;
BA_ "GenSigTimeoutTime_BCM" SG_ 2654339139 EOL_FD03_DTCM 0;
BA_ "GenSigTimeoutTime_BSM2" SG_ 2654339139 EOL_FD03_DTCM 0;
BA_ "GenSigTimeoutTime_CADM2" SG_ 2654339139 EOL_FD03_DTCM 0;
BA_ "GenSigTimeoutTime_CVADAS" SG_ 2654339139 EOL_FD03_DTCM 0;
BA_ "GenSigTimeoutTime_EPS" SG_ 2654339139 EOL_FD03_DTCM 0;
BA_ "GenSigTimeoutTime_ORC" SG_ 2654339139 EOL_FD03_DTCM 0;
BA_ "GenSigTimeoutTime_PAM" SG_ 2654339139 EOL_FD03_DTCM 0;
BA_ "GenSigTimeoutTime_SGW" SG_ 2654339139 EOL_FD03_DTCM 0;
BA_ "GenSigTimeoutTime_TRSKM" SG_ 2654339139 EOL_FD03_DTCM 0;
BA_ "GenSigTimeoutTime_BCM" SG_ 2654339139 GenericFailSts_FD03_DTCM 0;
BA_ "GenSigTimeoutTime_BSM2" SG_ 2654339139 GenericFailSts_FD03_DTCM 0;
BA_ "GenSigTimeoutTime_CADM2" SG_ 2654339139 GenericFailSts_FD03_DTCM 0;
BA_ "GenSigTimeoutTime_CVADAS" SG_ 2654339139 GenericFailSts_FD03_DTCM 0;
BA_ "GenSigTimeoutTime_EPS" SG_ 2654339139 GenericFailSts_FD03_DTCM 0;
BA_ "GenSigTimeoutTime_ORC" SG_ 2654339139 GenericFailSts_FD03_DTCM 0;
BA_ "GenSigTimeoutTime_PAM" SG_ 2654339139 GenericFailSts_FD03_DTCM 0;
BA_ "GenSigTimeoutTime_SGW" SG_ 2654339139 GenericFailSts_FD03_DTCM 0;
BA_ "GenSigTimeoutTime_TRSKM" SG_ 2654339139 GenericFailSts_FD03_DTCM 0;
BA_ "GenSigTimeoutTime_BCM" SG_ 2654339139 PreviousCanNMState_FD03_DTCM 0;
BA_ "GenSigTimeoutTime_BSM2" SG_ 2654339139 PreviousCanNMState_FD03_DTCM 0;
BA_ "GenSigTimeoutTime_CADM2" SG_ 2654339139 PreviousCanNMState_FD03_DTCM 0;
BA_ "GenSigTimeoutTime_CVADAS" SG_ 2654339139 PreviousCanNMState_FD03_DTCM 0;
BA_ "GenSigTimeoutTime_EPS" SG_ 2654339139 PreviousCanNMState_FD03_DTCM 0;
BA_ "GenSigTimeoutTime_ORC" SG_ 2654339139 PreviousCanNMState_FD03_DTCM 0;
BA_ "GenSigTimeoutTime_PAM" SG_ 2654339139 PreviousCanNMState_FD03_DTCM 0;
BA_ "GenSigTimeoutTime_SGW" SG_ 2654339139 PreviousCanNMState_FD03_DTCM 0;
BA_ "GenSigTimeoutTime_TRSKM" SG_ 2654339139 PreviousCanNMState_FD03_DTCM 0;
BA_ "GenSigTimeoutTime_BCM" SG_ 2654339139 StayActiveSource_FD03_DTCM 0;
BA_ "GenSigTimeoutTime_BSM2" SG_ 2654339139 StayActiveSource_FD03_DTCM 0;
BA_ "GenSigTimeoutTime_CADM2" SG_ 2654339139 StayActiveSource_FD03_DTCM 0;
BA_ "GenSigTimeoutTime_CVADAS" SG_ 2654339139 StayActiveSource_FD03_DTCM 0;
BA_ "GenSigTimeoutTime_EPS" SG_ 2654339139 StayActiveSource_FD03_DTCM 0;
BA_ "GenSigTimeoutTime_ORC" SG_ 2654339139 StayActiveSource_FD03_DTCM 0;
BA_ "GenSigTimeoutTime_PAM" SG_ 2654339139 StayActiveSource_FD03_DTCM 0;
BA_ "GenSigTimeoutTime_SGW" SG_ 2654339139 StayActiveSource_FD03_DTCM 0;
BA_ "GenSigTimeoutTime_TRSKM" SG_ 2654339139 StayActiveSource_FD03_DTCM 0;
BA_ "GenSigTimeoutTime_BCM" SG_ 2654339139 WakeupSource_FD03_DTCM 0;
BA_ "GenSigTimeoutTime_BSM2" SG_ 2654339139 WakeupSource_FD03_DTCM 0;
BA_ "GenSigTimeoutTime_CADM2" SG_ 2654339139 WakeupSource_FD03_DTCM 0;
BA_ "GenSigTimeoutTime_CVADAS" SG_ 2654339139 WakeupSource_FD03_DTCM 0;
BA_ "GenSigTimeoutTime_EPS" SG_ 2654339139 WakeupSource_FD03_DTCM 0;
BA_ "GenSigTimeoutTime_ORC" SG_ 2654339139 WakeupSource_FD03_DTCM 0;
BA_ "GenSigTimeoutTime_PAM" SG_ 2654339139 WakeupSource_FD03_DTCM 0;
BA_ "GenSigTimeoutTime_SGW" SG_ 2654339139 WakeupSource_FD03_DTCM 0;
BA_ "GenSigTimeoutTime_TRSKM" SG_ 2654339139 WakeupSource_FD03_DTCM 0;
BA_ "GenSigTimeoutTime_BCM" SG_ 2654339073 CurrentCanNMState_FD03_ECM 0;
BA_ "GenSigTimeoutTime_BSM2" SG_ 2654339073 CurrentCanNMState_FD03_ECM 0;
BA_ "GenSigTimeoutTime_CADM2" SG_ 2654339073 CurrentCanNMState_FD03_ECM 0;
BA_ "GenSigTimeoutTime_CVADAS" SG_ 2654339073 CurrentCanNMState_FD03_ECM 0;
BA_ "GenSigTimeoutTime_EPS" SG_ 2654339073 CurrentCanNMState_FD03_ECM 0;
BA_ "GenSigTimeoutTime_ORC" SG_ 2654339073 CurrentCanNMState_FD03_ECM 0;
BA_ "GenSigTimeoutTime_PAM" SG_ 2654339073 CurrentCanNMState_FD03_ECM 0;
BA_ "GenSigTimeoutTime_SGW" SG_ 2654339073 CurrentCanNMState_FD03_ECM 0;
BA_ "GenSigTimeoutTime_TRSKM" SG_ 2654339073 CurrentCanNMState_FD03_ECM 0;
BA_ "GenSigTimeoutTime_BCM" SG_ 2654339073 CurrentFailSts_FD03_ECM 0;
BA_ "GenSigTimeoutTime_BSM2" SG_ 2654339073 CurrentFailSts_FD03_ECM 0;
BA_ "GenSigTimeoutTime_CADM2" SG_ 2654339073 CurrentFailSts_FD03_ECM 0;
BA_ "GenSigTimeoutTime_CVADAS" SG_ 2654339073 CurrentFailSts_FD03_ECM 0;
BA_ "GenSigTimeoutTime_EPS" SG_ 2654339073 CurrentFailSts_FD03_ECM 0;
BA_ "GenSigTimeoutTime_ORC" SG_ 2654339073 CurrentFailSts_FD03_ECM 0;
BA_ "GenSigTimeoutTime_PAM" SG_ 2654339073 CurrentFailSts_FD03_ECM 0;
BA_ "GenSigTimeoutTime_SGW" SG_ 2654339073 CurrentFailSts_FD03_ECM 0;
BA_ "GenSigTimeoutTime_TRSKM" SG_ 2654339073 CurrentFailSts_FD03_ECM 0;
BA_ "GenSigTimeoutTime_BCM" SG_ 2654339073 DES_FD03_ECM 0;
BA_ "GenSigTimeoutTime_BSM2" SG_ 2654339073 DES_FD03_ECM 0;
BA_ "GenSigTimeoutTime_CADM2" SG_ 2654339073 DES_FD03_ECM 0;
BA_ "GenSigTimeoutTime_CVADAS" SG_ 2654339073 DES_FD03_ECM 0;
BA_ "GenSigTimeoutTime_EPS" SG_ 2654339073 DES_FD03_ECM 0;
BA_ "GenSigTimeoutTime_ORC" SG_ 2654339073 DES_FD03_ECM 0;
BA_ "GenSigTimeoutTime_PAM" SG_ 2654339073 DES_FD03_ECM 0;
BA_ "GenSigTimeoutTime_SGW" SG_ 2654339073 DES_FD03_ECM 0;
BA_ "GenSigTimeoutTime_TRSKM" SG_ 2654339073 DES_FD03_ECM 0;
BA_ "GenSigTimeoutTime_BCM" SG_ 2654339073 EOL_FD03_ECM 0;
BA_ "GenSigTimeoutTime_BSM2" SG_ 2654339073 EOL_FD03_ECM 0;
BA_ "GenSigTimeoutTime_CADM2" SG_ 2654339073 EOL_FD03_ECM 0;
BA_ "GenSigTimeoutTime_CVADAS" SG_ 2654339073 EOL_FD03_ECM 0;
BA_ "GenSigTimeoutTime_EPS" SG_ 2654339073 EOL_FD03_ECM 0;
BA_ "GenSigTimeoutTime_ORC" SG_ 2654339073 EOL_FD03_ECM 0;
BA_ "GenSigTimeoutTime_PAM" SG_ 2654339073 EOL_FD03_ECM 0;
BA_ "GenSigTimeoutTime_SGW" SG_ 2654339073 EOL_FD03_ECM 0;
BA_ "GenSigTimeoutTime_TRSKM" SG_ 2654339073 EOL_FD03_ECM 0;
BA_ "GenSigTimeoutTime_BCM" SG_ 2654339073 GenericFailSts_FD03_ECM 0;
BA_ "GenSigTimeoutTime_BSM2" SG_ 2654339073 GenericFailSts_FD03_ECM 0;
BA_ "GenSigTimeoutTime_CADM2" SG_ 2654339073 GenericFailSts_FD03_ECM 0;
BA_ "GenSigTimeoutTime_CVADAS" SG_ 2654339073 GenericFailSts_FD03_ECM 0;
BA_ "GenSigTimeoutTime_EPS" SG_ 2654339073 GenericFailSts_FD03_ECM 0;
BA_ "GenSigTimeoutTime_ORC" SG_ 2654339073 GenericFailSts_FD03_ECM 0;
BA_ "GenSigTimeoutTime_PAM" SG_ 2654339073 GenericFailSts_FD03_ECM 0;
BA_ "GenSigTimeoutTime_SGW" SG_ 2654339073 GenericFailSts_FD03_ECM 0;
BA_ "GenSigTimeoutTime_TRSKM" SG_ 2654339073 GenericFailSts_FD03_ECM 0;
BA_ "GenSigTimeoutTime_BCM" SG_ 2654339073 PreviousCanNMState_FD03_ECM 0;
BA_ "GenSigTimeoutTime_BSM2" SG_ 2654339073 PreviousCanNMState_FD03_ECM 0;
BA_ "GenSigTimeoutTime_CADM2" SG_ 2654339073 PreviousCanNMState_FD03_ECM 0;
BA_ "GenSigTimeoutTime_CVADAS" SG_ 2654339073 PreviousCanNMState_FD03_ECM 0;
BA_ "GenSigTimeoutTime_EPS" SG_ 2654339073 PreviousCanNMState_FD03_ECM 0;
BA_ "GenSigTimeoutTime_ORC" SG_ 2654339073 PreviousCanNMState_FD03_ECM 0;
BA_ "GenSigTimeoutTime_PAM" SG_ 2654339073 PreviousCanNMState_FD03_ECM 0;
BA_ "GenSigTimeoutTime_SGW" SG_ 2654339073 PreviousCanNMState_FD03_ECM 0;
BA_ "GenSigTimeoutTime_TRSKM" SG_ 2654339073 PreviousCanNMState_FD03_ECM 0;
BA_ "GenSigTimeoutTime_BCM" SG_ 2654339073 StayActiveSource_FD03_ECM 0;
BA_ "GenSigTimeoutTime_BSM2" SG_ 2654339073 StayActiveSource_FD03_ECM 0;
BA_ "GenSigTimeoutTime_CADM2" SG_ 2654339073 StayActiveSource_FD03_ECM 0;
BA_ "GenSigTimeoutTime_CVADAS" SG_ 2654339073 StayActiveSource_FD03_ECM 0;
BA_ "GenSigTimeoutTime_EPS" SG_ 2654339073 StayActiveSource_FD03_ECM 0;
BA_ "GenSigTimeoutTime_ORC" SG_ 2654339073 StayActiveSource_FD03_ECM 0;
BA_ "GenSigTimeoutTime_PAM" SG_ 2654339073 StayActiveSource_FD03_ECM 0;
BA_ "GenSigTimeoutTime_SGW" SG_ 2654339073 StayActiveSource_FD03_ECM 0;
BA_ "GenSigTimeoutTime_TRSKM" SG_ 2654339073 StayActiveSource_FD03_ECM 0;
BA_ "GenSigTimeoutTime_BCM" SG_ 2654339073 WakeupSource_FD03_ECM 0;
BA_ "GenSigTimeoutTime_BSM2" SG_ 2654339073 WakeupSource_FD03_ECM 0;
BA_ "GenSigTimeoutTime_CADM2" SG_ 2654339073 WakeupSource_FD03_ECM 0;
BA_ "GenSigTimeoutTime_CVADAS" SG_ 2654339073 WakeupSource_FD03_ECM 0;
BA_ "GenSigTimeoutTime_EPS" SG_ 2654339073 WakeupSource_FD03_ECM 0;
BA_ "GenSigTimeoutTime_ORC" SG_ 2654339073 WakeupSource_FD03_ECM 0;
BA_ "GenSigTimeoutTime_PAM" SG_ 2654339073 WakeupSource_FD03_ECM 0;
BA_ "GenSigTimeoutTime_SGW" SG_ 2654339073 WakeupSource_FD03_ECM 0;
BA_ "GenSigTimeoutTime_TRSKM" SG_ 2654339073 WakeupSource_FD03_ECM 0;
BA_ "GenSigTimeoutTime_EPS" SG_ 2654339074 CurrentCanNMState_FD02_EPS 0;
BA_ "GenSigTimeoutTime_EPS" SG_ 2654339074 CurrentFailSts_FD02_EPS 0;
BA_ "GenSigTimeoutTime_EPS" SG_ 2654339074 DES_FD02_EPS 0;
BA_ "GenSigTimeoutTime_EPS" SG_ 2654339074 EOL_FD02_EPS 0;
BA_ "GenSigTimeoutTime_EPS" SG_ 2654339074 GenericFailSts_FD02_EPS 0;
BA_ "GenSigTimeoutTime_EPS" SG_ 2654339074 PreviousCanNMState_FD02_EPS 0;
BA_ "GenSigTimeoutTime_EPS" SG_ 2654339074 StayActiveSource_FD02_EPS 0;
BA_ "GenSigTimeoutTime_EPS" SG_ 2654339074 WakeupSource_FD02_EPS 0;
BA_ "GenSigTimeoutTime_BCM" SG_ 2654339108 CurrentCanNMState_FD08_ETM 0;
BA_ "GenSigTimeoutTime_BSM2" SG_ 2654339108 CurrentCanNMState_FD08_ETM 0;
BA_ "GenSigTimeoutTime_CADM2" SG_ 2654339108 CurrentCanNMState_FD08_ETM 0;
BA_ "GenSigTimeoutTime_CVADAS" SG_ 2654339108 CurrentCanNMState_FD08_ETM 0;
BA_ "GenSigTimeoutTime_EPS" SG_ 2654339108 CurrentCanNMState_FD08_ETM 0;
BA_ "GenSigTimeoutTime_ORC" SG_ 2654339108 CurrentCanNMState_FD08_ETM 0;
BA_ "GenSigTimeoutTime_PAM" SG_ 2654339108 CurrentCanNMState_FD08_ETM 0;
BA_ "GenSigTimeoutTime_SGW" SG_ 2654339108 CurrentCanNMState_FD08_ETM 0;
BA_ "GenSigTimeoutTime_TRSKM" SG_ 2654339108 CurrentCanNMState_FD08_ETM 0;
BA_ "GenSigTimeoutTime_BCM" SG_ 2654339108 CurrentFailSts_FD08_ETM 0;
BA_ "GenSigTimeoutTime_BSM2" SG_ 2654339108 CurrentFailSts_FD08_ETM 0;
BA_ "GenSigTimeoutTime_CADM2" SG_ 2654339108 CurrentFailSts_FD08_ETM 0;
BA_ "GenSigTimeoutTime_CVADAS" SG_ 2654339108 CurrentFailSts_FD08_ETM 0;
BA_ "GenSigTimeoutTime_EPS" SG_ 2654339108 CurrentFailSts_FD08_ETM 0;
BA_ "GenSigTimeoutTime_ORC" SG_ 2654339108 CurrentFailSts_FD08_ETM 0;
BA_ "GenSigTimeoutTime_PAM" SG_ 2654339108 CurrentFailSts_FD08_ETM 0;
BA_ "GenSigTimeoutTime_SGW" SG_ 2654339108 CurrentFailSts_FD08_ETM 0;
BA_ "GenSigTimeoutTime_TRSKM" SG_ 2654339108 CurrentFailSts_FD08_ETM 0;
BA_ "GenSigTimeoutTime_BCM" SG_ 2654339108 DES_FD08_ETM 0;
BA_ "GenSigTimeoutTime_BSM2" SG_ 2654339108 DES_FD08_ETM 0;
BA_ "GenSigTimeoutTime_CADM2" SG_ 2654339108 DES_FD08_ETM 0;
BA_ "GenSigTimeoutTime_CVADAS" SG_ 2654339108 DES_FD08_ETM 0;
BA_ "GenSigTimeoutTime_EPS" SG_ 2654339108 DES_FD08_ETM 0;
BA_ "GenSigTimeoutTime_ORC" SG_ 2654339108 DES_FD08_ETM 0;
BA_ "GenSigTimeoutTime_PAM" SG_ 2654339108 DES_FD08_ETM 0;
BA_ "GenSigTimeoutTime_SGW" SG_ 2654339108 DES_FD08_ETM 0;
BA_ "GenSigTimeoutTime_TRSKM" SG_ 2654339108 DES_FD08_ETM 0;
BA_ "GenSigTimeoutTime_BCM" SG_ 2654339108 EOL_FD08_ETM 0;
BA_ "GenSigTimeoutTime_BSM2" SG_ 2654339108 EOL_FD08_ETM 0;
BA_ "GenSigTimeoutTime_CADM2" SG_ 2654339108 EOL_FD08_ETM 0;
BA_ "GenSigTimeoutTime_CVADAS" SG_ 2654339108 EOL_FD08_ETM 0;
BA_ "GenSigTimeoutTime_EPS" SG_ 2654339108 EOL_FD08_ETM 0;
BA_ "GenSigTimeoutTime_ORC" SG_ 2654339108 EOL_FD08_ETM 0;
BA_ "GenSigTimeoutTime_PAM" SG_ 2654339108 EOL_FD08_ETM 0;
BA_ "GenSigTimeoutTime_SGW" SG_ 2654339108 EOL_FD08_ETM 0;
BA_ "GenSigTimeoutTime_TRSKM" SG_ 2654339108 EOL_FD08_ETM 0;
BA_ "GenSigTimeoutTime_BCM" SG_ 2654339108 GenericFailSts_FD08_ETM 0;
BA_ "GenSigTimeoutTime_BSM2" SG_ 2654339108 GenericFailSts_FD08_ETM 0;
BA_ "GenSigTimeoutTime_CADM2" SG_ 2654339108 GenericFailSts_FD08_ETM 0;
BA_ "GenSigTimeoutTime_CVADAS" SG_ 2654339108 GenericFailSts_FD08_ETM 0;
BA_ "GenSigTimeoutTime_EPS" SG_ 2654339108 GenericFailSts_FD08_ETM 0;
BA_ "GenSigTimeoutTime_ORC" SG_ 2654339108 GenericFailSts_FD08_ETM 0;
BA_ "GenSigTimeoutTime_PAM" SG_ 2654339108 GenericFailSts_FD08_ETM 0;
BA_ "GenSigTimeoutTime_SGW" SG_ 2654339108 GenericFailSts_FD08_ETM 0;
BA_ "GenSigTimeoutTime_TRSKM" SG_ 2654339108 GenericFailSts_FD08_ETM 0;
BA_ "GenSigTimeoutTime_BCM" SG_ 2654339108 PreviousCanNMState_FD08_ETM 0;
BA_ "GenSigTimeoutTime_BSM2" SG_ 2654339108 PreviousCanNMState_FD08_ETM 0;
BA_ "GenSigTimeoutTime_CADM2" SG_ 2654339108 PreviousCanNMState_FD08_ETM 0;
BA_ "GenSigTimeoutTime_CVADAS" SG_ 2654339108 PreviousCanNMState_FD08_ETM 0;
BA_ "GenSigTimeoutTime_EPS" SG_ 2654339108 PreviousCanNMState_FD08_ETM 0;
BA_ "GenSigTimeoutTime_ORC" SG_ 2654339108 PreviousCanNMState_FD08_ETM 0;
BA_ "GenSigTimeoutTime_PAM" SG_ 2654339108 PreviousCanNMState_FD08_ETM 0;
BA_ "GenSigTimeoutTime_SGW" SG_ 2654339108 PreviousCanNMState_FD08_ETM 0;
BA_ "GenSigTimeoutTime_TRSKM" SG_ 2654339108 PreviousCanNMState_FD08_ETM 0;
BA_ "GenSigTimeoutTime_BCM" SG_ 2654339108 StayActiveSource_FD08_ETM 0;
BA_ "GenSigTimeoutTime_BSM2" SG_ 2654339108 StayActiveSource_FD08_ETM 0;
BA_ "GenSigTimeoutTime_CADM2" SG_ 2654339108 StayActiveSource_FD08_ETM 0;
BA_ "GenSigTimeoutTime_CVADAS" SG_ 2654339108 StayActiveSource_FD08_ETM 0;
BA_ "GenSigTimeoutTime_EPS" SG_ 2654339108 StayActiveSource_FD08_ETM 0;
BA_ "GenSigTimeoutTime_ORC" SG_ 2654339108 StayActiveSource_FD08_ETM 0;
BA_ "GenSigTimeoutTime_PAM" SG_ 2654339108 StayActiveSource_FD08_ETM 0;
BA_ "GenSigTimeoutTime_SGW" SG_ 2654339108 StayActiveSource_FD08_ETM 0;
BA_ "GenSigTimeoutTime_TRSKM" SG_ 2654339108 StayActiveSource_FD08_ETM 0;
BA_ "GenSigTimeoutTime_BCM" SG_ 2654339108 WakeupSource_FD08_ETM 0;
BA_ "GenSigTimeoutTime_BSM2" SG_ 2654339108 WakeupSource_FD08_ETM 0;
BA_ "GenSigTimeoutTime_CADM2" SG_ 2654339108 WakeupSource_FD08_ETM 0;
BA_ "GenSigTimeoutTime_CVADAS" SG_ 2654339108 WakeupSource_FD08_ETM 0;
BA_ "GenSigTimeoutTime_EPS" SG_ 2654339108 WakeupSource_FD08_ETM 0;
BA_ "GenSigTimeoutTime_ORC" SG_ 2654339108 WakeupSource_FD08_ETM 0;
BA_ "GenSigTimeoutTime_PAM" SG_ 2654339108 WakeupSource_FD08_ETM 0;
BA_ "GenSigTimeoutTime_SGW" SG_ 2654339108 WakeupSource_FD08_ETM 0;
BA_ "GenSigTimeoutTime_TRSKM" SG_ 2654339108 WakeupSource_FD08_ETM 0;
BA_ "GenSigTimeoutTime_BCM" SG_ 2654339256 CurrentCanNMState_FD09_FLDHM 0;
BA_ "GenSigTimeoutTime_BSM2" SG_ 2654339256 CurrentCanNMState_FD09_FLDHM 0;
BA_ "GenSigTimeoutTime_CADM2" SG_ 2654339256 CurrentCanNMState_FD09_FLDHM 0;
BA_ "GenSigTimeoutTime_CVADAS" SG_ 2654339256 CurrentCanNMState_FD09_FLDHM 0;
BA_ "GenSigTimeoutTime_EPS" SG_ 2654339256 CurrentCanNMState_FD09_FLDHM 0;
BA_ "GenSigTimeoutTime_ORC" SG_ 2654339256 CurrentCanNMState_FD09_FLDHM 0;
BA_ "GenSigTimeoutTime_PAM" SG_ 2654339256 CurrentCanNMState_FD09_FLDHM 0;
BA_ "GenSigTimeoutTime_SGW" SG_ 2654339256 CurrentCanNMState_FD09_FLDHM 0;
BA_ "GenSigTimeoutTime_TRSKM" SG_ 2654339256 CurrentCanNMState_FD09_FLDHM 0;
BA_ "GenSigTimeoutTime_BCM" SG_ 2654339256 CurrentFailSts_FD09_FLDHM 0;
BA_ "GenSigTimeoutTime_BSM2" SG_ 2654339256 CurrentFailSts_FD09_FLDHM 0;
BA_ "GenSigTimeoutTime_CADM2" SG_ 2654339256 CurrentFailSts_FD09_FLDHM 0;
BA_ "GenSigTimeoutTime_CVADAS" SG_ 2654339256 CurrentFailSts_FD09_FLDHM 0;
BA_ "GenSigTimeoutTime_EPS" SG_ 2654339256 CurrentFailSts_FD09_FLDHM 0;
BA_ "GenSigTimeoutTime_ORC" SG_ 2654339256 CurrentFailSts_FD09_FLDHM 0;
BA_ "GenSigTimeoutTime_PAM" SG_ 2654339256 CurrentFailSts_FD09_FLDHM 0;
BA_ "GenSigTimeoutTime_SGW" SG_ 2654339256 CurrentFailSts_FD09_FLDHM 0;
BA_ "GenSigTimeoutTime_TRSKM" SG_ 2654339256 CurrentFailSts_FD09_FLDHM 0;
BA_ "GenSigTimeoutTime_BCM" SG_ 2654339256 DES_FD09_FLDHM 0;
BA_ "GenSigTimeoutTime_BSM2" SG_ 2654339256 DES_FD09_FLDHM 0;
BA_ "GenSigTimeoutTime_CADM2" SG_ 2654339256 DES_FD09_FLDHM 0;
BA_ "GenSigTimeoutTime_CVADAS" SG_ 2654339256 DES_FD09_FLDHM 0;
BA_ "GenSigTimeoutTime_EPS" SG_ 2654339256 DES_FD09_FLDHM 0;
BA_ "GenSigTimeoutTime_ORC" SG_ 2654339256 DES_FD09_FLDHM 0;
BA_ "GenSigTimeoutTime_PAM" SG_ 2654339256 DES_FD09_FLDHM 0;
BA_ "GenSigTimeoutTime_SGW" SG_ 2654339256 DES_FD09_FLDHM 0;
BA_ "GenSigTimeoutTime_TRSKM" SG_ 2654339256 DES_FD09_FLDHM 0;
BA_ "GenSigTimeoutTime_BCM" SG_ 2654339256 EOL_FD09_FLDHM 0;
BA_ "GenSigTimeoutTime_BSM2" SG_ 2654339256 EOL_FD09_FLDHM 0;
BA_ "GenSigTimeoutTime_CADM2" SG_ 2654339256 EOL_FD09_FLDHM 0;
BA_ "GenSigTimeoutTime_CVADAS" SG_ 2654339256 EOL_FD09_FLDHM 0;
BA_ "GenSigTimeoutTime_EPS" SG_ 2654339256 EOL_FD09_FLDHM 0;
BA_ "GenSigTimeoutTime_ORC" SG_ 2654339256 EOL_FD09_FLDHM 0;
BA_ "GenSigTimeoutTime_PAM" SG_ 2654339256 EOL_FD09_FLDHM 0;
BA_ "GenSigTimeoutTime_SGW" SG_ 2654339256 EOL_FD09_FLDHM 0;
BA_ "GenSigTimeoutTime_TRSKM" SG_ 2654339256 EOL_FD09_FLDHM 0;
BA_ "GenSigTimeoutTime_BCM" SG_ 2654339256 GenericFailSts_FD09_FLDHM 0;
BA_ "GenSigTimeoutTime_BSM2" SG_ 2654339256 GenericFailSts_FD09_FLDHM 0;
BA_ "GenSigTimeoutTime_CADM2" SG_ 2654339256 GenericFailSts_FD09_FLDHM 0;
BA_ "GenSigTimeoutTime_CVADAS" SG_ 2654339256 GenericFailSts_FD09_FLDHM 0;
BA_ "GenSigTimeoutTime_EPS" SG_ 2654339256 GenericFailSts_FD09_FLDHM 0;
BA_ "GenSigTimeoutTime_ORC" SG_ 2654339256 GenericFailSts_FD09_FLDHM 0;
BA_ "GenSigTimeoutTime_PAM" SG_ 2654339256 GenericFailSts_FD09_FLDHM 0;
BA_ "GenSigTimeoutTime_SGW" SG_ 2654339256 GenericFailSts_FD09_FLDHM 0;
BA_ "GenSigTimeoutTime_TRSKM" SG_ 2654339256 GenericFailSts_FD09_FLDHM 0;
BA_ "GenSigTimeoutTime_BCM" SG_ 2654339256 PreviousCanNMState_FD09_FLDHM 0;
BA_ "GenSigTimeoutTime_BSM2" SG_ 2654339256 PreviousCanNMState_FD09_FLDHM 0;
BA_ "GenSigTimeoutTime_CADM2" SG_ 2654339256 PreviousCanNMState_FD09_FLDHM 0;
BA_ "GenSigTimeoutTime_CVADAS" SG_ 2654339256 PreviousCanNMState_FD09_FLDHM 0;
BA_ "GenSigTimeoutTime_EPS" SG_ 2654339256 PreviousCanNMState_FD09_FLDHM 0;
BA_ "GenSigTimeoutTime_ORC" SG_ 2654339256 PreviousCanNMState_FD09_FLDHM 0;
BA_ "GenSigTimeoutTime_PAM" SG_ 2654339256 PreviousCanNMState_FD09_FLDHM 0;
BA_ "GenSigTimeoutTime_SGW" SG_ 2654339256 PreviousCanNMState_FD09_FLDHM 0;
BA_ "GenSigTimeoutTime_TRSKM" SG_ 2654339256 PreviousCanNMState_FD09_FLDHM 0;
BA_ "GenSigTimeoutTime_BCM" SG_ 2654339256 StayActiveSource_FD09_FLDHM 0;
BA_ "GenSigTimeoutTime_BSM2" SG_ 2654339256 StayActiveSource_FD09_FLDHM 0;
BA_ "GenSigTimeoutTime_CADM2" SG_ 2654339256 StayActiveSource_FD09_FLDHM 0;
BA_ "GenSigTimeoutTime_CVADAS" SG_ 2654339256 StayActiveSource_FD09_FLDHM 0;
BA_ "GenSigTimeoutTime_EPS" SG_ 2654339256 StayActiveSource_FD09_FLDHM 0;
BA_ "GenSigTimeoutTime_ORC" SG_ 2654339256 StayActiveSource_FD09_FLDHM 0;
BA_ "GenSigTimeoutTime_PAM" SG_ 2654339256 StayActiveSource_FD09_FLDHM 0;
BA_ "GenSigTimeoutTime_SGW" SG_ 2654339256 StayActiveSource_FD09_FLDHM 0;
BA_ "GenSigTimeoutTime_TRSKM" SG_ 2654339256 StayActiveSource_FD09_FLDHM 0;
BA_ "GenSigTimeoutTime_BCM" SG_ 2654339256 WakeupSource_FD09_FLDHM 0;
BA_ "GenSigTimeoutTime_BSM2" SG_ 2654339256 WakeupSource_FD09_FLDHM 0;
BA_ "GenSigTimeoutTime_CADM2" SG_ 2654339256 WakeupSource_FD09_FLDHM 0;
BA_ "GenSigTimeoutTime_CVADAS" SG_ 2654339256 WakeupSource_FD09_FLDHM 0;
BA_ "GenSigTimeoutTime_EPS" SG_ 2654339256 WakeupSource_FD09_FLDHM 0;
BA_ "GenSigTimeoutTime_ORC" SG_ 2654339256 WakeupSource_FD09_FLDHM 0;
BA_ "GenSigTimeoutTime_PAM" SG_ 2654339256 WakeupSource_FD09_FLDHM 0;
BA_ "GenSigTimeoutTime_SGW" SG_ 2654339256 WakeupSource_FD09_FLDHM 0;
BA_ "GenSigTimeoutTime_TRSKM" SG_ 2654339256 WakeupSource_FD09_FLDHM 0;
BA_ "GenSigTimeoutTime_BCM" SG_ 2654339255 CurrentCanNMState_FD09_FRDHM 0;
BA_ "GenSigTimeoutTime_BSM2" SG_ 2654339255 CurrentCanNMState_FD09_FRDHM 0;
BA_ "GenSigTimeoutTime_CADM2" SG_ 2654339255 CurrentCanNMState_FD09_FRDHM 0;
BA_ "GenSigTimeoutTime_CVADAS" SG_ 2654339255 CurrentCanNMState_FD09_FRDHM 0;
BA_ "GenSigTimeoutTime_EPS" SG_ 2654339255 CurrentCanNMState_FD09_FRDHM 0;
BA_ "GenSigTimeoutTime_ORC" SG_ 2654339255 CurrentCanNMState_FD09_FRDHM 0;
BA_ "GenSigTimeoutTime_PAM" SG_ 2654339255 CurrentCanNMState_FD09_FRDHM 0;
BA_ "GenSigTimeoutTime_SGW" SG_ 2654339255 CurrentCanNMState_FD09_FRDHM 0;
BA_ "GenSigTimeoutTime_TRSKM" SG_ 2654339255 CurrentCanNMState_FD09_FRDHM 0;
BA_ "GenSigTimeoutTime_BCM" SG_ 2654339255 CurrentFailSts_FD09_FRDHM 0;
BA_ "GenSigTimeoutTime_BSM2" SG_ 2654339255 CurrentFailSts_FD09_FRDHM 0;
BA_ "GenSigTimeoutTime_CADM2" SG_ 2654339255 CurrentFailSts_FD09_FRDHM 0;
BA_ "GenSigTimeoutTime_CVADAS" SG_ 2654339255 CurrentFailSts_FD09_FRDHM 0;
BA_ "GenSigTimeoutTime_EPS" SG_ 2654339255 CurrentFailSts_FD09_FRDHM 0;
BA_ "GenSigTimeoutTime_ORC" SG_ 2654339255 CurrentFailSts_FD09_FRDHM 0;
BA_ "GenSigTimeoutTime_PAM" SG_ 2654339255 CurrentFailSts_FD09_FRDHM 0;
BA_ "GenSigTimeoutTime_SGW" SG_ 2654339255 CurrentFailSts_FD09_FRDHM 0;
BA_ "GenSigTimeoutTime_TRSKM" SG_ 2654339255 CurrentFailSts_FD09_FRDHM 0;
BA_ "GenSigTimeoutTime_BCM" SG_ 2654339255 DES_FD09_FRDHM 0;
BA_ "GenSigTimeoutTime_BSM2" SG_ 2654339255 DES_FD09_FRDHM 0;
BA_ "GenSigTimeoutTime_CADM2" SG_ 2654339255 DES_FD09_FRDHM 0;
BA_ "GenSigTimeoutTime_CVADAS" SG_ 2654339255 DES_FD09_FRDHM 0;
BA_ "GenSigTimeoutTime_EPS" SG_ 2654339255 DES_FD09_FRDHM 0;
BA_ "GenSigTimeoutTime_ORC" SG_ 2654339255 DES_FD09_FRDHM 0;
BA_ "GenSigTimeoutTime_PAM" SG_ 2654339255 DES_FD09_FRDHM 0;
BA_ "GenSigTimeoutTime_SGW" SG_ 2654339255 DES_FD09_FRDHM 0;
BA_ "GenSigTimeoutTime_TRSKM" SG_ 2654339255 DES_FD09_FRDHM 0;
BA_ "GenSigTimeoutTime_BCM" SG_ 2654339255 EOL_FD09_FRDHM 0;
BA_ "GenSigTimeoutTime_BSM2" SG_ 2654339255 EOL_FD09_FRDHM 0;
BA_ "GenSigTimeoutTime_CADM2" SG_ 2654339255 EOL_FD09_FRDHM 0;
BA_ "GenSigTimeoutTime_CVADAS" SG_ 2654339255 EOL_FD09_FRDHM 0;
BA_ "GenSigTimeoutTime_EPS" SG_ 2654339255 EOL_FD09_FRDHM 0;
BA_ "GenSigTimeoutTime_ORC" SG_ 2654339255 EOL_FD09_FRDHM 0;
BA_ "GenSigTimeoutTime_PAM" SG_ 2654339255 EOL_FD09_FRDHM 0;
BA_ "GenSigTimeoutTime_SGW" SG_ 2654339255 EOL_FD09_FRDHM 0;
BA_ "GenSigTimeoutTime_TRSKM" SG_ 2654339255 EOL_FD09_FRDHM 0;
BA_ "GenSigTimeoutTime_BCM" SG_ 2654339255 GenericFailSts_FD09_FRDHM 0;
BA_ "GenSigTimeoutTime_BSM2" SG_ 2654339255 GenericFailSts_FD09_FRDHM 0;
BA_ "GenSigTimeoutTime_CADM2" SG_ 2654339255 GenericFailSts_FD09_FRDHM 0;
BA_ "GenSigTimeoutTime_CVADAS" SG_ 2654339255 GenericFailSts_FD09_FRDHM 0;
BA_ "GenSigTimeoutTime_EPS" SG_ 2654339255 GenericFailSts_FD09_FRDHM 0;
BA_ "GenSigTimeoutTime_ORC" SG_ 2654339255 GenericFailSts_FD09_FRDHM 0;
BA_ "GenSigTimeoutTime_PAM" SG_ 2654339255 GenericFailSts_FD09_FRDHM 0;
BA_ "GenSigTimeoutTime_SGW" SG_ 2654339255 GenericFailSts_FD09_FRDHM 0;
BA_ "GenSigTimeoutTime_TRSKM" SG_ 2654339255 GenericFailSts_FD09_FRDHM 0;
BA_ "GenSigTimeoutTime_BCM" SG_ 2654339255 PreviousCanNMState_FD09_FRDHM 0;
BA_ "GenSigTimeoutTime_BSM2" SG_ 2654339255 PreviousCanNMState_FD09_FRDHM 0;
BA_ "GenSigTimeoutTime_CADM2" SG_ 2654339255 PreviousCanNMState_FD09_FRDHM 0;
BA_ "GenSigTimeoutTime_CVADAS" SG_ 2654339255 PreviousCanNMState_FD09_FRDHM 0;
BA_ "GenSigTimeoutTime_EPS" SG_ 2654339255 PreviousCanNMState_FD09_FRDHM 0;
BA_ "GenSigTimeoutTime_ORC" SG_ 2654339255 PreviousCanNMState_FD09_FRDHM 0;
BA_ "GenSigTimeoutTime_PAM" SG_ 2654339255 PreviousCanNMState_FD09_FRDHM 0;
BA_ "GenSigTimeoutTime_SGW" SG_ 2654339255 PreviousCanNMState_FD09_FRDHM 0;
BA_ "GenSigTimeoutTime_TRSKM" SG_ 2654339255 PreviousCanNMState_FD09_FRDHM 0;
BA_ "GenSigTimeoutTime_BCM" SG_ 2654339255 StayActiveSource_FD09_FRDHM 0;
BA_ "GenSigTimeoutTime_BSM2" SG_ 2654339255 StayActiveSource_FD09_FRDHM 0;
BA_ "GenSigTimeoutTime_CADM2" SG_ 2654339255 StayActiveSource_FD09_FRDHM 0;
BA_ "GenSigTimeoutTime_CVADAS" SG_ 2654339255 StayActiveSource_FD09_FRDHM 0;
BA_ "GenSigTimeoutTime_EPS" SG_ 2654339255 StayActiveSource_FD09_FRDHM 0;
BA_ "GenSigTimeoutTime_ORC" SG_ 2654339255 StayActiveSource_FD09_FRDHM 0;
BA_ "GenSigTimeoutTime_PAM" SG_ 2654339255 StayActiveSource_FD09_FRDHM 0;
BA_ "GenSigTimeoutTime_SGW" SG_ 2654339255 StayActiveSource_FD09_FRDHM 0;
BA_ "GenSigTimeoutTime_TRSKM" SG_ 2654339255 StayActiveSource_FD09_FRDHM 0;
BA_ "GenSigTimeoutTime_BCM" SG_ 2654339255 WakeupSource_FD09_FRDHM 0;
BA_ "GenSigTimeoutTime_BSM2" SG_ 2654339255 WakeupSource_FD09_FRDHM 0;
BA_ "GenSigTimeoutTime_CADM2" SG_ 2654339255 WakeupSource_FD09_FRDHM 0;
BA_ "GenSigTimeoutTime_CVADAS" SG_ 2654339255 WakeupSource_FD09_FRDHM 0;
BA_ "GenSigTimeoutTime_EPS" SG_ 2654339255 WakeupSource_FD09_FRDHM 0;
BA_ "GenSigTimeoutTime_ORC" SG_ 2654339255 WakeupSource_FD09_FRDHM 0;
BA_ "GenSigTimeoutTime_PAM" SG_ 2654339255 WakeupSource_FD09_FRDHM 0;
BA_ "GenSigTimeoutTime_SGW" SG_ 2654339255 WakeupSource_FD09_FRDHM 0;
BA_ "GenSigTimeoutTime_TRSKM" SG_ 2654339255 WakeupSource_FD09_FRDHM 0;
BA_ "GenSigTimeoutTime_BCM" SG_ 2654339216 CurrentCanNMState_FD03_GNMM 0;
BA_ "GenSigTimeoutTime_BSM2" SG_ 2654339216 CurrentCanNMState_FD03_GNMM 0;
BA_ "GenSigTimeoutTime_CADM2" SG_ 2654339216 CurrentCanNMState_FD03_GNMM 0;
BA_ "GenSigTimeoutTime_CVADAS" SG_ 2654339216 CurrentCanNMState_FD03_GNMM 0;
BA_ "GenSigTimeoutTime_EPS" SG_ 2654339216 CurrentCanNMState_FD03_GNMM 0;
BA_ "GenSigTimeoutTime_ORC" SG_ 2654339216 CurrentCanNMState_FD03_GNMM 0;
BA_ "GenSigTimeoutTime_PAM" SG_ 2654339216 CurrentCanNMState_FD03_GNMM 0;
BA_ "GenSigTimeoutTime_SGW" SG_ 2654339216 CurrentCanNMState_FD03_GNMM 0;
BA_ "GenSigTimeoutTime_TRSKM" SG_ 2654339216 CurrentCanNMState_FD03_GNMM 0;
BA_ "GenSigTimeoutTime_BCM" SG_ 2654339216 CurrentFailSts_FD03_GNMM 0;
BA_ "GenSigTimeoutTime_BSM2" SG_ 2654339216 CurrentFailSts_FD03_GNMM 0;
BA_ "GenSigTimeoutTime_CADM2" SG_ 2654339216 CurrentFailSts_FD03_GNMM 0;
BA_ "GenSigTimeoutTime_CVADAS" SG_ 2654339216 CurrentFailSts_FD03_GNMM 0;
BA_ "GenSigTimeoutTime_EPS" SG_ 2654339216 CurrentFailSts_FD03_GNMM 0;
BA_ "GenSigTimeoutTime_ORC" SG_ 2654339216 CurrentFailSts_FD03_GNMM 0;
BA_ "GenSigTimeoutTime_PAM" SG_ 2654339216 CurrentFailSts_FD03_GNMM 0;
BA_ "GenSigTimeoutTime_SGW" SG_ 2654339216 CurrentFailSts_FD03_GNMM 0;
BA_ "GenSigTimeoutTime_TRSKM" SG_ 2654339216 CurrentFailSts_FD03_GNMM 0;
BA_ "GenSigTimeoutTime_BCM" SG_ 2654339216 DES_FD03_GNMM 0;
BA_ "GenSigTimeoutTime_BSM2" SG_ 2654339216 DES_FD03_GNMM 0;
BA_ "GenSigTimeoutTime_CADM2" SG_ 2654339216 DES_FD03_GNMM 0;
BA_ "GenSigTimeoutTime_CVADAS" SG_ 2654339216 DES_FD03_GNMM 0;
BA_ "GenSigTimeoutTime_EPS" SG_ 2654339216 DES_FD03_GNMM 0;
BA_ "GenSigTimeoutTime_ORC" SG_ 2654339216 DES_FD03_GNMM 0;
BA_ "GenSigTimeoutTime_PAM" SG_ 2654339216 DES_FD03_GNMM 0;
BA_ "GenSigTimeoutTime_SGW" SG_ 2654339216 DES_FD03_GNMM 0;
BA_ "GenSigTimeoutTime_TRSKM" SG_ 2654339216 DES_FD03_GNMM 0;
BA_ "GenSigTimeoutTime_BCM" SG_ 2654339216 EOL_FD03_GNMM 0;
BA_ "GenSigTimeoutTime_BSM2" SG_ 2654339216 EOL_FD03_GNMM 0;
BA_ "GenSigTimeoutTime_CADM2" SG_ 2654339216 EOL_FD03_GNMM 0;
BA_ "GenSigTimeoutTime_CVADAS" SG_ 2654339216 EOL_FD03_GNMM 0;
BA_ "GenSigTimeoutTime_EPS" SG_ 2654339216 EOL_FD03_GNMM 0;
BA_ "GenSigTimeoutTime_ORC" SG_ 2654339216 EOL_FD03_GNMM 0;
BA_ "GenSigTimeoutTime_PAM" SG_ 2654339216 EOL_FD03_GNMM 0;
BA_ "GenSigTimeoutTime_SGW" SG_ 2654339216 EOL_FD03_GNMM 0;
BA_ "GenSigTimeoutTime_TRSKM" SG_ 2654339216 EOL_FD03_GNMM 0;
BA_ "GenSigTimeoutTime_BCM" SG_ 2654339216 GenericFailSts_FD03_GNMM 0;
BA_ "GenSigTimeoutTime_BSM2" SG_ 2654339216 GenericFailSts_FD03_GNMM 0;
BA_ "GenSigTimeoutTime_CADM2" SG_ 2654339216 GenericFailSts_FD03_GNMM 0;
BA_ "GenSigTimeoutTime_CVADAS" SG_ 2654339216 GenericFailSts_FD03_GNMM 0;
BA_ "GenSigTimeoutTime_EPS" SG_ 2654339216 GenericFailSts_FD03_GNMM 0;
BA_ "GenSigTimeoutTime_ORC" SG_ 2654339216 GenericFailSts_FD03_GNMM 0;
BA_ "GenSigTimeoutTime_PAM" SG_ 2654339216 GenericFailSts_FD03_GNMM 0;
BA_ "GenSigTimeoutTime_SGW" SG_ 2654339216 GenericFailSts_FD03_GNMM 0;
BA_ "GenSigTimeoutTime_TRSKM" SG_ 2654339216 GenericFailSts_FD03_GNMM 0;
BA_ "GenSigTimeoutTime_BCM" SG_ 2654339216 PreviousCanNMState_FD03_GNMM 0;
BA_ "GenSigTimeoutTime_BSM2" SG_ 2654339216 PreviousCanNMState_FD03_GNMM 0;
BA_ "GenSigTimeoutTime_CADM2" SG_ 2654339216 PreviousCanNMState_FD03_GNMM 0;
BA_ "GenSigTimeoutTime_CVADAS" SG_ 2654339216 PreviousCanNMState_FD03_GNMM 0;
BA_ "GenSigTimeoutTime_EPS" SG_ 2654339216 PreviousCanNMState_FD03_GNMM 0;
BA_ "GenSigTimeoutTime_ORC" SG_ 2654339216 PreviousCanNMState_FD03_GNMM 0;
BA_ "GenSigTimeoutTime_PAM" SG_ 2654339216 PreviousCanNMState_FD03_GNMM 0;
BA_ "GenSigTimeoutTime_SGW" SG_ 2654339216 PreviousCanNMState_FD03_GNMM 0;
BA_ "GenSigTimeoutTime_TRSKM" SG_ 2654339216 PreviousCanNMState_FD03_GNMM 0;
BA_ "GenSigTimeoutTime_BCM" SG_ 2654339216 StayActiveSource_FD03_GNMM 0;
BA_ "GenSigTimeoutTime_BSM2" SG_ 2654339216 StayActiveSource_FD03_GNMM 0;
BA_ "GenSigTimeoutTime_CADM2" SG_ 2654339216 StayActiveSource_FD03_GNMM 0;
BA_ "GenSigTimeoutTime_CVADAS" SG_ 2654339216 StayActiveSource_FD03_GNMM 0;
BA_ "GenSigTimeoutTime_EPS" SG_ 2654339216 StayActiveSource_FD03_GNMM 0;
BA_ "GenSigTimeoutTime_ORC" SG_ 2654339216 StayActiveSource_FD03_GNMM 0;
BA_ "GenSigTimeoutTime_PAM" SG_ 2654339216 StayActiveSource_FD03_GNMM 0;
BA_ "GenSigTimeoutTime_SGW" SG_ 2654339216 StayActiveSource_FD03_GNMM 0;
BA_ "GenSigTimeoutTime_TRSKM" SG_ 2654339216 StayActiveSource_FD03_GNMM 0;
BA_ "GenSigTimeoutTime_BCM" SG_ 2654339216 WakeupSource_FD03_GNMM 0;
BA_ "GenSigTimeoutTime_BSM2" SG_ 2654339216 WakeupSource_FD03_GNMM 0;
BA_ "GenSigTimeoutTime_CADM2" SG_ 2654339216 WakeupSource_FD03_GNMM 0;
BA_ "GenSigTimeoutTime_CVADAS" SG_ 2654339216 WakeupSource_FD03_GNMM 0;
BA_ "GenSigTimeoutTime_EPS" SG_ 2654339216 WakeupSource_FD03_GNMM 0;
BA_ "GenSigTimeoutTime_ORC" SG_ 2654339216 WakeupSource_FD03_GNMM 0;
BA_ "GenSigTimeoutTime_PAM" SG_ 2654339216 WakeupSource_FD03_GNMM 0;
BA_ "GenSigTimeoutTime_SGW" SG_ 2654339216 WakeupSource_FD03_GNMM 0;
BA_ "GenSigTimeoutTime_TRSKM" SG_ 2654339216 WakeupSource_FD03_GNMM 0;
BA_ "GenSigTimeoutTime_BCM" SG_ 2654339170 CurrentCanNMState_FD03_HCP 0;
BA_ "GenSigTimeoutTime_BSM2" SG_ 2654339170 CurrentCanNMState_FD03_HCP 0;
BA_ "GenSigTimeoutTime_CADM2" SG_ 2654339170 CurrentCanNMState_FD03_HCP 0;
BA_ "GenSigTimeoutTime_CVADAS" SG_ 2654339170 CurrentCanNMState_FD03_HCP 0;
BA_ "GenSigTimeoutTime_EPS" SG_ 2654339170 CurrentCanNMState_FD03_HCP 0;
BA_ "GenSigTimeoutTime_ORC" SG_ 2654339170 CurrentCanNMState_FD03_HCP 0;
BA_ "GenSigTimeoutTime_PAM" SG_ 2654339170 CurrentCanNMState_FD03_HCP 0;
BA_ "GenSigTimeoutTime_SGW" SG_ 2654339170 CurrentCanNMState_FD03_HCP 0;
BA_ "GenSigTimeoutTime_TRSKM" SG_ 2654339170 CurrentCanNMState_FD03_HCP 0;
BA_ "GenSigTimeoutTime_BCM" SG_ 2654339170 CurrentFailSts_FD03_HCP 0;
BA_ "GenSigTimeoutTime_BSM2" SG_ 2654339170 CurrentFailSts_FD03_HCP 0;
BA_ "GenSigTimeoutTime_CADM2" SG_ 2654339170 CurrentFailSts_FD03_HCP 0;
BA_ "GenSigTimeoutTime_CVADAS" SG_ 2654339170 CurrentFailSts_FD03_HCP 0;
BA_ "GenSigTimeoutTime_EPS" SG_ 2654339170 CurrentFailSts_FD03_HCP 0;
BA_ "GenSigTimeoutTime_ORC" SG_ 2654339170 CurrentFailSts_FD03_HCP 0;
BA_ "GenSigTimeoutTime_PAM" SG_ 2654339170 CurrentFailSts_FD03_HCP 0;
BA_ "GenSigTimeoutTime_SGW" SG_ 2654339170 CurrentFailSts_FD03_HCP 0;
BA_ "GenSigTimeoutTime_TRSKM" SG_ 2654339170 CurrentFailSts_FD03_HCP 0;
BA_ "GenSigTimeoutTime_BCM" SG_ 2654339170 DES_FD03_HCP 0;
BA_ "GenSigTimeoutTime_BSM2" SG_ 2654339170 DES_FD03_HCP 0;
BA_ "GenSigTimeoutTime_CADM2" SG_ 2654339170 DES_FD03_HCP 0;
BA_ "GenSigTimeoutTime_CVADAS" SG_ 2654339170 DES_FD03_HCP 0;
BA_ "GenSigTimeoutTime_EPS" SG_ 2654339170 DES_FD03_HCP 0;
BA_ "GenSigTimeoutTime_ORC" SG_ 2654339170 DES_FD03_HCP 0;
BA_ "GenSigTimeoutTime_PAM" SG_ 2654339170 DES_FD03_HCP 0;
BA_ "GenSigTimeoutTime_SGW" SG_ 2654339170 DES_FD03_HCP 0;
BA_ "GenSigTimeoutTime_TRSKM" SG_ 2654339170 DES_FD03_HCP 0;
BA_ "GenSigTimeoutTime_BCM" SG_ 2654339170 EOL_FD03_HCP 0;
BA_ "GenSigTimeoutTime_BSM2" SG_ 2654339170 EOL_FD03_HCP 0;
BA_ "GenSigTimeoutTime_CADM2" SG_ 2654339170 EOL_FD03_HCP 0;
BA_ "GenSigTimeoutTime_CVADAS" SG_ 2654339170 EOL_FD03_HCP 0;
BA_ "GenSigTimeoutTime_EPS" SG_ 2654339170 EOL_FD03_HCP 0;
BA_ "GenSigTimeoutTime_ORC" SG_ 2654339170 EOL_FD03_HCP 0;
BA_ "GenSigTimeoutTime_PAM" SG_ 2654339170 EOL_FD03_HCP 0;
BA_ "GenSigTimeoutTime_SGW" SG_ 2654339170 EOL_FD03_HCP 0;
BA_ "GenSigTimeoutTime_TRSKM" SG_ 2654339170 EOL_FD03_HCP 0;
BA_ "GenSigTimeoutTime_BCM" SG_ 2654339170 GenericFailSts_FD03_HCP 0;
BA_ "GenSigTimeoutTime_BSM2" SG_ 2654339170 GenericFailSts_FD03_HCP 0;
BA_ "GenSigTimeoutTime_CADM2" SG_ 2654339170 GenericFailSts_FD03_HCP 0;
BA_ "GenSigTimeoutTime_CVADAS" SG_ 2654339170 GenericFailSts_FD03_HCP 0;
BA_ "GenSigTimeoutTime_EPS" SG_ 2654339170 GenericFailSts_FD03_HCP 0;
BA_ "GenSigTimeoutTime_ORC" SG_ 2654339170 GenericFailSts_FD03_HCP 0;
BA_ "GenSigTimeoutTime_PAM" SG_ 2654339170 GenericFailSts_FD03_HCP 0;
BA_ "GenSigTimeoutTime_SGW" SG_ 2654339170 GenericFailSts_FD03_HCP 0;
BA_ "GenSigTimeoutTime_TRSKM" SG_ 2654339170 GenericFailSts_FD03_HCP 0;
BA_ "GenSigTimeoutTime_BCM" SG_ 2654339170 PreviousCanNMState_FD03_HCP 0;
BA_ "GenSigTimeoutTime_BSM2" SG_ 2654339170 PreviousCanNMState_FD03_HCP 0;
BA_ "GenSigTimeoutTime_CADM2" SG_ 2654339170 PreviousCanNMState_FD03_HCP 0;
BA_ "GenSigTimeoutTime_CVADAS" SG_ 2654339170 PreviousCanNMState_FD03_HCP 0;
BA_ "GenSigTimeoutTime_EPS" SG_ 2654339170 PreviousCanNMState_FD03_HCP 0;
BA_ "GenSigTimeoutTime_ORC" SG_ 2654339170 PreviousCanNMState_FD03_HCP 0;
BA_ "GenSigTimeoutTime_PAM" SG_ 2654339170 PreviousCanNMState_FD03_HCP 0;
BA_ "GenSigTimeoutTime_SGW" SG_ 2654339170 PreviousCanNMState_FD03_HCP 0;
BA_ "GenSigTimeoutTime_TRSKM" SG_ 2654339170 PreviousCanNMState_FD03_HCP 0;
BA_ "GenSigTimeoutTime_BCM" SG_ 2654339170 StayActiveSource_FD03_HCP 0;
BA_ "GenSigTimeoutTime_BSM2" SG_ 2654339170 StayActiveSource_FD03_HCP 0;
BA_ "GenSigTimeoutTime_CADM2" SG_ 2654339170 StayActiveSource_FD03_HCP 0;
BA_ "GenSigTimeoutTime_CVADAS" SG_ 2654339170 StayActiveSource_FD03_HCP 0;
BA_ "GenSigTimeoutTime_EPS" SG_ 2654339170 StayActiveSource_FD03_HCP 0;
BA_ "GenSigTimeoutTime_ORC" SG_ 2654339170 StayActiveSource_FD03_HCP 0;
BA_ "GenSigTimeoutTime_PAM" SG_ 2654339170 StayActiveSource_FD03_HCP 0;
BA_ "GenSigTimeoutTime_SGW" SG_ 2654339170 StayActiveSource_FD03_HCP 0;
BA_ "GenSigTimeoutTime_TRSKM" SG_ 2654339170 StayActiveSource_FD03_HCP 0;
BA_ "GenSigTimeoutTime_BCM" SG_ 2654339170 WakeupSource_FD03_HCP 0;
BA_ "GenSigTimeoutTime_BSM2" SG_ 2654339170 WakeupSource_FD03_HCP 0;
BA_ "GenSigTimeoutTime_CADM2" SG_ 2654339170 WakeupSource_FD03_HCP 0;
BA_ "GenSigTimeoutTime_CVADAS" SG_ 2654339170 WakeupSource_FD03_HCP 0;
BA_ "GenSigTimeoutTime_EPS" SG_ 2654339170 WakeupSource_FD03_HCP 0;
BA_ "GenSigTimeoutTime_ORC" SG_ 2654339170 WakeupSource_FD03_HCP 0;
BA_ "GenSigTimeoutTime_PAM" SG_ 2654339170 WakeupSource_FD03_HCP 0;
BA_ "GenSigTimeoutTime_SGW" SG_ 2654339170 WakeupSource_FD03_HCP 0;
BA_ "GenSigTimeoutTime_TRSKM" SG_ 2654339170 WakeupSource_FD03_HCP 0;
BA_ "GenSigTimeoutTime_BCM" SG_ 2654339075 CurrentCanNMState_FD03_IPC 0;
BA_ "GenSigTimeoutTime_BSM2" SG_ 2654339075 CurrentCanNMState_FD03_IPC 0;
BA_ "GenSigTimeoutTime_CADM2" SG_ 2654339075 CurrentCanNMState_FD03_IPC 0;
BA_ "GenSigTimeoutTime_CVADAS" SG_ 2654339075 CurrentCanNMState_FD03_IPC 0;
BA_ "GenSigTimeoutTime_EPS" SG_ 2654339075 CurrentCanNMState_FD03_IPC 0;
BA_ "GenSigTimeoutTime_ORC" SG_ 2654339075 CurrentCanNMState_FD03_IPC 0;
BA_ "GenSigTimeoutTime_PAM" SG_ 2654339075 CurrentCanNMState_FD03_IPC 0;
BA_ "GenSigTimeoutTime_SGW" SG_ 2654339075 CurrentCanNMState_FD03_IPC 0;
BA_ "GenSigTimeoutTime_TRSKM" SG_ 2654339075 CurrentCanNMState_FD03_IPC 0;
BA_ "GenSigTimeoutTime_BCM" SG_ 2654339075 CurrentFailSts_FD03_IPC 0;
BA_ "GenSigTimeoutTime_BSM2" SG_ 2654339075 CurrentFailSts_FD03_IPC 0;
BA_ "GenSigTimeoutTime_CADM2" SG_ 2654339075 CurrentFailSts_FD03_IPC 0;
BA_ "GenSigTimeoutTime_CVADAS" SG_ 2654339075 CurrentFailSts_FD03_IPC 0;
BA_ "GenSigTimeoutTime_EPS" SG_ 2654339075 CurrentFailSts_FD03_IPC 0;
BA_ "GenSigTimeoutTime_ORC" SG_ 2654339075 CurrentFailSts_FD03_IPC 0;
BA_ "GenSigTimeoutTime_PAM" SG_ 2654339075 CurrentFailSts_FD03_IPC 0;
BA_ "GenSigTimeoutTime_SGW" SG_ 2654339075 CurrentFailSts_FD03_IPC 0;
BA_ "GenSigTimeoutTime_TRSKM" SG_ 2654339075 CurrentFailSts_FD03_IPC 0;
BA_ "GenSigTimeoutTime_BCM" SG_ 2654339075 DES_FD03_IPC 0;
BA_ "GenSigTimeoutTime_BSM2" SG_ 2654339075 DES_FD03_IPC 0;
BA_ "GenSigTimeoutTime_CADM2" SG_ 2654339075 DES_FD03_IPC 0;
BA_ "GenSigTimeoutTime_CVADAS" SG_ 2654339075 DES_FD03_IPC 0;
BA_ "GenSigTimeoutTime_EPS" SG_ 2654339075 DES_FD03_IPC 0;
BA_ "GenSigTimeoutTime_ORC" SG_ 2654339075 DES_FD03_IPC 0;
BA_ "GenSigTimeoutTime_PAM" SG_ 2654339075 DES_FD03_IPC 0;
BA_ "GenSigTimeoutTime_SGW" SG_ 2654339075 DES_FD03_IPC 0;
BA_ "GenSigTimeoutTime_TRSKM" SG_ 2654339075 DES_FD03_IPC 0;
BA_ "GenSigTimeoutTime_BCM" SG_ 2654339075 EOL_FD03_IPC 0;
BA_ "GenSigTimeoutTime_BSM2" SG_ 2654339075 EOL_FD03_IPC 0;
BA_ "GenSigTimeoutTime_CADM2" SG_ 2654339075 EOL_FD03_IPC 0;
BA_ "GenSigTimeoutTime_CVADAS" SG_ 2654339075 EOL_FD03_IPC 0;
BA_ "GenSigTimeoutTime_EPS" SG_ 2654339075 EOL_FD03_IPC 0;
BA_ "GenSigTimeoutTime_ORC" SG_ 2654339075 EOL_FD03_IPC 0;
BA_ "GenSigTimeoutTime_PAM" SG_ 2654339075 EOL_FD03_IPC 0;
BA_ "GenSigTimeoutTime_SGW" SG_ 2654339075 EOL_FD03_IPC 0;
BA_ "GenSigTimeoutTime_TRSKM" SG_ 2654339075 EOL_FD03_IPC 0;
BA_ "GenSigTimeoutTime_BCM" SG_ 2654339075 GenericFailSts_FD03_IPC 0;
BA_ "GenSigTimeoutTime_BSM2" SG_ 2654339075 GenericFailSts_FD03_IPC 0;
BA_ "GenSigTimeoutTime_CADM2" SG_ 2654339075 GenericFailSts_FD03_IPC 0;
BA_ "GenSigTimeoutTime_CVADAS" SG_ 2654339075 GenericFailSts_FD03_IPC 0;
BA_ "GenSigTimeoutTime_EPS" SG_ 2654339075 GenericFailSts_FD03_IPC 0;
BA_ "GenSigTimeoutTime_ORC" SG_ 2654339075 GenericFailSts_FD03_IPC 0;
BA_ "GenSigTimeoutTime_PAM" SG_ 2654339075 GenericFailSts_FD03_IPC 0;
BA_ "GenSigTimeoutTime_SGW" SG_ 2654339075 GenericFailSts_FD03_IPC 0;
BA_ "GenSigTimeoutTime_TRSKM" SG_ 2654339075 GenericFailSts_FD03_IPC 0;
BA_ "GenSigTimeoutTime_BCM" SG_ 2654339075 PreviousCanNMState_FD03_IPC 0;
BA_ "GenSigTimeoutTime_BSM2" SG_ 2654339075 PreviousCanNMState_FD03_IPC 0;
BA_ "GenSigTimeoutTime_CADM2" SG_ 2654339075 PreviousCanNMState_FD03_IPC 0;
BA_ "GenSigTimeoutTime_CVADAS" SG_ 2654339075 PreviousCanNMState_FD03_IPC 0;
BA_ "GenSigTimeoutTime_EPS" SG_ 2654339075 PreviousCanNMState_FD03_IPC 0;
BA_ "GenSigTimeoutTime_ORC" SG_ 2654339075 PreviousCanNMState_FD03_IPC 0;
BA_ "GenSigTimeoutTime_PAM" SG_ 2654339075 PreviousCanNMState_FD03_IPC 0;
BA_ "GenSigTimeoutTime_SGW" SG_ 2654339075 PreviousCanNMState_FD03_IPC 0;
BA_ "GenSigTimeoutTime_TRSKM" SG_ 2654339075 PreviousCanNMState_FD03_IPC 0;
BA_ "GenSigTimeoutTime_BCM" SG_ 2654339075 StayActiveSource_FD03_IPC 0;
BA_ "GenSigTimeoutTime_BSM2" SG_ 2654339075 StayActiveSource_FD03_IPC 0;
BA_ "GenSigTimeoutTime_CADM2" SG_ 2654339075 StayActiveSource_FD03_IPC 0;
BA_ "GenSigTimeoutTime_CVADAS" SG_ 2654339075 StayActiveSource_FD03_IPC 0;
BA_ "GenSigTimeoutTime_EPS" SG_ 2654339075 StayActiveSource_FD03_IPC 0;
BA_ "GenSigTimeoutTime_ORC" SG_ 2654339075 StayActiveSource_FD03_IPC 0;
BA_ "GenSigTimeoutTime_PAM" SG_ 2654339075 StayActiveSource_FD03_IPC 0;
BA_ "GenSigTimeoutTime_SGW" SG_ 2654339075 StayActiveSource_FD03_IPC 0;
BA_ "GenSigTimeoutTime_TRSKM" SG_ 2654339075 StayActiveSource_FD03_IPC 0;
BA_ "GenSigTimeoutTime_BCM" SG_ 2654339075 WakeupSource_FD03_IPC 0;
BA_ "GenSigTimeoutTime_BSM2" SG_ 2654339075 WakeupSource_FD03_IPC 0;
BA_ "GenSigTimeoutTime_CADM2" SG_ 2654339075 WakeupSource_FD03_IPC 0;
BA_ "GenSigTimeoutTime_CVADAS" SG_ 2654339075 WakeupSource_FD03_IPC 0;
BA_ "GenSigTimeoutTime_EPS" SG_ 2654339075 WakeupSource_FD03_IPC 0;
BA_ "GenSigTimeoutTime_ORC" SG_ 2654339075 WakeupSource_FD03_IPC 0;
BA_ "GenSigTimeoutTime_PAM" SG_ 2654339075 WakeupSource_FD03_IPC 0;
BA_ "GenSigTimeoutTime_SGW" SG_ 2654339075 WakeupSource_FD03_IPC 0;
BA_ "GenSigTimeoutTime_TRSKM" SG_ 2654339075 WakeupSource_FD03_IPC 0;
BA_ "GenSigTimeoutTime_ORC" SG_ 2654339098 CurrentCanNMState_FD02_ORC 0;
BA_ "GenSigTimeoutTime_ORC" SG_ 2654339098 CurrentFailSts_FD02_ORC 0;
BA_ "GenSigTimeoutTime_ORC" SG_ 2654339098 DES_FD02_ORC 0;
BA_ "GenSigTimeoutTime_ORC" SG_ 2654339098 EOL_FD02_ORC 0;
BA_ "GenSigTimeoutTime_ORC" SG_ 2654339098 GenericFailSts_FD02_ORC 0;
BA_ "GenSigTimeoutTime_ORC" SG_ 2654339098 PreviousCanNMState_FD02_ORC 0;
BA_ "GenSigTimeoutTime_ORC" SG_ 2654339098 StayActiveSource_FD02_ORC 0;
BA_ "GenSigTimeoutTime_ORC" SG_ 2654339098 WakeupSource_FD02_ORC 0;
BA_ "GenSigTimeoutTime_CVADAS" SG_ 2654339096 CurrentCanNMState_FD02_PAM 0;
BA_ "GenSigTimeoutTime_PAM" SG_ 2654339096 CurrentCanNMState_FD02_PAM 0;
BA_ "GenSigTimeoutTime_CVADAS" SG_ 2654339096 CurrentFailSts_FD02_PAM 0;
BA_ "GenSigTimeoutTime_PAM" SG_ 2654339096 CurrentFailSts_FD02_PAM 0;
BA_ "GenSigTimeoutTime_CVADAS" SG_ 2654339096 DES_FD02_PAM 0;
BA_ "GenSigTimeoutTime_PAM" SG_ 2654339096 DES_FD02_PAM 0;
BA_ "GenSigTimeoutTime_CVADAS" SG_ 2654339096 EOL_FD02_PAM 0;
BA_ "GenSigTimeoutTime_PAM" SG_ 2654339096 EOL_FD02_PAM 0;
BA_ "GenSigTimeoutTime_CVADAS" SG_ 2654339096 GenericFailSts_FD02_PAM 0;
BA_ "GenSigTimeoutTime_PAM" SG_ 2654339096 GenericFailSts_FD02_PAM 0;
BA_ "GenSigTimeoutTime_CVADAS" SG_ 2654339096 PreviousCanNMState_FD02_PAM 0;
BA_ "GenSigTimeoutTime_PAM" SG_ 2654339096 PreviousCanNMState_FD02_PAM 0;
BA_ "GenSigTimeoutTime_CVADAS" SG_ 2654339096 StayActiveSource_FD02_PAM 0;
BA_ "GenSigTimeoutTime_PAM" SG_ 2654339096 StayActiveSource_FD02_PAM 0;
BA_ "GenSigTimeoutTime_CVADAS" SG_ 2654339096 WakeupSource_FD02_PAM 0;
BA_ "GenSigTimeoutTime_PAM" SG_ 2654339096 WakeupSource_FD02_PAM 0;
BA_ "GenSigTimeoutTime_BCM" SG_ 2654339137 CurrentCanNMState_FD03_RFHM 0;
BA_ "GenSigTimeoutTime_BSM2" SG_ 2654339137 CurrentCanNMState_FD03_RFHM 0;
BA_ "GenSigTimeoutTime_CADM2" SG_ 2654339137 CurrentCanNMState_FD03_RFHM 0;
BA_ "GenSigTimeoutTime_CVADAS" SG_ 2654339137 CurrentCanNMState_FD03_RFHM 0;
BA_ "GenSigTimeoutTime_EPS" SG_ 2654339137 CurrentCanNMState_FD03_RFHM 0;
BA_ "GenSigTimeoutTime_ORC" SG_ 2654339137 CurrentCanNMState_FD03_RFHM 0;
BA_ "GenSigTimeoutTime_PAM" SG_ 2654339137 CurrentCanNMState_FD03_RFHM 0;
BA_ "GenSigTimeoutTime_SGW" SG_ 2654339137 CurrentCanNMState_FD03_RFHM 0;
BA_ "GenSigTimeoutTime_TRSKM" SG_ 2654339137 CurrentCanNMState_FD03_RFHM 0;
BA_ "GenSigTimeoutTime_BCM" SG_ 2654339137 CurrentFailSts_FD03_RFHM 0;
BA_ "GenSigTimeoutTime_BSM2" SG_ 2654339137 CurrentFailSts_FD03_RFHM 0;
BA_ "GenSigTimeoutTime_CADM2" SG_ 2654339137 CurrentFailSts_FD03_RFHM 0;
BA_ "GenSigTimeoutTime_CVADAS" SG_ 2654339137 CurrentFailSts_FD03_RFHM 0;
BA_ "GenSigTimeoutTime_EPS" SG_ 2654339137 CurrentFailSts_FD03_RFHM 0;
BA_ "GenSigTimeoutTime_ORC" SG_ 2654339137 CurrentFailSts_FD03_RFHM 0;
BA_ "GenSigTimeoutTime_PAM" SG_ 2654339137 CurrentFailSts_FD03_RFHM 0;
BA_ "GenSigTimeoutTime_SGW" SG_ 2654339137 CurrentFailSts_FD03_RFHM 0;
BA_ "GenSigTimeoutTime_TRSKM" SG_ 2654339137 CurrentFailSts_FD03_RFHM 0;
BA_ "GenSigTimeoutTime_BCM" SG_ 2654339137 DES_FD03_RFHM 0;
BA_ "GenSigTimeoutTime_BSM2" SG_ 2654339137 DES_FD03_RFHM 0;
BA_ "GenSigTimeoutTime_CADM2" SG_ 2654339137 DES_FD03_RFHM 0;
BA_ "GenSigTimeoutTime_CVADAS" SG_ 2654339137 DES_FD03_RFHM 0;
BA_ "GenSigTimeoutTime_EPS" SG_ 2654339137 DES_FD03_RFHM 0;
BA_ "GenSigTimeoutTime_ORC" SG_ 2654339137 DES_FD03_RFHM 0;
BA_ "GenSigTimeoutTime_PAM" SG_ 2654339137 DES_FD03_RFHM 0;
BA_ "GenSigTimeoutTime_SGW" SG_ 2654339137 DES_FD03_RFHM 0;
BA_ "GenSigTimeoutTime_TRSKM" SG_ 2654339137 DES_FD03_RFHM 0;
BA_ "GenSigTimeoutTime_BCM" SG_ 2654339137 EOL_FD03_RFHM 0;
BA_ "GenSigTimeoutTime_BSM2" SG_ 2654339137 EOL_FD03_RFHM 0;
BA_ "GenSigTimeoutTime_CADM2" SG_ 2654339137 EOL_FD03_RFHM 0;
BA_ "GenSigTimeoutTime_CVADAS" SG_ 2654339137 EOL_FD03_RFHM 0;
BA_ "GenSigTimeoutTime_EPS" SG_ 2654339137 EOL_FD03_RFHM 0;
BA_ "GenSigTimeoutTime_ORC" SG_ 2654339137 EOL_FD03_RFHM 0;
BA_ "GenSigTimeoutTime_PAM" SG_ 2654339137 EOL_FD03_RFHM 0;
BA_ "GenSigTimeoutTime_SGW" SG_ 2654339137 EOL_FD03_RFHM 0;
BA_ "GenSigTimeoutTime_TRSKM" SG_ 2654339137 EOL_FD03_RFHM 0;
BA_ "GenSigTimeoutTime_BCM" SG_ 2654339137 GenericFailSts_FD03_RFHM 0;
BA_ "GenSigTimeoutTime_BSM2" SG_ 2654339137 GenericFailSts_FD03_RFHM 0;
BA_ "GenSigTimeoutTime_CADM2" SG_ 2654339137 GenericFailSts_FD03_RFHM 0;
BA_ "GenSigTimeoutTime_CVADAS" SG_ 2654339137 GenericFailSts_FD03_RFHM 0;
BA_ "GenSigTimeoutTime_EPS" SG_ 2654339137 GenericFailSts_FD03_RFHM 0;
BA_ "GenSigTimeoutTime_ORC" SG_ 2654339137 GenericFailSts_FD03_RFHM 0;
BA_ "GenSigTimeoutTime_PAM" SG_ 2654339137 GenericFailSts_FD03_RFHM 0;
BA_ "GenSigTimeoutTime_SGW" SG_ 2654339137 GenericFailSts_FD03_RFHM 0;
BA_ "GenSigTimeoutTime_TRSKM" SG_ 2654339137 GenericFailSts_FD03_RFHM 0;
BA_ "GenSigTimeoutTime_BCM" SG_ 2654339137 PreviousCanNMState_FD03_RFHM 0;
BA_ "GenSigTimeoutTime_BSM2" SG_ 2654339137 PreviousCanNMState_FD03_RFHM 0;
BA_ "GenSigTimeoutTime_CADM2" SG_ 2654339137 PreviousCanNMState_FD03_RFHM 0;
BA_ "GenSigTimeoutTime_CVADAS" SG_ 2654339137 PreviousCanNMState_FD03_RFHM 0;
BA_ "GenSigTimeoutTime_EPS" SG_ 2654339137 PreviousCanNMState_FD03_RFHM 0;
BA_ "GenSigTimeoutTime_ORC" SG_ 2654339137 PreviousCanNMState_FD03_RFHM 0;
BA_ "GenSigTimeoutTime_PAM" SG_ 2654339137 PreviousCanNMState_FD03_RFHM 0;
BA_ "GenSigTimeoutTime_SGW" SG_ 2654339137 PreviousCanNMState_FD03_RFHM 0;
BA_ "GenSigTimeoutTime_TRSKM" SG_ 2654339137 PreviousCanNMState_FD03_RFHM 0;
BA_ "GenSigTimeoutTime_BCM" SG_ 2654339137 StayActiveSource_FD03_RFHM 0;
BA_ "GenSigTimeoutTime_BSM2" SG_ 2654339137 StayActiveSource_FD03_RFHM 0;
BA_ "GenSigTimeoutTime_CADM2" SG_ 2654339137 StayActiveSource_FD03_RFHM 0;
BA_ "GenSigTimeoutTime_CVADAS" SG_ 2654339137 StayActiveSource_FD03_RFHM 0;
BA_ "GenSigTimeoutTime_EPS" SG_ 2654339137 StayActiveSource_FD03_RFHM 0;
BA_ "GenSigTimeoutTime_ORC" SG_ 2654339137 StayActiveSource_FD03_RFHM 0;
BA_ "GenSigTimeoutTime_PAM" SG_ 2654339137 StayActiveSource_FD03_RFHM 0;
BA_ "GenSigTimeoutTime_SGW" SG_ 2654339137 StayActiveSource_FD03_RFHM 0;
BA_ "GenSigTimeoutTime_TRSKM" SG_ 2654339137 StayActiveSource_FD03_RFHM 0;
BA_ "GenSigTimeoutTime_BCM" SG_ 2654339137 WakeupSource_FD03_RFHM 0;
BA_ "GenSigTimeoutTime_BSM2" SG_ 2654339137 WakeupSource_FD03_RFHM 0;
BA_ "GenSigTimeoutTime_CADM2" SG_ 2654339137 WakeupSource_FD03_RFHM 0;
BA_ "GenSigTimeoutTime_CVADAS" SG_ 2654339137 WakeupSource_FD03_RFHM 0;
BA_ "GenSigTimeoutTime_EPS" SG_ 2654339137 WakeupSource_FD03_RFHM 0;
BA_ "GenSigTimeoutTime_ORC" SG_ 2654339137 WakeupSource_FD03_RFHM 0;
BA_ "GenSigTimeoutTime_PAM" SG_ 2654339137 WakeupSource_FD03_RFHM 0;
BA_ "GenSigTimeoutTime_SGW" SG_ 2654339137 WakeupSource_FD03_RFHM 0;
BA_ "GenSigTimeoutTime_TRSKM" SG_ 2654339137 WakeupSource_FD03_RFHM 0;
VAL_ 1954 SBR1RowPsngrSeatPPDSts 0 "ODS_STAT_NOCC" 1 "ODS_STAT_OCC" 2 "ODS_FAULT" 3 "SNA" ;
VAL_ 274 InternalError 0 "No_int_processing_error_detected" 1 "Int_processing_error_detected" ;
VAL_ 274 LatAcceleration 4095 "SNA" ;
VAL_ 274 LatAccelerationFailSts 0 "Fail_Not_Present" 1 "Fail_Present" ;
VAL_ 274 LongAcceleration 4095 "SNA" ;
VAL_ 274 LongAccelerationFailSts 0 "Fail_Not_Present" 1 "Fail_Present" ;
VAL_ 274 YawRate 4095 "SNA" ;
VAL_ 274 YawRate_HR_Sign 0 "Negative" 1 "Positive" ;
VAL_ 274 YawRateFailSts 0 "Fail_Not_Present" 1 "Fail_Present" ;
VAL_ 2654339109 CurrentCanNMState_FD01_ADCM 0 "Uninitialized State" 1 "Bus-Sleep State" 2 "Prepare-Bus State" 3 "Ready-Sleep State" 4 "Normal Operation State" 5 "Repeat Message State" 6 "Synchronize State" 7 "Offline State" ;
VAL_ 2654339109 CurrentFailSts_FD01_ADCM 0 "No_Fail_Present" 1 "Fail_Present" ;
VAL_ 2654339109 DES_FD01_ADCM 0 "Error_Active_state" 1 "Error_passive_warning_state" 2 "Bus_off_state" 3 "Not_used" ;
VAL_ 2654339109 EOL_FD01_ADCM 0 "No_EOL_Programming" 1 "EOL_Programming" ;
VAL_ 2654339109 GenericFailSts_FD01_ADCM 0 "No_Fail_Present" 1 "Fail_Present" ;
VAL_ 2654339109 PreviousCanNMState_FD01_ADCM 0 "Uninitialized State" 1 "Bus-Sleep State" 2 "Prepare-Bus State" 3 "Ready-Sleep State" 4 "Normal Operation State" 5 "Repeat Message State" 6 "Synchronize State" 7 "Offline State" ;
VAL_ 2654339109 WakeupSource_FD01_ADCM 0 "No_Wakeup" ;
VAL_ 2654339094 CurrentCanNMState_FD03_AGSM 0 "Uninitialized State" 1 "Bus-Sleep State" 2 "Prepare-Bus State" 3 "Ready-Sleep State" 4 "Normal Operation State" 5 "Repeat Message State" 6 "Synchronize State" 7 "Offline State" ;
VAL_ 2654339094 CurrentFailSts_FD03_AGSM 0 "No_Fail_Present" 1 "Fail_Present" ;
VAL_ 2654339094 DES_FD03_AGSM 0 "Error_Active_state" 1 "Error_passive_warning_state" 2 "Bus_off_state" 3 "Not_used" ;
VAL_ 2654339094 EOL_FD03_AGSM 0 "No_EOL_Programming" 1 "EOL_Programming" ;
VAL_ 2654339094 GenericFailSts_FD03_AGSM 0 "No_Fail_Present" 1 "Fail_Present" ;
VAL_ 2654339094 PreviousCanNMState_FD03_AGSM 0 "Uninitialized State" 1 "Bus-Sleep State" 2 "Prepare-Bus State" 3 "Ready-Sleep State" 4 "Normal Operation State" 5 "Repeat Message State" 6 "Synchronize State" 7 "Offline State" ;
VAL_ 2654339094 WakeupSource_FD03_AGSM 0 "No_Wakeup" ;
VAL_ 2654339099 CurrentCanNMState_FD01_ASCM 0 "Uninitialized State" 1 "Bus-Sleep State" 2 "Prepare-Bus State" 3 "Ready-Sleep State" 4 "Normal Operation State" 5 "Repeat Message State" 6 "Synchronize State" 7 "Offline State" ;
VAL_ 2654339099 CurrentFailSts_FD01_ASCM 0 "No_Fail_Present" 1 "Fail_Present" ;
VAL_ 2654339099 DES_FD01_ASCM 0 "Error_Active_state" 1 "Error_passive_warning_state" 2 "Bus_off_state" 3 "Not_used" ;
VAL_ 2654339099 EOL_FD01_ASCM 0 "No_EOL_Programming" 1 "EOL_Programming" ;
VAL_ 2654339099 GenericFailSts_FD01_ASCM 0 "No_Fail_Present" 1 "Fail_Present" ;
VAL_ 2654339099 PreviousCanNMState_FD01_ASCM 0 "Uninitialized State" 1 "Bus-Sleep State" 2 "Prepare-Bus State" 3 "Ready-Sleep State" 4 "Normal Operation State" 5 "Repeat Message State" 6 "Synchronize State" 7 "Offline State" ;
VAL_ 2654339099 WakeupSource_FD01_ASCM 0 "No_Wakeup" ;
VAL_ 2654339072 CurrentCanNMState_FD01_BCM 0 "Uninitialized State" 1 "Bus-Sleep State" 2 "Prepare-Bus State" 3 "Ready-Sleep State" 4 "Normal Operation State" 5 "Repeat Message State" 6 "Synchronize State" 7 "Offline State" ;
VAL_ 2654339072 CurrentCanNMState_FD02_BCM 0 "Uninitialized State" 1 "Bus-Sleep State" 2 "Prepare-Bus State" 3 "Ready-Sleep State" 4 "Normal Operation State" 5 "Repeat Message State" 6 "Synchronize State" 7 "Offline State" ;
VAL_ 2654339072 CurrentCanNMState_FD03_BCM 0 "Uninitialized State" 1 "Bus-Sleep State" 2 "Prepare-Bus State" 3 "Ready-Sleep State" 4 "Normal Operation State" 5 "Repeat Message State" 6 "Synchronize State" 7 "Offline State" ;
VAL_ 2654339072 CurrentCanNMState_FD04_BCM 0 "Uninitialized State" 1 "Bus-Sleep State" 2 "Prepare-Bus State" 3 "Ready-Sleep State" 4 "Normal Operation State" 5 "Repeat Message State" 6 "Synchronize State" 7 "Offline State" ;
VAL_ 2654339072 CurrentFailSts_FD01_BCM 0 "No_Fail_Present" 1 "Fail_Present" ;
VAL_ 2654339072 CurrentFailSts_FD02_BCM 0 "No_Fail_Present" 1 "Fail_Present" ;
VAL_ 2654339072 CurrentFailSts_FD03_BCM 0 "No_Fail_Present" 1 "Fail_Present" ;
VAL_ 2654339072 CurrentFailSts_FD04_BCM 0 "No_Fail_Present" 1 "Fail_Present" ;
VAL_ 2654339072 DES_FD01_BCM 0 "Error_Active_state" 1 "Error_passive_warning_state" 2 "Bus_off_state" 3 "Not_used" ;
VAL_ 2654339072 DES_FD02_BCM 0 "Error_Active_state" 1 "Error_passive_warning_state" 2 "Bus_off_state" 3 "Not_used" ;
VAL_ 2654339072 DES_FD03_BCM 0 "Error_Active_state" 1 "Error_passive_warning_state" 2 "Bus_off_state" 3 "Not_used" ;
VAL_ 2654339072 DES_FD04_BCM 0 "Error_Active_state" 1 "Error_passive_warning_state" 2 "Bus_off_state" 3 "Not_used" ;
VAL_ 2654339072 EOL_FD01_BCM 0 "No_EOL_Programming" 1 "EOL_Programming" ;
VAL_ 2654339072 EOL_FD02_BCM 0 "No_EOL_Programming" 1 "EOL_Programming" ;
VAL_ 2654339072 EOL_FD03_BCM 0 "No_EOL_Programming" 1 "EOL_Programming" ;
VAL_ 2654339072 EOL_FD04_BCM 0 "No_EOL_Programming" 1 "EOL_Programming" ;
VAL_ 2654339072 GenericFailSts_FD01_BCM 0 "No_Fail_Present" 1 "Fail_Present" ;
VAL_ 2654339072 GenericFailSts_FD02_BCM 0 "No_Fail_Present" 1 "Fail_Present" ;
VAL_ 2654339072 GenericFailSts_FD03_BCM 0 "No_Fail_Present" 1 "Fail_Present" ;
VAL_ 2654339072 GenericFailSts_FD04_BCM 0 "No_Fail_Present" 1 "Fail_Present" ;
VAL_ 2654339072 PreviousCanNMState_FD01_BCM 0 "Uninitialized State" 1 "Bus-Sleep State" 2 "Prepare-Bus State" 3 "Ready-Sleep State" 4 "Normal Operation State" 5 "Repeat Message State" 6 "Synchronize State" 7 "Offline State" ;
VAL_ 2654339072 PreviousCanNMState_FD02_BCM 0 "Uninitialized State" 1 "Bus-Sleep State" 2 "Prepare-Bus State" 3 "Ready-Sleep State" 4 "Normal Operation State" 5 "Repeat Message State" 6 "Synchronize State" 7 "Offline State" ;
VAL_ 2654339072 PreviousCanNMState_FD03_BCM 0 "Uninitialized State" 1 "Bus-Sleep State" 2 "Prepare-Bus State" 3 "Ready-Sleep State" 4 "Normal Operation State" 5 "Repeat Message State" 6 "Synchronize State" 7 "Offline State" ;
VAL_ 2654339072 PreviousCanNMState_FD04_BCM 0 "Uninitialized State" 1 "Bus-Sleep State" 2 "Prepare-Bus State" 3 "Ready-Sleep State" 4 "Normal Operation State" 5 "Repeat Message State" 6 "Synchronize State" 7 "Offline State" ;
VAL_ 2654339072 StayActiveSource_FD01_BCM 0 "None" 1 "Ignition_Active" 2 "CmdIgnSts_LK_to_ACC_RUN_START" 4 "HazardSwitch_ON" 8 "DrvDoorAjar" 16 "DrvDoor2Ajar" 32 "PsngrDoorAjar" 64 "LR_DoorAjar" 128 "RR_DoorAjar" 256 "TrunkAjar" 512 "BonnetAjar" 1024 "RAPHandle_Req" 2048 "MainLightSelector_Req_OFF" 4096 "HiBmLvr_Stat_HIBM_FLASH_ON_PSD" 8192 "LowBeamSts_SET" 16384 "ParkingLightSts_SET" 32768 "FlashToPass_SET" 65536 "RemStActvSts_Active" 131072 "Fuel_Door_Release_Switch" 262144 "ENGINE_FD_8_RefuelEvent_Pending" 524288 "OHC_1_Front_Int_LG_Sw_1" 1048576 "HFRM_1_RearKick" 2097152 "LeakCheckTimerExpired" 4194304 "Horn_Req_Not_Pressed_to_Pressed" 8388608 "Comfort_Enable_Time_not_0" 16777216 "CmdIgnSts_ACC_RUN_START" 33554432 "ENGINE_FD_8_LeakTestSts_1" 67108864 "Non_Default_Diagnostic_Session" 134217728 "RL_Lk_Sw_LK_RQ_or_UNLK_RQ" 268435456 "RR_Lk_Sw_LK_RQ_or_UNLK_RQ" 536870912 "FD_CAN1" 1073741824 "FD_CAN2" -2147483648 "FD_CAN3" -2147483648 "FD_CAN4" -2147483648 "BH_CAN" -2147483648 "C_CAN1" -2147483648 "EVAP_SWC" -2147483648 "FUEL_DR_REL_SWC" -2147483648 "Other_Software_Factory_Component" ;
VAL_ 2654339072 StayActiveSource_FD02_BCM 0 "None" 1 "Ignition_Active" 2 "CmdIgnSts_LK_to_ACC_RUN_START" 4 "HazardSwitch_ON" 8 "DrvDoorAjar" 16 "DrvDoor2Ajar" 32 "PsngrDoorAjar" 64 "LR_DoorAjar" 128 "RR_DoorAjar" 256 "TrunkAjar" 512 "BonnetAjar" 1024 "RAPHandle_Req" 2048 "MainLightSelector_Req_OFF" 4096 "HiBmLvr_Stat_HIBM_FLASH_ON_PSD" 8192 "LowBeamSts_SET" 16384 "ParkingLightSts_SET" 32768 "FlashToPass_SET" 65536 "RemStActvSts_Active" 131072 "Fuel_Door_Release_Switch" 262144 "ENGINE_FD_8_RefuelEvent_Pending" 524288 "OHC_1_Front_Int_LG_Sw_1" 1048576 "HFRM_1_RearKick" 2097152 "LeakCheckTimerExpired" 4194304 "Horn_Req_Not_Pressed_to_Pressed" 8388608 "Comfort_Enable_Time_not_0" 16777216 "CmdIgnSts_ACC_RUN_START" 33554432 "ENGINE_FD_8_LeakTestSts_1" 67108864 "Non_Default_Diagnostic_Session" 134217728 "RL_Lk_Sw_LK_RQ_or_UNLK_RQ" 268435456 "RR_Lk_Sw_LK_RQ_or_UNLK_RQ" 536870912 "FD_CAN1" 1073741824 "FD_CAN2" -2147483648 "FD_CAN3" -2147483648 "FD_CAN4" -2147483648 "BH_CAN" -2147483648 "C_CAN1" -2147483648 "EVAP_SWC" -2147483648 "FUEL_DR_REL_SWC" -2147483648 "Other_Software_Factory_Component" ;
VAL_ 2654339072 StayActiveSource_FD03_BCM 0 "None" 1 "Ignition_Active" 2 "CmdIgnSts_LK_to_ACC_RUN_START" 4 "HazardSwitch_ON" 8 "DrvDoorAjar" 16 "DrvDoor2Ajar" 32 "PsngrDoorAjar" 64 "LR_DoorAjar" 128 "RR_DoorAjar" 256 "TrunkAjar" 512 "BonnetAjar" 1024 "RAPHandle_Req" 2048 "MainLightSelector_Req_OFF" 4096 "HiBmLvr_Stat_HIBM_FLASH_ON_PSD" 8192 "LowBeamSts_SET" 16384 "ParkingLightSts_SET" 32768 "FlashToPass_SET" 65536 "RemStActvSts_Active" 131072 "Fuel_Door_Release_Switch" 262144 "ENGINE_FD_8_RefuelEvent_Pending" 524288 "OHC_1_Front_Int_LG_Sw_1" 1048576 "HFRM_1_RearKick" 2097152 "LeakCheckTimerExpired" 4194304 "Horn_Req_Not_Pressed_to_Pressed" 8388608 "Comfort_Enable_Time_not_0" 16777216 "CmdIgnSts_ACC_RUN_START" 33554432 "ENGINE_FD_8_LeakTestSts_1" 67108864 "Non_Default_Diagnostic_Session" 134217728 "RL_Lk_Sw_LK_RQ_or_UNLK_RQ" 268435456 "RR_Lk_Sw_LK_RQ_or_UNLK_RQ" 536870912 "FD_CAN1" 1073741824 "FD_CAN2" -2147483648 "FD_CAN3" -2147483648 "FD_CAN4" -2147483648 "BH_CAN" -2147483648 "C_CAN1" -2147483648 "EVAP_SWC" -2147483648 "FUEL_DR_REL_SWC" -2147483648 "Other_Software_Factory_Component" ;
VAL_ 2654339072 StayActiveSource_FD04_BCM 0 "None" 1 "Ignition_Active" 2 "CmdIgnSts_LK_to_ACC_RUN_START" 4 "HazardSwitch_ON" 8 "DrvDoorAjar" 16 "DrvDoor2Ajar" 32 "PsngrDoorAjar" 64 "LR_DoorAjar" 128 "RR_DoorAjar" 256 "TrunkAjar" 512 "BonnetAjar" 1024 "RAPHandle_Req" 2048 "MainLightSelector_Req_OFF" 4096 "HiBmLvr_Stat_HIBM_FLASH_ON_PSD" 8192 "LowBeamSts_SET" 16384 "ParkingLightSts_SET" 32768 "FlashToPass_SET" 65536 "RemStActvSts_Active" 131072 "Fuel_Door_Release_Switch" 262144 "ENGINE_FD_8_RefuelEvent_Pending" 524288 "OHC_1_Front_Int_LG_Sw_1" 1048576 "HFRM_1_RearKick" 2097152 "LeakCheckTimerExpired" 4194304 "Horn_Req_Not_Pressed_to_Pressed" 8388608 "Comfort_Enable_Time_not_0" 16777216 "CmdIgnSts_ACC_RUN_START" 33554432 "ENGINE_FD_8_LeakTestSts_1" 67108864 "Non_Default_Diagnostic_Session" 134217728 "RL_Lk_Sw_LK_RQ_or_UNLK_RQ" 268435456 "RR_Lk_Sw_LK_RQ_or_UNLK_RQ" 536870912 "FD_CAN1" 1073741824 "FD_CAN2" -2147483648 "FD_CAN3" -2147483648 "FD_CAN4" -2147483648 "BH_CAN" -2147483648 "C_CAN1" -2147483648 "EVAP_SWC" -2147483648 "FUEL_DR_REL_SWC" -2147483648 "Other_Software_Factory_Component" ;
VAL_ 2654339072 WakeupSource_FD01_BCM 0 "None" 1 "Ignition_Active" 2 "CmdIgnSts_LK_to_ACC_RUN_START" 3 "HazardSwitch_ON" 4 "DrvDoorAjar" 5 "DrvDoor2Ajar" 6 "PsngrDoorAjar" 7 "LR_DoorAjar" 8 "RR_DoorAjar" 9 "TrunkAjar" 10 "BonnetAjar" 11 "RAPHandle_Req" 12 "MainLightSelector_Req_OFF" 13 "HiBmLvr_Stat_HIBM_FLASH_ON_PSD" 14 "LowBeamSts_SET" 15 "ParkingLightSts_SET" 16 "FlashToPass_SET" 17 "RemStActvSts_Active" 18 "Fuel_Door_Release_Switch" 19 "ENGINE_FD_8_RefuelEvent_Pending" 20 "OHC_1_Front_Int_LG_Sw_1" 21 "HFRM_1_RearKick" 22 "LeakCheckTimerExpired" 23 "Horn_Req_Not Pressed_to_Pressed" 24 "Comfort_Enable_Time_not_0" 25 "CmdIgnSts_ACC_RUN_START" 26 "ENGINE_FD_8_LeakTestSts_1" 27 "Non_Default_Diagnostic_Session" 28 "RL_Lk_Sw_LK_RQ_or_UNLK_RQ" 29 "RR_Lk_Sw_LK_RQ_or_UNLK_RQ" 30 "FD-CAN1" 31 "FD-CAN2" 32 "FD-CAN3" 33 "FD-CAN4" 34 "BH-CAN" 35 "C-CAN1" 36 "EVAP_SWC" 37 "FUEL_DR_REL_SWC" 38 "Other_Software_Factory_Component" 39 "OHC_1_Front_Map_LGT_RT_Sw" 40 "OHC_1_Front_Map_LGT_LT_Sw" 41 "Fog_Lights_Signal " 42 "DOME_ON_OR_DOME_DEFEAT " 43 "Screen_Open_Close_is_pressed" 44 "Diagnostic_Message_Routing_DMR" 45 "Reserved" 46 "Reserved" 47 "Reserved" 48 "Reserved" 49 "Reserved" 50 "Reserved" 51 "Reserved" 52 "Reserved" 53 "Reserved" 54 "Reserved" 55 "Reserved" 56 "Reserved" 57 "Reserved" 58 "Reserved" 59 "Reserved" 60 "Reserved" 61 "Reserved" 62 "Reserved" 63 "Reserved" 64 "Reserved" 65 "Reserved" 66 "Reserved" 67 "Reserved" 68 "Reserved" 69 "Reserved" 70 "Reserved" 71 "Reserved" 72 "Reserved" 73 "Reserved" 74 "Reserved" 75 "Reserved" 76 "Reserved" 77 "Reserved" 78 "Reserved" 79 "Reserved" 80 "Reserved" 81 "Reserved" 82 "Reserved" 83 "Reserved" 84 "Reserved" 85 "Reserved" 86 "Reserved" 87 "Reserved" 88 "Reserved" 89 "Reserved" 90 "Reserved" 91 "Reserved" 92 "Reserved" 93 "Reserved" 94 "Reserved" 95 "Reserved" 96 "Reserved" 97 "Reserved" 98 "Reserved" 99 "Reserved" 100 "Reserved" 101 "Reserved" 102 "Reserved" 103 "Reserved" 104 "Reserved" 105 "Reserved" 106 "Reserved" 107 "Reserved" 108 "Reserved" 109 "Reserved" 110 "Reserved" 111 "Reserved" 112 "Reserved" 113 "Reserved" 114 "Reserved" 115 "Reserved" 116 "Reserved" 117 "Reserved" 118 "Reserved" 119 "Reserved" 120 "Reserved" 121 "Reserved" 122 "Reserved" 123 "Reserved" 124 "Reserved" 125 "Reserved" 126 "Reserved" 127 "Reserved" 128 "Reserved" 129 "FD_CAN1" 130 "FD_CAN2" 131 "FD_CAN3" 132 "FD_CAN4" 133 "FD_CAN5" 134 "FD_CAN6" 135 "FD_CAN7" 136 "FD_CAN8" 137 "FD_CAN9" 138 "FD_CAN10" 139 "FD_CAN11" 140 "FD_CAN12" 141 "FD_CAN13" 142 "FD_CAN14" 143 "FD_CAN15" 144 "FD_CAN16" 145 "FD_CAN17" 146 "FD_CAN18" 147 "FD_CAN19" 148 "FD_CAN20" 149 "FD_CAN21" 150 "FD_CAN22" 151 "FD_CAN23" 152 "FD_CAN24" 153 "FD_CAN25" 154 "FD_CAN26" 155 "FD_CAN27" 156 "FD_CAN28" 157 "FD_CAN29" 158 "FD_CAN30" 159 "FD_CAN31" 160 "BH-CAN" 161 "BH-CAN1" 162 "BH-CAN2" 163 "C-CAN" 164 "C-CAN1" 165 "Reserved" 166 "Reserved" 167 "Reserved" 168 "Reserved" 169 "Reserved" 170 "Reserved" 171 "Reserved" 172 "Reserved" 173 "Reserved" 174 "Reserved" 175 "Reserved" 176 "Reserved" 177 "Reserved" 178 "Reserved" 179 "Reserved" 180 "Reserved" 181 "Reserved" 182 "Reserved" 183 "Reserved" 184 "Reserved" 185 "Reserved" 186 "Reserved" 187 "Reserved" 188 "Reserved" 189 "Reserved" 190 "Reserved" 191 "Reserved" 192 "Reserved" 193 "Reserved" 194 "Reserved" 195 "Reserved" 196 "Reserved" 197 "Reserved" 198 "Reserved" 199 "Reserved" 200 "Reserved" 201 "Reserved" 202 "Reserved" 203 "Reserved" 204 "Reserved" 205 "Reserved" 206 "Reserved" 207 "Reserved" 208 "Reserved" 209 "Reserved" 210 "Reserved" 211 "Reserved" 212 "Reserved" 213 "Reserved" 214 "Reserved" 215 "Reserved" 216 "Reserved" 217 "Reserved" 218 "Reserved" 219 "Reserved" 220 "Reserved" 221 "Reserved" 222 "Reserved" 223 "Reserved" 224 "Reserved" 225 "Reserved" 226 "Reserved" 227 "Reserved" 228 "Reserved" 229 "Reserved" 230 "Reserved" 231 "Reserved" 232 "Reserved" 233 "Reserved" 234 "Reserved" 235 "Reserved" 236 "Reserved" 237 "Reserved" 238 "Reserved" 239 "Reserved" 240 "Reserved" 241 "Reserved" 242 "Reserved" 243 "Reserved" 244 "Reserved" 245 "Reserved" 246 "Reserved" 247 "Reserved" 248 "Reserved" 249 "Reserved" 250 "Reserved" 251 "Reserved" 252 "Reserved" 253 "Reserved" 254 "Reserved" 255 "Reserved" ;
VAL_ 2654339072 WakeupSource_FD02_BCM 0 "None" 1 "Ignition_Active" 2 "CmdIgnSts_LK_to_ACC_RUN_START" 3 "HazardSwitch_ON" 4 "DrvDoorAjar" 5 "DrvDoor2Ajar" 6 "PsngrDoorAjar" 7 "LR_DoorAjar" 8 "RR_DoorAjar" 9 "TrunkAjar" 10 "BonnetAjar" 11 "RAPHandle_Req" 12 "MainLightSelector_Req_OFF" 13 "HiBmLvr_Stat_HIBM_FLASH_ON_PSD" 14 "LowBeamSts_SET" 15 "ParkingLightSts_SET" 16 "FlashToPass_SET" 17 "RemStActvSts_Active" 18 "Fuel_Door_Release_Switch" 19 "ENGINE_FD_8_RefuelEvent_Pending" 20 "OHC_1_Front_Int_LG_Sw_1" 21 "HFRM_1_RearKick" 22 "LeakCheckTimerExpired" 23 "Horn_Req_Not Pressed_to_Pressed" 24 "Comfort_Enable_Time_not_0" 25 "CmdIgnSts_ACC_RUN_START" 26 "ENGINE_FD_8_LeakTestSts_1" 27 "Non_Default_Diagnostic_Session" 28 "RL_Lk_Sw_LK_RQ_or_UNLK_RQ" 29 "RR_Lk_Sw_LK_RQ_or_UNLK_RQ" 30 "FD-CAN1" 31 "FD-CAN2" 32 "FD-CAN3" 33 "FD-CAN4" 34 "BH-CAN" 35 "C-CAN1" 36 "EVAP_SWC" 37 "FUEL_DR_REL_SWC" 38 "Other_Software_Factory_Component" 39 "OHC_1_Front_Map_LGT_RT_Sw" 40 "OHC_1_Front_Map_LGT_LT_Sw" 41 "Fog_Lights_Signal " 42 "DOME_ON_OR_DOME_DEFEAT " 43 "Screen_Open_Close_is_pressed" 44 "Diagnostic_Message_Routing_DMR" 45 "Reserved" 46 "Reserved" 47 "Reserved" 48 "Reserved" 49 "Reserved" 50 "Reserved" 51 "Reserved" 52 "Reserved" 53 "Reserved" 54 "Reserved" 55 "Reserved" 56 "Reserved" 57 "Reserved" 58 "Reserved" 59 "Reserved" 60 "Reserved" 61 "Reserved" 62 "Reserved" 63 "Reserved" 64 "Reserved" 65 "Reserved" 66 "Reserved" 67 "Reserved" 68 "Reserved" 69 "Reserved" 70 "Reserved" 71 "Reserved" 72 "Reserved" 73 "Reserved" 74 "Reserved" 75 "Reserved" 76 "Reserved" 77 "Reserved" 78 "Reserved" 79 "Reserved" 80 "Reserved" 81 "Reserved" 82 "Reserved" 83 "Reserved" 84 "Reserved" 85 "Reserved" 86 "Reserved" 87 "Reserved" 88 "Reserved" 89 "Reserved" 90 "Reserved" 91 "Reserved" 92 "Reserved" 93 "Reserved" 94 "Reserved" 95 "Reserved" 96 "Reserved" 97 "Reserved" 98 "Reserved" 99 "Reserved" 100 "Reserved" 101 "Reserved" 102 "Reserved" 103 "Reserved" 104 "Reserved" 105 "Reserved" 106 "Reserved" 107 "Reserved" 108 "Reserved" 109 "Reserved" 110 "Reserved" 111 "Reserved" 112 "Reserved" 113 "Reserved" 114 "Reserved" 115 "Reserved" 116 "Reserved" 117 "Reserved" 118 "Reserved" 119 "Reserved" 120 "Reserved" 121 "Reserved" 122 "Reserved" 123 "Reserved" 124 "Reserved" 125 "Reserved" 126 "Reserved" 127 "Reserved" 128 "Reserved" 129 "FD_CAN1" 130 "FD_CAN2" 131 "FD_CAN3" 132 "FD_CAN4" 133 "FD_CAN5" 134 "FD_CAN6" 135 "FD_CAN7" 136 "FD_CAN8" 137 "FD_CAN9" 138 "FD_CAN10" 139 "FD_CAN11" 140 "FD_CAN12" 141 "FD_CAN13" 142 "FD_CAN14" 143 "FD_CAN15" 144 "FD_CAN16" 145 "FD_CAN17" 146 "FD_CAN18" 147 "FD_CAN19" 148 "FD_CAN20" 149 "FD_CAN21" 150 "FD_CAN22" 151 "FD_CAN23" 152 "FD_CAN24" 153 "FD_CAN25" 154 "FD_CAN26" 155 "FD_CAN27" 156 "FD_CAN28" 157 "FD_CAN29" 158 "FD_CAN30" 159 "FD_CAN31" 160 "BH-CAN" 161 "BH-CAN1" 162 "BH-CAN2" 163 "C-CAN" 164 "C-CAN1" 165 "Reserved" 166 "Reserved" 167 "Reserved" 168 "Reserved" 169 "Reserved" 170 "Reserved" 171 "Reserved" 172 "Reserved" 173 "Reserved" 174 "Reserved" 175 "Reserved" 176 "Reserved" 177 "Reserved" 178 "Reserved" 179 "Reserved" 180 "Reserved" 181 "Reserved" 182 "Reserved" 183 "Reserved" 184 "Reserved" 185 "Reserved" 186 "Reserved" 187 "Reserved" 188 "Reserved" 189 "Reserved" 190 "Reserved" 191 "Reserved" 192 "Reserved" 193 "Reserved" 194 "Reserved" 195 "Reserved" 196 "Reserved" 197 "Reserved" 198 "Reserved" 199 "Reserved" 200 "Reserved" 201 "Reserved" 202 "Reserved" 203 "Reserved" 204 "Reserved" 205 "Reserved" 206 "Reserved" 207 "Reserved" 208 "Reserved" 209 "Reserved" 210 "Reserved" 211 "Reserved" 212 "Reserved" 213 "Reserved" 214 "Reserved" 215 "Reserved" 216 "Reserved" 217 "Reserved" 218 "Reserved" 219 "Reserved" 220 "Reserved" 221 "Reserved" 222 "Reserved" 223 "Reserved" 224 "Reserved" 225 "Reserved" 226 "Reserved" 227 "Reserved" 228 "Reserved" 229 "Reserved" 230 "Reserved" 231 "Reserved" 232 "Reserved" 233 "Reserved" 234 "Reserved" 235 "Reserved" 236 "Reserved" 237 "Reserved" 238 "Reserved" 239 "Reserved" 240 "Reserved" 241 "Reserved" 242 "Reserved" 243 "Reserved" 244 "Reserved" 245 "Reserved" 246 "Reserved" 247 "Reserved" 248 "Reserved" 249 "Reserved" 250 "Reserved" 251 "Reserved" 252 "Reserved" 253 "Reserved" 254 "Reserved" 255 "Reserved" ;
VAL_ 2654339072 WakeupSource_FD03_BCM 0 "None" 1 "Ignition_Active" 2 "CmdIgnSts_LK_to_ACC_RUN_START" 3 "HazardSwitch_ON" 4 "DrvDoorAjar" 5 "DrvDoor2Ajar" 6 "PsngrDoorAjar" 7 "LR_DoorAjar" 8 "RR_DoorAjar" 9 "TrunkAjar" 10 "BonnetAjar" 11 "RAPHandle_Req" 12 "MainLightSelector_Req_OFF" 13 "HiBmLvr_Stat_HIBM_FLASH_ON_PSD" 14 "LowBeamSts_SET" 15 "ParkingLightSts_SET" 16 "FlashToPass_SET" 17 "RemStActvSts_Active" 18 "Fuel_Door_Release_Switch" 19 "ENGINE_FD_8_RefuelEvent_Pending" 20 "OHC_1_Front_Int_LG_Sw_1" 21 "HFRM_1_RearKick" 22 "LeakCheckTimerExpired" 23 "Horn_Req_Not Pressed_to_Pressed" 24 "Comfort_Enable_Time_not_0" 25 "CmdIgnSts_ACC_RUN_START" 26 "ENGINE_FD_8_LeakTestSts_1" 27 "Non_Default_Diagnostic_Session" 28 "RL_Lk_Sw_LK_RQ_or_UNLK_RQ" 29 "RR_Lk_Sw_LK_RQ_or_UNLK_RQ" 30 "FD-CAN1" 31 "FD-CAN2" 32 "FD-CAN3" 33 "FD-CAN4" 34 "BH-CAN" 35 "C-CAN1" 36 "EVAP_SWC" 37 "FUEL_DR_REL_SWC" 38 "Other_Software_Factory_Component" 39 "OHC_1_Front_Map_LGT_RT_Sw" 40 "OHC_1_Front_Map_LGT_LT_Sw" 41 "Fog_Lights_Signal " 42 "DOME_ON_OR_DOME_DEFEAT " 43 "Screen_Open_Close_is_pressed" 44 "Diagnostic_Message_Routing_DMR" 45 "Reserved" 46 "Reserved" 47 "Reserved" 48 "Reserved" 49 "Reserved" 50 "Reserved" 51 "Reserved" 52 "Reserved" 53 "Reserved" 54 "Reserved" 55 "Reserved" 56 "Reserved" 57 "Reserved" 58 "Reserved" 59 "Reserved" 60 "Reserved" 61 "Reserved" 62 "Reserved" 63 "Reserved" 64 "Reserved" 65 "Reserved" 66 "Reserved" 67 "Reserved" 68 "Reserved" 69 "Reserved" 70 "Reserved" 71 "Reserved" 72 "Reserved" 73 "Reserved" 74 "Reserved" 75 "Reserved" 76 "Reserved" 77 "Reserved" 78 "Reserved" 79 "Reserved" 80 "Reserved" 81 "Reserved" 82 "Reserved" 83 "Reserved" 84 "Reserved" 85 "Reserved" 86 "Reserved" 87 "Reserved" 88 "Reserved" 89 "Reserved" 90 "Reserved" 91 "Reserved" 92 "Reserved" 93 "Reserved" 94 "Reserved" 95 "Reserved" 96 "Reserved" 97 "Reserved" 98 "Reserved" 99 "Reserved" 100 "Reserved" 101 "Reserved" 102 "Reserved" 103 "Reserved" 104 "Reserved" 105 "Reserved" 106 "Reserved" 107 "Reserved" 108 "Reserved" 109 "Reserved" 110 "Reserved" 111 "Reserved" 112 "Reserved" 113 "Reserved" 114 "Reserved" 115 "Reserved" 116 "Reserved" 117 "Reserved" 118 "Reserved" 119 "Reserved" 120 "Reserved" 121 "Reserved" 122 "Reserved" 123 "Reserved" 124 "Reserved" 125 "Reserved" 126 "Reserved" 127 "Reserved" 128 "Reserved" 129 "FD_CAN1" 130 "FD_CAN2" 131 "FD_CAN3" 132 "FD_CAN4" 133 "FD_CAN5" 134 "FD_CAN6" 135 "FD_CAN7" 136 "FD_CAN8" 137 "FD_CAN9" 138 "FD_CAN10" 139 "FD_CAN11" 140 "FD_CAN12" 141 "FD_CAN13" 142 "FD_CAN14" 143 "FD_CAN15" 144 "FD_CAN16" 145 "FD_CAN17" 146 "FD_CAN18" 147 "FD_CAN19" 148 "FD_CAN20" 149 "FD_CAN21" 150 "FD_CAN22" 151 "FD_CAN23" 152 "FD_CAN24" 153 "FD_CAN25" 154 "FD_CAN26" 155 "FD_CAN27" 156 "FD_CAN28" 157 "FD_CAN29" 158 "FD_CAN30" 159 "FD_CAN31" 160 "BH-CAN" 161 "BH-CAN1" 162 "BH-CAN2" 163 "C-CAN" 164 "C-CAN1" 165 "Reserved" 166 "Reserved" 167 "Reserved" 168 "Reserved" 169 "Reserved" 170 "Reserved" 171 "Reserved" 172 "Reserved" 173 "Reserved" 174 "Reserved" 175 "Reserved" 176 "Reserved" 177 "Reserved" 178 "Reserved" 179 "Reserved" 180 "Reserved" 181 "Reserved" 182 "Reserved" 183 "Reserved" 184 "Reserved" 185 "Reserved" 186 "Reserved" 187 "Reserved" 188 "Reserved" 189 "Reserved" 190 "Reserved" 191 "Reserved" 192 "Reserved" 193 "Reserved" 194 "Reserved" 195 "Reserved" 196 "Reserved" 197 "Reserved" 198 "Reserved" 199 "Reserved" 200 "Reserved" 201 "Reserved" 202 "Reserved" 203 "Reserved" 204 "Reserved" 205 "Reserved" 206 "Reserved" 207 "Reserved" 208 "Reserved" 209 "Reserved" 210 "Reserved" 211 "Reserved" 212 "Reserved" 213 "Reserved" 214 "Reserved" 215 "Reserved" 216 "Reserved" 217 "Reserved" 218 "Reserved" 219 "Reserved" 220 "Reserved" 221 "Reserved" 222 "Reserved" 223 "Reserved" 224 "Reserved" 225 "Reserved" 226 "Reserved" 227 "Reserved" 228 "Reserved" 229 "Reserved" 230 "Reserved" 231 "Reserved" 232 "Reserved" 233 "Reserved" 234 "Reserved" 235 "Reserved" 236 "Reserved" 237 "Reserved" 238 "Reserved" 239 "Reserved" 240 "Reserved" 241 "Reserved" 242 "Reserved" 243 "Reserved" 244 "Reserved" 245 "Reserved" 246 "Reserved" 247 "Reserved" 248 "Reserved" 249 "Reserved" 250 "Reserved" 251 "Reserved" 252 "Reserved" 253 "Reserved" 254 "Reserved" 255 "Reserved" ;
VAL_ 2654339072 WakeupSource_FD04_BCM 0 "None" 1 "Ignition_Active" 2 "CmdIgnSts_LK_to_ACC_RUN_START" 3 "HazardSwitch_ON" 4 "DrvDoorAjar" 5 "DrvDoor2Ajar" 6 "PsngrDoorAjar" 7 "LR_DoorAjar" 8 "RR_DoorAjar" 9 "TrunkAjar" 10 "BonnetAjar" 11 "RAPHandle_Req" 12 "MainLightSelector_Req_OFF" 13 "HiBmLvr_Stat_HIBM_FLASH_ON_PSD" 14 "LowBeamSts_SET" 15 "ParkingLightSts_SET" 16 "FlashToPass_SET" 17 "RemStActvSts_Active" 18 "Fuel_Door_Release_Switch" 19 "ENGINE_FD_8_RefuelEvent_Pending" 20 "OHC_1_Front_Int_LG_Sw_1" 21 "HFRM_1_RearKick" 22 "LeakCheckTimerExpired" 23 "Horn_Req_Not Pressed_to_Pressed" 24 "Comfort_Enable_Time_not_0" 25 "CmdIgnSts_ACC_RUN_START" 26 "ENGINE_FD_8_LeakTestSts_1" 27 "Non_Default_Diagnostic_Session" 28 "RL_Lk_Sw_LK_RQ_or_UNLK_RQ" 29 "RR_Lk_Sw_LK_RQ_or_UNLK_RQ" 30 "FD-CAN1" 31 "FD-CAN2" 32 "FD-CAN3" 33 "FD-CAN4" 34 "BH-CAN" 35 "C-CAN1" 36 "EVAP_SWC" 37 "FUEL_DR_REL_SWC" 38 "Other_Software_Factory_Component" 39 "OHC_1_Front_Map_LGT_RT_Sw" 40 "OHC_1_Front_Map_LGT_LT_Sw" 41 "Fog_Lights_Signal " 42 "DOME_ON_OR_DOME_DEFEAT " 43 "Screen_Open_Close_is_pressed" 44 "Diagnostic_Message_Routing_DMR" 45 "Reserved" 46 "Reserved" 47 "Reserved" 48 "Reserved" 49 "Reserved" 50 "Reserved" 51 "Reserved" 52 "Reserved" 53 "Reserved" 54 "Reserved" 55 "Reserved" 56 "Reserved" 57 "Reserved" 58 "Reserved" 59 "Reserved" 60 "Reserved" 61 "Reserved" 62 "Reserved" 63 "Reserved" 64 "Reserved" 65 "Reserved" 66 "Reserved" 67 "Reserved" 68 "Reserved" 69 "Reserved" 70 "Reserved" 71 "Reserved" 72 "Reserved" 73 "Reserved" 74 "Reserved" 75 "Reserved" 76 "Reserved" 77 "Reserved" 78 "Reserved" 79 "Reserved" 80 "Reserved" 81 "Reserved" 82 "Reserved" 83 "Reserved" 84 "Reserved" 85 "Reserved" 86 "Reserved" 87 "Reserved" 88 "Reserved" 89 "Reserved" 90 "Reserved" 91 "Reserved" 92 "Reserved" 93 "Reserved" 94 "Reserved" 95 "Reserved" 96 "Reserved" 97 "Reserved" 98 "Reserved" 99 "Reserved" 100 "Reserved" 101 "Reserved" 102 "Reserved" 103 "Reserved" 104 "Reserved" 105 "Reserved" 106 "Reserved" 107 "Reserved" 108 "Reserved" 109 "Reserved" 110 "Reserved" 111 "Reserved" 112 "Reserved" 113 "Reserved" 114 "Reserved" 115 "Reserved" 116 "Reserved" 117 "Reserved" 118 "Reserved" 119 "Reserved" 120 "Reserved" 121 "Reserved" 122 "Reserved" 123 "Reserved" 124 "Reserved" 125 "Reserved" 126 "Reserved" 127 "Reserved" 128 "Reserved" 129 "FD_CAN1" 130 "FD_CAN2" 131 "FD_CAN3" 132 "FD_CAN4" 133 "FD_CAN5" 134 "FD_CAN6" 135 "FD_CAN7" 136 "FD_CAN8" 137 "FD_CAN9" 138 "FD_CAN10" 139 "FD_CAN11" 140 "FD_CAN12" 141 "FD_CAN13" 142 "FD_CAN14" 143 "FD_CAN15" 144 "FD_CAN16" 145 "FD_CAN17" 146 "FD_CAN18" 147 "FD_CAN19" 148 "FD_CAN20" 149 "FD_CAN21" 150 "FD_CAN22" 151 "FD_CAN23" 152 "FD_CAN24" 153 "FD_CAN25" 154 "FD_CAN26" 155 "FD_CAN27" 156 "FD_CAN28" 157 "FD_CAN29" 158 "FD_CAN30" 159 "FD_CAN31" 160 "BH-CAN" 161 "BH-CAN1" 162 "BH-CAN2" 163 "C-CAN" 164 "C-CAN1" 165 "Reserved" 166 "Reserved" 167 "Reserved" 168 "Reserved" 169 "Reserved" 170 "Reserved" 171 "Reserved" 172 "Reserved" 173 "Reserved" 174 "Reserved" 175 "Reserved" 176 "Reserved" 177 "Reserved" 178 "Reserved" 179 "Reserved" 180 "Reserved" 181 "Reserved" 182 "Reserved" 183 "Reserved" 184 "Reserved" 185 "Reserved" 186 "Reserved" 187 "Reserved" 188 "Reserved" 189 "Reserved" 190 "Reserved" 191 "Reserved" 192 "Reserved" 193 "Reserved" 194 "Reserved" 195 "Reserved" 196 "Reserved" 197 "Reserved" 198 "Reserved" 199 "Reserved" 200 "Reserved" 201 "Reserved" 202 "Reserved" 203 "Reserved" 204 "Reserved" 205 "Reserved" 206 "Reserved" 207 "Reserved" 208 "Reserved" 209 "Reserved" 210 "Reserved" 211 "Reserved" 212 "Reserved" 213 "Reserved" 214 "Reserved" 215 "Reserved" 216 "Reserved" 217 "Reserved" 218 "Reserved" 219 "Reserved" 220 "Reserved" 221 "Reserved" 222 "Reserved" 223 "Reserved" 224 "Reserved" 225 "Reserved" 226 "Reserved" 227 "Reserved" 228 "Reserved" 229 "Reserved" 230 "Reserved" 231 "Reserved" 232 "Reserved" 233 "Reserved" 234 "Reserved" 235 "Reserved" 236 "Reserved" 237 "Reserved" 238 "Reserved" 239 "Reserved" 240 "Reserved" 241 "Reserved" 242 "Reserved" 243 "Reserved" 244 "Reserved" 245 "Reserved" 246 "Reserved" 247 "Reserved" 248 "Reserved" 249 "Reserved" 250 "Reserved" 251 "Reserved" 252 "Reserved" 253 "Reserved" 254 "Reserved" 255 "Reserved" ;
VAL_ 2654339142 CurrentCanNMState_FD11_BPCM 0 "Uninitialized State" 1 "Bus-Sleep State" 2 "Prepare-Bus State" 3 "Ready-Sleep State" 4 "Normal Operation State" 5 "Repeat Message State" 6 "Synchronize State" 7 "Offline State" ;
VAL_ 2654339142 CurrentFailSts_FD11_BPCM 0 "No_Fail_Present" 1 "Fail_Present" ;
VAL_ 2654339142 DES_FD11_BPCM 0 "Error_Active_state" 1 "Error_passive_warning_state" 2 "Bus_off_state" 3 "Not_used" ;
VAL_ 2654339142 EOL_FD11_BPCM 0 "No_EOL_Programming" 1 "EOL_Programming" ;
VAL_ 2654339142 GenericFailSts_FD11_BPCM 0 "No_Fail_Present" 1 "Fail_Present" ;
VAL_ 2654339142 PreviousCanNMState_FD11_BPCM 0 "Uninitialized State" 1 "Bus-Sleep State" 2 "Prepare-Bus State" 3 "Ready-Sleep State" 4 "Normal Operation State" 5 "Repeat Message State" 6 "Synchronize State" 7 "Offline State" ;
VAL_ 2654339142 WakeupSource_FD11_BPCM 0 "No_Wakeup" ;
VAL_ 2654339078 CurrentCanNMState_FD03_BSM 0 "Uninitialized State" 1 "Bus-Sleep State" 2 "Prepare-Bus State" 3 "Ready-Sleep State" 4 "Normal Operation State" 5 "Repeat Message State" 6 "Synchronize State" 7 "Offline State" ;
VAL_ 2654339078 CurrentFailSts_FD03_BSM 0 "No_Fail_Present" 1 "Fail_Present" ;
VAL_ 2654339078 DES_FD03_BSM 0 "Error_Active_state" 1 "Error_passive_warning_state" 2 "Bus_off_state" 3 "Not_used" ;
VAL_ 2654339078 EOL_FD03_BSM 0 "No_EOL_Programming" 1 "EOL_Programming" ;
VAL_ 2654339078 GenericFailSts_FD03_BSM 0 "No_Fail_Present" 1 "Fail_Present" ;
VAL_ 2654339078 PreviousCanNMState_FD03_BSM 0 "Uninitialized State" 1 "Bus-Sleep State" 2 "Prepare-Bus State" 3 "Ready-Sleep State" 4 "Normal Operation State" 5 "Repeat Message State" 6 "Synchronize State" 7 "Offline State" ;
VAL_ 2654339078 StayActiveSource_FD03_BSM 0 "CANNM_Ready_Sleep" 1 "IGN_ON" 2 "NonDefault_Diag" 4 "ING_OFF_NormSt_RptSt" 8 "EPB_Switch_Apply_Release_Request" 10 "Brake_Pedal_Pressed" 20 "Vahicle_is_Moving" ;
VAL_ 2654339078 WakeupSource_FD03_BSM 0 "No_Wakeup" 1 "IGN_ON" 131 "FD3_Psv_WU" 255 "HW_DIA_WU" ;
VAL_ 2654339220 CurrentCanNMState_FD02_BSM2 0 "Uninitialized State" 1 "Bus-Sleep State" 2 "Prepare-Bus State" 3 "Ready-Sleep State" 4 "Normal Operation State" 5 "Repeat Message State" 6 "Synchronize State" 7 "Offline State" ;
VAL_ 2654339220 CurrentFailSts_FD02_BSM2 0 "No_Fail_Present" 1 "Fail_Present" ;
VAL_ 2654339220 DES_FD02_BSM2 0 "Error_Active_state" 1 "Error_passive_warning_state" 2 "Bus_off_state" 3 "Not_used" ;
VAL_ 2654339220 EOL_FD02_BSM2 0 "No_EOL_Programming" 1 "EOL_Programming" ;
VAL_ 2654339220 GenericFailSts_FD02_BSM2 0 "No_Fail_Present" 1 "Fail_Present" ;
VAL_ 2654339220 PreviousCanNMState_FD02_BSM2 0 "Uninitialized State" 1 "Bus-Sleep State" 2 "Prepare-Bus State" 3 "Ready-Sleep State" 4 "Normal Operation State" 5 "Repeat Message State" 6 "Synchronize State" 7 "Offline State" ;
VAL_ 2654339220 StayActiveSource_FD02_BSM2 0 "CANNM_Ready_Sleep" 1 "IGN_ON" 2 "NonDefault_Diag" 4 "ING_OFF_NormSt_RptSt" ;
VAL_ 2654339220 WakeupSource_FD02_BSM2 0 "No_Wakeup" 1 "IGN_ON" 129 "FD1_Psv_WU" 130 "FD2_Psv_WU" 131 "FD3_Psv_WU" 132 "FD4_Psv_WU" 133 "FD5_Psv_WU" 134 "FD6_Psv_WU" 135 "FD7_Psv_WU" 136 "FD8_Psv_WU" 137 "FD9_Psv_WU" 138 "FD10_Psv_WU" 139 "FD11_Psv_WU" 140 "FD12_Psv_WU" 141 "FD13_Psv_WU" 142 "FD14_Psv_WU" 143 "FD15_Psv_WU" 144 "FD16_Psv_WU" 145 "FD17_Psv_WU" 146 "FD18_Psv_WU" 147 "FD19_Psv_WU" 148 "FD20_Psv_WU" 149 "FD21_Psv_WU" 150 "FD22_Psv_WU" 151 "FD23_Psv_WU" 152 "FD24_Psv_WU" 153 "FD25_Psv_WU" 154 "FD26_Psv_WU" 155 "FD27_Psv_WU" 156 "FD28_Psv_WU" 157 "FD29_Psv_WU" 158 "BHCAN_Psv_WU" 159 "CCAN_Psv_WU" ;
VAL_ 2654339213 CurrentCanNMState_FD03_CADM 0 "Uninitialized State" 1 "Bus-Sleep State" 2 "Prepare-Bus State" 3 "Ready-Sleep State" 4 "Normal Operation State" 5 "Repeat Message State" 6 "Synchronize State" 7 "Offline State" ;
VAL_ 2654339213 CurrentFailSts_FD03_CADM 0 "No_Fail_Present" 1 "Fail_Present" ;
VAL_ 2654339213 DES_FD03_CADM 0 "Error_Active_state" 1 "Error_passive_warning_state" 2 "Bus_off_state" 3 "Not_used" ;
VAL_ 2654339213 EOL_FD03_CADM 0 "No_EOL_Programming" 1 "EOL_Programming" ;
VAL_ 2654339213 GenericFailSts_FD03_CADM 0 "No_Fail_Present" 1 "Fail_Present" ;
VAL_ 2654339213 PreviousCanNMState_FD03_CADM 0 "Uninitialized State" 1 "Bus-Sleep State" 2 "Prepare-Bus State" 3 "Ready-Sleep State" 4 "Normal Operation State" 5 "Repeat Message State" 6 "Synchronize State" 7 "Offline State" ;
VAL_ 2654339213 WakeupSource_FD03_CADM 0 "No_Wakeup" ;
VAL_ 2654339214 CurrentCanNMState_FD02_CADM2 0 "Uninitialized State" 1 "Bus-Sleep State" 2 "Prepare-Bus State" 3 "Ready-Sleep State" 4 "Normal Operation State" 5 "Repeat Message State" 6 "Synchronize State" 7 "Offline State" ;
VAL_ 2654339214 CurrentFailSts_FD02_CADM2 0 "No_Fail_Present" 1 "Fail_Present" ;
VAL_ 2654339214 DES_FD02_CADM2 0 "Error_Active_state" 1 "Error_passive_warning_state" 2 "Bus_off_state" 3 "Not_used" ;
VAL_ 2654339214 EOL_FD02_CADM2 0 "No_EOL_Programming" 1 "EOL_Programming" ;
VAL_ 2654339214 GenericFailSts_FD02_CADM2 0 "No_Fail_Present" 1 "Fail_Present" ;
VAL_ 2654339214 PreviousCanNMState_FD02_CADM2 0 "Uninitialized State" 1 "Bus-Sleep State" 2 "Prepare-Bus State" 3 "Ready-Sleep State" 4 "Normal Operation State" 5 "Repeat Message State" 6 "Synchronize State" 7 "Offline State" ;
VAL_ 2654339214 WakeupSource_FD02_CADM2 0 "No_Wakeup" ;
VAL_ 2654339225 CurrentCanNMState_FD03_DMSM 0 "Uninitialized State" 1 "Bus-Sleep State" 2 "Prepare-Bus State" 3 "Ready-Sleep State" 4 "Normal Operation State" 5 "Repeat Message State" 6 "Synchronize State" 7 "Offline State" ;
VAL_ 2654339225 CurrentFailSts_FD03_DMSM 0 "No_Fail_Present" 1 "Fail_Present" ;
VAL_ 2654339225 DES_FD03_DMSM 0 "Error_Active_state" 1 "Error_passive_warning_state" 2 "Bus_off_state" 3 "Not_used" ;
VAL_ 2654339225 EOL_FD03_DMSM 0 "No_EOL_Programming" 1 "EOL_Programming" ;
VAL_ 2654339225 GenericFailSts_FD03_DMSM 0 "No_Fail_Present" 1 "Fail_Present" ;
VAL_ 2654339225 PreviousCanNMState_FD03_DMSM 0 "Uninitialized State" 1 "Bus-Sleep State" 2 "Prepare-Bus State" 3 "Ready-Sleep State" 4 "Normal Operation State" 5 "Repeat Message State" 6 "Synchronize State" 7 "Offline State" ;
VAL_ 2654339225 WakeupSource_FD03_DMSM 0 "No_Wakeup" ;
VAL_ 2654339139 CurrentCanNMState_FD03_DTCM 0 "Uninitialized State" 1 "Bus-Sleep State" 2 "Prepare-Bus State" 3 "Ready-Sleep State" 4 "Normal Operation State" 5 "Repeat Message State" 6 "Synchronize State" 7 "Offline State" ;
VAL_ 2654339139 CurrentFailSts_FD03_DTCM 0 "No_Fail_Present" 1 "Fail_Present" ;
VAL_ 2654339139 DES_FD03_DTCM 0 "Error_Active_state" 1 "Error_passive_warning_state" 2 "Bus_off_state" 3 "Not_used" ;
VAL_ 2654339139 EOL_FD03_DTCM 0 "No_EOL_Programming" 1 "EOL_Programming" ;
VAL_ 2654339139 GenericFailSts_FD03_DTCM 0 "No_Fail_Present" 1 "Fail_Present" ;
VAL_ 2654339139 PreviousCanNMState_FD03_DTCM 0 "Uninitialized State" 1 "Bus-Sleep State" 2 "Prepare-Bus State" 3 "Ready-Sleep State" 4 "Normal Operation State" 5 "Repeat Message State" 6 "Synchronize State" 7 "Offline State" ;
VAL_ 2654339139 WakeupSource_FD03_DTCM 0 "No_Wakeup" ;
VAL_ 2654339073 CurrentCanNMState_FD03_ECM 0 "Uninitialized State" 1 "Bus-Sleep State" 2 "Prepare-Bus State" 3 "Ready-Sleep State" 4 "Normal Operation State" 5 "Repeat Message State" 6 "Synchronize State" 7 "Offline State" ;
VAL_ 2654339073 CurrentFailSts_FD03_ECM 0 "No_Fail_Present" 1 "Fail_Present" ;
VAL_ 2654339073 DES_FD03_ECM 0 "Error_Active_state" 1 "Error_passive_warning_state" 2 "Bus_off_state" 3 "Not_used" ;
VAL_ 2654339073 EOL_FD03_ECM 0 "No_EOL_Programming" 1 "EOL_Programming" ;
VAL_ 2654339073 GenericFailSts_FD03_ECM 0 "No_Fail_Present" 1 "Fail_Present" ;
VAL_ 2654339073 PreviousCanNMState_FD03_ECM 0 "Uninitialized State" 1 "Bus-Sleep State" 2 "Prepare-Bus State" 3 "Ready-Sleep State" 4 "Normal Operation State" 5 "Repeat Message State" 6 "Synchronize State" 7 "Offline State" ;
VAL_ 2654339073 WakeupSource_FD03_ECM 0 "No_Wakeup" ;
VAL_ 2654339074 CurrentCanNMState_FD02_EPS 0 "Uninitialized State" 1 "Bus-Sleep State" 2 "Prepare-Bus State" 3 "Ready-Sleep State" 4 "Normal Operation State" 5 "Repeat Message State" 6 "Synchronize State" 7 "Offline State" ;
VAL_ 2654339074 CurrentFailSts_FD02_EPS 0 "No_Fail_Present" 1 "Fail_Present" ;
VAL_ 2654339074 DES_FD02_EPS 0 "Error_Active_state" 1 "Error_passive_warning_state" 2 "Bus_off_state" 3 "Not_used" ;
VAL_ 2654339074 EOL_FD02_EPS 0 "No_EOL_Programming" 1 "EOL_Programming" ;
VAL_ 2654339074 GenericFailSts_FD02_EPS 0 "No_Fail_Present" 1 "Fail_Present" ;
VAL_ 2654339074 PreviousCanNMState_FD02_EPS 0 "Uninitialized State" 1 "Bus-Sleep State" 2 "Prepare-Bus State" 3 "Ready-Sleep State" 4 "Normal Operation State" 5 "Repeat Message State" 6 "Synchronize State" 7 "Offline State" ;
VAL_ 2654339074 StayActiveSource_FD02_EPS 0 "CANNM_Ready_Sleep" 1 "IGN_ON" 2 "NonDefault_Diag" 4 "ING_OFF_NormSt_RptSt" ;
VAL_ 2654339074 WakeupSource_FD02_EPS 0 "No_Wakeup" 1 "IGN_ON" 129 "FD1_Psv_WU" 130 "FD2_Psv_WU" 131 "FD3_Psv_WU" 132 "FD4_Psv_WU" 133 "FD5_Psv_WU" 134 "FD6_Psv_WU" 135 "FD7_Psv_WU" 136 "FD8_Psv_WU" 137 "FD9_Psv_WU" 138 "FD10_Psv_WU" 139 "FD11_Psv_WU" 140 "FD12_Psv_WU" 141 "FD13_Psv_WU" 142 "FD14_Psv_WU" 143 "FD15_Psv_WU" 144 "FD16_Psv_WU" 145 "FD17_Psv_WU" 146 "FD18_Psv_WU" 147 "FD19_Psv_WU" 148 "FD20_Psv_WU" 149 "FD21_Psv_WU" 150 "FD22_Psv_WU" 151 "FD23_Psv_WU" 152 "FD24_Psv_WU" 153 "FD25_Psv_WU" 154 "FD26_Psv_WU" 155 "FD27_Psv_WU" 156 "FD28_Psv_WU" 157 "FD29_Psv_WU" 158 "BHCAN_Psv_WU" 159 "CCAN_Psv_WU" ;
VAL_ 2654339108 CurrentCanNMState_FD08_ETM 0 "Uninitialized State" 1 "Bus-Sleep State" 2 "Prepare-Bus State" 3 "Ready-Sleep State" 4 "Normal Operation State" 5 "Repeat Message State" 6 "Synchronize State" 7 "Offline State" ;
VAL_ 2654339108 CurrentFailSts_FD08_ETM 0 "No_Fail_Present" 1 "Fail_Present" ;
VAL_ 2654339108 DES_FD08_ETM 0 "Error_Active_state" 1 "Error_passive_warning_state" 2 "Bus_off_state" 3 "Not_used" ;
VAL_ 2654339108 EOL_FD08_ETM 0 "No_EOL_Programming" 1 "EOL_Programming" ;
VAL_ 2654339108 GenericFailSts_FD08_ETM 0 "No_Fail_Present" 1 "Fail_Present" ;
VAL_ 2654339108 PreviousCanNMState_FD08_ETM 0 "Uninitialized State" 1 "Bus-Sleep State" 2 "Prepare-Bus State" 3 "Ready-Sleep State" 4 "Normal Operation State" 5 "Repeat Message State" 6 "Synchronize State" 7 "Offline State" ;
VAL_ 2654339108 StayActiveSource_FD08_ETM 0 "CANNM_Ready_Sleep" 1 "IGN_ON" 2 "NonDefault_Diag" 4 "ING_OFF_NormSt_RptSt" ;
VAL_ 2654339108 WakeupSource_FD08_ETM 0 "No_Wakeup" 1 "IGN_ON" 129 "FD1_Psv_WU" 130 "FD2_Psv_WU" 131 "FD3_Psv_WU" 132 "FD4_Psv_WU" 133 "FD5_Psv_WU" 134 "FD6_Psv_WU" 135 "FD7_Psv_WU" 136 "FD8_Psv_WU" 137 "FD9_Psv_WU" 138 "FD10_Psv_WU" 139 "FD11_Psv_WU" 140 "FD12_Psv_WU" 141 "FD13_Psv_WU" 142 "FD14_Psv_WU" 143 "FD15_Psv_WU" 144 "FD16_Psv_WU" 145 "FD17_Psv_WU" 146 "FD18_Psv_WU" 147 "FD19_Psv_WU" 148 "FD20_Psv_WU" 149 "FD21_Psv_WU" 150 "FD22_Psv_WU" 151 "FD23_Psv_WU" 152 "FD24_Psv_WU" 153 "FD25_Psv_WU" 154 "FD26_Psv_WU" 155 "FD27_Psv_WU" 156 "FD28_Psv_WU" 157 "FD29_Psv_WU" 158 "BHCAN_Psv_WU" 159 "CCAN_Psv_WU" ;
VAL_ 2654339256 CurrentCanNMState_FD09_FLDHM 0 "Uninitialized State" 1 "Bus-Sleep State" 2 "Prepare-Bus State" 3 "Ready-Sleep State" 4 "Normal Operation State" 5 "Repeat Message State" 6 "Synchronize State" 7 "Offline State" ;
VAL_ 2654339256 CurrentFailSts_FD09_FLDHM 0 "No_Fail_Present" 1 "Fail_Present" ;
VAL_ 2654339256 DES_FD09_FLDHM 0 "Error_Active_state" 1 "Error_passive_warning_state" 2 "Bus_off_state" 3 "Not_used" ;
VAL_ 2654339256 EOL_FD09_FLDHM 0 "No_EOL_Programming" 1 "EOL_Programming" ;
VAL_ 2654339256 GenericFailSts_FD09_FLDHM 0 "No_Fail_Present" 1 "Fail_Present" ;
VAL_ 2654339256 PreviousCanNMState_FD09_FLDHM 0 "Uninitialized State" 1 "Bus-Sleep State" 2 "Prepare-Bus State" 3 "Ready-Sleep State" 4 "Normal Operation State" 5 "Repeat Message State" 6 "Synchronize State" 7 "Offline State" ;
VAL_ 2654339256 StayActiveSource_FD09_FLDHM 0 "CANNM_Ready_Sleep" 1 "IGN_ON" 2 "NonDefault_Diag" 4 "ING_OFF_NormSt_RptSt" ;
VAL_ 2654339256 WakeupSource_FD09_FLDHM 0 "No_Wakeup" 1 "Diagnostic" 2 "Network_FD3" 3 "Start_Stop_Ignition_Button" 4 "Left_Front_Door_Handle_Input" 5 "Right_Front_Door_Handle_Input" 6 "Left_Rear_Door_Handle_Input" 7 "Right_Rear_Door_Handle_Input" 8 "Trunk_Liftgate_Input" 9 "RF_Input" 10 "Reset" 11 "Cap_Sens_24Hr_Reset_Timer_Expire" 12 "Clutch_Input" 13 "Network_FD9" 14 "Proximity" 15 "SNA" 129 "FD1_Psv_WU" 130 "FD2_Psv_WU" 131 "FD3_Psv_WU" 132 "FD4_Psv_WU" 133 "FD5_Psv_WU" 134 "FD6_Psv_WU" 135 "FD7_Psv_WU" 136 "FD8_Psv_WU" 137 "FD9_Psv_WU" 138 "FD10_Psv_WU" 139 "FD11_Psv_WU" 140 "FD12_Psv_WU" 141 "FD13_Psv_WU" 142 "FD14_Psv_WU" 143 "FD15_Psv_WU" 144 "FD16_Psv_WU" 145 "FD17_Psv_WU" 146 "FD18_Psv_WU" 147 "FD19_Psv_WU" 148 "FD20_Psv_WU" 149 "FD21_Psv_WU" 150 "FD22_Psv_WU" 151 "FD23_Psv_WU" 152 "FD24_Psv_WU" 153 "FD25_Psv_WU" 154 "FD26_Psv_WU" 155 "FD27_Psv_WU" 156 "FD28_Psv_WU" 157 "FD29_Psv_WU" 158 "BHCAN_Psv_WU" 159 "CCAN_Psv_WU" ;
VAL_ 2654339255 CurrentCanNMState_FD09_FRDHM 0 "Uninitialized State" 1 "Bus-Sleep State" 2 "Prepare-Bus State" 3 "Ready-Sleep State" 4 "Normal Operation State" 5 "Repeat Message State" 6 "Synchronize State" 7 "Offline State" ;
VAL_ 2654339255 CurrentFailSts_FD09_FRDHM 0 "No_Fail_Present" 1 "Fail_Present" ;
VAL_ 2654339255 DES_FD09_FRDHM 0 "Error_Active_state" 1 "Error_passive_warning_state" 2 "Bus_off_state" 3 "Not_used" ;
VAL_ 2654339255 EOL_FD09_FRDHM 0 "No_EOL_Programming" 1 "EOL_Programming" ;
VAL_ 2654339255 GenericFailSts_FD09_FRDHM 0 "No_Fail_Present" 1 "Fail_Present" ;
VAL_ 2654339255 PreviousCanNMState_FD09_FRDHM 0 "Uninitialized State" 1 "Bus-Sleep State" 2 "Prepare-Bus State" 3 "Ready-Sleep State" 4 "Normal Operation State" 5 "Repeat Message State" 6 "Synchronize State" 7 "Offline State" ;
VAL_ 2654339255 StayActiveSource_FD09_FRDHM 0 "CANNM_Ready_Sleep" 1 "IGN_ON" 2 "NonDefault_Diag" 4 "ING_OFF_NormSt_RptSt" ;
VAL_ 2654339255 WakeupSource_FD09_FRDHM 0 "No_Wakeup" 1 "Diagnostic" 2 "Network_FD3" 3 "Start_Stop_Ignition_Button" 4 "Left_Front_Door_Handle_Input" 5 "Right_Front_Door_Handle_Input" 6 "Left_Rear_Door_Handle_Input" 7 "Right_Rear_Door_Handle_Input" 8 "Trunk_Liftgate_Input" 9 "RF_Input" 10 "Reset" 11 "Cap_Sens_24Hr_Reset_Timer_Expire" 12 "Clutch_Input" 13 "Network_FD9" 14 "Proximity" 15 "SNA" 129 "FD1_Psv_WU" 130 "FD2_Psv_WU" 131 "FD3_Psv_WU" 132 "FD4_Psv_WU" 133 "FD5_Psv_WU" 134 "FD6_Psv_WU" 135 "FD7_Psv_WU" 136 "FD8_Psv_WU" 137 "FD9_Psv_WU" 138 "FD10_Psv_WU" 139 "FD11_Psv_WU" 140 "FD12_Psv_WU" 141 "FD13_Psv_WU" 142 "FD14_Psv_WU" 143 "FD15_Psv_WU" 144 "FD16_Psv_WU" 145 "FD17_Psv_WU" 146 "FD18_Psv_WU" 147 "FD19_Psv_WU" 148 "FD20_Psv_WU" 149 "FD21_Psv_WU" 150 "FD22_Psv_WU" 151 "FD23_Psv_WU" 152 "FD24_Psv_WU" 153 "FD25_Psv_WU" 154 "FD26_Psv_WU" 155 "FD27_Psv_WU" 156 "FD28_Psv_WU" 157 "FD29_Psv_WU" 158 "BHCAN_Psv_WU" 159 "CCAN_Psv_WU" ;
VAL_ 2654339216 CurrentCanNMState_FD03_GNMM 0 "Uninitialized State" 1 "Bus-Sleep State" 2 "Prepare-Bus State" 3 "Ready-Sleep State" 4 "Normal Operation State" 5 "Repeat Message State" 6 "Synchronize State" 7 "Offline State" ;
VAL_ 2654339216 CurrentFailSts_FD03_GNMM 0 "No_Fail_Present" 1 "Fail_Present" ;
VAL_ 2654339216 DES_FD03_GNMM 0 "Error_Active_state" 1 "Error_passive_warning_state" 2 "Bus_off_state" 3 "Not_used" ;
VAL_ 2654339216 EOL_FD03_GNMM 0 "No_EOL_Programming" 1 "EOL_Programming" ;
VAL_ 2654339216 GenericFailSts_FD03_GNMM 0 "No_Fail_Present" 1 "Fail_Present" ;
VAL_ 2654339216 PreviousCanNMState_FD03_GNMM 0 "Uninitialized State" 1 "Bus-Sleep State" 2 "Prepare-Bus State" 3 "Ready-Sleep State" 4 "Normal Operation State" 5 "Repeat Message State" 6 "Synchronize State" 7 "Offline State" ;
VAL_ 2654339216 StayActiveSource_FD03_GNMM 0 "CANNM_Ready_Sleep" 1 "IGN_ON" 2 "NonDefault_Diag" 4 "ING_OFF_NormSt_RptSt" ;
VAL_ 2654339216 WakeupSource_FD03_GNMM 0 "No_Wakeup" 1 "IGN_ON" 129 "FD1_Psv_WU" 130 "FD2_Psv_WU" 131 "FD3_Psv_WU" 132 "FD4_Psv_WU" 133 "FD5_Psv_WU" 134 "FD6_Psv_WU" 135 "FD7_Psv_WU" 136 "FD8_Psv_WU" 137 "FD9_Psv_WU" 138 "FD10_Psv_WU" 139 "FD11_Psv_WU" 140 "FD12_Psv_WU" 141 "FD13_Psv_WU" 142 "FD14_Psv_WU" 143 "FD15_Psv_WU" 144 "FD16_Psv_WU" 145 "FD17_Psv_WU" 146 "FD18_Psv_WU" 147 "FD19_Psv_WU" 148 "FD20_Psv_WU" 149 "FD21_Psv_WU" 150 "FD22_Psv_WU" 151 "FD23_Psv_WU" 152 "FD24_Psv_WU" 153 "FD25_Psv_WU" 154 "FD26_Psv_WU" 155 "FD27_Psv_WU" 156 "FD28_Psv_WU" 157 "FD29_Psv_WU" 158 "BHCAN_Psv_WU" 159 "CCAN_Psv_WU" ;
VAL_ 2654339170 CurrentCanNMState_FD03_HCP 0 "Uninitialized State" 1 "Bus-Sleep State" 2 "Prepare-Bus State" 3 "Ready-Sleep State" 4 "Normal Operation State" 5 "Repeat Message State" 6 "Synchronize State" 7 "Offline State" ;
VAL_ 2654339170 CurrentFailSts_FD03_HCP 0 "No_Fail_Present" 1 "Fail_Present" ;
VAL_ 2654339170 DES_FD03_HCP 0 "Error_Active_state" 1 "Error_passive_warning_state" 2 "Bus_off_state" 3 "Not_used" ;
VAL_ 2654339170 EOL_FD03_HCP 0 "No_EOL_Programming" 1 "EOL_Programming" ;
VAL_ 2654339170 GenericFailSts_FD03_HCP 0 "No_Fail_Present" 1 "Fail_Present" ;
VAL_ 2654339170 PreviousCanNMState_FD03_HCP 0 "Uninitialized State" 1 "Bus-Sleep State" 2 "Prepare-Bus State" 3 "Ready-Sleep State" 4 "Normal Operation State" 5 "Repeat Message State" 6 "Synchronize State" 7 "Offline State" ;
VAL_ 2654339170 WakeupSource_FD03_HCP 0 "No_Wakeup" ;
VAL_ 2654339075 CurrentCanNMState_FD03_IPC 0 "Uninitialized State" 1 "Bus-Sleep State" 2 "Prepare-Bus State" 3 "Ready-Sleep State" 4 "Normal Operation State" 5 "Repeat Message State" 6 "Synchronize State" 7 "Offline State" ;
VAL_ 2654339075 CurrentFailSts_FD03_IPC 0 "No_Fail_Present" 1 "Fail_Present" ;
VAL_ 2654339075 DES_FD03_IPC 0 "Error_Active_state" 1 "Error_passive_warning_state" 2 "Bus_off_state" 3 "Not_used" ;
VAL_ 2654339075 EOL_FD03_IPC 0 "No_EOL_Programming" 1 "EOL_Programming" ;
VAL_ 2654339075 GenericFailSts_FD03_IPC 0 "No_Fail_Present" 1 "Fail_Present" ;
VAL_ 2654339075 PreviousCanNMState_FD03_IPC 0 "Uninitialized State" 1 "Bus-Sleep State" 2 "Prepare-Bus State" 3 "Ready-Sleep State" 4 "Normal Operation State" 5 "Repeat Message State" 6 "Synchronize State" 7 "Offline State" ;
VAL_ 2654339075 WakeupSource_FD03_IPC 0 "No_Wakeup" ;
VAL_ 2654339098 CurrentCanNMState_FD02_ORC 0 "Uninitialized State" 1 "Bus-Sleep State" 2 "Prepare-Bus State" 3 "Ready-Sleep State" 4 "Normal Operation State" 5 "Repeat Message State" 6 "Synchronize State" 7 "Offline State" ;
VAL_ 2654339098 CurrentFailSts_FD02_ORC 0 "No_Fail_Present" 1 "Fail_Present" ;
VAL_ 2654339098 DES_FD02_ORC 0 "Error_Active_state" 1 "Error_passive_warning_state" 2 "Bus_off_state" 3 "Not_used" ;
VAL_ 2654339098 EOL_FD02_ORC 0 "No_EOL_Programming" 1 "EOL_Programming" ;
VAL_ 2654339098 GenericFailSts_FD02_ORC 0 "No_Fail_Present" 1 "Fail_Present" ;
VAL_ 2654339098 PreviousCanNMState_FD02_ORC 0 "Uninitialized State" 1 "Bus-Sleep State" 2 "Prepare-Bus State" 3 "Ready-Sleep State" 4 "Normal Operation State" 5 "Repeat Message State" 6 "Synchronize State" 7 "Offline State" ;
VAL_ 2654339098 StayActiveSource_FD02_ORC 0 "CANNM_Ready_Sleep" 1 "IGN_ON" 2 "NonDefault_Diag" 4 "ING_OFF_NormSt_RptSt" ;
VAL_ 2654339098 WakeupSource_FD02_ORC 0 "No_Wakeup" 1 "IGN_ON" 129 "FD1_Psv_WU" 130 "FD2_Psv_WU" 131 "FD3_Psv_WU" 132 "FD4_Psv_WU" 133 "FD5_Psv_WU" 134 "FD6_Psv_WU" 135 "FD7_Psv_WU" 136 "FD8_Psv_WU" 137 "FD9_Psv_WU" 138 "FD10_Psv_WU" 139 "FD11_Psv_WU" 140 "FD12_Psv_WU" 141 "FD13_Psv_WU" 142 "FD14_Psv_WU" 143 "FD15_Psv_WU" 144 "FD16_Psv_WU" 145 "FD17_Psv_WU" 146 "FD18_Psv_WU" 147 "FD19_Psv_WU" 148 "FD20_Psv_WU" 149 "FD21_Psv_WU" 150 "FD22_Psv_WU" 151 "FD23_Psv_WU" 152 "FD24_Psv_WU" 153 "FD25_Psv_WU" 154 "FD26_Psv_WU" 155 "FD27_Psv_WU" 156 "FD28_Psv_WU" 157 "FD29_Psv_WU" 158 "BHCAN_Psv_WU" 159 "CCAN_Psv_WU" ;
VAL_ 2654339096 CurrentCanNMState_FD02_PAM 0 "Uninitialized State" 1 "Bus-Sleep State" 2 "Prepare-Bus State" 3 "Ready-Sleep State" 4 "Normal Operation State" 5 "Repeat Message State" 6 "Synchronize State" 7 "Offline State" ;
VAL_ 2654339096 CurrentFailSts_FD02_PAM 0 "No_Fail_Present" 1 "Fail_Present" ;
VAL_ 2654339096 DES_FD02_PAM 0 "Error_Active_state" 1 "Error_passive_warning_state" 2 "Bus_off_state" 3 "Not_used" ;
VAL_ 2654339096 EOL_FD02_PAM 0 "No_EOL_Programming" 1 "EOL_Programming" ;
VAL_ 2654339096 GenericFailSts_FD02_PAM 0 "No_Fail_Present" 1 "Fail_Present" ;
VAL_ 2654339096 PreviousCanNMState_FD02_PAM 0 "Uninitialized State" 1 "Bus-Sleep State" 2 "Prepare-Bus State" 3 "Ready-Sleep State" 4 "Normal Operation State" 5 "Repeat Message State" 6 "Synchronize State" 7 "Offline State" ;
VAL_ 2654339096 StayActiveSource_FD02_PAM 0 "No_active_session" 1 "IGN_Run" 2 "Extended_Diagnostic_Session" 4 "IGN_OFF" ;
VAL_ 2654339096 WakeupSource_FD02_PAM 0 "No_Wakeup" 130 "CANFD2_Bus_Wakeup" ;
VAL_ 2654339137 CurrentCanNMState_FD03_RFHM 0 "Uninitialized State" 1 "Bus-Sleep State" 2 "Prepare-Bus State" 3 "Ready-Sleep State" 4 "Normal Operation State" 5 "Repeat Message State" 6 "Synchronize State" 7 "Offline State" ;
VAL_ 2654339137 CurrentFailSts_FD03_RFHM 0 "No_Fail_Present" 1 "Fail_Present" ;
VAL_ 2654339137 DES_FD03_RFHM 0 "Error_Active_state" 1 "Error_passive_warning_state" 2 "Bus_off_state" 3 "Not_used" ;
VAL_ 2654339137 EOL_FD03_RFHM 0 "No_EOL_Programming" 1 "EOL_Programming" ;
VAL_ 2654339137 GenericFailSts_FD03_RFHM 0 "No_Fail_Present" 1 "Fail_Present" ;
VAL_ 2654339137 PreviousCanNMState_FD03_RFHM 0 "Uninitialized State" 1 "Bus-Sleep State" 2 "Prepare-Bus State" 3 "Ready-Sleep State" 4 "Normal Operation State" 5 "Repeat Message State" 6 "Synchronize State" 7 "Offline State" ;
VAL_ 2654339137 WakeupSource_FD03_RFHM 0 "No_Wakeup" 1 "Diagnostic" 2 "Network_FD3" 3 "Start_Stop_Ignition_Button" 4 "Left_Front_Door_Handle_Input" 5 "Right_Front_Door_Handle_Input" 6 "Left_Rear_Door_Handle_Input" 7 "Right_Rear_Door_Handle_Input" 8 "Trunk_Liftgate_Input" 9 "RF_Input" 10 "Reset" 11 "Cap_Sens_24Hr_Reset_Timer_Expire" 12 "Clutch_Input" 13 "Network_FD9" 14 "Proximity" 255 "SNA" ;
