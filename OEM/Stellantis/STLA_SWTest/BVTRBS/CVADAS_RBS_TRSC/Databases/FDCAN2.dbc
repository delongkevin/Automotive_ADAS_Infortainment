VERSION ""

NS_ :

BS_:

BU_: BCM BSM2 CADM2 CVADAS EPS ORC PAM SGW TRSKM

BO_ 3221225472 VECTOR__INDEPENDENT_SIG_MSG: 0 Vector__XXX
 SG_ MessageCounter_BRAKE1 : 0|4@0+ (1,0) [0|15] "" Vector__XXX

BO_ 1458 ADAS_FD_HMI_C2: 32 CADM2
 SG_ ACC_DispPopupSts_C2 : 22|7@0+ (1,0) [0|127] ""  SGW
 SG_ ACC_FailSts_C2 : 57|1@0+ (1,0) [0|1] ""  BCM,BSM2
 SG_ AEB_DispPopupSts_C2 : 39|6@0+ (1,0) [0|63] ""  SGW
 SG_ Chime_Priority_C2 : 79|3@0+ (1,0) [0|4] ""  BCM,SGW
 SG_ Chime_RepRate_C2 : 43|4@0+ (1,0) [0|15] "Hz"  BCM,SGW
 SG_ Chime_TypSts_C2 : 55|4@0+ (1,0) [0|15] ""  BCM,SGW
 SG_ CRC_ADAS_HMI_C2 : 191|8@0+ (1,0) [0|255] "-"  BCM,BSM2,EPS
 SG_ DisplaySts_ACC_C2 : 47|4@0+ (1,0) [0|15] ""  SGW
 SG_ DisplaySts_OFF_C2 : 76|3@0+ (1,0) [0|7] ""  SGW
 SG_ DisplaySts_Veh_C2 : 63|3@0+ (1,0) [0|7] ""  SGW
 SG_ HAS_Escalation_Sts_C2 : 51|4@0+ (1,0) [0|8] ""  BCM
 SG_ HAS_Hazard_C2 : 83|1@0+ (1,0) [0|1] ""  BCM
 SG_ HAS_TelltaleSts_C2 : 68|3@0+ (1,0) [0|0] ""  SGW
 SG_ Lane_DisplaySts_Left_C2 : 60|3@0+ (1,0) [0|7] ""  SGW
 SG_ Lane_DisplaySts_Right_C2 : 71|3@0+ (1,0) [0|7] ""  SGW
 SG_ Lane_DispPopupSts_C2 : 31|6@0+ (1,0) [0|63] ""  SGW
 SG_ LF_Chime_RqSts_C2 : 72|1@0+ (1,0) [0|1] ""  BCM,SGW
 SG_ LR_Chime_RqSts_C2 : 86|1@0+ (1,0) [0|1] ""  BCM,SGW
 SG_ MessageCounter_ADAS_HMI_C2 : 179|4@0+ (1,0) [0|15] "-"  BCM,BSM2,EPS
 SG_ RF_Chime_RqSts_C2 : 73|1@0+ (1,0) [0|1] ""  BCM,SGW
 SG_ RR_Chime_RqSts_C2 : 87|1@0+ (1,0) [0|1] ""  BCM,SGW
 SG_ Set_Speed_KPH_C2 : 7|8@0+ (1,0) [0|255] "kph"  SGW
 SG_ Set_Speed_MPH_C2 : 15|8@0+ (1,0) [0|255] "mph"  SGW
 SG_ SVI_Request_C2 : 25|2@0+ (1,0) [0|0] ""  BCM,SGW

BO_ 280 ADAS_FD_INFO: 32 BCM
 SG_ CRC_ADAS_FD_INFO : 191|8@0+ (1,0) [0|255] "-"  BSM2
 SG_ HAS_Status : 106|2@0+ (1,0) [0|3] ""  BSM2
 SG_ MessageCounter_ADAS_FD_INFO : 179|4@0+ (1,0) [0|15] "-"  BSM2

BO_ 281 ADAS_FD_INFO_C2: 32 CADM2
 SG_ ACC_Systemsts_C2 : 23|4@0+ (1,0) [0|14] ""  BCM,BSM2
 SG_ AEB_Type_C2 : 39|4@0+ (1,0) [0|14] ""  BCM,BSM2
 SG_ CADM_EPSADAS_FAIL : 32|1@0+ (1,0) [0|1] ""  EPS
 SG_ CADM2_Mode : 33|1@0+ (1,0) [0|1] ""  BCM
 SG_ CADM2_OpStat : 47|3@0+ (1,0) [0|5] "" Vector__XXX
 SG_ CRC_ADAS_INFO_C2 : 191|8@0+ (1,0) [0|255] "-"  BCM,BSM2,CVADAS,EPS
 SG_ ESCALATION_TYPE_C2 : 55|3@0+ (1,0) [0|4] ""  ORC
 SG_ HAS_LAT_CTRL_RequestSts_C2 : 41|2@0+ (1,0) [0|3] ""  EPS
 SG_ HAS_OpStat_Sec : 44|3@0+ (1,0) [0|5] ""  BCM,ORC
 SG_ HAS_Status_C2 : 35|2@0+ (1,0) [0|3] ""  BCM,BSM2,CVADAS
 SG_ HIS_Req_C2 : 19|1@0+ (1,0) [0|1] ""  BCM,BSM2
 SG_ Intervention_C2 : 3|12@0+ (0.01,-16) [-16|24.95] "m/s2"  BCM,BSM2
 SG_ MessageCounter_ADAS_INFO_C2 : 179|4@0+ (1,0) [0|15] "-"  BCM,BSM2,CVADAS,EPS
 SG_ MRM_STATUS_C2 : 52|3@0+ (1,0) [0|6] ""  BCM,CVADAS,SGW
 SG_ TorqueOverlaySteeringReq_C2 : 18|11@0+ (0.0048828125,-5) [-5|4.9951171875] ""  EPS,SGW

BO_ 613 ADAS_FD_INFO2_C2: 32 CADM2
 SG_ CADM2_DALM_CRC : 23|8@0+ (1,0) [0|255] "-"  BCM
 SG_ CADM2_DALM_MC : 11|4@0+ (1,0) [0|15] "-"  BCM
 SG_ DALM_Request_C2 : 15|4@0+ (1,0) [0|14] ""  BCM
 SG_ HAS_OpStat_Sec_DALM : 3|4@0+ (1,0) [0|15] ""  BCM
 SG_ HAS_Status_C2_DALM : 7|4@0+ (1,0) [0|3] ""  BCM

BO_ 730 ADAS_FD_LANES_1: 64 CVADAS
 SG_ Camera_Status : 23|4@0+ (1,0) [0|15] ""  CADM2
 SG_ Cntr_ADAS_FD_LANES_1 : 455|16@0+ (1,0) [0|65535] "-"  CADM2
 SG_ CRC_ADAS_FD_LANES_1 : 447|8@0+ (1,0) [0|255] "-"  CADM2
 SG_ FOD_Confidence : 335|2@0+ (1,0) [0|3] ""  CADM2
 SG_ Frame_Index_Lanes_1 : 7|16@0+ (1,0) [0|65535] ""  CADM2
 SG_ Health_Front_Object_Detection : 17|2@0+ (1,0) [0|3] ""  CADM2
 SG_ Health_Lane_Detection : 19|2@0+ (1,0) [0|3] ""  CADM2
 SG_ Line_1_Confidence : 159|4@0+ (0.1,0) [0|1.5] ""  CADM2
 SG_ Line_1_Curvature : 31|16@0+ (9.77E-007,-0.032) [-0.032|0.032027695] ""  CADM2
 SG_ Line_1_Curvature_Rate : 95|16@0+ (3.7252902985E-009,-0.000122) [-0.000122|0.000122136899712198] ""  CADM2
 SG_ Line_1_End_Range : 303|7@0+ (0.5,-25) [-25|38.5] "m"  CADM2
 SG_ Line_1_Heading : 231|10@0+ (0.0009765625,-0.357) [-0.357|0.6420234375] "rad"  CADM2
 SG_ Line_1_Offset : 191|10@0+ (0.01,-5) [-5|5.23] "m"  CADM2
 SG_ Line_1_Start_Range : 271|7@0+ (0.5,-25) [-25|38.5] "m"  CADM2
 SG_ Line_1_Type : 175|4@0+ (1,0) [0|15] ""  CADM2
 SG_ Line_2_Confidence : 155|4@0+ (0.1,0) [0|1.5] ""  CADM2
 SG_ Line_2_Curvature : 47|16@0+ (9.77E-007,-0.032) [-0.032|0.032027695] ""  CADM2
 SG_ Line_2_Curvature_Rate : 111|16@0+ (3.7252902985E-009,-0.000122) [-0.000122|0.000122136899712198] ""  CADM2
 SG_ Line_2_End_Range : 310|7@0+ (0.5,-25) [-25|38.5] "m"  CADM2
 SG_ Line_2_Heading : 237|10@0+ (0.0009765625,-0.357) [-0.357|0.6420234375] "rad"  CADM2
 SG_ Line_2_Offset : 197|10@0+ (0.01,-5) [-5|5.23] "m"  CADM2
 SG_ Line_2_Start_Range : 278|7@0+ (0.5,-25) [-25|38.5] "m"  CADM2
 SG_ Line_2_Type : 171|4@0+ (1,0) [0|15] ""  CADM2
 SG_ Line_3_Confidence : 167|4@0+ (0.1,0) [0|1.5] ""  CADM2
 SG_ Line_3_Curvature : 63|16@0+ (9.77E-007,-0.032) [-0.032|0.032027695] ""  CADM2
 SG_ Line_3_Curvature_Rate : 127|16@0+ (3.7252902985E-009,-0.000122) [-0.000122|0.000122136899712198] ""  CADM2
 SG_ Line_3_End_Range : 319|7@0+ (0.5,-25) [-25|38.5] "m"  CADM2
 SG_ Line_3_Heading : 243|10@0+ (0.0009765625,-0.357) [-0.357|0.6420234375] "rad"  CADM2
 SG_ Line_3_Offset : 203|10@0+ (0.01,-5) [-5|5.23] "m"  CADM2
 SG_ Line_3_Start_Range : 287|7@0+ (0.5,-25) [-25|38.5] "m"  CADM2
 SG_ Line_3_Type : 183|4@0+ (1,0) [0|15] ""  CADM2
 SG_ Line_4_Confidence : 163|4@0+ (0.1,0) [0|1.5] ""  CADM2
 SG_ Line_4_Curvature : 79|16@0+ (9.77E-007,-0.032) [-0.032|0.032027695] ""  CADM2
 SG_ Line_4_Curvature_Rate : 143|16@0+ (3.7252902985E-009,-0.000122) [-0.000122|0.000122136899712198] ""  CADM2
 SG_ Line_4_End_Range : 326|7@0+ (0.5,-25) [-25|38.5] "m"  CADM2
 SG_ Line_4_Heading : 249|10@0+ (0.0009765625,-0.357) [-0.357|0.6420234375] "rad"  CADM2
 SG_ Line_4_Offset : 209|10@0+ (0.01,-5) [-5|5.23] "m"  CADM2
 SG_ Line_4_Start_Range : 294|7@0+ (0.5,-25) [-25|38.5] "m"  CADM2
 SG_ Line_4_Type : 179|4@0+ (1,0) [0|15] ""  CADM2
 SG_ MAC_ADAS_FD_LANES_1 : 471|48@0+ (1,0) [0|0] "-"  CADM2
 SG_ MessageCounter_ADAS_FD_LANES_1 : 435|4@0+ (1,0) [0|15] "-"  CADM2
 SG_ Reserved_for_functional_safety : 431|12@0+ (1,0) [0|0] ""  CADM2

BO_ 734 ADAS_FD_LANES_2: 64 CVADAS
 SG_ Cntr_ADAS_FD_LANES_2 : 455|16@0+ (1,0) [0|65535] "-"  CADM2
 SG_ CRC_ADAS_FD_LANES_2 : 447|8@0+ (1,0) [0|255] "-"  CADM2
 SG_ Frame_Index_Lanes_2 : 7|16@0+ (1,0) [0|65535] ""  CADM2
 SG_ MAC_ADAS_FD_LANES_2 : 471|48@0+ (1,0) [0|0] "-"  CADM2
 SG_ MessageCounter_ADAS_FD_LANES_2 : 435|4@0+ (1,0) [0|15] "-"  CADM2
 SG_ Reserved_for_functional_safety : 431|12@0+ (1,0) [0|0] ""  CADM2
 SG_ Segment_1_Confidence : 391|4@0+ (0.1,0) [0|1.5] ""  CADM2
 SG_ Segment_1_ID : 23|4@0+ (1,0) [0|15] ""  CADM2
 SG_ Segment_1_X1 : 55|11@0+ (0.03,-21) [-21|40.41] "m"  CADM2
 SG_ Segment_1_X2 : 223|11@0+ (0.03,-21) [-21|40.41] "m"  CADM2
 SG_ Segment_1_Y1 : 143|10@0+ (0.01,-5) [-5|5.23] "m"  CADM2
 SG_ Segment_1_Y2 : 311|10@0+ (0.01,-5) [-5|5.23] "m"  CADM2
 SG_ Segment_2_Confidence : 387|4@0+ (0.1,0) [0|1.5] ""  CADM2
 SG_ Segment_2_ID : 19|4@0+ (1,0) [0|15] ""  CADM2
 SG_ Segment_2_X1 : 60|11@0+ (0.03,-21) [-21|40.41] "m"  CADM2
 SG_ Segment_2_X2 : 228|11@0+ (0.03,-21) [-21|40.41] "m"  CADM2
 SG_ Segment_2_Y1 : 149|10@0+ (0.01,-5) [-5|5.23] "m"  CADM2
 SG_ Segment_2_Y2 : 317|10@0+ (0.01,-5) [-5|5.23] "m"  CADM2
 SG_ Segment_3_Confidence : 399|4@0+ (0.1,0) [0|1.5] ""  CADM2
 SG_ Segment_3_ID : 31|4@0+ (1,0) [0|15] ""  CADM2
 SG_ Segment_3_X1 : 65|11@0+ (0.03,-21) [-21|40.41] "m"  CADM2
 SG_ Segment_3_X2 : 233|11@0+ (0.03,-21) [-21|40.41] "m"  CADM2
 SG_ Segment_3_Y1 : 155|10@0+ (0.01,-5) [-5|5.23] "m"  CADM2
 SG_ Segment_3_Y2 : 323|10@0+ (0.01,-5) [-5|5.23] "m"  CADM2
 SG_ Segment_4_Confidence : 395|4@0+ (0.1,0) [0|1.5] ""  CADM2
 SG_ Segment_4_ID : 27|4@0+ (1,0) [0|15] ""  CADM2
 SG_ Segment_4_X1 : 86|11@0+ (0.03,-21) [-21|40.41] "m"  CADM2
 SG_ Segment_4_X2 : 254|11@0+ (0.03,-21) [-21|40.41] "m"  CADM2
 SG_ Segment_4_Y1 : 161|10@0+ (0.01,-5) [-5|5.23] "m"  CADM2
 SG_ Segment_4_Y2 : 329|10@0+ (0.01,-5) [-5|5.23] "m"  CADM2
 SG_ Segment_5_Confidence : 407|4@0+ (0.1,0) [0|1.5] ""  CADM2
 SG_ Segment_5_ID : 39|4@0+ (1,0) [0|15] ""  CADM2
 SG_ Segment_5_X1 : 91|11@0+ (0.03,-21) [-21|40.41] "m"  CADM2
 SG_ Segment_5_X2 : 259|11@0+ (0.03,-21) [-21|40.41] "m"  CADM2
 SG_ Segment_5_Y1 : 183|10@0+ (0.01,-5) [-5|5.23] "m"  CADM2
 SG_ Segment_5_Y2 : 351|10@0+ (0.01,-5) [-5|5.23] "m"  CADM2
 SG_ Segment_6_Confidence : 403|4@0+ (0.1,0) [0|1.5] ""  CADM2
 SG_ Segment_6_ID : 35|4@0+ (1,0) [0|15] ""  CADM2
 SG_ Segment_6_X1 : 96|11@0+ (0.03,-21) [-21|40.41] "m"  CADM2
 SG_ Segment_6_X2 : 264|11@0+ (0.03,-21) [-21|40.41] "m"  CADM2
 SG_ Segment_6_Y1 : 189|10@0+ (0.01,-5) [-5|5.23] "m"  CADM2
 SG_ Segment_6_Y2 : 357|10@0+ (0.01,-5) [-5|5.23] "m"  CADM2
 SG_ Segment_7_Confidence : 415|4@0+ (0.1,0) [0|1.5] ""  CADM2
 SG_ Segment_7_ID : 47|4@0+ (1,0) [0|15] ""  CADM2
 SG_ Segment_7_X1 : 117|11@0+ (0.03,-21) [-21|40.41] "m"  CADM2
 SG_ Segment_7_X2 : 285|11@0+ (0.03,-21) [-21|40.41] "m"  CADM2
 SG_ Segment_7_Y1 : 195|10@0+ (0.01,-5) [-5|5.23] "m"  CADM2
 SG_ Segment_7_Y2 : 363|10@0+ (0.01,-5) [-5|5.23] "m"  CADM2
 SG_ Segment_8_Confidence : 411|4@0+ (0.1,0) [0|1.5] ""  CADM2
 SG_ Segment_8_ID : 43|4@0+ (1,0) [0|15] ""  CADM2
 SG_ Segment_8_X1 : 122|11@0+ (0.03,-21) [-21|40.41] "m"  CADM2
 SG_ Segment_8_X2 : 290|11@0+ (0.03,-21) [-21|40.41] "m"  CADM2
 SG_ Segment_8_Y1 : 201|10@0+ (0.01,-5) [-5|5.23] "m"  CADM2
 SG_ Segment_8_Y2 : 369|10@0+ (0.01,-5) [-5|5.23] "m"  CADM2

BO_ 476 AGSM_FD_2: 32 BCM
 SG_ CRC_AGSM2 : 191|8@0+ (1,0) [0|255] "-"  CVADAS
 SG_ MessageCounter_AGSM2 : 179|4@0+ (1,0) [0|15] "-"  CVADAS
 SG_ Shifter_ADAS_Inhibit : 105|1@0+ (1,0) [0|1] "-"  CVADAS
 SG_ ShiftLeverPositionReq : 95|4@0+ (1,0) [0|7] "-"  CVADAS

BO_ 1327 ASCM_FD_1: 32 BCM
 SG_ MessageCounter_ASCM1 : 179|4@0+ (1,0) [0|15] ""  CVADAS
 SG_ CRC_ASCM1 : 191|8@0+ (1,0) [0|255] ""  CVADAS
 SG_ FL_Lvl : 103|8@0+ (1,-100) [-100|153] "mm"  CVADAS
 SG_ FL_Lvl_Adj : 87|1@0+ (1,0) [0|1] "-"  CVADAS
 SG_ FR_Lvl : 111|8@0+ (1,-100) [-100|153] "mm"  CVADAS
 SG_ FR_Lvl_Adj : 86|1@0+ (1,0) [0|1] "-"  CVADAS
 SG_ RL_Lvl : 119|8@0+ (1,-100) [-100|153] "mm"  CVADAS
 SG_ RL_Lvl_Adj : 84|1@0+ (1,0) [0|1] "-"  CVADAS
 SG_ RR_Lvl : 127|8@0+ (1,-100) [-100|153] "mm"  CVADAS
 SG_ RR_Lvl_Adj : 83|1@0+ (1,0) [0|1] "-"  CVADAS

BO_ 1445 ASCM_FD_2: 32 BCM
 SG_ MessageCounter_ASCM2 : 179|4@0+ (1,0) [0|15] ""  CVADAS
 SG_ CRC_ASCM2 : 191|8@0+ (1,0) [0|255] ""  CVADAS
 SG_ ADC_Stat_2 : 10|3@0+ (1,0) [0|6] "-"  ORC
 SG_ ASCM_Srv : 111|1@0+ (1,0) [0|1] "-"  ORC
 SG_ ASCM_Stat : 135|4@0+ (1,0) [0|14] "-"  CVADAS
 SG_ ASCM_StatDisp : 99|4@0+ (1,0) [0|14] "-"  ORC
 SG_ ASCM_SysFail : 110|1@0+ (1,0) [0|1] "-"  CVADAS,ORC

BO_ 204 AXLE_TORQUE_FD_1: 48 BCM
 SG_ Axle_Torque_DrvReqMod : 55|16@0+ (2,-65534) [-65534|65536] "Nm"  ORC
 SG_ Axle_TorqueStatic_D_TTC : 39|16@0+ (2,-65534) [-65534|65536] "Nm"  ORC

BO_ 1153 BCM_FD_10: 32 BCM
 SG_ BSS_LT_Blind_RQSts : 8|1@0+ (1,0) [0|1] "-"  ORC
 SG_ BSS_LT_CFG_STATSts : 23|2@0+ (1,0) [0|2] "-"  ORC
 SG_ BSS_LT_SRV_RQSts : 21|1@0+ (1,0) [0|1] "-"  ORC
 SG_ BSS_RT_Blind_RQSts : 20|1@0+ (1,0) [0|1] "-"  ORC
 SG_ BSS_RT_CFG_STATSts : 19|2@0+ (1,0) [0|2] "-"  ORC
 SG_ BSS_RT_SRV_RQSts : 17|1@0+ (1,0) [0|1] "-"  ORC
 SG_ CmdIgnSts : 138|3@0+ (1,0) [0|7] ""  BCM,BSM2,CADM2,CVADAS,EPS,ORC,PAM,SGW,TRSKM
 SG_ CRC_BCM10 : 191|8@0+ (1,0) [0|255] "-"  BSM2,CADM2,CVADAS,EPS
 SG_ DAY_LGT_MD : 15|1@0+ (1,0) [0|1] ""  TRSKM
 SG_ ExternalTemperatureC : 80|9@0+ (0.5,-85) [-85|170] "°C"  CADM2,TRSKM
 SG_ ExternalTemperatureF : 96|9@0+ (1,-121) [-121|389] "°F" Vector__XXX
 SG_ MessageCounter_BCM10 : 179|4@0+ (1,0) [0|15] "-"  BSM2,CADM2,CVADAS,EPS
 SG_ PANEL_INTS : 7|8@0+ (0.5,0) [0|100] "%"  TRSKM
 SG_ StTypSts : 141|3@0+ (1,0) [0|7] "" Vector__XXX
 SG_ TurnIndicationSts : 143|2@0+ (1,0) [0|3] "" Vector__XXX
 SG_ WPR_SYS_AUTO : 43|1@0+ (1,0) [0|1] "-" Vector__XXX

BO_ 1430 BCM_FD_11: 32 BCM
 SG_ EngineOffTimer : 83|12@0+ (1,0) [0|4080] "min" Vector__XXX

BO_ 1431 BCM_FD_12: 32 BCM
 SG_ AirTemp_Outsd : 47|8@0+ (0.5,-40) [-40|85] "°C" Vector__XXX
 SG_ APARequestSts : 124|1@0+ (1,0) [0|1] ""  CVADAS
 SG_ CRC_BCM12 : 191|8@0+ (1,0) [0|255] "-"  CADM2,CVADAS
 SG_ DALM_Status : 96|1@0+ (1,0) [0|1] ""  CADM2
 SG_ EPS_MODE_REQ : 20|3@0+ (1,0) [0|6] ""  EPS,ORC,SGW
 SG_ FT_PAMRequestSts : 37|1@0+ (1,0) [0|1] ""  CVADAS,PAM
 SG_ IGN_OFF_TIME_LNG : 147|12@0+ (1,0) [0|4080] "min" Vector__XXX
 SG_ MessageCounter_BCM12 : 179|4@0+ (1,0) [0|15] "-"  CADM2,CVADAS
 SG_ PAMRequestSts : 125|1@0+ (1,0) [0|1] ""  CVADAS,PAM
 SG_ SeatVib_Sts : 33|2@0+ (1,0) [0|3] ""  CADM2

BO_ 159 BCM_FD_13: 32 BCM
 SG_ ACC_DistSwDec : 87|1@0+ (1,0) [0|1] "" Vector__XXX
 SG_ ACC_DistSwInc : 86|1@0+ (1,0) [0|1] "" Vector__XXX
 SG_ ACC_On : 85|1@0+ (1,0) [0|1] ""  CADM2
 SG_ AcceleratorSts : 110|1@0+ (1,0) [0|1] "" Vector__XXX
 SG_ CRC_BCM13 : 191|8@0+ (1,0) [0|255] "-" Vector__XXX
 SG_ CRC_CSWC_1 : 103|8@0+ (1,0) [0|255] "" Vector__XXX
 SG_ CruiseControlFailSts : 107|1@0+ (1,0) [0|1] ""  ORC
 SG_ CruiseControlOnOffSts : 111|1@0+ (1,0) [0|1] ""  ORC
 SG_ CrusCnclSwitch : 84|1@0+ (1,0) [0|1] ""  CADM2
 SG_ DeceleratorSts : 109|1@0+ (1,0) [0|1] "" Vector__XXX
 SG_ MC_CSWC_1 : 95|4@0+ (1,0) [0|15] "" Vector__XXX
 SG_ MessageCounter_BCM13 : 179|4@0+ (1,0) [0|15] "-" Vector__XXX
 SG_ ResumeSwitch : 108|1@0+ (1,0) [0|1] "" Vector__XXX

BO_ 736 BCM_FD_14: 32 BCM
 SG_ Command_01Sts : 75|2@0+ (1,0) [0|2] "" Vector__XXX
 SG_ Command_02Sts : 73|2@0+ (1,0) [0|2] "" Vector__XXX
 SG_ Command_03Sts : 87|2@0+ (1,0) [0|2] "" Vector__XXX
 SG_ Command_04Sts : 85|2@0+ (1,0) [0|2] "" Vector__XXX
 SG_ Command_05Sts : 83|2@0+ (1,0) [0|2] "" Vector__XXX
 SG_ Command_06Sts : 81|2@0+ (1,0) [0|2] "" Vector__XXX
 SG_ Command_07Sts : 95|2@0+ (1,0) [0|2] "" Vector__XXX
 SG_ Command_08Sts : 93|2@0+ (1,0) [0|2] "" Vector__XXX
 SG_ Command_09Sts : 91|2@0+ (1,0) [0|2] "" Vector__XXX
 SG_ Command_10Sts : 89|2@0+ (1,0) [0|2] "" Vector__XXX
 SG_ Command_11Sts : 103|2@0+ (1,0) [0|2] "" Vector__XXX
 SG_ Command_12Sts : 101|2@0+ (1,0) [0|2] "" Vector__XXX
 SG_ Command_13Sts : 99|2@0+ (1,0) [0|2] "" Vector__XXX
 SG_ Command_14Sts : 97|2@0+ (1,0) [0|2] "" Vector__XXX
 SG_ Command_15Sts : 111|2@0+ (1,0) [0|2] "" Vector__XXX
 SG_ CRC_BCM14 : 191|8@0+ (1,0) [0|255] "-" Vector__XXX
 SG_ MessageCounter_BCM14 : 179|4@0+ (1,0) [0|15] "-" Vector__XXX

BO_ 512 BCM_FD_18: 32 BCM
 SG_ BonnetAjarRawValSts_8 : 15|8@0+ (0.019607843,0) [0|4.999999965] "Volt"  ORC
 SG_ DriverDoor2AjarRawValSts_8 : 7|8@0+ (0.019607843,0) [0|4.999999965] "Volt"  ORC
 SG_ DriverDoorAjarRawValSts_8 : 31|8@0+ (0.019607843,0) [0|4.999999965] "Volt"  ORC

BO_ 256 BCM_FD_2: 32 BCM
 SG_ CRC_BCM2 : 191|8@0+ (1,0) [0|255] "-"  BSM2,CVADAS
 SG_ KeyInIgnSts : 106|2@0+ (1,0) [0|2] "" Vector__XXX
 SG_ MessageCounter_BCM2 : 179|4@0+ (1,0) [0|15] "-"  BSM2,CVADAS
 SG_ OperationalModeSts : 75|4@0+ (1,0) [0|15] ""  BSM2,CADM2,CVADAS,EPS,ORC,PAM,SGW
 SG_ RemStActvSts : 107|1@0+ (1,0) [0|1] ""  CVADAS,PAM
 SG_ TurnIndicatorSts : 95|2@0+ (1,0) [0|3] "-"  CVADAS,ORC

BO_ 1826 BCM_FD_21: 32 BCM
 SG_ OCMPsgSeatSBRSts : 75|4@0+ (1,0) [0|15] ""  ORC
 SG_ PsgSeatOCFaultSts : 83|1@0+ (1,0) [0|1] ""  ORC
 SG_ PsgSeatOCSts : 87|4@0+ (1,0) [0|15] ""  ORC,SGW

BO_ 602 BCM_FD_22: 32 BCM
 SG_ CRC_BCM22 : 191|8@0+ (1,0) [0|255] "-"  CADM2
 SG_ MessageCounter_BCM22 : 179|4@0+ (1,0) [0|15] "-"  CADM2
 SG_ TurnLeverLatched : 8|1@0+ (1,0) [0|1] ""  CADM2

BO_ 1434 BCM_FD_23: 32 BCM
 SG_ BCM_AUX1_HLEnbl : 27|1@0+ (1,0) [0|1] "" Vector__XXX
 SG_ BCM_AUX1_PWRMD : 31|1@0+ (1,0) [0|1] "" Vector__XXX
 SG_ BCM_AUX1_Type : 0|1@0+ (1,0) [0|1] "" Vector__XXX
 SG_ BCM_AUX2_HLEnbl : 26|1@0+ (1,0) [0|1] "" Vector__XXX
 SG_ BCM_AUX2_PWRMD : 30|1@0+ (1,0) [0|1] "" Vector__XXX
 SG_ BCM_AUX2_Type : 10|1@0+ (1,0) [0|1] "" Vector__XXX
 SG_ BCM_AUX3_HLEnbl : 25|1@0+ (1,0) [0|1] "" Vector__XXX
 SG_ BCM_AUX3_PWRMD : 29|1@0+ (1,0) [0|1] "" Vector__XXX
 SG_ BCM_AUX3_Type : 9|1@0+ (1,0) [0|1] "" Vector__XXX
 SG_ BCM_AUX4_HLEnbl : 24|1@0+ (1,0) [0|1] "" Vector__XXX
 SG_ BCM_AUX4_PWRMD : 28|1@0+ (1,0) [0|1] "" Vector__XXX
 SG_ BCM_AUX4_Type : 8|1@0+ (1,0) [0|1] "" Vector__XXX
 SG_ BCM_AUX5_HLEnbl : 62|1@0+ (1,0) [0|1] "" Vector__XXX
 SG_ BCM_AUX5_PWRMD : 32|1@0+ (1,0) [0|1] "" Vector__XXX
 SG_ BCM_AUX5_Type : 34|1@0+ (1,0) [0|1] "" Vector__XXX
 SG_ BCM_AUX6_HLEnbl : 61|1@0+ (1,0) [0|1] "" Vector__XXX
 SG_ BCM_AUX6_PWRMD : 63|1@0+ (1,0) [0|1] "" Vector__XXX
 SG_ BCM_AUX6_Type : 33|1@0+ (1,0) [0|1] "" Vector__XXX
 SG_ Cfg_Aux_PTO : 39|3@0+ (1,0) [0|6] "" Vector__XXX

BO_ 1069 BCM_FD_24: 32 BCM
 SG_ FronWasherSts : 147|1@0+ (1,0) [0|1] "" Vector__XXX

BO_ 1435 BCM_FD_26: 32 BCM
 SG_ ADS_MODE_REQ : 125|3@0+ (1,0) [0|7] ""  ORC,SGW
 SG_ CRC_BCM26 : 191|8@0+ (1,0) [0|255] "-" Vector__XXX
 SG_ HAS_OnOffSts : 122|1@0+ (1,0) [0|1] ""  CADM2
 SG_ MessageCounter_BCM26 : 179|4@0+ (1,0) [0|15] "-" Vector__XXX

BO_ 1436 BCM_FD_27: 32 BCM
 SG_ Comfort_Enable_Act : 5|1@0+ (1,0) [0|0] "" Vector__XXX
 SG_ Comfort_Enable_Time : 55|16@0+ (1,0) [0|65534] "sec" Vector__XXX
 SG_ CRC_BCM27 : 191|8@0+ (1,0) [0|255] "-"  CVADAS
 SG_ MessageCounter_BCM27 : 179|4@0+ (1,0) [0|15] "-"  CVADAS
 SG_ TrailerConnectionSts : 106|2@0+ (1,0) [0|3] ""  CVADAS,PAM

BO_ 1470 BCM_FD_29: 32 BCM
 SG_ CRC_BCM29 : 191|8@0+ (1,0) [0|255] "-"  CVADAS
 SG_ ITBM_TrlrStat : 46|2@0+ (1,0) [0|0] ""  CVADAS,PAM
 SG_ MessageCounter_BCM29 : 179|4@0+ (1,0) [0|15] "-"  CVADAS

BO_ 750 BCM_FD_3: 32 BCM
 SG_ Battery_Volt_1 : 56|9@0+ (0.025,5) [5|17.75] "Volt"  BSM2,CADM2,CVADAS,EPS,ORC,PAM,TRSKM
 SG_ Battery_Volt_2 : 49|9@0+ (0.025,5) [5|17.75] "Volt"  CADM2
 SG_ CRC_BCM3 : 191|8@0+ (1,0) [0|255] "-"  BSM2
 SG_ FronWiperFailSts : 7|1@0+ (1,0) [0|1] "" Vector__XXX
 SG_ MessageCounter_BCM3 : 179|4@0+ (1,0) [0|15] "-"  BSM2

CM_ "Project_DT24_ProjectStandard_FD-CAN2 [CS00155_FD]";
CM_ BO_ 3221225472 "This is a message for not used signals, created by Vector CANdb++ DBC OLE DB Provider.";
CM_ SG_ 1458 ACC_DispPopupSts_C2 "ACC_DispPopupSts_C2";
CM_ SG_ 1458 ACC_FailSts_C2 "ACC_FailSts_C2";
CM_ SG_ 1458 AEB_DispPopupSts_C2 "AEB_DispPopupSts_C2";
CM_ SG_ 1458 Chime_Priority_C2 "Chime_Priority_C2";
CM_ SG_ 1458 Chime_RepRate_C2 "Chime_RepRate_C2";
CM_ SG_ 1458 Chime_TypSts_C2 "Chime_TypSts_C2";
CM_ SG_ 1458 CRC_ADAS_HMI_C2 "CRC according to SAE J1850 standard at each frame transmission.";
CM_ SG_ 1458 DisplaySts_ACC_C2 "DisplaySts_ACC_C2";
CM_ SG_ 1458 DisplaySts_OFF_C2 "DisplaySts_OFF_C2";
CM_ SG_ 1458 DisplaySts_Veh_C2 "DisplaySts_Veh_C2";
CM_ SG_ 1458 HAS_Escalation_Sts_C2 "Request from the primary controller to actuate the Hazard lamps.";
CM_ SG_ 1458 HAS_Hazard_C2 "Request from the primary controller to actuate the Hazard lamps.";
CM_ SG_ 1458 HAS_TelltaleSts_C2 "HAS_TelltaleSts_C2";
CM_ SG_ 1458 Lane_DisplaySts_Left_C2 "Lane_DisplaySts_Left_C2";
CM_ SG_ 1458 Lane_DisplaySts_Right_C2 "Lane_DisplaySts_Right_C2";
CM_ SG_ 1458 Lane_DispPopupSts_C2 "Lane_DispPopupSts_C2";
CM_ SG_ 1458 LF_Chime_RqSts_C2 "LF_Chime_RqSts_C2";
CM_ SG_ 1458 LR_Chime_RqSts_C2 "LR_Chime_RqSts_C2";
CM_ SG_ 1458 MessageCounter_ADAS_HMI_C2 "This signal is a counter used for safety checks strategies. This counter is incremented of 1 (one) unit at each frame transmission.";
CM_ SG_ 1458 RF_Chime_RqSts_C2 "RF_Chime_RqSts_C2";
CM_ SG_ 1458 RR_Chime_RqSts_C2 "RR_Chime_RqSts_C2";
CM_ SG_ 1458 Set_Speed_KPH_C2 "Set_Speed_KPH_C2";
CM_ SG_ 1458 Set_Speed_MPH_C2 "Set_Speed_MPH_C2";
CM_ SG_ 1458 SVI_Request_C2 "SVI_Request_C2";
CM_ SG_ 280 CRC_ADAS_FD_INFO "CRC according to SAE J1850 standard at each frame transmission.";
CM_ SG_ 280 HAS_Status "Highway Assist System Status as reported by the main controller";
CM_ SG_ 280 MessageCounter_ADAS_FD_INFO "This signal is a counter used for safety checks strategies. This counter is incremented of 1 (one) unit at each frame transmission.";
CM_ SG_ 281 ACC_Systemsts_C2 "ACC_Systemsts_C2";
CM_ SG_ 281 AEB_Type_C2 "AEB_Type_C2";
CM_ SG_ 281 CADM_EPSADAS_FAIL "CADM detection of failure to communicate to EPS";
CM_ SG_ 281 CADM2_Mode "Mode CADM2 is currently functioning";
CM_ SG_ 281 CADM2_OpStat "Capability of secondary controller to sense and compute a valid trajectory path based on external data dependencies and internal failures";
CM_ SG_ 281 CRC_ADAS_INFO_C2 "CRC according to SAE J1850 standard at each frame transmission.";
CM_ SG_ 281 ESCALATION_TYPE_C2 "Type of HMI escalation to be provided to driver from failover controller";
CM_ SG_ 281 HAS_LAT_CTRL_RequestSts_C2 "HAS_LAT_CTRL_RequestSts_C2";
CM_ SG_ 281 HAS_OpStat_Sec "Capability of the failover controller to perform sensing, computing, and actuation";
CM_ SG_ 281 HAS_Status_C2 "Highway Assist System Status as reported by the failover controller";
CM_ SG_ 281 HIS_Req_C2 "HIS_Req_C2";
CM_ SG_ 281 Intervention_C2 "Intervention_C2";
CM_ SG_ 281 MessageCounter_ADAS_INFO_C2 "This signal is a counter used for safety checks strategies. This counter is incremented of 1 (one) unit at each frame transmission.";
CM_ SG_ 281 MRM_STATUS_C2 "Status of the minimum risk maneuver to handle system faults or driver abuse as understood by secondary controller";
CM_ SG_ 281 TorqueOverlaySteeringReq_C2 "TorqueOverlaySteeringReq_C2";
CM_ SG_ 613 CADM2_DALM_CRC "CRC according to SAE J1850 standard at each frame transmission.";
CM_ SG_ 613 CADM2_DALM_MC "This signal is a counter used for safety checks strategies. This counter is incremented of 1 (one) unit at each frame transmission.";
CM_ SG_ 613 DALM_Request_C2 "Request to driver alert lighting modules to trigger patttern and color display from secondary controller";
CM_ SG_ 613 HAS_OpStat_Sec_DALM "Capability of the secondary controller to perform sensing, computing, and actuation";
CM_ SG_ 613 HAS_Status_C2_DALM "Highway Assist System Status as reported by the secondary controller";
CM_ SG_ 730 Camera_Status "List of which cameras are active";
CM_ SG_ 730 CRC_ADAS_FD_LANES_1 "CRC according to SAE J1850 standard at each frame transmission.";
CM_ SG_ 730 FOD_Confidence "Front Object Detection Confidence";
CM_ SG_ 730 Frame_Index_Lanes_1 "Frame index number for lanes_1 data";
CM_ SG_ 730 Health_Front_Object_Detection "Health of the Front Object Detection system";
CM_ SG_ 730 Health_Lane_Detection "Health of the Lane Marker Detection system";
CM_ SG_ 730 Line_1_Confidence "Lane marker 1 confidence";
CM_ SG_ 730 Line_1_Curvature "Lane marker 1 curvature rate (2nd order)";
CM_ SG_ 730 Line_1_Curvature_Rate "Lane marker 1 curvature rate (3rd order)";
CM_ SG_ 730 Line_1_End_Range "Lane marker 1 end range/view range";
CM_ SG_ 730 Line_1_Heading "Lane marker 1 heading angle (1st order)";
CM_ SG_ 730 Line_1_Offset "Lane marker 1 offset distance";
CM_ SG_ 730 Line_1_Start_Range "Lane marker 1 start range/view range";
CM_ SG_ 730 Line_1_Type "Lane marker 1 type";
CM_ SG_ 730 Line_2_Confidence "Lane marker 2 confidence";
CM_ SG_ 730 Line_2_Curvature "Lane marker 2 curvature rate (2nd order)";
CM_ SG_ 730 Line_2_Curvature_Rate "Lane marker 2 curvature rate (3rd order)";
CM_ SG_ 730 Line_2_End_Range "Lane marker 2 end range/view range";
CM_ SG_ 730 Line_2_Heading "Lane marker 2 heading angle (1st order)";
CM_ SG_ 730 Line_2_Offset "Lane marker 2 offset distance";
CM_ SG_ 730 Line_2_Start_Range "Lane marker 2 start range/view range";
CM_ SG_ 730 Line_2_Type "Lane marker 2 type";
CM_ SG_ 730 Line_3_Confidence "Lane marker 3 confidence";
CM_ SG_ 730 Line_3_Curvature "Lane marker 3 curvature rate (2nd order)";
CM_ SG_ 730 Line_3_Curvature_Rate "Lane marker 3 curvature rate (3rd order)";
CM_ SG_ 730 Line_3_End_Range "Lane marker 3 end range/view range";
CM_ SG_ 730 Line_3_Heading "Lane marker 3 heading angle (1st order)";
CM_ SG_ 730 Line_3_Offset "Lane marker 3 offset distance";
CM_ SG_ 730 Line_3_Start_Range "Lane marker 3 start range/view range";
CM_ SG_ 730 Line_3_Type "Lane marker 3 type";
CM_ SG_ 730 Line_4_Confidence "Lane marker 4 confidence";
CM_ SG_ 730 Line_4_Curvature "Lane marker 4 curvature rate (2nd order)";
CM_ SG_ 730 Line_4_Curvature_Rate "Lane marker 4 curvature rate (3rd order)";
CM_ SG_ 730 Line_4_End_Range "Lane marker 4 end range/view range";
CM_ SG_ 730 Line_4_Heading "Lane marker 4 heading angle (1st order)";
CM_ SG_ 730 Line_4_Offset "Lane marker 4 offset distance";
CM_ SG_ 730 Line_4_Start_Range "Lane marker 4 start range/view range";
CM_ SG_ 730 Line_4_Type "Lane marker 4 type";
CM_ SG_ 730 MAC_ADAS_FD_LANES_1 "-";
CM_ SG_ 730 MessageCounter_ADAS_FD_LANES_1 "This signal is a counter used for safety checks strategies. This counter is incremented of 1 (one) unit at each frame transmission.";
CM_ SG_ 734 CRC_ADAS_FD_LANES_2 "CRC according to SAE J1850 standard at each frame transmission.";
CM_ SG_ 734 Frame_Index_Lanes_2 "Frame index number for lanes_2 data";
CM_ SG_ 734 MAC_ADAS_FD_LANES_2 "-";
CM_ SG_ 734 MessageCounter_ADAS_FD_LANES_2 "This signal is a counter used for safety checks strategies. This counter is incremented of 1 (one) unit at each frame transmission.";
CM_ SG_ 734 Segment_1_Confidence "Line segment 1 confidence";
CM_ SG_ 734 Segment_1_ID "ID value of line segment 1";
CM_ SG_ 734 Segment_1_X1 "Line segment 1 start point longitudinal position";
CM_ SG_ 734 Segment_1_X2 "Line segment 1 end point longitudinal position";
CM_ SG_ 734 Segment_1_Y1 "Line segment 1 start point lateral position";
CM_ SG_ 734 Segment_1_Y2 "Line segment 1 end point lateral position";
CM_ SG_ 734 Segment_2_Confidence "Line segment 2 confidence";
CM_ SG_ 734 Segment_2_ID "ID value of line segment 2";
CM_ SG_ 734 Segment_2_X1 "Line segment 2 start point longitudinal position";
CM_ SG_ 734 Segment_2_X2 "Line segment 2 end point longitudinal position";
CM_ SG_ 734 Segment_2_Y1 "Line segment 2 start point lateral position";
CM_ SG_ 734 Segment_2_Y2 "Line segment 2 end point lateral position";
CM_ SG_ 734 Segment_3_Confidence "Line segment 3 confidence";
CM_ SG_ 734 Segment_3_ID "ID value of line segment 3";
CM_ SG_ 734 Segment_3_X1 "Line segment 3 start point longitudinal position";
CM_ SG_ 734 Segment_3_X2 "Line segment 3 end point longitudinal position";
CM_ SG_ 734 Segment_3_Y1 "Line segment 3 start point lateral position";
CM_ SG_ 734 Segment_3_Y2 "Line segment 3 end point lateral position";
CM_ SG_ 734 Segment_4_Confidence "Line segment 4 confidence";
CM_ SG_ 734 Segment_4_ID "ID value of line segment 4";
CM_ SG_ 734 Segment_4_X1 "Line segment 4 start point longitudinal position";
CM_ SG_ 734 Segment_4_X2 "Line segment 4 end point longitudinal position";
CM_ SG_ 734 Segment_4_Y1 "Line segment 4 start point lateral position";
CM_ SG_ 734 Segment_4_Y2 "Line segment 4 end point lateral position";
CM_ SG_ 734 Segment_5_Confidence "Line segment 5 confidence";
CM_ SG_ 734 Segment_5_ID "ID value of line segment 5";
CM_ SG_ 734 Segment_5_X1 "Line segment 5 start point longitudinal position";
CM_ SG_ 734 Segment_5_X2 "Line segment 5 end point longitudinal position";
CM_ SG_ 734 Segment_5_Y1 "Line segment 5 start point lateral position";
CM_ SG_ 734 Segment_5_Y2 "Line segment 5 end point lateral position";
CM_ SG_ 734 Segment_6_Confidence "Line segment 6 confidence";
CM_ SG_ 734 Segment_6_ID "ID value of line segment 6";
CM_ SG_ 734 Segment_6_X1 "Line segment 6 start point longitudinal position";
CM_ SG_ 734 Segment_6_X2 "Line segment 6 end point longitudinal position";
CM_ SG_ 734 Segment_6_Y1 "Line segment 6 start point lateral position";
CM_ SG_ 734 Segment_6_Y2 "Line segment 6 end point lateral position";
CM_ SG_ 734 Segment_7_Confidence "Line segment 7 confidence";
CM_ SG_ 734 Segment_7_ID "ID value of line segment 7";
CM_ SG_ 734 Segment_7_X1 "Line segment 7 start point longitudinal position";
CM_ SG_ 734 Segment_7_X2 "Line segment 7 end point longitudinal position";
CM_ SG_ 734 Segment_7_Y1 "Line segment 7 start point lateral position";
CM_ SG_ 734 Segment_7_Y2 "Line segment 7 end point lateral position";
CM_ SG_ 734 Segment_8_Confidence "Line segment 8 confidence";
CM_ SG_ 734 Segment_8_ID "ID value of line segment 8";
CM_ SG_ 734 Segment_8_X1 "Line segment 8 start point longitudinal position";
CM_ SG_ 734 Segment_8_X2 "Line segment 8 end point longitudinal position";
CM_ SG_ 734 Segment_8_Y1 "Line segment 8 start point lateral position";
CM_ SG_ 734 Segment_8_Y2 "Line segment 8 end point lateral position";
CM_ SG_ 476 CRC_AGSM2 "CRC according to SAE J1850 standard at each frame transmission.";
CM_ SG_ 476 MessageCounter_AGSM2 "This signal is a counter used for safety checks strategies. This counter is incremented of 1 (one) unit at each frame transmission.";
CM_ SG_ 476 Shifter_ADAS_Inhibit "Indicates if the shifter is able to autocorrect";
CM_ SG_ 476 ShiftLeverPositionReq "-";
CM_ SG_ 1327 FL_Lvl "Front left level";
CM_ SG_ 1327 FL_Lvl_Adj "Front left level adjust (1=adjusting)";
CM_ SG_ 1327 FR_Lvl "Front right level";
CM_ SG_ 1327 FR_Lvl_Adj "Front right level adjust (1=adjusting)";
CM_ SG_ 1327 RL_Lvl "Rear left level";
CM_ SG_ 1327 RL_Lvl_Adj "Rear left level adjust (1=adjusting)";
CM_ SG_ 1327 RR_Lvl "Rear right level";
CM_ SG_ 1327 RR_Lvl_Adj "Rear right level adjust (1=adjusting)";
CM_ SG_ 1445 ADC_Stat_2 "Active damping control status";
CM_ SG_ 1445 ASCM_Srv "Service air suspension; 1 = True";
CM_ SG_ 1445 ASCM_Stat "Air suspension status";
CM_ SG_ 1445 ASCM_StatDisp "Air suspension status for display";
CM_ SG_ 1445 ASCM_SysFail "Loss of function - system fault; 1 = True";
CM_ SG_ 204 Axle_Torque_DrvReqMod "Driver requested Axle torque raw (no torque shaping)";
CM_ SG_ 204 Axle_TorqueStatic_D_TTC "Driver requested Axle torque (filtered/ torque shaped)";
CM_ SG_ 1153 BSS_LT_Blind_RQSts "Sensor blinded request from BSS Left";
CM_ SG_ 1153 BSS_LT_CFG_STATSts "Blind Spot left Side configuration status";
CM_ SG_ 1153 BSS_LT_SRV_RQSts "BSS Left Side service warning request";
CM_ SG_ 1153 BSS_RT_Blind_RQSts "Sensor blinded request from BSS Right";
CM_ SG_ 1153 BSS_RT_CFG_STATSts "Blind Spot Right Side configuration status";
CM_ SG_ 1153 BSS_RT_SRV_RQSts "BSS Right Side service warning request";
CM_ SG_ 1153 CmdIgnSts "Used to give information about the key selector position";
CM_ SG_ 1153 CRC_BCM10 "CRC according to SAE J1850 standard at each frame transmission.";
CM_ SG_ 1153 DAY_LGT_MD "Day light brightness mode; Night=[0], Day=[1]";
CM_ SG_ 1153 ExternalTemperatureC "Used to indicate the external temperature value in °C";
CM_ SG_ 1153 ExternalTemperatureF "Used to indicate the external temperature value in °F";
CM_ SG_ 1153 MessageCounter_BCM10 "This signal is a counter used for safety checks strategies. This counter is incremented of 1 (one) unit at each frame transmission.";
CM_ SG_ 1153 PANEL_INTS "Panel-/display intensity";
CM_ SG_ 1153 WPR_SYS_AUTO "Wiper system auto; [1] = Auto wipers equipped";
CM_ SG_ 1430 EngineOffTimer "Engine off timer - engine off ignition NOT lock.";
CM_ SG_ 1431 AirTemp_Outsd "Outside air temperature";
CM_ SG_ 1431 APARequestSts "It indicates the pressure of Advanced Park Assist pushbutton";
CM_ SG_ 1431 CRC_BCM12 "CRC according to SAE J1850 standard at each frame transmission.";
CM_ SG_ 1431 DALM_Status "DALM status";
CM_ SG_ 1431 EPS_MODE_REQ "EPS mode personalization request";
CM_ SG_ 1431 FT_PAMRequestSts "Front Park Sense Button Status";
CM_ SG_ 1431 IGN_OFF_TIME_LNG "Time since last ignition on (long)";
CM_ SG_ 1431 MessageCounter_BCM12 "This signal is a counter used for safety checks strategies. This counter is incremented of 1 (one) unit at each frame transmission.";
CM_ SG_ 1431 PAMRequestSts "It indicates the pressure of Park Assist pushbutton";
CM_ SG_ 1431 SeatVib_Sts "Seat vibration status";
CM_ SG_ 159 ACC_DistSwDec "ACC distance switch decrement";
CM_ SG_ 159 ACC_DistSwInc "ACC distance switch increment";
CM_ SG_ 159 ACC_On "ACC on/off";
CM_ SG_ 159 AcceleratorSts "This signal is used to give information about cruise control accelerator button activation.";
CM_ SG_ 159 CRC_BCM13 "CRC according to SAE J1850 standard at each frame transmission.";
CM_ SG_ 159 CRC_CSWC_1 "CRC according to SAE J1850 standard that has to be calculated from bit 63 to bit 48 at each frame transmission.";
CM_ SG_ 159 CruiseControlFailSts "This signal is used to give information about a fault on cruise control commands";
CM_ SG_ 159 CruiseControlOnOffSts "This signal is used to give information about cruise control on/off button activation .";
CM_ SG_ 159 CrusCnclSwitch "Cruise Switch:  Cancel Pressed.";
CM_ SG_ 159 DeceleratorSts "This signal is used to give information about cruise control decelerator button activation.";
CM_ SG_ 159 MC_CSWC_1 "This signal is a counter used for safety checks strategies. This counter is incremented of 1 (one) unit at each frame transmission.";
CM_ SG_ 159 MessageCounter_BCM13 "This signal is a counter used for safety checks strategies. This counter is incremented of 1 (one) unit at each frame transmission.";
CM_ SG_ 159 ResumeSwitch "This signal is used to give information about cruise control RESUME button activation.";
CM_ SG_ 736 Command_01Sts "Infotainment Switch 1";
CM_ SG_ 736 Command_02Sts "Infotainment Switch 2";
CM_ SG_ 736 Command_03Sts "Infotainment Switch 3";
CM_ SG_ 736 Command_04Sts "Infotainment Switch 4";
CM_ SG_ 736 Command_05Sts "Infotainment Switch 5";
CM_ SG_ 736 Command_06Sts "Infotainment Switch 6";
CM_ SG_ 736 Command_07Sts "Infotainment Switch 7";
CM_ SG_ 736 Command_08Sts "Infotainment Switch 8";
CM_ SG_ 736 Command_09Sts "Infotainment Switch 9";
CM_ SG_ 736 Command_10Sts "Infotainment Switch 10";
CM_ SG_ 736 Command_11Sts "Infotainment Switch 11";
CM_ SG_ 736 Command_12Sts "Infotainment Switch 12";
CM_ SG_ 736 Command_13Sts "Infotainment Switch 13";
CM_ SG_ 736 Command_14Sts "Infotainment Switch 14";
CM_ SG_ 736 Command_15Sts "Infotainment Switch 15";
CM_ SG_ 736 CRC_BCM14 "CRC according to SAE J1850 standard at each frame transmission.";
CM_ SG_ 736 MessageCounter_BCM14 "This signal is a counter used for safety checks strategies. This counter is incremented of 1 (one) unit at each frame transmission.";
CM_ SG_ 512 BonnetAjarRawValSts_8 "The signal gives info on Bonnet ajar input to engine controller to use for stop-start and do diagnosis in the engine controller.";
CM_ SG_ 512 DriverDoor2AjarRawValSts_8 "Driver door status value";
CM_ SG_ 512 DriverDoorAjarRawValSts_8 "The signal gives info on Driver Door ajar input to engine controller to use for stop-start and do diagnosis in the engine controller.";
CM_ SG_ 256 CRC_BCM2 "CRC according to SAE J1850 standard at each frame transmission.";
CM_ SG_ 256 KeyInIgnSts "Key in ignition status";
CM_ SG_ 256 MessageCounter_BCM2 "This signal is a counter used for safety checks strategies. This counter is incremented of 1 (one) unit at each frame transmission.";
CM_ SG_ 256 RemStActvSts "Redundant Remote Start Active Status";
CM_ SG_ 256 TurnIndicatorSts "The signal is used to indicate the turn indicator position.";
CM_ SG_ 1826 OCMPsgSeatSBRSts "OCM Passenger Seat SBR Status";
CM_ SG_ 1826 PsgSeatOCFaultSts "Passenger Seat OC Fault Status";
CM_ SG_ 1826 PsgSeatOCSts "Passenger Seat OC Status";
CM_ SG_ 602 CRC_BCM22 "CRC according to SAE J1850 standard at each frame transmission.";
CM_ SG_ 602 MessageCounter_BCM22 "This signal is a counter used for safety checks strategies. This counter is incremented of 1 (one) unit at each frame transmission.";
CM_ SG_ 602 TurnLeverLatched "Indicate if Turn Lever is in a Latched Position";
CM_ SG_ 1434 BCM_AUX1_HLEnbl "Aux switch 1 enable holding last state";
CM_ SG_ 1434 BCM_AUX1_PWRMD "Aux switch 1 power mode";
CM_ SG_ 1434 BCM_AUX1_Type "Aux switch 1 behavior";
CM_ SG_ 1434 BCM_AUX2_HLEnbl "Aux switch 2 enable holding last state";
CM_ SG_ 1434 BCM_AUX2_PWRMD "Aux switch 2 power mode";
CM_ SG_ 1434 BCM_AUX2_Type "Aux switch 2 behavior";
CM_ SG_ 1434 BCM_AUX3_HLEnbl "Aux switch 3 enable holding last state";
CM_ SG_ 1434 BCM_AUX3_PWRMD "Aux switch 3 power mode";
CM_ SG_ 1434 BCM_AUX3_Type "Aux switch 3 behavior";
CM_ SG_ 1434 BCM_AUX4_HLEnbl "Aux switch 4 enable holding last state";
CM_ SG_ 1434 BCM_AUX4_PWRMD "Aux switch 4 power mode";
CM_ SG_ 1434 BCM_AUX4_Type "Aux switch 4 behavior";
CM_ SG_ 1434 BCM_AUX5_HLEnbl "1= Enabled";
CM_ SG_ 1434 BCM_AUX5_PWRMD "0 = Latching
1 = Momentary";
CM_ SG_ 1434 BCM_AUX5_Type "0 = Latching
1 = Momentary";
CM_ SG_ 1434 BCM_AUX6_HLEnbl "1= Enabled";
CM_ SG_ 1434 BCM_AUX6_PWRMD "0 = Latching
1 = Momentary";
CM_ SG_ 1434 BCM_AUX6_Type "0 = Latching
1 = Momentary";
CM_ SG_ 1434 Cfg_Aux_PTO "AUX Switches Configuration";
CM_ SG_ 1069 FronWasherSts "Wiper System Wash.";
CM_ SG_ 1435 ADS_MODE_REQ "Active damping system mode personalization request";
CM_ SG_ 1435 CRC_BCM26 "CRC according to SAE J1850 standard at each frame transmission.";
CM_ SG_ 1435 HAS_OnOffSts "HAS request signal";
CM_ SG_ 1435 MessageCounter_BCM26 "This signal is a counter used for safety checks strategies. This counter is incremented of 1 (one) unit at each frame transmission.";
CM_ SG_ 1436 Comfort_Enable_Act "Accessory Delay Active";
CM_ SG_ 1436 Comfort_Enable_Time "Power accessory delay time";
CM_ SG_ 1436 CRC_BCM27 "CRC according to SAE J1850 standard at each frame transmission.";
CM_ SG_ 1436 MessageCounter_BCM27 "This signal is a counter used for safety checks strategies. This counter is incremented of 1 (one) unit at each frame transmission.";
CM_ SG_ 1436 TrailerConnectionSts "Connection status of TTM";
CM_ SG_ 1470 CRC_BCM29 "CRC according to SAE J1850 standard at each frame transmission.";
CM_ SG_ 1470 ITBM_TrlrStat "Trailer connection status";
CM_ SG_ 1470 MessageCounter_BCM29 "This signal is a counter used for safety checks strategies. This counter is incremented of 1 (one) unit at each frame transmission.";
CM_ SG_ 750 Battery_Volt_1 "Battery Volt 1 signal";
CM_ SG_ 750 Battery_Volt_2 "Battery Volt 2 signal";
CM_ SG_ 750 CRC_BCM3 "CRC according to SAE J1850 standard at each frame transmission.";
CM_ SG_ 750 FronWiperFailSts "Wiper System fault Present.";
CM_ SG_ 750 MessageCounter_BCM3 "This signal is a counter used for safety checks strategies. This counter is incremented of 1 (one) unit at each frame transmission.";
BA_DEF_ SG_  "GenSigStartValue" INT 0 2147483647;
BA_DEF_ SG_  "GenSigInactiveValue" INT 0 2147483647;
BA_DEF_ SG_  "GenSigSendType" ENUM  "NotUsed","OnWrite","OnWriteWithRepetition","OnChange","OnChangeWithRepetition","IfActive","IfActiveWithRepetition","NoSigSendType";
BA_DEF_ SG_  "GenSigTimeoutTime_BCM" INT 0 65535;
BA_DEF_ SG_  "GenSigTimeoutTime_BSM2" INT 0 65535;
BA_DEF_ SG_  "GenSigTimeoutTime_CADM2" INT 0 65535;
BA_DEF_ SG_  "GenSigTimeoutTime_CVADAS" INT 0 65535;
BA_DEF_ SG_  "GenSigTimeoutTime_EPS" INT 0 65535;
BA_DEF_ SG_  "GenSigTimeoutTime_ORC" INT 0 65535;
BA_DEF_ SG_  "GenSigTimeoutTime_PAM" INT 0 65535;
BA_DEF_ SG_  "GenSigTimeoutTime_SGW" INT 0 65535;
BA_DEF_ SG_  "GenSigTimeoutTime_TRSKM" INT 0 65535;
BA_DEF_ BO_  "DiagRequest" ENUM  "No","Yes";
BA_DEF_ BO_  "Type" ENUM  "P","C","PE","COC","PE_Cntrl","E","E_Cntrl","OC","S","BAF","DC","EM","MM","ISO-TP","-";
BA_DEF_ BO_  "DiagResponse" ENUM  "No","Yes";
BA_DEF_ BO_  "NmMessage" ENUM  "No","Yes";
BA_DEF_ BO_  "GenMsgSendType" ENUM  "Cyclic","NotUsed","NotUsed","NotUsed","NotUsed","NotUsed","NotUsed","NotUsed","NoMsgSendType";
BA_DEF_ BO_  "GenMsgNrOfRepetition" INT 0 255;
BA_DEF_ BO_  "GenMsgILSupport" ENUM  "No","Yes";
BA_DEF_ BO_  "GenMsgStartDelayTime" INT 0 65535;
BA_DEF_ BO_  "GenMsgCycleTimeFast" INT 0 65535;
BA_DEF_ BO_  "GenMsgCycleTime" INT 0 65535;
BA_DEF_ BO_  "GenMsgDelayTime" INT 0 65535;
BA_DEF_ BO_  "NmAsrMessage" ENUM  "No","Yes";
BA_DEF_ BO_  "DiagState" ENUM  "No","Yes";
BA_DEF_ BO_  "DiagConnection" HEX 0 65535;
BA_DEF_ BO_  "VFrameFormat" ENUM  "StandardCAN","ExtendedCAN","reserved","reserved","reserved","reserved","reserved","reserved","reserved","reserved","reserved","reserved","reserved","reserved","StandardCAN_FD","ExtendedCAN_FD";
BA_DEF_ BO_  "CANFD_BRS" INT 0 1;
BA_DEF_  "Manufacturer" STRING ;
BA_DEF_  "NmType" STRING ;
BA_DEF_  "BusType" STRING ;
BA_DEF_  "Baudrate" INT 0 1000000;
BA_DEF_  "DBName" STRING ;
BA_DEF_  "NmAsrTimeoutTime" INT 1 65535;
BA_DEF_  "NmAsrWaitBusSleepTime" INT 1 65535;
BA_DEF_  "NmAsrRepeatMessageTime" INT 1 65535;
BA_DEF_  "NmAsrMessageCount" INT 1 256;
BA_DEF_  "NmAsrBaseAddress" HEX 235487232 2147483647;
BA_DEF_  "NmAsrCanMsgCycleTime" INT 1 65535;
BA_DEF_  "Version" HEX 0 255;
BA_DEF_  "VersionWeek" INT 0 53;
BA_DEF_  "VersionYear" INT 0 99;
BA_DEF_ BU_  "Description" STRING ;
BA_DEF_ BU_  "NmStationAddress" HEX 0 255;
BA_DEF_ BU_  "NmNode" ENUM  "No","Yes";
BA_DEF_ BU_  "NmAsrNode" ENUM  "No","Yes";
BA_DEF_ BU_  "NmAsrNodeIdentifier" HEX 0 255;
BA_DEF_ BU_  "NmAsrCanMsgReducedTime" INT 1 65535;
BA_DEF_ BU_  "NmNodeType" ENUM  "+15_NotWakeable","+30_Wakeable","+30_NotWakeable","kMaster","kSlave15","kSlave30","none";
BA_DEF_ BU_  "NwmNodeType" ENUM  "+15_NotWakeable","+30_Wakeable","+30_NotWakeable","kMaster","kSlave15","kSlave30","none";
BA_DEF_ BU_ "NodeLayerModules" STRING ;
BA_DEF_DEF_  "GenSigStartValue" 0;
BA_DEF_DEF_  "GenSigInactiveValue" 0;
BA_DEF_DEF_  "GenSigSendType" "NoSigSendType";
BA_DEF_DEF_  "GenSigTimeoutTime_BCM" 2500;
BA_DEF_DEF_  "GenSigTimeoutTime_BSM2" 2500;
BA_DEF_DEF_  "GenSigTimeoutTime_CADM2" 2500;
BA_DEF_DEF_  "GenSigTimeoutTime_CVADAS" 2500;
BA_DEF_DEF_  "GenSigTimeoutTime_EPS" 2500;
BA_DEF_DEF_  "GenSigTimeoutTime_ORC" 2500;
BA_DEF_DEF_  "GenSigTimeoutTime_PAM" 2500;
BA_DEF_DEF_  "GenSigTimeoutTime_SGW" 2500;
BA_DEF_DEF_  "GenSigTimeoutTime_TRSKM" 2500;
BA_DEF_DEF_  "DiagRequest" "No";
BA_DEF_DEF_  "Type" "-";
BA_DEF_DEF_  "DiagResponse" "No";
BA_DEF_DEF_  "NmMessage" "No";
BA_DEF_DEF_  "GenMsgSendType" "NoMsgSendType";
BA_DEF_DEF_  "GenMsgNrOfRepetition" 0;
BA_DEF_DEF_  "GenMsgILSupport" "No";
BA_DEF_DEF_  "GenMsgStartDelayTime" 0;
BA_DEF_DEF_  "GenMsgCycleTimeFast" 0;
BA_DEF_DEF_  "GenMsgCycleTime" 0;
BA_DEF_DEF_  "GenMsgDelayTime" 0;
BA_DEF_DEF_  "NmAsrMessage" "No";
BA_DEF_DEF_  "DiagState" "No";
BA_DEF_DEF_  "DiagConnection" 0;
BA_DEF_DEF_  "VFrameFormat" "StandardCAN_FD";
BA_DEF_DEF_  "CANFD_BRS" 0;
BA_DEF_DEF_  "Manufacturer" "Fiat";
BA_DEF_DEF_  "NmType" "";
BA_DEF_DEF_  "BusType" "CAN";
BA_DEF_DEF_  "Baudrate" 500000;
BA_DEF_DEF_  "DBName" "CAN";
BA_DEF_DEF_  "NmAsrTimeoutTime" 1000;
BA_DEF_DEF_  "NmAsrWaitBusSleepTime" 750;
BA_DEF_DEF_  "NmAsrRepeatMessageTime" 800;
BA_DEF_DEF_  "NmAsrMessageCount" 256;
BA_DEF_DEF_  "NmAsrBaseAddress" 506724352;
BA_DEF_DEF_  "NmAsrCanMsgCycleTime" 200;
BA_DEF_DEF_  "Version" 160;
BA_DEF_DEF_  "VersionWeek" 45;
BA_DEF_DEF_  "VersionYear" 22;
BA_DEF_DEF_  "Description" "";
BA_DEF_DEF_  "NmStationAddress" 0;
BA_DEF_DEF_  "NmNode" "Yes";
BA_DEF_DEF_  "NmAsrNode" "Yes";
BA_DEF_DEF_  "NmAsrNodeIdentifier" 0;
BA_DEF_DEF_  "NmAsrCanMsgReducedTime" 100;
BA_DEF_DEF_  "NmNodeType" "none";
BA_DEF_DEF_  "NwmNodeType" "none";
BA_DEF_DEF_ "NodeLayerModules" "";
BA_ "NmType" "NmAsr";
BA_ "BusType" "CAN FD";
BA_ "NmAsrTimeoutTime" 8000;
BA_ "NmAsrWaitBusSleepTime" 1000;
BA_ "NmAsrRepeatMessageTime" 5000;
BA_ "NmAsrBaseAddress" 507002880;
BA_ "NmAsrCanMsgCycleTime" 1000;
BA_ "DBName" "FDCAN2";
BA_ "Description" BU_ BCM "Body Control Module";
BA_ "NmAsrCanMsgReducedTime" BU_ BCM 500;
BA_ "NmNodeType" BU_ BCM 1;
BA_ "NwmNodeType" BU_ BCM 1;
BA_ "Description" BU_ BSM2 "Brake System Module 2";
BA_ "NmStationAddress" BU_ BSM2 148;
BA_ "NmAsrNodeIdentifier" BU_ BSM2 148;
BA_ "NmAsrCanMsgReducedTime" BU_ BSM2 550;
BA_ "NmNodeType" BU_ BSM2 1;
BA_ "NwmNodeType" BU_ BSM2 1;
BA_ "Description" BU_ CADM2 "Central ADAS Decision Module 2";
BA_ "NmStationAddress" BU_ CADM2 142;
BA_ "NmAsrNodeIdentifier" BU_ CADM2 142;
BA_ "NmAsrCanMsgReducedTime" BU_ CADM2 575;
BA_ "NmNodeType" BU_ CADM2 1;
BA_ "NwmNodeType" BU_ CADM2 1;
BA_ "Description" BU_ CVADAS "Central Vision ADAS";
BA_ "NmStationAddress" BU_ CVADAS 24;
BA_ "NmAsrNodeIdentifier" BU_ CVADAS 24;
BA_ "NmAsrCanMsgReducedTime" BU_ CVADAS 675;
BA_ "NmNodeType" BU_ CVADAS 1;
BA_ "NwmNodeType" BU_ CVADAS 1;
BA_ "Description" BU_ EPS "Electric Power Steering";
BA_ "NmStationAddress" BU_ EPS 2;
BA_ "NmAsrNodeIdentifier" BU_ EPS 2;
BA_ "NmAsrCanMsgReducedTime" BU_ EPS 525;
BA_ "NmNodeType" BU_ EPS 1;
BA_ "NwmNodeType" BU_ EPS 1;
BA_ "Description" BU_ ORC "Occupant Restraint Control";
BA_ "NmStationAddress" BU_ ORC 26;
BA_ "NmAsrNodeIdentifier" BU_ ORC 26;
BA_ "NmAsrCanMsgReducedTime" BU_ ORC 925;
BA_ "NmNodeType" BU_ ORC 1;
BA_ "NwmNodeType" BU_ ORC 1;
BA_ "Description" BU_ PAM "Parking Aid Module";
BA_ "NmStationAddress" BU_ PAM 24;
BA_ "NmNode" BU_ PAM 0;
BA_ "NmAsrNode" BU_ PAM 0;
BA_ "NmAsrNodeIdentifier" BU_ PAM 24;
BA_ "NmNodeType" BU_ PAM 0;
BA_ "NwmNodeType" BU_ PAM 0;
BA_ "Description" BU_ SGW "Security Gateway Module";
BA_ "NmStationAddress" BU_ SGW 112;
BA_ "NmAsrNodeIdentifier" BU_ SGW 112;
BA_ "NmAsrCanMsgReducedTime" BU_ SGW 800;
BA_ "NmNodeType" BU_ SGW 1;
BA_ "NwmNodeType" BU_ SGW 1;
BA_ "Description" BU_ TRSKM "Trailer Reverse Steering Knob Module";
BA_ "NmStationAddress" BU_ TRSKM 177;
BA_ "NmAsrNodeIdentifier" BU_ TRSKM 177;
BA_ "NmAsrCanMsgReducedTime" BU_ TRSKM 600;
BA_ "NmNodeType" BU_ TRSKM 1;
BA_ "NwmNodeType" BU_ TRSKM 1;
BA_ "Type" BO_ 1458 3;
BA_ "GenMsgSendType" BO_ 1458 0;
BA_ "GenMsgILSupport" BO_ 1458 1;
BA_ "GenMsgCycleTime" BO_ 1458 100;
BA_ "GenMsgDelayTime" BO_ 1458 20;
BA_ "CANFD_BRS" BO_ 1458 1;
BA_ "Type" BO_ 280 1;
BA_ "GenMsgSendType" BO_ 280 0;
BA_ "GenMsgILSupport" BO_ 280 1;
BA_ "GenMsgCycleTime" BO_ 280 10;
BA_ "CANFD_BRS" BO_ 280 1;
BA_ "Type" BO_ 281 1;
BA_ "GenMsgSendType" BO_ 281 0;
BA_ "GenMsgILSupport" BO_ 281 1;
BA_ "GenMsgCycleTime" BO_ 281 10;
BA_ "CANFD_BRS" BO_ 281 1;
BA_ "Type" BO_ 613 3;
BA_ "GenMsgSendType" BO_ 613 0;
BA_ "GenMsgNrOfRepetition" BO_ 613 2;
BA_ "GenMsgILSupport" BO_ 613 1;
BA_ "GenMsgCycleTimeFast" BO_ 613 20;
BA_ "GenMsgCycleTime" BO_ 613 100;
BA_ "GenMsgDelayTime" BO_ 613 20;
BA_ "CANFD_BRS" BO_ 613 1;
BA_ "Type" BO_ 730 1;
BA_ "GenMsgSendType" BO_ 730 0;
BA_ "GenMsgILSupport" BO_ 730 1;
BA_ "GenMsgCycleTime" BO_ 730 40;
BA_ "CANFD_BRS" BO_ 730 1;
BA_ "Type" BO_ 734 1;
BA_ "GenMsgSendType" BO_ 734 0;
BA_ "GenMsgILSupport" BO_ 734 1;
BA_ "GenMsgCycleTime" BO_ 734 40;
BA_ "CANFD_BRS" BO_ 734 1;
BA_ "Type" BO_ 476 3;
BA_ "GenMsgSendType" BO_ 476 0;
BA_ "GenMsgNrOfRepetition" BO_ 476 2;
BA_ "GenMsgILSupport" BO_ 476 1;
BA_ "GenMsgCycleTimeFast" BO_ 476 20;
BA_ "GenMsgCycleTime" BO_ 476 20;
BA_ "GenMsgDelayTime" BO_ 476 15;
BA_ "CANFD_BRS" BO_ 476 1;
BA_ "Type" BO_ 1327 1;
BA_ "GenMsgSendType" BO_ 1327 0;
BA_ "GenMsgILSupport" BO_ 1327 1;
BA_ "GenMsgCycleTime" BO_ 1327 200;
BA_ "CANFD_BRS" BO_ 1327 1;
BA_ "Type" BO_ 1445 3;
BA_ "GenMsgSendType" BO_ 1445 0;
BA_ "GenMsgNrOfRepetition" BO_ 1445 2;
BA_ "GenMsgILSupport" BO_ 1445 1;
BA_ "GenMsgStartDelayTime" BO_ 1445 160;
BA_ "GenMsgCycleTimeFast" BO_ 1445 20;
BA_ "GenMsgCycleTime" BO_ 1445 1000;
BA_ "GenMsgDelayTime" BO_ 1445 20;
BA_ "CANFD_BRS" BO_ 1445 1;
BA_ "Type" BO_ 204 1;
BA_ "GenMsgSendType" BO_ 204 0;
BA_ "GenMsgILSupport" BO_ 204 1;
BA_ "GenMsgCycleTime" BO_ 204 10;
BA_ "CANFD_BRS" BO_ 204 1;
BA_ "Type" BO_ 1153 3;
BA_ "GenMsgSendType" BO_ 1153 0;
BA_ "GenMsgNrOfRepetition" BO_ 1153 2;
BA_ "GenMsgILSupport" BO_ 1153 1;
BA_ "GenMsgStartDelayTime" BO_ 1153 75;
BA_ "GenMsgCycleTimeFast" BO_ 1153 20;
BA_ "GenMsgCycleTime" BO_ 1153 500;
BA_ "GenMsgDelayTime" BO_ 1153 20;
BA_ "CANFD_BRS" BO_ 1153 1;
BA_ "Type" BO_ 1430 3;
BA_ "GenMsgSendType" BO_ 1430 0;
BA_ "GenMsgNrOfRepetition" BO_ 1430 2;
BA_ "GenMsgILSupport" BO_ 1430 1;
BA_ "GenMsgStartDelayTime" BO_ 1430 165;
BA_ "GenMsgCycleTimeFast" BO_ 1430 20;
BA_ "GenMsgCycleTime" BO_ 1430 1000;
BA_ "GenMsgDelayTime" BO_ 1430 20;
BA_ "CANFD_BRS" BO_ 1430 1;
BA_ "Type" BO_ 1431 3;
BA_ "GenMsgSendType" BO_ 1431 0;
BA_ "GenMsgNrOfRepetition" BO_ 1431 2;
BA_ "GenMsgILSupport" BO_ 1431 1;
BA_ "GenMsgStartDelayTime" BO_ 1431 170;
BA_ "GenMsgCycleTimeFast" BO_ 1431 20;
BA_ "GenMsgCycleTime" BO_ 1431 100;
BA_ "GenMsgDelayTime" BO_ 1431 20;
BA_ "CANFD_BRS" BO_ 1431 1;
BA_ "Type" BO_ 159 11;
BA_ "GenMsgILSupport" BO_ 159 1;
BA_ "GenMsgDelayTime" BO_ 159 50;
BA_ "CANFD_BRS" BO_ 159 1;
BA_ "Type" BO_ 736 7;
BA_ "GenMsgILSupport" BO_ 736 1;
BA_ "GenMsgDelayTime" BO_ 736 20;
BA_ "CANFD_BRS" BO_ 736 1;
BA_ "Type" BO_ 512 1;
BA_ "GenMsgSendType" BO_ 512 0;
BA_ "GenMsgILSupport" BO_ 512 1;
BA_ "GenMsgCycleTime" BO_ 512 20;
BA_ "CANFD_BRS" BO_ 512 1;
BA_ "Type" BO_ 256 1;
BA_ "GenMsgSendType" BO_ 256 0;
BA_ "GenMsgILSupport" BO_ 256 1;
BA_ "GenMsgCycleTime" BO_ 256 10;
BA_ "CANFD_BRS" BO_ 256 1;
BA_ "Type" BO_ 1826 1;
BA_ "GenMsgSendType" BO_ 1826 0;
BA_ "GenMsgILSupport" BO_ 1826 1;
BA_ "GenMsgStartDelayTime" BO_ 1826 175;
BA_ "GenMsgCycleTime" BO_ 1826 1000;
BA_ "CANFD_BRS" BO_ 1826 1;
BA_ "Type" BO_ 602 3;
BA_ "GenMsgSendType" BO_ 602 0;
BA_ "GenMsgNrOfRepetition" BO_ 602 2;
BA_ "GenMsgILSupport" BO_ 602 1;
BA_ "GenMsgStartDelayTime" BO_ 602 85;
BA_ "GenMsgCycleTimeFast" BO_ 602 20;
BA_ "GenMsgCycleTime" BO_ 602 100;
BA_ "GenMsgDelayTime" BO_ 602 20;
BA_ "CANFD_BRS" BO_ 602 1;
BA_ "Type" BO_ 1434 3;
BA_ "GenMsgSendType" BO_ 1434 0;
BA_ "GenMsgNrOfRepetition" BO_ 1434 2;
BA_ "GenMsgILSupport" BO_ 1434 1;
BA_ "GenMsgStartDelayTime" BO_ 1434 180;
BA_ "GenMsgCycleTimeFast" BO_ 1434 20;
BA_ "GenMsgCycleTime" BO_ 1434 1000;
BA_ "GenMsgDelayTime" BO_ 1434 20;
BA_ "CANFD_BRS" BO_ 1434 1;
BA_ "Type" BO_ 1069 3;
BA_ "GenMsgSendType" BO_ 1069 0;
BA_ "GenMsgILSupport" BO_ 1069 1;
BA_ "GenMsgStartDelayTime" BO_ 1069 90;
BA_ "GenMsgCycleTime" BO_ 1069 100;
BA_ "CANFD_BRS" BO_ 1069 1;
BA_ "Type" BO_ 1435 3;
BA_ "GenMsgSendType" BO_ 1435 0;
BA_ "GenMsgNrOfRepetition" BO_ 1435 2;
BA_ "GenMsgILSupport" BO_ 1435 1;
BA_ "GenMsgStartDelayTime" BO_ 1435 185;
BA_ "GenMsgCycleTimeFast" BO_ 1435 20;
BA_ "GenMsgCycleTime" BO_ 1435 1000;
BA_ "GenMsgDelayTime" BO_ 1435 20;
BA_ "CANFD_BRS" BO_ 1435 1;
BA_ "Type" BO_ 1436 3;
BA_ "GenMsgSendType" BO_ 1436 0;
BA_ "GenMsgNrOfRepetition" BO_ 1436 2;
BA_ "GenMsgILSupport" BO_ 1436 1;
BA_ "GenMsgStartDelayTime" BO_ 1436 190;
BA_ "GenMsgCycleTimeFast" BO_ 1436 20;
BA_ "GenMsgCycleTime" BO_ 1436 1000;
BA_ "GenMsgDelayTime" BO_ 1436 20;
BA_ "CANFD_BRS" BO_ 1436 1;
BA_ "Type" BO_ 1470 3;
BA_ "GenMsgSendType" BO_ 1470 0;
BA_ "GenMsgILSupport" BO_ 1470 1;
BA_ "GenMsgCycleTime" BO_ 1470 1000;
BA_ "CANFD_BRS" BO_ 1470 1;
BA_ "Type" BO_ 750 1;
BA_ "GenMsgSendType" BO_ 750 0;
BA_ "GenMsgILSupport" BO_ 750 1;
BA_ "GenMsgStartDelayTime" BO_ 750 15;
BA_ "GenMsgCycleTime" BO_ 750 50;
BA_ "CANFD_BRS" BO_ 750 1;
BA_ "GenSigTimeoutTime_TRSKM" SG_ 3221225472 MessageCounter_BRAKE1 0;
BA_ "GenSigTimeoutTime_SGW" SG_ 3221225472 MessageCounter_BRAKE1 0;
BA_ "GenSigTimeoutTime_PAM" SG_ 3221225472 MessageCounter_BRAKE1 0;
BA_ "GenSigTimeoutTime_ORC" SG_ 3221225472 MessageCounter_BRAKE1 0;
BA_ "GenSigTimeoutTime_EPS" SG_ 3221225472 MessageCounter_BRAKE1 0;
BA_ "GenSigTimeoutTime_CADM2" SG_ 3221225472 MessageCounter_BRAKE1 0;
BA_ "GenSigTimeoutTime_BSM2" SG_ 3221225472 MessageCounter_BRAKE1 0;
BA_ "GenSigTimeoutTime_BCM" SG_ 3221225472 MessageCounter_BRAKE1 0;
BA_ "GenSigSendType" SG_ 1458 ACC_DispPopupSts_C2 3;
BA_ "GenSigTimeoutTime_BCM" SG_ 1458 ACC_DispPopupSts_C2 0;
BA_ "GenSigTimeoutTime_BSM2" SG_ 1458 ACC_DispPopupSts_C2 0;
BA_ "GenSigTimeoutTime_CADM2" SG_ 1458 ACC_DispPopupSts_C2 0;
BA_ "GenSigTimeoutTime_CVADAS" SG_ 1458 ACC_DispPopupSts_C2 0;
BA_ "GenSigTimeoutTime_EPS" SG_ 1458 ACC_DispPopupSts_C2 0;
BA_ "GenSigTimeoutTime_ORC" SG_ 1458 ACC_DispPopupSts_C2 0;
BA_ "GenSigTimeoutTime_PAM" SG_ 1458 ACC_DispPopupSts_C2 0;
BA_ "GenSigTimeoutTime_TRSKM" SG_ 1458 ACC_DispPopupSts_C2 0;
BA_ "GenSigSendType" SG_ 1458 ACC_FailSts_C2 3;
BA_ "GenSigTimeoutTime_CADM2" SG_ 1458 ACC_FailSts_C2 0;
BA_ "GenSigTimeoutTime_CVADAS" SG_ 1458 ACC_FailSts_C2 0;
BA_ "GenSigTimeoutTime_EPS" SG_ 1458 ACC_FailSts_C2 0;
BA_ "GenSigTimeoutTime_ORC" SG_ 1458 ACC_FailSts_C2 0;
BA_ "GenSigTimeoutTime_PAM" SG_ 1458 ACC_FailSts_C2 0;
BA_ "GenSigTimeoutTime_SGW" SG_ 1458 ACC_FailSts_C2 0;
BA_ "GenSigTimeoutTime_TRSKM" SG_ 1458 ACC_FailSts_C2 0;
BA_ "GenSigSendType" SG_ 1458 AEB_DispPopupSts_C2 3;
BA_ "GenSigTimeoutTime_BCM" SG_ 1458 AEB_DispPopupSts_C2 0;
BA_ "GenSigTimeoutTime_BSM2" SG_ 1458 AEB_DispPopupSts_C2 0;
BA_ "GenSigTimeoutTime_CADM2" SG_ 1458 AEB_DispPopupSts_C2 0;
BA_ "GenSigTimeoutTime_CVADAS" SG_ 1458 AEB_DispPopupSts_C2 0;
BA_ "GenSigTimeoutTime_EPS" SG_ 1458 AEB_DispPopupSts_C2 0;
BA_ "GenSigTimeoutTime_ORC" SG_ 1458 AEB_DispPopupSts_C2 0;
BA_ "GenSigTimeoutTime_PAM" SG_ 1458 AEB_DispPopupSts_C2 0;
BA_ "GenSigTimeoutTime_TRSKM" SG_ 1458 AEB_DispPopupSts_C2 0;
BA_ "GenSigSendType" SG_ 1458 Chime_Priority_C2 3;
BA_ "GenSigTimeoutTime_BSM2" SG_ 1458 Chime_Priority_C2 0;
BA_ "GenSigTimeoutTime_CADM2" SG_ 1458 Chime_Priority_C2 0;
BA_ "GenSigTimeoutTime_CVADAS" SG_ 1458 Chime_Priority_C2 0;
BA_ "GenSigTimeoutTime_EPS" SG_ 1458 Chime_Priority_C2 0;
BA_ "GenSigTimeoutTime_ORC" SG_ 1458 Chime_Priority_C2 0;
BA_ "GenSigTimeoutTime_PAM" SG_ 1458 Chime_Priority_C2 0;
BA_ "GenSigTimeoutTime_TRSKM" SG_ 1458 Chime_Priority_C2 0;
BA_ "GenSigSendType" SG_ 1458 Chime_RepRate_C2 3;
BA_ "GenSigTimeoutTime_BSM2" SG_ 1458 Chime_RepRate_C2 0;
BA_ "GenSigTimeoutTime_CADM2" SG_ 1458 Chime_RepRate_C2 0;
BA_ "GenSigTimeoutTime_CVADAS" SG_ 1458 Chime_RepRate_C2 0;
BA_ "GenSigTimeoutTime_EPS" SG_ 1458 Chime_RepRate_C2 0;
BA_ "GenSigTimeoutTime_ORC" SG_ 1458 Chime_RepRate_C2 0;
BA_ "GenSigTimeoutTime_PAM" SG_ 1458 Chime_RepRate_C2 0;
BA_ "GenSigTimeoutTime_TRSKM" SG_ 1458 Chime_RepRate_C2 0;
BA_ "GenSigSendType" SG_ 1458 Chime_TypSts_C2 3;
BA_ "GenSigTimeoutTime_BSM2" SG_ 1458 Chime_TypSts_C2 0;
BA_ "GenSigTimeoutTime_CADM2" SG_ 1458 Chime_TypSts_C2 0;
BA_ "GenSigTimeoutTime_CVADAS" SG_ 1458 Chime_TypSts_C2 0;
BA_ "GenSigTimeoutTime_EPS" SG_ 1458 Chime_TypSts_C2 0;
BA_ "GenSigTimeoutTime_ORC" SG_ 1458 Chime_TypSts_C2 0;
BA_ "GenSigTimeoutTime_PAM" SG_ 1458 Chime_TypSts_C2 0;
BA_ "GenSigTimeoutTime_TRSKM" SG_ 1458 Chime_TypSts_C2 0;
BA_ "GenSigTimeoutTime_CADM2" SG_ 1458 CRC_ADAS_HMI_C2 0;
BA_ "GenSigTimeoutTime_CVADAS" SG_ 1458 CRC_ADAS_HMI_C2 0;
BA_ "GenSigTimeoutTime_ORC" SG_ 1458 CRC_ADAS_HMI_C2 0;
BA_ "GenSigTimeoutTime_PAM" SG_ 1458 CRC_ADAS_HMI_C2 0;
BA_ "GenSigTimeoutTime_SGW" SG_ 1458 CRC_ADAS_HMI_C2 0;
BA_ "GenSigTimeoutTime_TRSKM" SG_ 1458 CRC_ADAS_HMI_C2 0;
BA_ "GenSigSendType" SG_ 1458 DisplaySts_ACC_C2 3;
BA_ "GenSigTimeoutTime_BCM" SG_ 1458 DisplaySts_ACC_C2 0;
BA_ "GenSigTimeoutTime_BSM2" SG_ 1458 DisplaySts_ACC_C2 0;
BA_ "GenSigTimeoutTime_CADM2" SG_ 1458 DisplaySts_ACC_C2 0;
BA_ "GenSigTimeoutTime_CVADAS" SG_ 1458 DisplaySts_ACC_C2 0;
BA_ "GenSigTimeoutTime_EPS" SG_ 1458 DisplaySts_ACC_C2 0;
BA_ "GenSigTimeoutTime_ORC" SG_ 1458 DisplaySts_ACC_C2 0;
BA_ "GenSigTimeoutTime_PAM" SG_ 1458 DisplaySts_ACC_C2 0;
BA_ "GenSigTimeoutTime_TRSKM" SG_ 1458 DisplaySts_ACC_C2 0;
BA_ "GenSigSendType" SG_ 1458 DisplaySts_OFF_C2 3;
BA_ "GenSigTimeoutTime_BCM" SG_ 1458 DisplaySts_OFF_C2 0;
BA_ "GenSigTimeoutTime_BSM2" SG_ 1458 DisplaySts_OFF_C2 0;
BA_ "GenSigTimeoutTime_CADM2" SG_ 1458 DisplaySts_OFF_C2 0;
BA_ "GenSigTimeoutTime_CVADAS" SG_ 1458 DisplaySts_OFF_C2 0;
BA_ "GenSigTimeoutTime_EPS" SG_ 1458 DisplaySts_OFF_C2 0;
BA_ "GenSigTimeoutTime_ORC" SG_ 1458 DisplaySts_OFF_C2 0;
BA_ "GenSigTimeoutTime_PAM" SG_ 1458 DisplaySts_OFF_C2 0;
BA_ "GenSigTimeoutTime_TRSKM" SG_ 1458 DisplaySts_OFF_C2 0;
BA_ "GenSigSendType" SG_ 1458 DisplaySts_Veh_C2 3;
BA_ "GenSigTimeoutTime_BCM" SG_ 1458 DisplaySts_Veh_C2 0;
BA_ "GenSigTimeoutTime_BSM2" SG_ 1458 DisplaySts_Veh_C2 0;
BA_ "GenSigTimeoutTime_CADM2" SG_ 1458 DisplaySts_Veh_C2 0;
BA_ "GenSigTimeoutTime_CVADAS" SG_ 1458 DisplaySts_Veh_C2 0;
BA_ "GenSigTimeoutTime_EPS" SG_ 1458 DisplaySts_Veh_C2 0;
BA_ "GenSigTimeoutTime_ORC" SG_ 1458 DisplaySts_Veh_C2 0;
BA_ "GenSigTimeoutTime_PAM" SG_ 1458 DisplaySts_Veh_C2 0;
BA_ "GenSigTimeoutTime_TRSKM" SG_ 1458 DisplaySts_Veh_C2 0;
BA_ "GenSigSendType" SG_ 1458 HAS_Escalation_Sts_C2 3;
BA_ "GenSigTimeoutTime_BSM2" SG_ 1458 HAS_Escalation_Sts_C2 0;
BA_ "GenSigTimeoutTime_CADM2" SG_ 1458 HAS_Escalation_Sts_C2 0;
BA_ "GenSigTimeoutTime_CVADAS" SG_ 1458 HAS_Escalation_Sts_C2 0;
BA_ "GenSigTimeoutTime_EPS" SG_ 1458 HAS_Escalation_Sts_C2 0;
BA_ "GenSigTimeoutTime_ORC" SG_ 1458 HAS_Escalation_Sts_C2 0;
BA_ "GenSigTimeoutTime_PAM" SG_ 1458 HAS_Escalation_Sts_C2 0;
BA_ "GenSigTimeoutTime_SGW" SG_ 1458 HAS_Escalation_Sts_C2 0;
BA_ "GenSigTimeoutTime_TRSKM" SG_ 1458 HAS_Escalation_Sts_C2 0;
BA_ "GenSigSendType" SG_ 1458 HAS_Hazard_C2 3;
BA_ "GenSigTimeoutTime_BSM2" SG_ 1458 HAS_Hazard_C2 0;
BA_ "GenSigTimeoutTime_CADM2" SG_ 1458 HAS_Hazard_C2 0;
BA_ "GenSigTimeoutTime_CVADAS" SG_ 1458 HAS_Hazard_C2 0;
BA_ "GenSigTimeoutTime_EPS" SG_ 1458 HAS_Hazard_C2 0;
BA_ "GenSigTimeoutTime_ORC" SG_ 1458 HAS_Hazard_C2 0;
BA_ "GenSigTimeoutTime_PAM" SG_ 1458 HAS_Hazard_C2 0;
BA_ "GenSigTimeoutTime_SGW" SG_ 1458 HAS_Hazard_C2 0;
BA_ "GenSigTimeoutTime_TRSKM" SG_ 1458 HAS_Hazard_C2 0;
BA_ "GenSigSendType" SG_ 1458 HAS_TelltaleSts_C2 3;
BA_ "GenSigTimeoutTime_BCM" SG_ 1458 HAS_TelltaleSts_C2 0;
BA_ "GenSigTimeoutTime_BSM2" SG_ 1458 HAS_TelltaleSts_C2 0;
BA_ "GenSigTimeoutTime_CADM2" SG_ 1458 HAS_TelltaleSts_C2 0;
BA_ "GenSigTimeoutTime_CVADAS" SG_ 1458 HAS_TelltaleSts_C2 0;
BA_ "GenSigTimeoutTime_EPS" SG_ 1458 HAS_TelltaleSts_C2 0;
BA_ "GenSigTimeoutTime_ORC" SG_ 1458 HAS_TelltaleSts_C2 0;
BA_ "GenSigTimeoutTime_PAM" SG_ 1458 HAS_TelltaleSts_C2 0;
BA_ "GenSigTimeoutTime_TRSKM" SG_ 1458 HAS_TelltaleSts_C2 0;
BA_ "GenSigSendType" SG_ 1458 Lane_DisplaySts_Left_C2 3;
BA_ "GenSigTimeoutTime_BCM" SG_ 1458 Lane_DisplaySts_Left_C2 0;
BA_ "GenSigTimeoutTime_BSM2" SG_ 1458 Lane_DisplaySts_Left_C2 0;
BA_ "GenSigTimeoutTime_CADM2" SG_ 1458 Lane_DisplaySts_Left_C2 0;
BA_ "GenSigTimeoutTime_CVADAS" SG_ 1458 Lane_DisplaySts_Left_C2 0;
BA_ "GenSigTimeoutTime_EPS" SG_ 1458 Lane_DisplaySts_Left_C2 0;
BA_ "GenSigTimeoutTime_ORC" SG_ 1458 Lane_DisplaySts_Left_C2 0;
BA_ "GenSigTimeoutTime_PAM" SG_ 1458 Lane_DisplaySts_Left_C2 0;
BA_ "GenSigTimeoutTime_TRSKM" SG_ 1458 Lane_DisplaySts_Left_C2 0;
BA_ "GenSigSendType" SG_ 1458 Lane_DisplaySts_Right_C2 3;
BA_ "GenSigTimeoutTime_BCM" SG_ 1458 Lane_DisplaySts_Right_C2 0;
BA_ "GenSigTimeoutTime_BSM2" SG_ 1458 Lane_DisplaySts_Right_C2 0;
BA_ "GenSigTimeoutTime_CADM2" SG_ 1458 Lane_DisplaySts_Right_C2 0;
BA_ "GenSigTimeoutTime_CVADAS" SG_ 1458 Lane_DisplaySts_Right_C2 0;
BA_ "GenSigTimeoutTime_EPS" SG_ 1458 Lane_DisplaySts_Right_C2 0;
BA_ "GenSigTimeoutTime_ORC" SG_ 1458 Lane_DisplaySts_Right_C2 0;
BA_ "GenSigTimeoutTime_PAM" SG_ 1458 Lane_DisplaySts_Right_C2 0;
BA_ "GenSigTimeoutTime_TRSKM" SG_ 1458 Lane_DisplaySts_Right_C2 0;
BA_ "GenSigSendType" SG_ 1458 Lane_DispPopupSts_C2 3;
BA_ "GenSigTimeoutTime_BCM" SG_ 1458 Lane_DispPopupSts_C2 0;
BA_ "GenSigTimeoutTime_BSM2" SG_ 1458 Lane_DispPopupSts_C2 0;
BA_ "GenSigTimeoutTime_CADM2" SG_ 1458 Lane_DispPopupSts_C2 0;
BA_ "GenSigTimeoutTime_CVADAS" SG_ 1458 Lane_DispPopupSts_C2 0;
BA_ "GenSigTimeoutTime_EPS" SG_ 1458 Lane_DispPopupSts_C2 0;
BA_ "GenSigTimeoutTime_ORC" SG_ 1458 Lane_DispPopupSts_C2 0;
BA_ "GenSigTimeoutTime_PAM" SG_ 1458 Lane_DispPopupSts_C2 0;
BA_ "GenSigTimeoutTime_TRSKM" SG_ 1458 Lane_DispPopupSts_C2 0;
BA_ "GenSigSendType" SG_ 1458 LF_Chime_RqSts_C2 3;
BA_ "GenSigTimeoutTime_BSM2" SG_ 1458 LF_Chime_RqSts_C2 0;
BA_ "GenSigTimeoutTime_CADM2" SG_ 1458 LF_Chime_RqSts_C2 0;
BA_ "GenSigTimeoutTime_CVADAS" SG_ 1458 LF_Chime_RqSts_C2 0;
BA_ "GenSigTimeoutTime_EPS" SG_ 1458 LF_Chime_RqSts_C2 0;
BA_ "GenSigTimeoutTime_ORC" SG_ 1458 LF_Chime_RqSts_C2 0;
BA_ "GenSigTimeoutTime_PAM" SG_ 1458 LF_Chime_RqSts_C2 0;
BA_ "GenSigTimeoutTime_TRSKM" SG_ 1458 LF_Chime_RqSts_C2 0;
BA_ "GenSigSendType" SG_ 1458 LR_Chime_RqSts_C2 3;
BA_ "GenSigTimeoutTime_BSM2" SG_ 1458 LR_Chime_RqSts_C2 0;
BA_ "GenSigTimeoutTime_CADM2" SG_ 1458 LR_Chime_RqSts_C2 0;
BA_ "GenSigTimeoutTime_CVADAS" SG_ 1458 LR_Chime_RqSts_C2 0;
BA_ "GenSigTimeoutTime_EPS" SG_ 1458 LR_Chime_RqSts_C2 0;
BA_ "GenSigTimeoutTime_ORC" SG_ 1458 LR_Chime_RqSts_C2 0;
BA_ "GenSigTimeoutTime_PAM" SG_ 1458 LR_Chime_RqSts_C2 0;
BA_ "GenSigTimeoutTime_TRSKM" SG_ 1458 LR_Chime_RqSts_C2 0;
BA_ "GenSigTimeoutTime_CADM2" SG_ 1458 MessageCounter_ADAS_HMI_C2 0;
BA_ "GenSigTimeoutTime_CVADAS" SG_ 1458 MessageCounter_ADAS_HMI_C2 0;
BA_ "GenSigTimeoutTime_ORC" SG_ 1458 MessageCounter_ADAS_HMI_C2 0;
BA_ "GenSigTimeoutTime_PAM" SG_ 1458 MessageCounter_ADAS_HMI_C2 0;
BA_ "GenSigTimeoutTime_SGW" SG_ 1458 MessageCounter_ADAS_HMI_C2 0;
BA_ "GenSigTimeoutTime_TRSKM" SG_ 1458 MessageCounter_ADAS_HMI_C2 0;
BA_ "GenSigSendType" SG_ 1458 RF_Chime_RqSts_C2 3;
BA_ "GenSigTimeoutTime_BSM2" SG_ 1458 RF_Chime_RqSts_C2 0;
BA_ "GenSigTimeoutTime_CADM2" SG_ 1458 RF_Chime_RqSts_C2 0;
BA_ "GenSigTimeoutTime_CVADAS" SG_ 1458 RF_Chime_RqSts_C2 0;
BA_ "GenSigTimeoutTime_EPS" SG_ 1458 RF_Chime_RqSts_C2 0;
BA_ "GenSigTimeoutTime_ORC" SG_ 1458 RF_Chime_RqSts_C2 0;
BA_ "GenSigTimeoutTime_PAM" SG_ 1458 RF_Chime_RqSts_C2 0;
BA_ "GenSigTimeoutTime_TRSKM" SG_ 1458 RF_Chime_RqSts_C2 0;
BA_ "GenSigSendType" SG_ 1458 RR_Chime_RqSts_C2 3;
BA_ "GenSigTimeoutTime_BSM2" SG_ 1458 RR_Chime_RqSts_C2 0;
BA_ "GenSigTimeoutTime_CADM2" SG_ 1458 RR_Chime_RqSts_C2 0;
BA_ "GenSigTimeoutTime_CVADAS" SG_ 1458 RR_Chime_RqSts_C2 0;
BA_ "GenSigTimeoutTime_EPS" SG_ 1458 RR_Chime_RqSts_C2 0;
BA_ "GenSigTimeoutTime_ORC" SG_ 1458 RR_Chime_RqSts_C2 0;
BA_ "GenSigTimeoutTime_PAM" SG_ 1458 RR_Chime_RqSts_C2 0;
BA_ "GenSigTimeoutTime_TRSKM" SG_ 1458 RR_Chime_RqSts_C2 0;
BA_ "GenSigSendType" SG_ 1458 Set_Speed_KPH_C2 3;
BA_ "GenSigTimeoutTime_BCM" SG_ 1458 Set_Speed_KPH_C2 0;
BA_ "GenSigTimeoutTime_BSM2" SG_ 1458 Set_Speed_KPH_C2 0;
BA_ "GenSigTimeoutTime_CADM2" SG_ 1458 Set_Speed_KPH_C2 0;
BA_ "GenSigTimeoutTime_CVADAS" SG_ 1458 Set_Speed_KPH_C2 0;
BA_ "GenSigTimeoutTime_EPS" SG_ 1458 Set_Speed_KPH_C2 0;
BA_ "GenSigTimeoutTime_ORC" SG_ 1458 Set_Speed_KPH_C2 0;
BA_ "GenSigTimeoutTime_PAM" SG_ 1458 Set_Speed_KPH_C2 0;
BA_ "GenSigTimeoutTime_TRSKM" SG_ 1458 Set_Speed_KPH_C2 0;
BA_ "GenSigSendType" SG_ 1458 Set_Speed_MPH_C2 3;
BA_ "GenSigTimeoutTime_BCM" SG_ 1458 Set_Speed_MPH_C2 0;
BA_ "GenSigTimeoutTime_BSM2" SG_ 1458 Set_Speed_MPH_C2 0;
BA_ "GenSigTimeoutTime_CADM2" SG_ 1458 Set_Speed_MPH_C2 0;
BA_ "GenSigTimeoutTime_CVADAS" SG_ 1458 Set_Speed_MPH_C2 0;
BA_ "GenSigTimeoutTime_EPS" SG_ 1458 Set_Speed_MPH_C2 0;
BA_ "GenSigTimeoutTime_ORC" SG_ 1458 Set_Speed_MPH_C2 0;
BA_ "GenSigTimeoutTime_PAM" SG_ 1458 Set_Speed_MPH_C2 0;
BA_ "GenSigTimeoutTime_TRSKM" SG_ 1458 Set_Speed_MPH_C2 0;
BA_ "GenSigSendType" SG_ 1458 SVI_Request_C2 3;
BA_ "GenSigTimeoutTime_BSM2" SG_ 1458 SVI_Request_C2 0;
BA_ "GenSigTimeoutTime_CADM2" SG_ 1458 SVI_Request_C2 0;
BA_ "GenSigTimeoutTime_CVADAS" SG_ 1458 SVI_Request_C2 0;
BA_ "GenSigTimeoutTime_EPS" SG_ 1458 SVI_Request_C2 0;
BA_ "GenSigTimeoutTime_ORC" SG_ 1458 SVI_Request_C2 0;
BA_ "GenSigTimeoutTime_PAM" SG_ 1458 SVI_Request_C2 0;
BA_ "GenSigTimeoutTime_TRSKM" SG_ 1458 SVI_Request_C2 0;
BA_ "GenSigTimeoutTime_BCM" SG_ 280 CRC_ADAS_FD_INFO 0;
BA_ "GenSigTimeoutTime_CADM2" SG_ 280 CRC_ADAS_FD_INFO 0;
BA_ "GenSigTimeoutTime_CVADAS" SG_ 280 CRC_ADAS_FD_INFO 0;
BA_ "GenSigTimeoutTime_EPS" SG_ 280 CRC_ADAS_FD_INFO 0;
BA_ "GenSigTimeoutTime_ORC" SG_ 280 CRC_ADAS_FD_INFO 0;
BA_ "GenSigTimeoutTime_PAM" SG_ 280 CRC_ADAS_FD_INFO 0;
BA_ "GenSigTimeoutTime_SGW" SG_ 280 CRC_ADAS_FD_INFO 0;
BA_ "GenSigTimeoutTime_TRSKM" SG_ 280 CRC_ADAS_FD_INFO 0;
BA_ "GenSigTimeoutTime_BCM" SG_ 280 HAS_Status 0;
BA_ "GenSigTimeoutTime_CADM2" SG_ 280 HAS_Status 0;
BA_ "GenSigTimeoutTime_CVADAS" SG_ 280 HAS_Status 0;
BA_ "GenSigTimeoutTime_EPS" SG_ 280 HAS_Status 0;
BA_ "GenSigTimeoutTime_ORC" SG_ 280 HAS_Status 0;
BA_ "GenSigTimeoutTime_PAM" SG_ 280 HAS_Status 0;
BA_ "GenSigTimeoutTime_SGW" SG_ 280 HAS_Status 0;
BA_ "GenSigTimeoutTime_TRSKM" SG_ 280 HAS_Status 0;
BA_ "GenSigTimeoutTime_BCM" SG_ 280 MessageCounter_ADAS_FD_INFO 0;
BA_ "GenSigTimeoutTime_CADM2" SG_ 280 MessageCounter_ADAS_FD_INFO 0;
BA_ "GenSigTimeoutTime_CVADAS" SG_ 280 MessageCounter_ADAS_FD_INFO 0;
BA_ "GenSigTimeoutTime_EPS" SG_ 280 MessageCounter_ADAS_FD_INFO 0;
BA_ "GenSigTimeoutTime_ORC" SG_ 280 MessageCounter_ADAS_FD_INFO 0;
BA_ "GenSigTimeoutTime_PAM" SG_ 280 MessageCounter_ADAS_FD_INFO 0;
BA_ "GenSigTimeoutTime_SGW" SG_ 280 MessageCounter_ADAS_FD_INFO 0;
BA_ "GenSigTimeoutTime_TRSKM" SG_ 280 MessageCounter_ADAS_FD_INFO 0;
BA_ "GenSigTimeoutTime_CADM2" SG_ 281 ACC_Systemsts_C2 0;
BA_ "GenSigTimeoutTime_CVADAS" SG_ 281 ACC_Systemsts_C2 0;
BA_ "GenSigTimeoutTime_EPS" SG_ 281 ACC_Systemsts_C2 0;
BA_ "GenSigTimeoutTime_ORC" SG_ 281 ACC_Systemsts_C2 0;
BA_ "GenSigTimeoutTime_PAM" SG_ 281 ACC_Systemsts_C2 0;
BA_ "GenSigTimeoutTime_SGW" SG_ 281 ACC_Systemsts_C2 0;
BA_ "GenSigTimeoutTime_TRSKM" SG_ 281 ACC_Systemsts_C2 0;
BA_ "GenSigTimeoutTime_CADM2" SG_ 281 AEB_Type_C2 0;
BA_ "GenSigTimeoutTime_CVADAS" SG_ 281 AEB_Type_C2 0;
BA_ "GenSigTimeoutTime_EPS" SG_ 281 AEB_Type_C2 0;
BA_ "GenSigTimeoutTime_ORC" SG_ 281 AEB_Type_C2 0;
BA_ "GenSigTimeoutTime_PAM" SG_ 281 AEB_Type_C2 0;
BA_ "GenSigTimeoutTime_SGW" SG_ 281 AEB_Type_C2 0;
BA_ "GenSigTimeoutTime_TRSKM" SG_ 281 AEB_Type_C2 0;
BA_ "GenSigTimeoutTime_BCM" SG_ 281 CADM_EPSADAS_FAIL 0;
BA_ "GenSigTimeoutTime_BSM2" SG_ 281 CADM_EPSADAS_FAIL 0;
BA_ "GenSigTimeoutTime_CADM2" SG_ 281 CADM_EPSADAS_FAIL 0;
BA_ "GenSigTimeoutTime_CVADAS" SG_ 281 CADM_EPSADAS_FAIL 0;
BA_ "GenSigTimeoutTime_ORC" SG_ 281 CADM_EPSADAS_FAIL 0;
BA_ "GenSigTimeoutTime_PAM" SG_ 281 CADM_EPSADAS_FAIL 0;
BA_ "GenSigTimeoutTime_SGW" SG_ 281 CADM_EPSADAS_FAIL 0;
BA_ "GenSigTimeoutTime_TRSKM" SG_ 281 CADM_EPSADAS_FAIL 0;
BA_ "GenSigTimeoutTime_BSM2" SG_ 281 CADM2_Mode 0;
BA_ "GenSigTimeoutTime_CADM2" SG_ 281 CADM2_Mode 0;
BA_ "GenSigTimeoutTime_CVADAS" SG_ 281 CADM2_Mode 0;
BA_ "GenSigTimeoutTime_EPS" SG_ 281 CADM2_Mode 0;
BA_ "GenSigTimeoutTime_ORC" SG_ 281 CADM2_Mode 0;
BA_ "GenSigTimeoutTime_PAM" SG_ 281 CADM2_Mode 0;
BA_ "GenSigTimeoutTime_SGW" SG_ 281 CADM2_Mode 0;
BA_ "GenSigTimeoutTime_TRSKM" SG_ 281 CADM2_Mode 0;
BA_ "GenSigTimeoutTime_BCM" SG_ 281 CADM2_OpStat 0;
BA_ "GenSigTimeoutTime_BSM2" SG_ 281 CADM2_OpStat 0;
BA_ "GenSigTimeoutTime_CADM2" SG_ 281 CADM2_OpStat 0;
BA_ "GenSigTimeoutTime_CVADAS" SG_ 281 CADM2_OpStat 0;
BA_ "GenSigTimeoutTime_EPS" SG_ 281 CADM2_OpStat 0;
BA_ "GenSigTimeoutTime_ORC" SG_ 281 CADM2_OpStat 0;
BA_ "GenSigTimeoutTime_PAM" SG_ 281 CADM2_OpStat 0;
BA_ "GenSigTimeoutTime_SGW" SG_ 281 CADM2_OpStat 0;
BA_ "GenSigTimeoutTime_TRSKM" SG_ 281 CADM2_OpStat 0;
BA_ "GenSigTimeoutTime_CADM2" SG_ 281 CRC_ADAS_INFO_C2 0;
BA_ "GenSigTimeoutTime_ORC" SG_ 281 CRC_ADAS_INFO_C2 0;
BA_ "GenSigTimeoutTime_PAM" SG_ 281 CRC_ADAS_INFO_C2 0;
BA_ "GenSigTimeoutTime_SGW" SG_ 281 CRC_ADAS_INFO_C2 0;
BA_ "GenSigTimeoutTime_TRSKM" SG_ 281 CRC_ADAS_INFO_C2 0;
BA_ "GenSigTimeoutTime_BCM" SG_ 281 ESCALATION_TYPE_C2 0;
BA_ "GenSigTimeoutTime_BSM2" SG_ 281 ESCALATION_TYPE_C2 0;
BA_ "GenSigTimeoutTime_CADM2" SG_ 281 ESCALATION_TYPE_C2 0;
BA_ "GenSigTimeoutTime_CVADAS" SG_ 281 ESCALATION_TYPE_C2 0;
BA_ "GenSigTimeoutTime_EPS" SG_ 281 ESCALATION_TYPE_C2 0;
BA_ "GenSigTimeoutTime_PAM" SG_ 281 ESCALATION_TYPE_C2 0;
BA_ "GenSigTimeoutTime_SGW" SG_ 281 ESCALATION_TYPE_C2 0;
BA_ "GenSigTimeoutTime_TRSKM" SG_ 281 ESCALATION_TYPE_C2 0;
BA_ "GenSigTimeoutTime_BCM" SG_ 281 HAS_LAT_CTRL_RequestSts_C2 0;
BA_ "GenSigTimeoutTime_BSM2" SG_ 281 HAS_LAT_CTRL_RequestSts_C2 0;
BA_ "GenSigTimeoutTime_CADM2" SG_ 281 HAS_LAT_CTRL_RequestSts_C2 0;
BA_ "GenSigTimeoutTime_CVADAS" SG_ 281 HAS_LAT_CTRL_RequestSts_C2 0;
BA_ "GenSigTimeoutTime_ORC" SG_ 281 HAS_LAT_CTRL_RequestSts_C2 0;
BA_ "GenSigTimeoutTime_PAM" SG_ 281 HAS_LAT_CTRL_RequestSts_C2 0;
BA_ "GenSigTimeoutTime_SGW" SG_ 281 HAS_LAT_CTRL_RequestSts_C2 0;
BA_ "GenSigTimeoutTime_TRSKM" SG_ 281 HAS_LAT_CTRL_RequestSts_C2 0;
BA_ "GenSigTimeoutTime_BSM2" SG_ 281 HAS_OpStat_Sec 0;
BA_ "GenSigTimeoutTime_CADM2" SG_ 281 HAS_OpStat_Sec 0;
BA_ "GenSigTimeoutTime_CVADAS" SG_ 281 HAS_OpStat_Sec 0;
BA_ "GenSigTimeoutTime_EPS" SG_ 281 HAS_OpStat_Sec 0;
BA_ "GenSigTimeoutTime_PAM" SG_ 281 HAS_OpStat_Sec 0;
BA_ "GenSigTimeoutTime_SGW" SG_ 281 HAS_OpStat_Sec 0;
BA_ "GenSigTimeoutTime_TRSKM" SG_ 281 HAS_OpStat_Sec 0;
BA_ "GenSigTimeoutTime_CADM2" SG_ 281 HAS_Status_C2 0;
BA_ "GenSigTimeoutTime_EPS" SG_ 281 HAS_Status_C2 0;
BA_ "GenSigTimeoutTime_ORC" SG_ 281 HAS_Status_C2 0;
BA_ "GenSigTimeoutTime_PAM" SG_ 281 HAS_Status_C2 0;
BA_ "GenSigTimeoutTime_SGW" SG_ 281 HAS_Status_C2 0;
BA_ "GenSigTimeoutTime_TRSKM" SG_ 281 HAS_Status_C2 0;
BA_ "GenSigTimeoutTime_CADM2" SG_ 281 HIS_Req_C2 0;
BA_ "GenSigTimeoutTime_CVADAS" SG_ 281 HIS_Req_C2 0;
BA_ "GenSigTimeoutTime_EPS" SG_ 281 HIS_Req_C2 0;
BA_ "GenSigTimeoutTime_ORC" SG_ 281 HIS_Req_C2 0;
BA_ "GenSigTimeoutTime_PAM" SG_ 281 HIS_Req_C2 0;
BA_ "GenSigTimeoutTime_SGW" SG_ 281 HIS_Req_C2 0;
BA_ "GenSigTimeoutTime_TRSKM" SG_ 281 HIS_Req_C2 0;
BA_ "GenSigStartValue" SG_ 281 Intervention_C2 4095;
BA_ "GenSigTimeoutTime_CADM2" SG_ 281 Intervention_C2 0;
BA_ "GenSigTimeoutTime_CVADAS" SG_ 281 Intervention_C2 0;
BA_ "GenSigTimeoutTime_EPS" SG_ 281 Intervention_C2 0;
BA_ "GenSigTimeoutTime_ORC" SG_ 281 Intervention_C2 0;
BA_ "GenSigTimeoutTime_PAM" SG_ 281 Intervention_C2 0;
BA_ "GenSigTimeoutTime_SGW" SG_ 281 Intervention_C2 0;
BA_ "GenSigTimeoutTime_TRSKM" SG_ 281 Intervention_C2 0;
BA_ "GenSigTimeoutTime_CADM2" SG_ 281 MessageCounter_ADAS_INFO_C2 0;
BA_ "GenSigTimeoutTime_ORC" SG_ 281 MessageCounter_ADAS_INFO_C2 0;
BA_ "GenSigTimeoutTime_PAM" SG_ 281 MessageCounter_ADAS_INFO_C2 0;
BA_ "GenSigTimeoutTime_SGW" SG_ 281 MessageCounter_ADAS_INFO_C2 0;
BA_ "GenSigTimeoutTime_TRSKM" SG_ 281 MessageCounter_ADAS_INFO_C2 0;
BA_ "GenSigTimeoutTime_BSM2" SG_ 281 MRM_STATUS_C2 0;
BA_ "GenSigTimeoutTime_CADM2" SG_ 281 MRM_STATUS_C2 0;
BA_ "GenSigTimeoutTime_EPS" SG_ 281 MRM_STATUS_C2 0;
BA_ "GenSigTimeoutTime_ORC" SG_ 281 MRM_STATUS_C2 0;
BA_ "GenSigTimeoutTime_PAM" SG_ 281 MRM_STATUS_C2 0;
BA_ "GenSigTimeoutTime_TRSKM" SG_ 281 MRM_STATUS_C2 0;
BA_ "GenSigStartValue" SG_ 281 TorqueOverlaySteeringReq_C2 1024;
BA_ "GenSigTimeoutTime_BCM" SG_ 281 TorqueOverlaySteeringReq_C2 0;
BA_ "GenSigTimeoutTime_BSM2" SG_ 281 TorqueOverlaySteeringReq_C2 0;
BA_ "GenSigTimeoutTime_CADM2" SG_ 281 TorqueOverlaySteeringReq_C2 0;
BA_ "GenSigTimeoutTime_CVADAS" SG_ 281 TorqueOverlaySteeringReq_C2 0;
BA_ "GenSigTimeoutTime_ORC" SG_ 281 TorqueOverlaySteeringReq_C2 0;
BA_ "GenSigTimeoutTime_PAM" SG_ 281 TorqueOverlaySteeringReq_C2 0;
BA_ "GenSigTimeoutTime_TRSKM" SG_ 281 TorqueOverlaySteeringReq_C2 0;
BA_ "GenSigTimeoutTime_BSM2" SG_ 613 CADM2_DALM_CRC 0;
BA_ "GenSigTimeoutTime_CADM2" SG_ 613 CADM2_DALM_CRC 0;
BA_ "GenSigTimeoutTime_CVADAS" SG_ 613 CADM2_DALM_CRC 0;
BA_ "GenSigTimeoutTime_EPS" SG_ 613 CADM2_DALM_CRC 0;
BA_ "GenSigTimeoutTime_ORC" SG_ 613 CADM2_DALM_CRC 0;
BA_ "GenSigTimeoutTime_PAM" SG_ 613 CADM2_DALM_CRC 0;
BA_ "GenSigTimeoutTime_SGW" SG_ 613 CADM2_DALM_CRC 0;
BA_ "GenSigTimeoutTime_TRSKM" SG_ 613 CADM2_DALM_CRC 0;
BA_ "GenSigTimeoutTime_BSM2" SG_ 613 CADM2_DALM_MC 0;
BA_ "GenSigTimeoutTime_CADM2" SG_ 613 CADM2_DALM_MC 0;
BA_ "GenSigTimeoutTime_CVADAS" SG_ 613 CADM2_DALM_MC 0;
BA_ "GenSigTimeoutTime_EPS" SG_ 613 CADM2_DALM_MC 0;
BA_ "GenSigTimeoutTime_ORC" SG_ 613 CADM2_DALM_MC 0;
BA_ "GenSigTimeoutTime_PAM" SG_ 613 CADM2_DALM_MC 0;
BA_ "GenSigTimeoutTime_SGW" SG_ 613 CADM2_DALM_MC 0;
BA_ "GenSigTimeoutTime_TRSKM" SG_ 613 CADM2_DALM_MC 0;
BA_ "GenSigSendType" SG_ 613 DALM_Request_C2 3;
BA_ "GenSigTimeoutTime_BSM2" SG_ 613 DALM_Request_C2 0;
BA_ "GenSigTimeoutTime_CADM2" SG_ 613 DALM_Request_C2 0;
BA_ "GenSigTimeoutTime_CVADAS" SG_ 613 DALM_Request_C2 0;
BA_ "GenSigTimeoutTime_EPS" SG_ 613 DALM_Request_C2 0;
BA_ "GenSigTimeoutTime_ORC" SG_ 613 DALM_Request_C2 0;
BA_ "GenSigTimeoutTime_PAM" SG_ 613 DALM_Request_C2 0;
BA_ "GenSigTimeoutTime_SGW" SG_ 613 DALM_Request_C2 0;
BA_ "GenSigTimeoutTime_TRSKM" SG_ 613 DALM_Request_C2 0;
BA_ "GenSigSendType" SG_ 613 HAS_OpStat_Sec_DALM 3;
BA_ "GenSigTimeoutTime_BSM2" SG_ 613 HAS_OpStat_Sec_DALM 0;
BA_ "GenSigTimeoutTime_CADM2" SG_ 613 HAS_OpStat_Sec_DALM 0;
BA_ "GenSigTimeoutTime_CVADAS" SG_ 613 HAS_OpStat_Sec_DALM 0;
BA_ "GenSigTimeoutTime_EPS" SG_ 613 HAS_OpStat_Sec_DALM 0;
BA_ "GenSigTimeoutTime_ORC" SG_ 613 HAS_OpStat_Sec_DALM 0;
BA_ "GenSigTimeoutTime_PAM" SG_ 613 HAS_OpStat_Sec_DALM 0;
BA_ "GenSigTimeoutTime_SGW" SG_ 613 HAS_OpStat_Sec_DALM 0;
BA_ "GenSigTimeoutTime_TRSKM" SG_ 613 HAS_OpStat_Sec_DALM 0;
BA_ "GenSigSendType" SG_ 613 HAS_Status_C2_DALM 3;
BA_ "GenSigTimeoutTime_BSM2" SG_ 613 HAS_Status_C2_DALM 0;
BA_ "GenSigTimeoutTime_CADM2" SG_ 613 HAS_Status_C2_DALM 0;
BA_ "GenSigTimeoutTime_CVADAS" SG_ 613 HAS_Status_C2_DALM 0;
BA_ "GenSigTimeoutTime_EPS" SG_ 613 HAS_Status_C2_DALM 0;
BA_ "GenSigTimeoutTime_ORC" SG_ 613 HAS_Status_C2_DALM 0;
BA_ "GenSigTimeoutTime_PAM" SG_ 613 HAS_Status_C2_DALM 0;
BA_ "GenSigTimeoutTime_SGW" SG_ 613 HAS_Status_C2_DALM 0;
BA_ "GenSigTimeoutTime_TRSKM" SG_ 613 HAS_Status_C2_DALM 0;
BA_ "GenSigTimeoutTime_BCM" SG_ 730 Camera_Status 0;
BA_ "GenSigTimeoutTime_BSM2" SG_ 730 Camera_Status 0;
BA_ "GenSigTimeoutTime_CVADAS" SG_ 730 Camera_Status 0;
BA_ "GenSigTimeoutTime_EPS" SG_ 730 Camera_Status 0;
BA_ "GenSigTimeoutTime_ORC" SG_ 730 Camera_Status 0;
BA_ "GenSigTimeoutTime_PAM" SG_ 730 Camera_Status 0;
BA_ "GenSigTimeoutTime_SGW" SG_ 730 Camera_Status 0;
BA_ "GenSigTimeoutTime_TRSKM" SG_ 730 Camera_Status 0;
BA_ "GenSigTimeoutTime_BCM" SG_ 730 Cntr_ADAS_FD_LANES_1 0;
BA_ "GenSigTimeoutTime_BSM2" SG_ 730 Cntr_ADAS_FD_LANES_1 0;
BA_ "GenSigTimeoutTime_CVADAS" SG_ 730 Cntr_ADAS_FD_LANES_1 0;
BA_ "GenSigTimeoutTime_EPS" SG_ 730 Cntr_ADAS_FD_LANES_1 0;
BA_ "GenSigTimeoutTime_ORC" SG_ 730 Cntr_ADAS_FD_LANES_1 0;
BA_ "GenSigTimeoutTime_PAM" SG_ 730 Cntr_ADAS_FD_LANES_1 0;
BA_ "GenSigTimeoutTime_SGW" SG_ 730 Cntr_ADAS_FD_LANES_1 0;
BA_ "GenSigTimeoutTime_TRSKM" SG_ 730 Cntr_ADAS_FD_LANES_1 0;
BA_ "GenSigTimeoutTime_BCM" SG_ 730 CRC_ADAS_FD_LANES_1 0;
BA_ "GenSigTimeoutTime_BSM2" SG_ 730 CRC_ADAS_FD_LANES_1 0;
BA_ "GenSigTimeoutTime_CVADAS" SG_ 730 CRC_ADAS_FD_LANES_1 0;
BA_ "GenSigTimeoutTime_EPS" SG_ 730 CRC_ADAS_FD_LANES_1 0;
BA_ "GenSigTimeoutTime_ORC" SG_ 730 CRC_ADAS_FD_LANES_1 0;
BA_ "GenSigTimeoutTime_PAM" SG_ 730 CRC_ADAS_FD_LANES_1 0;
BA_ "GenSigTimeoutTime_SGW" SG_ 730 CRC_ADAS_FD_LANES_1 0;
BA_ "GenSigTimeoutTime_TRSKM" SG_ 730 CRC_ADAS_FD_LANES_1 0;
BA_ "GenSigTimeoutTime_BCM" SG_ 730 FOD_Confidence 0;
BA_ "GenSigTimeoutTime_BSM2" SG_ 730 FOD_Confidence 0;
BA_ "GenSigTimeoutTime_CVADAS" SG_ 730 FOD_Confidence 0;
BA_ "GenSigTimeoutTime_EPS" SG_ 730 FOD_Confidence 0;
BA_ "GenSigTimeoutTime_ORC" SG_ 730 FOD_Confidence 0;
BA_ "GenSigTimeoutTime_PAM" SG_ 730 FOD_Confidence 0;
BA_ "GenSigTimeoutTime_SGW" SG_ 730 FOD_Confidence 0;
BA_ "GenSigTimeoutTime_TRSKM" SG_ 730 FOD_Confidence 0;
BA_ "GenSigTimeoutTime_BCM" SG_ 730 Frame_Index_Lanes_1 0;
BA_ "GenSigTimeoutTime_BSM2" SG_ 730 Frame_Index_Lanes_1 0;
BA_ "GenSigTimeoutTime_CVADAS" SG_ 730 Frame_Index_Lanes_1 0;
BA_ "GenSigTimeoutTime_EPS" SG_ 730 Frame_Index_Lanes_1 0;
BA_ "GenSigTimeoutTime_ORC" SG_ 730 Frame_Index_Lanes_1 0;
BA_ "GenSigTimeoutTime_PAM" SG_ 730 Frame_Index_Lanes_1 0;
BA_ "GenSigTimeoutTime_SGW" SG_ 730 Frame_Index_Lanes_1 0;
BA_ "GenSigTimeoutTime_TRSKM" SG_ 730 Frame_Index_Lanes_1 0;
BA_ "GenSigTimeoutTime_BCM" SG_ 730 Health_Front_Object_Detection 0;
BA_ "GenSigTimeoutTime_BSM2" SG_ 730 Health_Front_Object_Detection 0;
BA_ "GenSigTimeoutTime_CVADAS" SG_ 730 Health_Front_Object_Detection 0;
BA_ "GenSigTimeoutTime_EPS" SG_ 730 Health_Front_Object_Detection 0;
BA_ "GenSigTimeoutTime_ORC" SG_ 730 Health_Front_Object_Detection 0;
BA_ "GenSigTimeoutTime_PAM" SG_ 730 Health_Front_Object_Detection 0;
BA_ "GenSigTimeoutTime_SGW" SG_ 730 Health_Front_Object_Detection 0;
BA_ "GenSigTimeoutTime_TRSKM" SG_ 730 Health_Front_Object_Detection 0;
BA_ "GenSigTimeoutTime_BCM" SG_ 730 Health_Lane_Detection 0;
BA_ "GenSigTimeoutTime_BSM2" SG_ 730 Health_Lane_Detection 0;
BA_ "GenSigTimeoutTime_CVADAS" SG_ 730 Health_Lane_Detection 0;
BA_ "GenSigTimeoutTime_EPS" SG_ 730 Health_Lane_Detection 0;
BA_ "GenSigTimeoutTime_ORC" SG_ 730 Health_Lane_Detection 0;
BA_ "GenSigTimeoutTime_PAM" SG_ 730 Health_Lane_Detection 0;
BA_ "GenSigTimeoutTime_SGW" SG_ 730 Health_Lane_Detection 0;
BA_ "GenSigTimeoutTime_TRSKM" SG_ 730 Health_Lane_Detection 0;
BA_ "GenSigTimeoutTime_BCM" SG_ 730 Line_1_Confidence 0;
BA_ "GenSigTimeoutTime_BSM2" SG_ 730 Line_1_Confidence 0;
BA_ "GenSigTimeoutTime_CVADAS" SG_ 730 Line_1_Confidence 0;
BA_ "GenSigTimeoutTime_EPS" SG_ 730 Line_1_Confidence 0;
BA_ "GenSigTimeoutTime_ORC" SG_ 730 Line_1_Confidence 0;
BA_ "GenSigTimeoutTime_PAM" SG_ 730 Line_1_Confidence 0;
BA_ "GenSigTimeoutTime_SGW" SG_ 730 Line_1_Confidence 0;
BA_ "GenSigTimeoutTime_TRSKM" SG_ 730 Line_1_Confidence 0;
BA_ "GenSigTimeoutTime_BCM" SG_ 730 Line_1_Curvature 0;
BA_ "GenSigTimeoutTime_BSM2" SG_ 730 Line_1_Curvature 0;
BA_ "GenSigTimeoutTime_CVADAS" SG_ 730 Line_1_Curvature 0;
BA_ "GenSigTimeoutTime_EPS" SG_ 730 Line_1_Curvature 0;
BA_ "GenSigTimeoutTime_ORC" SG_ 730 Line_1_Curvature 0;
BA_ "GenSigTimeoutTime_PAM" SG_ 730 Line_1_Curvature 0;
BA_ "GenSigTimeoutTime_SGW" SG_ 730 Line_1_Curvature 0;
BA_ "GenSigTimeoutTime_TRSKM" SG_ 730 Line_1_Curvature 0;
BA_ "GenSigTimeoutTime_BCM" SG_ 730 Line_1_Curvature_Rate 0;
BA_ "GenSigTimeoutTime_BSM2" SG_ 730 Line_1_Curvature_Rate 0;
BA_ "GenSigTimeoutTime_CVADAS" SG_ 730 Line_1_Curvature_Rate 0;
BA_ "GenSigTimeoutTime_EPS" SG_ 730 Line_1_Curvature_Rate 0;
BA_ "GenSigTimeoutTime_ORC" SG_ 730 Line_1_Curvature_Rate 0;
BA_ "GenSigTimeoutTime_PAM" SG_ 730 Line_1_Curvature_Rate 0;
BA_ "GenSigTimeoutTime_SGW" SG_ 730 Line_1_Curvature_Rate 0;
BA_ "GenSigTimeoutTime_TRSKM" SG_ 730 Line_1_Curvature_Rate 0;
BA_ "GenSigTimeoutTime_BCM" SG_ 730 Line_1_End_Range 0;
BA_ "GenSigTimeoutTime_BSM2" SG_ 730 Line_1_End_Range 0;
BA_ "GenSigTimeoutTime_CVADAS" SG_ 730 Line_1_End_Range 0;
BA_ "GenSigTimeoutTime_EPS" SG_ 730 Line_1_End_Range 0;
BA_ "GenSigTimeoutTime_ORC" SG_ 730 Line_1_End_Range 0;
BA_ "GenSigTimeoutTime_PAM" SG_ 730 Line_1_End_Range 0;
BA_ "GenSigTimeoutTime_SGW" SG_ 730 Line_1_End_Range 0;
BA_ "GenSigTimeoutTime_TRSKM" SG_ 730 Line_1_End_Range 0;
BA_ "GenSigTimeoutTime_BCM" SG_ 730 Line_1_Heading 0;
BA_ "GenSigTimeoutTime_BSM2" SG_ 730 Line_1_Heading 0;
BA_ "GenSigTimeoutTime_CVADAS" SG_ 730 Line_1_Heading 0;
BA_ "GenSigTimeoutTime_EPS" SG_ 730 Line_1_Heading 0;
BA_ "GenSigTimeoutTime_ORC" SG_ 730 Line_1_Heading 0;
BA_ "GenSigTimeoutTime_PAM" SG_ 730 Line_1_Heading 0;
BA_ "GenSigTimeoutTime_SGW" SG_ 730 Line_1_Heading 0;
BA_ "GenSigTimeoutTime_TRSKM" SG_ 730 Line_1_Heading 0;
BA_ "GenSigTimeoutTime_BCM" SG_ 730 Line_1_Offset 0;
BA_ "GenSigTimeoutTime_BSM2" SG_ 730 Line_1_Offset 0;
BA_ "GenSigTimeoutTime_CVADAS" SG_ 730 Line_1_Offset 0;
BA_ "GenSigTimeoutTime_EPS" SG_ 730 Line_1_Offset 0;
BA_ "GenSigTimeoutTime_ORC" SG_ 730 Line_1_Offset 0;
BA_ "GenSigTimeoutTime_PAM" SG_ 730 Line_1_Offset 0;
BA_ "GenSigTimeoutTime_SGW" SG_ 730 Line_1_Offset 0;
BA_ "GenSigTimeoutTime_TRSKM" SG_ 730 Line_1_Offset 0;
BA_ "GenSigTimeoutTime_BCM" SG_ 730 Line_1_Start_Range 0;
BA_ "GenSigTimeoutTime_BSM2" SG_ 730 Line_1_Start_Range 0;
BA_ "GenSigTimeoutTime_CVADAS" SG_ 730 Line_1_Start_Range 0;
BA_ "GenSigTimeoutTime_EPS" SG_ 730 Line_1_Start_Range 0;
BA_ "GenSigTimeoutTime_ORC" SG_ 730 Line_1_Start_Range 0;
BA_ "GenSigTimeoutTime_PAM" SG_ 730 Line_1_Start_Range 0;
BA_ "GenSigTimeoutTime_SGW" SG_ 730 Line_1_Start_Range 0;
BA_ "GenSigTimeoutTime_TRSKM" SG_ 730 Line_1_Start_Range 0;
BA_ "GenSigTimeoutTime_BCM" SG_ 730 Line_1_Type 0;
BA_ "GenSigTimeoutTime_BSM2" SG_ 730 Line_1_Type 0;
BA_ "GenSigTimeoutTime_CVADAS" SG_ 730 Line_1_Type 0;
BA_ "GenSigTimeoutTime_EPS" SG_ 730 Line_1_Type 0;
BA_ "GenSigTimeoutTime_ORC" SG_ 730 Line_1_Type 0;
BA_ "GenSigTimeoutTime_PAM" SG_ 730 Line_1_Type 0;
BA_ "GenSigTimeoutTime_SGW" SG_ 730 Line_1_Type 0;
BA_ "GenSigTimeoutTime_TRSKM" SG_ 730 Line_1_Type 0;
BA_ "GenSigTimeoutTime_BCM" SG_ 730 Line_2_Confidence 0;
BA_ "GenSigTimeoutTime_BSM2" SG_ 730 Line_2_Confidence 0;
BA_ "GenSigTimeoutTime_CVADAS" SG_ 730 Line_2_Confidence 0;
BA_ "GenSigTimeoutTime_EPS" SG_ 730 Line_2_Confidence 0;
BA_ "GenSigTimeoutTime_ORC" SG_ 730 Line_2_Confidence 0;
BA_ "GenSigTimeoutTime_PAM" SG_ 730 Line_2_Confidence 0;
BA_ "GenSigTimeoutTime_SGW" SG_ 730 Line_2_Confidence 0;
BA_ "GenSigTimeoutTime_TRSKM" SG_ 730 Line_2_Confidence 0;
BA_ "GenSigTimeoutTime_BCM" SG_ 730 Line_2_Curvature 0;
BA_ "GenSigTimeoutTime_BSM2" SG_ 730 Line_2_Curvature 0;
BA_ "GenSigTimeoutTime_CVADAS" SG_ 730 Line_2_Curvature 0;
BA_ "GenSigTimeoutTime_EPS" SG_ 730 Line_2_Curvature 0;
BA_ "GenSigTimeoutTime_ORC" SG_ 730 Line_2_Curvature 0;
BA_ "GenSigTimeoutTime_PAM" SG_ 730 Line_2_Curvature 0;
BA_ "GenSigTimeoutTime_SGW" SG_ 730 Line_2_Curvature 0;
BA_ "GenSigTimeoutTime_TRSKM" SG_ 730 Line_2_Curvature 0;
BA_ "GenSigTimeoutTime_BCM" SG_ 730 Line_2_Curvature_Rate 0;
BA_ "GenSigTimeoutTime_BSM2" SG_ 730 Line_2_Curvature_Rate 0;
BA_ "GenSigTimeoutTime_CVADAS" SG_ 730 Line_2_Curvature_Rate 0;
BA_ "GenSigTimeoutTime_EPS" SG_ 730 Line_2_Curvature_Rate 0;
BA_ "GenSigTimeoutTime_ORC" SG_ 730 Line_2_Curvature_Rate 0;
BA_ "GenSigTimeoutTime_PAM" SG_ 730 Line_2_Curvature_Rate 0;
BA_ "GenSigTimeoutTime_SGW" SG_ 730 Line_2_Curvature_Rate 0;
BA_ "GenSigTimeoutTime_TRSKM" SG_ 730 Line_2_Curvature_Rate 0;
BA_ "GenSigTimeoutTime_BCM" SG_ 730 Line_2_End_Range 0;
BA_ "GenSigTimeoutTime_BSM2" SG_ 730 Line_2_End_Range 0;
BA_ "GenSigTimeoutTime_CVADAS" SG_ 730 Line_2_End_Range 0;
BA_ "GenSigTimeoutTime_EPS" SG_ 730 Line_2_End_Range 0;
BA_ "GenSigTimeoutTime_ORC" SG_ 730 Line_2_End_Range 0;
BA_ "GenSigTimeoutTime_PAM" SG_ 730 Line_2_End_Range 0;
BA_ "GenSigTimeoutTime_SGW" SG_ 730 Line_2_End_Range 0;
BA_ "GenSigTimeoutTime_TRSKM" SG_ 730 Line_2_End_Range 0;
BA_ "GenSigTimeoutTime_BCM" SG_ 730 Line_2_Heading 0;
BA_ "GenSigTimeoutTime_BSM2" SG_ 730 Line_2_Heading 0;
BA_ "GenSigTimeoutTime_CVADAS" SG_ 730 Line_2_Heading 0;
BA_ "GenSigTimeoutTime_EPS" SG_ 730 Line_2_Heading 0;
BA_ "GenSigTimeoutTime_ORC" SG_ 730 Line_2_Heading 0;
BA_ "GenSigTimeoutTime_PAM" SG_ 730 Line_2_Heading 0;
BA_ "GenSigTimeoutTime_SGW" SG_ 730 Line_2_Heading 0;
BA_ "GenSigTimeoutTime_TRSKM" SG_ 730 Line_2_Heading 0;
BA_ "GenSigTimeoutTime_BCM" SG_ 730 Line_2_Offset 0;
BA_ "GenSigTimeoutTime_BSM2" SG_ 730 Line_2_Offset 0;
BA_ "GenSigTimeoutTime_CVADAS" SG_ 730 Line_2_Offset 0;
BA_ "GenSigTimeoutTime_EPS" SG_ 730 Line_2_Offset 0;
BA_ "GenSigTimeoutTime_ORC" SG_ 730 Line_2_Offset 0;
BA_ "GenSigTimeoutTime_PAM" SG_ 730 Line_2_Offset 0;
BA_ "GenSigTimeoutTime_SGW" SG_ 730 Line_2_Offset 0;
BA_ "GenSigTimeoutTime_TRSKM" SG_ 730 Line_2_Offset 0;
BA_ "GenSigTimeoutTime_BCM" SG_ 730 Line_2_Start_Range 0;
BA_ "GenSigTimeoutTime_BSM2" SG_ 730 Line_2_Start_Range 0;
BA_ "GenSigTimeoutTime_CVADAS" SG_ 730 Line_2_Start_Range 0;
BA_ "GenSigTimeoutTime_EPS" SG_ 730 Line_2_Start_Range 0;
BA_ "GenSigTimeoutTime_ORC" SG_ 730 Line_2_Start_Range 0;
BA_ "GenSigTimeoutTime_PAM" SG_ 730 Line_2_Start_Range 0;
BA_ "GenSigTimeoutTime_SGW" SG_ 730 Line_2_Start_Range 0;
BA_ "GenSigTimeoutTime_TRSKM" SG_ 730 Line_2_Start_Range 0;
BA_ "GenSigTimeoutTime_BCM" SG_ 730 Line_2_Type 0;
BA_ "GenSigTimeoutTime_BSM2" SG_ 730 Line_2_Type 0;
BA_ "GenSigTimeoutTime_CVADAS" SG_ 730 Line_2_Type 0;
BA_ "GenSigTimeoutTime_EPS" SG_ 730 Line_2_Type 0;
BA_ "GenSigTimeoutTime_ORC" SG_ 730 Line_2_Type 0;
BA_ "GenSigTimeoutTime_PAM" SG_ 730 Line_2_Type 0;
BA_ "GenSigTimeoutTime_SGW" SG_ 730 Line_2_Type 0;
BA_ "GenSigTimeoutTime_TRSKM" SG_ 730 Line_2_Type 0;
BA_ "GenSigTimeoutTime_BCM" SG_ 730 Line_3_Confidence 0;
BA_ "GenSigTimeoutTime_BSM2" SG_ 730 Line_3_Confidence 0;
BA_ "GenSigTimeoutTime_CVADAS" SG_ 730 Line_3_Confidence 0;
BA_ "GenSigTimeoutTime_EPS" SG_ 730 Line_3_Confidence 0;
BA_ "GenSigTimeoutTime_ORC" SG_ 730 Line_3_Confidence 0;
BA_ "GenSigTimeoutTime_PAM" SG_ 730 Line_3_Confidence 0;
BA_ "GenSigTimeoutTime_SGW" SG_ 730 Line_3_Confidence 0;
BA_ "GenSigTimeoutTime_TRSKM" SG_ 730 Line_3_Confidence 0;
BA_ "GenSigTimeoutTime_BCM" SG_ 730 Line_3_Curvature 0;
BA_ "GenSigTimeoutTime_BSM2" SG_ 730 Line_3_Curvature 0;
BA_ "GenSigTimeoutTime_CVADAS" SG_ 730 Line_3_Curvature 0;
BA_ "GenSigTimeoutTime_EPS" SG_ 730 Line_3_Curvature 0;
BA_ "GenSigTimeoutTime_ORC" SG_ 730 Line_3_Curvature 0;
BA_ "GenSigTimeoutTime_PAM" SG_ 730 Line_3_Curvature 0;
BA_ "GenSigTimeoutTime_SGW" SG_ 730 Line_3_Curvature 0;
BA_ "GenSigTimeoutTime_TRSKM" SG_ 730 Line_3_Curvature 0;
BA_ "GenSigTimeoutTime_BCM" SG_ 730 Line_3_Curvature_Rate 0;
BA_ "GenSigTimeoutTime_BSM2" SG_ 730 Line_3_Curvature_Rate 0;
BA_ "GenSigTimeoutTime_CVADAS" SG_ 730 Line_3_Curvature_Rate 0;
BA_ "GenSigTimeoutTime_EPS" SG_ 730 Line_3_Curvature_Rate 0;
BA_ "GenSigTimeoutTime_ORC" SG_ 730 Line_3_Curvature_Rate 0;
BA_ "GenSigTimeoutTime_PAM" SG_ 730 Line_3_Curvature_Rate 0;
BA_ "GenSigTimeoutTime_SGW" SG_ 730 Line_3_Curvature_Rate 0;
BA_ "GenSigTimeoutTime_TRSKM" SG_ 730 Line_3_Curvature_Rate 0;
BA_ "GenSigTimeoutTime_BCM" SG_ 730 Line_3_End_Range 0;
BA_ "GenSigTimeoutTime_BSM2" SG_ 730 Line_3_End_Range 0;
BA_ "GenSigTimeoutTime_CVADAS" SG_ 730 Line_3_End_Range 0;
BA_ "GenSigTimeoutTime_EPS" SG_ 730 Line_3_End_Range 0;
BA_ "GenSigTimeoutTime_ORC" SG_ 730 Line_3_End_Range 0;
BA_ "GenSigTimeoutTime_PAM" SG_ 730 Line_3_End_Range 0;
BA_ "GenSigTimeoutTime_SGW" SG_ 730 Line_3_End_Range 0;
BA_ "GenSigTimeoutTime_TRSKM" SG_ 730 Line_3_End_Range 0;
BA_ "GenSigTimeoutTime_BCM" SG_ 730 Line_3_Heading 0;
BA_ "GenSigTimeoutTime_BSM2" SG_ 730 Line_3_Heading 0;
BA_ "GenSigTimeoutTime_CVADAS" SG_ 730 Line_3_Heading 0;
BA_ "GenSigTimeoutTime_EPS" SG_ 730 Line_3_Heading 0;
BA_ "GenSigTimeoutTime_ORC" SG_ 730 Line_3_Heading 0;
BA_ "GenSigTimeoutTime_PAM" SG_ 730 Line_3_Heading 0;
BA_ "GenSigTimeoutTime_SGW" SG_ 730 Line_3_Heading 0;
BA_ "GenSigTimeoutTime_TRSKM" SG_ 730 Line_3_Heading 0;
BA_ "GenSigTimeoutTime_BCM" SG_ 730 Line_3_Offset 0;
BA_ "GenSigTimeoutTime_BSM2" SG_ 730 Line_3_Offset 0;
BA_ "GenSigTimeoutTime_CVADAS" SG_ 730 Line_3_Offset 0;
BA_ "GenSigTimeoutTime_EPS" SG_ 730 Line_3_Offset 0;
BA_ "GenSigTimeoutTime_ORC" SG_ 730 Line_3_Offset 0;
BA_ "GenSigTimeoutTime_PAM" SG_ 730 Line_3_Offset 0;
BA_ "GenSigTimeoutTime_SGW" SG_ 730 Line_3_Offset 0;
BA_ "GenSigTimeoutTime_TRSKM" SG_ 730 Line_3_Offset 0;
BA_ "GenSigTimeoutTime_BCM" SG_ 730 Line_3_Start_Range 0;
BA_ "GenSigTimeoutTime_BSM2" SG_ 730 Line_3_Start_Range 0;
BA_ "GenSigTimeoutTime_CVADAS" SG_ 730 Line_3_Start_Range 0;
BA_ "GenSigTimeoutTime_EPS" SG_ 730 Line_3_Start_Range 0;
BA_ "GenSigTimeoutTime_ORC" SG_ 730 Line_3_Start_Range 0;
BA_ "GenSigTimeoutTime_PAM" SG_ 730 Line_3_Start_Range 0;
BA_ "GenSigTimeoutTime_SGW" SG_ 730 Line_3_Start_Range 0;
BA_ "GenSigTimeoutTime_TRSKM" SG_ 730 Line_3_Start_Range 0;
BA_ "GenSigTimeoutTime_BCM" SG_ 730 Line_3_Type 0;
BA_ "GenSigTimeoutTime_BSM2" SG_ 730 Line_3_Type 0;
BA_ "GenSigTimeoutTime_CVADAS" SG_ 730 Line_3_Type 0;
BA_ "GenSigTimeoutTime_EPS" SG_ 730 Line_3_Type 0;
BA_ "GenSigTimeoutTime_ORC" SG_ 730 Line_3_Type 0;
BA_ "GenSigTimeoutTime_PAM" SG_ 730 Line_3_Type 0;
BA_ "GenSigTimeoutTime_SGW" SG_ 730 Line_3_Type 0;
BA_ "GenSigTimeoutTime_TRSKM" SG_ 730 Line_3_Type 0;
BA_ "GenSigTimeoutTime_BCM" SG_ 730 Line_4_Confidence 0;
BA_ "GenSigTimeoutTime_BSM2" SG_ 730 Line_4_Confidence 0;
BA_ "GenSigTimeoutTime_CVADAS" SG_ 730 Line_4_Confidence 0;
BA_ "GenSigTimeoutTime_EPS" SG_ 730 Line_4_Confidence 0;
BA_ "GenSigTimeoutTime_ORC" SG_ 730 Line_4_Confidence 0;
BA_ "GenSigTimeoutTime_PAM" SG_ 730 Line_4_Confidence 0;
BA_ "GenSigTimeoutTime_SGW" SG_ 730 Line_4_Confidence 0;
BA_ "GenSigTimeoutTime_TRSKM" SG_ 730 Line_4_Confidence 0;
BA_ "GenSigTimeoutTime_BCM" SG_ 730 Line_4_Curvature 0;
BA_ "GenSigTimeoutTime_BSM2" SG_ 730 Line_4_Curvature 0;
BA_ "GenSigTimeoutTime_CVADAS" SG_ 730 Line_4_Curvature 0;
BA_ "GenSigTimeoutTime_EPS" SG_ 730 Line_4_Curvature 0;
BA_ "GenSigTimeoutTime_ORC" SG_ 730 Line_4_Curvature 0;
BA_ "GenSigTimeoutTime_PAM" SG_ 730 Line_4_Curvature 0;
BA_ "GenSigTimeoutTime_SGW" SG_ 730 Line_4_Curvature 0;
BA_ "GenSigTimeoutTime_TRSKM" SG_ 730 Line_4_Curvature 0;
BA_ "GenSigTimeoutTime_BCM" SG_ 730 Line_4_Curvature_Rate 0;
BA_ "GenSigTimeoutTime_BSM2" SG_ 730 Line_4_Curvature_Rate 0;
BA_ "GenSigTimeoutTime_CVADAS" SG_ 730 Line_4_Curvature_Rate 0;
BA_ "GenSigTimeoutTime_EPS" SG_ 730 Line_4_Curvature_Rate 0;
BA_ "GenSigTimeoutTime_ORC" SG_ 730 Line_4_Curvature_Rate 0;
BA_ "GenSigTimeoutTime_PAM" SG_ 730 Line_4_Curvature_Rate 0;
BA_ "GenSigTimeoutTime_SGW" SG_ 730 Line_4_Curvature_Rate 0;
BA_ "GenSigTimeoutTime_TRSKM" SG_ 730 Line_4_Curvature_Rate 0;
BA_ "GenSigTimeoutTime_BCM" SG_ 730 Line_4_End_Range 0;
BA_ "GenSigTimeoutTime_BSM2" SG_ 730 Line_4_End_Range 0;
BA_ "GenSigTimeoutTime_CVADAS" SG_ 730 Line_4_End_Range 0;
BA_ "GenSigTimeoutTime_EPS" SG_ 730 Line_4_End_Range 0;
BA_ "GenSigTimeoutTime_ORC" SG_ 730 Line_4_End_Range 0;
BA_ "GenSigTimeoutTime_PAM" SG_ 730 Line_4_End_Range 0;
BA_ "GenSigTimeoutTime_SGW" SG_ 730 Line_4_End_Range 0;
BA_ "GenSigTimeoutTime_TRSKM" SG_ 730 Line_4_End_Range 0;
BA_ "GenSigTimeoutTime_BCM" SG_ 730 Line_4_Heading 0;
BA_ "GenSigTimeoutTime_BSM2" SG_ 730 Line_4_Heading 0;
BA_ "GenSigTimeoutTime_CVADAS" SG_ 730 Line_4_Heading 0;
BA_ "GenSigTimeoutTime_EPS" SG_ 730 Line_4_Heading 0;
BA_ "GenSigTimeoutTime_ORC" SG_ 730 Line_4_Heading 0;
BA_ "GenSigTimeoutTime_PAM" SG_ 730 Line_4_Heading 0;
BA_ "GenSigTimeoutTime_SGW" SG_ 730 Line_4_Heading 0;
BA_ "GenSigTimeoutTime_TRSKM" SG_ 730 Line_4_Heading 0;
BA_ "GenSigTimeoutTime_BCM" SG_ 730 Line_4_Offset 0;
BA_ "GenSigTimeoutTime_BSM2" SG_ 730 Line_4_Offset 0;
BA_ "GenSigTimeoutTime_CVADAS" SG_ 730 Line_4_Offset 0;
BA_ "GenSigTimeoutTime_EPS" SG_ 730 Line_4_Offset 0;
BA_ "GenSigTimeoutTime_ORC" SG_ 730 Line_4_Offset 0;
BA_ "GenSigTimeoutTime_PAM" SG_ 730 Line_4_Offset 0;
BA_ "GenSigTimeoutTime_SGW" SG_ 730 Line_4_Offset 0;
BA_ "GenSigTimeoutTime_TRSKM" SG_ 730 Line_4_Offset 0;
BA_ "GenSigTimeoutTime_BCM" SG_ 730 Line_4_Start_Range 0;
BA_ "GenSigTimeoutTime_BSM2" SG_ 730 Line_4_Start_Range 0;
BA_ "GenSigTimeoutTime_CVADAS" SG_ 730 Line_4_Start_Range 0;
BA_ "GenSigTimeoutTime_EPS" SG_ 730 Line_4_Start_Range 0;
BA_ "GenSigTimeoutTime_ORC" SG_ 730 Line_4_Start_Range 0;
BA_ "GenSigTimeoutTime_PAM" SG_ 730 Line_4_Start_Range 0;
BA_ "GenSigTimeoutTime_SGW" SG_ 730 Line_4_Start_Range 0;
BA_ "GenSigTimeoutTime_TRSKM" SG_ 730 Line_4_Start_Range 0;
BA_ "GenSigTimeoutTime_BCM" SG_ 730 Line_4_Type 0;
BA_ "GenSigTimeoutTime_BSM2" SG_ 730 Line_4_Type 0;
BA_ "GenSigTimeoutTime_CVADAS" SG_ 730 Line_4_Type 0;
BA_ "GenSigTimeoutTime_EPS" SG_ 730 Line_4_Type 0;
BA_ "GenSigTimeoutTime_ORC" SG_ 730 Line_4_Type 0;
BA_ "GenSigTimeoutTime_PAM" SG_ 730 Line_4_Type 0;
BA_ "GenSigTimeoutTime_SGW" SG_ 730 Line_4_Type 0;
BA_ "GenSigTimeoutTime_TRSKM" SG_ 730 Line_4_Type 0;
BA_ "GenSigTimeoutTime_BCM" SG_ 730 MAC_ADAS_FD_LANES_1 0;
BA_ "GenSigTimeoutTime_BSM2" SG_ 730 MAC_ADAS_FD_LANES_1 0;
BA_ "GenSigTimeoutTime_CVADAS" SG_ 730 MAC_ADAS_FD_LANES_1 0;
BA_ "GenSigTimeoutTime_EPS" SG_ 730 MAC_ADAS_FD_LANES_1 0;
BA_ "GenSigTimeoutTime_ORC" SG_ 730 MAC_ADAS_FD_LANES_1 0;
BA_ "GenSigTimeoutTime_PAM" SG_ 730 MAC_ADAS_FD_LANES_1 0;
BA_ "GenSigTimeoutTime_SGW" SG_ 730 MAC_ADAS_FD_LANES_1 0;
BA_ "GenSigTimeoutTime_TRSKM" SG_ 730 MAC_ADAS_FD_LANES_1 0;
BA_ "GenSigTimeoutTime_BCM" SG_ 730 MessageCounter_ADAS_FD_LANES_1 0;
BA_ "GenSigTimeoutTime_BSM2" SG_ 730 MessageCounter_ADAS_FD_LANES_1 0;
BA_ "GenSigTimeoutTime_CVADAS" SG_ 730 MessageCounter_ADAS_FD_LANES_1 0;
BA_ "GenSigTimeoutTime_EPS" SG_ 730 MessageCounter_ADAS_FD_LANES_1 0;
BA_ "GenSigTimeoutTime_ORC" SG_ 730 MessageCounter_ADAS_FD_LANES_1 0;
BA_ "GenSigTimeoutTime_PAM" SG_ 730 MessageCounter_ADAS_FD_LANES_1 0;
BA_ "GenSigTimeoutTime_SGW" SG_ 730 MessageCounter_ADAS_FD_LANES_1 0;
BA_ "GenSigTimeoutTime_TRSKM" SG_ 730 MessageCounter_ADAS_FD_LANES_1 0;
BA_ "GenSigTimeoutTime_BCM" SG_ 730 Reserved_for_functional_safety 0;
BA_ "GenSigTimeoutTime_BSM2" SG_ 730 Reserved_for_functional_safety 0;
BA_ "GenSigTimeoutTime_CVADAS" SG_ 730 Reserved_for_functional_safety 0;
BA_ "GenSigTimeoutTime_EPS" SG_ 730 Reserved_for_functional_safety 0;
BA_ "GenSigTimeoutTime_ORC" SG_ 730 Reserved_for_functional_safety 0;
BA_ "GenSigTimeoutTime_PAM" SG_ 730 Reserved_for_functional_safety 0;
BA_ "GenSigTimeoutTime_SGW" SG_ 730 Reserved_for_functional_safety 0;
BA_ "GenSigTimeoutTime_TRSKM" SG_ 730 Reserved_for_functional_safety 0;
BA_ "GenSigTimeoutTime_BCM" SG_ 734 Cntr_ADAS_FD_LANES_2 0;
BA_ "GenSigTimeoutTime_BSM2" SG_ 734 Cntr_ADAS_FD_LANES_2 0;
BA_ "GenSigTimeoutTime_CVADAS" SG_ 734 Cntr_ADAS_FD_LANES_2 0;
BA_ "GenSigTimeoutTime_EPS" SG_ 734 Cntr_ADAS_FD_LANES_2 0;
BA_ "GenSigTimeoutTime_ORC" SG_ 734 Cntr_ADAS_FD_LANES_2 0;
BA_ "GenSigTimeoutTime_PAM" SG_ 734 Cntr_ADAS_FD_LANES_2 0;
BA_ "GenSigTimeoutTime_SGW" SG_ 734 Cntr_ADAS_FD_LANES_2 0;
BA_ "GenSigTimeoutTime_TRSKM" SG_ 734 Cntr_ADAS_FD_LANES_2 0;
BA_ "GenSigTimeoutTime_BCM" SG_ 734 CRC_ADAS_FD_LANES_2 0;
BA_ "GenSigTimeoutTime_BSM2" SG_ 734 CRC_ADAS_FD_LANES_2 0;
BA_ "GenSigTimeoutTime_CVADAS" SG_ 734 CRC_ADAS_FD_LANES_2 0;
BA_ "GenSigTimeoutTime_EPS" SG_ 734 CRC_ADAS_FD_LANES_2 0;
BA_ "GenSigTimeoutTime_ORC" SG_ 734 CRC_ADAS_FD_LANES_2 0;
BA_ "GenSigTimeoutTime_PAM" SG_ 734 CRC_ADAS_FD_LANES_2 0;
BA_ "GenSigTimeoutTime_SGW" SG_ 734 CRC_ADAS_FD_LANES_2 0;
BA_ "GenSigTimeoutTime_TRSKM" SG_ 734 CRC_ADAS_FD_LANES_2 0;
BA_ "GenSigTimeoutTime_BCM" SG_ 734 Frame_Index_Lanes_2 0;
BA_ "GenSigTimeoutTime_BSM2" SG_ 734 Frame_Index_Lanes_2 0;
BA_ "GenSigTimeoutTime_CVADAS" SG_ 734 Frame_Index_Lanes_2 0;
BA_ "GenSigTimeoutTime_EPS" SG_ 734 Frame_Index_Lanes_2 0;
BA_ "GenSigTimeoutTime_ORC" SG_ 734 Frame_Index_Lanes_2 0;
BA_ "GenSigTimeoutTime_PAM" SG_ 734 Frame_Index_Lanes_2 0;
BA_ "GenSigTimeoutTime_SGW" SG_ 734 Frame_Index_Lanes_2 0;
BA_ "GenSigTimeoutTime_TRSKM" SG_ 734 Frame_Index_Lanes_2 0;
BA_ "GenSigTimeoutTime_BCM" SG_ 734 MAC_ADAS_FD_LANES_2 0;
BA_ "GenSigTimeoutTime_BSM2" SG_ 734 MAC_ADAS_FD_LANES_2 0;
BA_ "GenSigTimeoutTime_CVADAS" SG_ 734 MAC_ADAS_FD_LANES_2 0;
BA_ "GenSigTimeoutTime_EPS" SG_ 734 MAC_ADAS_FD_LANES_2 0;
BA_ "GenSigTimeoutTime_ORC" SG_ 734 MAC_ADAS_FD_LANES_2 0;
BA_ "GenSigTimeoutTime_PAM" SG_ 734 MAC_ADAS_FD_LANES_2 0;
BA_ "GenSigTimeoutTime_SGW" SG_ 734 MAC_ADAS_FD_LANES_2 0;
BA_ "GenSigTimeoutTime_TRSKM" SG_ 734 MAC_ADAS_FD_LANES_2 0;
BA_ "GenSigTimeoutTime_BCM" SG_ 734 MessageCounter_ADAS_FD_LANES_2 0;
BA_ "GenSigTimeoutTime_BSM2" SG_ 734 MessageCounter_ADAS_FD_LANES_2 0;
BA_ "GenSigTimeoutTime_CVADAS" SG_ 734 MessageCounter_ADAS_FD_LANES_2 0;
BA_ "GenSigTimeoutTime_EPS" SG_ 734 MessageCounter_ADAS_FD_LANES_2 0;
BA_ "GenSigTimeoutTime_ORC" SG_ 734 MessageCounter_ADAS_FD_LANES_2 0;
BA_ "GenSigTimeoutTime_PAM" SG_ 734 MessageCounter_ADAS_FD_LANES_2 0;
BA_ "GenSigTimeoutTime_SGW" SG_ 734 MessageCounter_ADAS_FD_LANES_2 0;
BA_ "GenSigTimeoutTime_TRSKM" SG_ 734 MessageCounter_ADAS_FD_LANES_2 0;
BA_ "GenSigTimeoutTime_BCM" SG_ 734 Reserved_for_functional_safety 0;
BA_ "GenSigTimeoutTime_BSM2" SG_ 734 Reserved_for_functional_safety 0;
BA_ "GenSigTimeoutTime_CVADAS" SG_ 734 Reserved_for_functional_safety 0;
BA_ "GenSigTimeoutTime_EPS" SG_ 734 Reserved_for_functional_safety 0;
BA_ "GenSigTimeoutTime_ORC" SG_ 734 Reserved_for_functional_safety 0;
BA_ "GenSigTimeoutTime_PAM" SG_ 734 Reserved_for_functional_safety 0;
BA_ "GenSigTimeoutTime_SGW" SG_ 734 Reserved_for_functional_safety 0;
BA_ "GenSigTimeoutTime_TRSKM" SG_ 734 Reserved_for_functional_safety 0;
BA_ "GenSigTimeoutTime_BCM" SG_ 734 Segment_1_Confidence 0;
BA_ "GenSigTimeoutTime_BSM2" SG_ 734 Segment_1_Confidence 0;
BA_ "GenSigTimeoutTime_CVADAS" SG_ 734 Segment_1_Confidence 0;
BA_ "GenSigTimeoutTime_EPS" SG_ 734 Segment_1_Confidence 0;
BA_ "GenSigTimeoutTime_ORC" SG_ 734 Segment_1_Confidence 0;
BA_ "GenSigTimeoutTime_PAM" SG_ 734 Segment_1_Confidence 0;
BA_ "GenSigTimeoutTime_SGW" SG_ 734 Segment_1_Confidence 0;
BA_ "GenSigTimeoutTime_TRSKM" SG_ 734 Segment_1_Confidence 0;
BA_ "GenSigTimeoutTime_BCM" SG_ 734 Segment_1_ID 0;
BA_ "GenSigTimeoutTime_BSM2" SG_ 734 Segment_1_ID 0;
BA_ "GenSigTimeoutTime_CVADAS" SG_ 734 Segment_1_ID 0;
BA_ "GenSigTimeoutTime_EPS" SG_ 734 Segment_1_ID 0;
BA_ "GenSigTimeoutTime_ORC" SG_ 734 Segment_1_ID 0;
BA_ "GenSigTimeoutTime_PAM" SG_ 734 Segment_1_ID 0;
BA_ "GenSigTimeoutTime_SGW" SG_ 734 Segment_1_ID 0;
BA_ "GenSigTimeoutTime_TRSKM" SG_ 734 Segment_1_ID 0;
BA_ "GenSigTimeoutTime_BCM" SG_ 734 Segment_1_X1 0;
BA_ "GenSigTimeoutTime_BSM2" SG_ 734 Segment_1_X1 0;
BA_ "GenSigTimeoutTime_CVADAS" SG_ 734 Segment_1_X1 0;
BA_ "GenSigTimeoutTime_EPS" SG_ 734 Segment_1_X1 0;
BA_ "GenSigTimeoutTime_ORC" SG_ 734 Segment_1_X1 0;
BA_ "GenSigTimeoutTime_PAM" SG_ 734 Segment_1_X1 0;
BA_ "GenSigTimeoutTime_SGW" SG_ 734 Segment_1_X1 0;
BA_ "GenSigTimeoutTime_TRSKM" SG_ 734 Segment_1_X1 0;
BA_ "GenSigTimeoutTime_BCM" SG_ 734 Segment_1_X2 0;
BA_ "GenSigTimeoutTime_BSM2" SG_ 734 Segment_1_X2 0;
BA_ "GenSigTimeoutTime_CVADAS" SG_ 734 Segment_1_X2 0;
BA_ "GenSigTimeoutTime_EPS" SG_ 734 Segment_1_X2 0;
BA_ "GenSigTimeoutTime_ORC" SG_ 734 Segment_1_X2 0;
BA_ "GenSigTimeoutTime_PAM" SG_ 734 Segment_1_X2 0;
BA_ "GenSigTimeoutTime_SGW" SG_ 734 Segment_1_X2 0;
BA_ "GenSigTimeoutTime_TRSKM" SG_ 734 Segment_1_X2 0;
BA_ "GenSigTimeoutTime_BCM" SG_ 734 Segment_1_Y1 0;
BA_ "GenSigTimeoutTime_BSM2" SG_ 734 Segment_1_Y1 0;
BA_ "GenSigTimeoutTime_CVADAS" SG_ 734 Segment_1_Y1 0;
BA_ "GenSigTimeoutTime_EPS" SG_ 734 Segment_1_Y1 0;
BA_ "GenSigTimeoutTime_ORC" SG_ 734 Segment_1_Y1 0;
BA_ "GenSigTimeoutTime_PAM" SG_ 734 Segment_1_Y1 0;
BA_ "GenSigTimeoutTime_SGW" SG_ 734 Segment_1_Y1 0;
BA_ "GenSigTimeoutTime_TRSKM" SG_ 734 Segment_1_Y1 0;
BA_ "GenSigTimeoutTime_BCM" SG_ 734 Segment_1_Y2 0;
BA_ "GenSigTimeoutTime_BSM2" SG_ 734 Segment_1_Y2 0;
BA_ "GenSigTimeoutTime_CVADAS" SG_ 734 Segment_1_Y2 0;
BA_ "GenSigTimeoutTime_EPS" SG_ 734 Segment_1_Y2 0;
BA_ "GenSigTimeoutTime_ORC" SG_ 734 Segment_1_Y2 0;
BA_ "GenSigTimeoutTime_PAM" SG_ 734 Segment_1_Y2 0;
BA_ "GenSigTimeoutTime_SGW" SG_ 734 Segment_1_Y2 0;
BA_ "GenSigTimeoutTime_TRSKM" SG_ 734 Segment_1_Y2 0;
BA_ "GenSigTimeoutTime_BCM" SG_ 734 Segment_2_Confidence 0;
BA_ "GenSigTimeoutTime_BSM2" SG_ 734 Segment_2_Confidence 0;
BA_ "GenSigTimeoutTime_CVADAS" SG_ 734 Segment_2_Confidence 0;
BA_ "GenSigTimeoutTime_EPS" SG_ 734 Segment_2_Confidence 0;
BA_ "GenSigTimeoutTime_ORC" SG_ 734 Segment_2_Confidence 0;
BA_ "GenSigTimeoutTime_PAM" SG_ 734 Segment_2_Confidence 0;
BA_ "GenSigTimeoutTime_SGW" SG_ 734 Segment_2_Confidence 0;
BA_ "GenSigTimeoutTime_TRSKM" SG_ 734 Segment_2_Confidence 0;
BA_ "GenSigTimeoutTime_BCM" SG_ 734 Segment_2_ID 0;
BA_ "GenSigTimeoutTime_BSM2" SG_ 734 Segment_2_ID 0;
BA_ "GenSigTimeoutTime_CVADAS" SG_ 734 Segment_2_ID 0;
BA_ "GenSigTimeoutTime_EPS" SG_ 734 Segment_2_ID 0;
BA_ "GenSigTimeoutTime_ORC" SG_ 734 Segment_2_ID 0;
BA_ "GenSigTimeoutTime_PAM" SG_ 734 Segment_2_ID 0;
BA_ "GenSigTimeoutTime_SGW" SG_ 734 Segment_2_ID 0;
BA_ "GenSigTimeoutTime_TRSKM" SG_ 734 Segment_2_ID 0;
BA_ "GenSigTimeoutTime_BCM" SG_ 734 Segment_2_X1 0;
BA_ "GenSigTimeoutTime_BSM2" SG_ 734 Segment_2_X1 0;
BA_ "GenSigTimeoutTime_CVADAS" SG_ 734 Segment_2_X1 0;
BA_ "GenSigTimeoutTime_EPS" SG_ 734 Segment_2_X1 0;
BA_ "GenSigTimeoutTime_ORC" SG_ 734 Segment_2_X1 0;
BA_ "GenSigTimeoutTime_PAM" SG_ 734 Segment_2_X1 0;
BA_ "GenSigTimeoutTime_SGW" SG_ 734 Segment_2_X1 0;
BA_ "GenSigTimeoutTime_TRSKM" SG_ 734 Segment_2_X1 0;
BA_ "GenSigTimeoutTime_BCM" SG_ 734 Segment_2_X2 0;
BA_ "GenSigTimeoutTime_BSM2" SG_ 734 Segment_2_X2 0;
BA_ "GenSigTimeoutTime_CVADAS" SG_ 734 Segment_2_X2 0;
BA_ "GenSigTimeoutTime_EPS" SG_ 734 Segment_2_X2 0;
BA_ "GenSigTimeoutTime_ORC" SG_ 734 Segment_2_X2 0;
BA_ "GenSigTimeoutTime_PAM" SG_ 734 Segment_2_X2 0;
BA_ "GenSigTimeoutTime_SGW" SG_ 734 Segment_2_X2 0;
BA_ "GenSigTimeoutTime_TRSKM" SG_ 734 Segment_2_X2 0;
BA_ "GenSigTimeoutTime_BCM" SG_ 734 Segment_2_Y1 0;
BA_ "GenSigTimeoutTime_BSM2" SG_ 734 Segment_2_Y1 0;
BA_ "GenSigTimeoutTime_CVADAS" SG_ 734 Segment_2_Y1 0;
BA_ "GenSigTimeoutTime_EPS" SG_ 734 Segment_2_Y1 0;
BA_ "GenSigTimeoutTime_ORC" SG_ 734 Segment_2_Y1 0;
BA_ "GenSigTimeoutTime_PAM" SG_ 734 Segment_2_Y1 0;
BA_ "GenSigTimeoutTime_SGW" SG_ 734 Segment_2_Y1 0;
BA_ "GenSigTimeoutTime_TRSKM" SG_ 734 Segment_2_Y1 0;
BA_ "GenSigTimeoutTime_BCM" SG_ 734 Segment_2_Y2 0;
BA_ "GenSigTimeoutTime_BSM2" SG_ 734 Segment_2_Y2 0;
BA_ "GenSigTimeoutTime_CVADAS" SG_ 734 Segment_2_Y2 0;
BA_ "GenSigTimeoutTime_EPS" SG_ 734 Segment_2_Y2 0;
BA_ "GenSigTimeoutTime_ORC" SG_ 734 Segment_2_Y2 0;
BA_ "GenSigTimeoutTime_PAM" SG_ 734 Segment_2_Y2 0;
BA_ "GenSigTimeoutTime_SGW" SG_ 734 Segment_2_Y2 0;
BA_ "GenSigTimeoutTime_TRSKM" SG_ 734 Segment_2_Y2 0;
BA_ "GenSigTimeoutTime_BCM" SG_ 734 Segment_3_Confidence 0;
BA_ "GenSigTimeoutTime_BSM2" SG_ 734 Segment_3_Confidence 0;
BA_ "GenSigTimeoutTime_CVADAS" SG_ 734 Segment_3_Confidence 0;
BA_ "GenSigTimeoutTime_EPS" SG_ 734 Segment_3_Confidence 0;
BA_ "GenSigTimeoutTime_ORC" SG_ 734 Segment_3_Confidence 0;
BA_ "GenSigTimeoutTime_PAM" SG_ 734 Segment_3_Confidence 0;
BA_ "GenSigTimeoutTime_SGW" SG_ 734 Segment_3_Confidence 0;
BA_ "GenSigTimeoutTime_TRSKM" SG_ 734 Segment_3_Confidence 0;
BA_ "GenSigTimeoutTime_BCM" SG_ 734 Segment_3_ID 0;
BA_ "GenSigTimeoutTime_BSM2" SG_ 734 Segment_3_ID 0;
BA_ "GenSigTimeoutTime_CVADAS" SG_ 734 Segment_3_ID 0;
BA_ "GenSigTimeoutTime_EPS" SG_ 734 Segment_3_ID 0;
BA_ "GenSigTimeoutTime_ORC" SG_ 734 Segment_3_ID 0;
BA_ "GenSigTimeoutTime_PAM" SG_ 734 Segment_3_ID 0;
BA_ "GenSigTimeoutTime_SGW" SG_ 734 Segment_3_ID 0;
BA_ "GenSigTimeoutTime_TRSKM" SG_ 734 Segment_3_ID 0;
BA_ "GenSigTimeoutTime_BCM" SG_ 734 Segment_3_X1 0;
BA_ "GenSigTimeoutTime_BSM2" SG_ 734 Segment_3_X1 0;
BA_ "GenSigTimeoutTime_CVADAS" SG_ 734 Segment_3_X1 0;
BA_ "GenSigTimeoutTime_EPS" SG_ 734 Segment_3_X1 0;
BA_ "GenSigTimeoutTime_ORC" SG_ 734 Segment_3_X1 0;
BA_ "GenSigTimeoutTime_PAM" SG_ 734 Segment_3_X1 0;
BA_ "GenSigTimeoutTime_SGW" SG_ 734 Segment_3_X1 0;
BA_ "GenSigTimeoutTime_TRSKM" SG_ 734 Segment_3_X1 0;
BA_ "GenSigTimeoutTime_BCM" SG_ 734 Segment_3_X2 0;
BA_ "GenSigTimeoutTime_BSM2" SG_ 734 Segment_3_X2 0;
BA_ "GenSigTimeoutTime_CVADAS" SG_ 734 Segment_3_X2 0;
BA_ "GenSigTimeoutTime_EPS" SG_ 734 Segment_3_X2 0;
BA_ "GenSigTimeoutTime_ORC" SG_ 734 Segment_3_X2 0;
BA_ "GenSigTimeoutTime_PAM" SG_ 734 Segment_3_X2 0;
BA_ "GenSigTimeoutTime_SGW" SG_ 734 Segment_3_X2 0;
BA_ "GenSigTimeoutTime_TRSKM" SG_ 734 Segment_3_X2 0;
BA_ "GenSigTimeoutTime_BCM" SG_ 734 Segment_3_Y1 0;
BA_ "GenSigTimeoutTime_BSM2" SG_ 734 Segment_3_Y1 0;
BA_ "GenSigTimeoutTime_CVADAS" SG_ 734 Segment_3_Y1 0;
BA_ "GenSigTimeoutTime_EPS" SG_ 734 Segment_3_Y1 0;
BA_ "GenSigTimeoutTime_ORC" SG_ 734 Segment_3_Y1 0;
BA_ "GenSigTimeoutTime_PAM" SG_ 734 Segment_3_Y1 0;
BA_ "GenSigTimeoutTime_SGW" SG_ 734 Segment_3_Y1 0;
BA_ "GenSigTimeoutTime_TRSKM" SG_ 734 Segment_3_Y1 0;
BA_ "GenSigTimeoutTime_BCM" SG_ 734 Segment_3_Y2 0;
BA_ "GenSigTimeoutTime_BSM2" SG_ 734 Segment_3_Y2 0;
BA_ "GenSigTimeoutTime_CVADAS" SG_ 734 Segment_3_Y2 0;
BA_ "GenSigTimeoutTime_EPS" SG_ 734 Segment_3_Y2 0;
BA_ "GenSigTimeoutTime_ORC" SG_ 734 Segment_3_Y2 0;
BA_ "GenSigTimeoutTime_PAM" SG_ 734 Segment_3_Y2 0;
BA_ "GenSigTimeoutTime_SGW" SG_ 734 Segment_3_Y2 0;
BA_ "GenSigTimeoutTime_TRSKM" SG_ 734 Segment_3_Y2 0;
BA_ "GenSigTimeoutTime_BCM" SG_ 734 Segment_4_Confidence 0;
BA_ "GenSigTimeoutTime_BSM2" SG_ 734 Segment_4_Confidence 0;
BA_ "GenSigTimeoutTime_CVADAS" SG_ 734 Segment_4_Confidence 0;
BA_ "GenSigTimeoutTime_EPS" SG_ 734 Segment_4_Confidence 0;
BA_ "GenSigTimeoutTime_ORC" SG_ 734 Segment_4_Confidence 0;
BA_ "GenSigTimeoutTime_PAM" SG_ 734 Segment_4_Confidence 0;
BA_ "GenSigTimeoutTime_SGW" SG_ 734 Segment_4_Confidence 0;
BA_ "GenSigTimeoutTime_TRSKM" SG_ 734 Segment_4_Confidence 0;
BA_ "GenSigTimeoutTime_BCM" SG_ 734 Segment_4_ID 0;
BA_ "GenSigTimeoutTime_BSM2" SG_ 734 Segment_4_ID 0;
BA_ "GenSigTimeoutTime_CVADAS" SG_ 734 Segment_4_ID 0;
BA_ "GenSigTimeoutTime_EPS" SG_ 734 Segment_4_ID 0;
BA_ "GenSigTimeoutTime_ORC" SG_ 734 Segment_4_ID 0;
BA_ "GenSigTimeoutTime_PAM" SG_ 734 Segment_4_ID 0;
BA_ "GenSigTimeoutTime_SGW" SG_ 734 Segment_4_ID 0;
BA_ "GenSigTimeoutTime_TRSKM" SG_ 734 Segment_4_ID 0;
BA_ "GenSigTimeoutTime_BCM" SG_ 734 Segment_4_X1 0;
BA_ "GenSigTimeoutTime_BSM2" SG_ 734 Segment_4_X1 0;
BA_ "GenSigTimeoutTime_CVADAS" SG_ 734 Segment_4_X1 0;
BA_ "GenSigTimeoutTime_EPS" SG_ 734 Segment_4_X1 0;
BA_ "GenSigTimeoutTime_ORC" SG_ 734 Segment_4_X1 0;
BA_ "GenSigTimeoutTime_PAM" SG_ 734 Segment_4_X1 0;
BA_ "GenSigTimeoutTime_SGW" SG_ 734 Segment_4_X1 0;
BA_ "GenSigTimeoutTime_TRSKM" SG_ 734 Segment_4_X1 0;
BA_ "GenSigTimeoutTime_BCM" SG_ 734 Segment_4_X2 0;
BA_ "GenSigTimeoutTime_BSM2" SG_ 734 Segment_4_X2 0;
BA_ "GenSigTimeoutTime_CVADAS" SG_ 734 Segment_4_X2 0;
BA_ "GenSigTimeoutTime_EPS" SG_ 734 Segment_4_X2 0;
BA_ "GenSigTimeoutTime_ORC" SG_ 734 Segment_4_X2 0;
BA_ "GenSigTimeoutTime_PAM" SG_ 734 Segment_4_X2 0;
BA_ "GenSigTimeoutTime_SGW" SG_ 734 Segment_4_X2 0;
BA_ "GenSigTimeoutTime_TRSKM" SG_ 734 Segment_4_X2 0;
BA_ "GenSigTimeoutTime_BCM" SG_ 734 Segment_4_Y1 0;
BA_ "GenSigTimeoutTime_BSM2" SG_ 734 Segment_4_Y1 0;
BA_ "GenSigTimeoutTime_CVADAS" SG_ 734 Segment_4_Y1 0;
BA_ "GenSigTimeoutTime_EPS" SG_ 734 Segment_4_Y1 0;
BA_ "GenSigTimeoutTime_ORC" SG_ 734 Segment_4_Y1 0;
BA_ "GenSigTimeoutTime_PAM" SG_ 734 Segment_4_Y1 0;
BA_ "GenSigTimeoutTime_SGW" SG_ 734 Segment_4_Y1 0;
BA_ "GenSigTimeoutTime_TRSKM" SG_ 734 Segment_4_Y1 0;
BA_ "GenSigTimeoutTime_BCM" SG_ 734 Segment_4_Y2 0;
BA_ "GenSigTimeoutTime_BSM2" SG_ 734 Segment_4_Y2 0;
BA_ "GenSigTimeoutTime_CVADAS" SG_ 734 Segment_4_Y2 0;
BA_ "GenSigTimeoutTime_EPS" SG_ 734 Segment_4_Y2 0;
BA_ "GenSigTimeoutTime_ORC" SG_ 734 Segment_4_Y2 0;
BA_ "GenSigTimeoutTime_PAM" SG_ 734 Segment_4_Y2 0;
BA_ "GenSigTimeoutTime_SGW" SG_ 734 Segment_4_Y2 0;
BA_ "GenSigTimeoutTime_TRSKM" SG_ 734 Segment_4_Y2 0;
BA_ "GenSigTimeoutTime_BCM" SG_ 734 Segment_5_Confidence 0;
BA_ "GenSigTimeoutTime_BSM2" SG_ 734 Segment_5_Confidence 0;
BA_ "GenSigTimeoutTime_CVADAS" SG_ 734 Segment_5_Confidence 0;
BA_ "GenSigTimeoutTime_EPS" SG_ 734 Segment_5_Confidence 0;
BA_ "GenSigTimeoutTime_ORC" SG_ 734 Segment_5_Confidence 0;
BA_ "GenSigTimeoutTime_PAM" SG_ 734 Segment_5_Confidence 0;
BA_ "GenSigTimeoutTime_SGW" SG_ 734 Segment_5_Confidence 0;
BA_ "GenSigTimeoutTime_TRSKM" SG_ 734 Segment_5_Confidence 0;
BA_ "GenSigTimeoutTime_BCM" SG_ 734 Segment_5_ID 0;
BA_ "GenSigTimeoutTime_BSM2" SG_ 734 Segment_5_ID 0;
BA_ "GenSigTimeoutTime_CVADAS" SG_ 734 Segment_5_ID 0;
BA_ "GenSigTimeoutTime_EPS" SG_ 734 Segment_5_ID 0;
BA_ "GenSigTimeoutTime_ORC" SG_ 734 Segment_5_ID 0;
BA_ "GenSigTimeoutTime_PAM" SG_ 734 Segment_5_ID 0;
BA_ "GenSigTimeoutTime_SGW" SG_ 734 Segment_5_ID 0;
BA_ "GenSigTimeoutTime_TRSKM" SG_ 734 Segment_5_ID 0;
BA_ "GenSigTimeoutTime_BCM" SG_ 734 Segment_5_X1 0;
BA_ "GenSigTimeoutTime_BSM2" SG_ 734 Segment_5_X1 0;
BA_ "GenSigTimeoutTime_CVADAS" SG_ 734 Segment_5_X1 0;
BA_ "GenSigTimeoutTime_EPS" SG_ 734 Segment_5_X1 0;
BA_ "GenSigTimeoutTime_ORC" SG_ 734 Segment_5_X1 0;
BA_ "GenSigTimeoutTime_PAM" SG_ 734 Segment_5_X1 0;
BA_ "GenSigTimeoutTime_SGW" SG_ 734 Segment_5_X1 0;
BA_ "GenSigTimeoutTime_TRSKM" SG_ 734 Segment_5_X1 0;
BA_ "GenSigTimeoutTime_BCM" SG_ 734 Segment_5_X2 0;
BA_ "GenSigTimeoutTime_BSM2" SG_ 734 Segment_5_X2 0;
BA_ "GenSigTimeoutTime_CVADAS" SG_ 734 Segment_5_X2 0;
BA_ "GenSigTimeoutTime_EPS" SG_ 734 Segment_5_X2 0;
BA_ "GenSigTimeoutTime_ORC" SG_ 734 Segment_5_X2 0;
BA_ "GenSigTimeoutTime_PAM" SG_ 734 Segment_5_X2 0;
BA_ "GenSigTimeoutTime_SGW" SG_ 734 Segment_5_X2 0;
BA_ "GenSigTimeoutTime_TRSKM" SG_ 734 Segment_5_X2 0;
BA_ "GenSigTimeoutTime_BCM" SG_ 734 Segment_5_Y1 0;
BA_ "GenSigTimeoutTime_BSM2" SG_ 734 Segment_5_Y1 0;
BA_ "GenSigTimeoutTime_CVADAS" SG_ 734 Segment_5_Y1 0;
BA_ "GenSigTimeoutTime_EPS" SG_ 734 Segment_5_Y1 0;
BA_ "GenSigTimeoutTime_ORC" SG_ 734 Segment_5_Y1 0;
BA_ "GenSigTimeoutTime_PAM" SG_ 734 Segment_5_Y1 0;
BA_ "GenSigTimeoutTime_SGW" SG_ 734 Segment_5_Y1 0;
BA_ "GenSigTimeoutTime_TRSKM" SG_ 734 Segment_5_Y1 0;
BA_ "GenSigTimeoutTime_BCM" SG_ 734 Segment_5_Y2 0;
BA_ "GenSigTimeoutTime_BSM2" SG_ 734 Segment_5_Y2 0;
BA_ "GenSigTimeoutTime_CVADAS" SG_ 734 Segment_5_Y2 0;
BA_ "GenSigTimeoutTime_EPS" SG_ 734 Segment_5_Y2 0;
BA_ "GenSigTimeoutTime_ORC" SG_ 734 Segment_5_Y2 0;
BA_ "GenSigTimeoutTime_PAM" SG_ 734 Segment_5_Y2 0;
BA_ "GenSigTimeoutTime_SGW" SG_ 734 Segment_5_Y2 0;
BA_ "GenSigTimeoutTime_TRSKM" SG_ 734 Segment_5_Y2 0;
BA_ "GenSigTimeoutTime_BCM" SG_ 734 Segment_6_Confidence 0;
BA_ "GenSigTimeoutTime_BSM2" SG_ 734 Segment_6_Confidence 0;
BA_ "GenSigTimeoutTime_CVADAS" SG_ 734 Segment_6_Confidence 0;
BA_ "GenSigTimeoutTime_EPS" SG_ 734 Segment_6_Confidence 0;
BA_ "GenSigTimeoutTime_ORC" SG_ 734 Segment_6_Confidence 0;
BA_ "GenSigTimeoutTime_PAM" SG_ 734 Segment_6_Confidence 0;
BA_ "GenSigTimeoutTime_SGW" SG_ 734 Segment_6_Confidence 0;
BA_ "GenSigTimeoutTime_TRSKM" SG_ 734 Segment_6_Confidence 0;
BA_ "GenSigTimeoutTime_BCM" SG_ 734 Segment_6_ID 0;
BA_ "GenSigTimeoutTime_BSM2" SG_ 734 Segment_6_ID 0;
BA_ "GenSigTimeoutTime_CVADAS" SG_ 734 Segment_6_ID 0;
BA_ "GenSigTimeoutTime_EPS" SG_ 734 Segment_6_ID 0;
BA_ "GenSigTimeoutTime_ORC" SG_ 734 Segment_6_ID 0;
BA_ "GenSigTimeoutTime_PAM" SG_ 734 Segment_6_ID 0;
BA_ "GenSigTimeoutTime_SGW" SG_ 734 Segment_6_ID 0;
BA_ "GenSigTimeoutTime_TRSKM" SG_ 734 Segment_6_ID 0;
BA_ "GenSigTimeoutTime_BCM" SG_ 734 Segment_6_X1 0;
BA_ "GenSigTimeoutTime_BSM2" SG_ 734 Segment_6_X1 0;
BA_ "GenSigTimeoutTime_CVADAS" SG_ 734 Segment_6_X1 0;
BA_ "GenSigTimeoutTime_EPS" SG_ 734 Segment_6_X1 0;
BA_ "GenSigTimeoutTime_ORC" SG_ 734 Segment_6_X1 0;
BA_ "GenSigTimeoutTime_PAM" SG_ 734 Segment_6_X1 0;
BA_ "GenSigTimeoutTime_SGW" SG_ 734 Segment_6_X1 0;
BA_ "GenSigTimeoutTime_TRSKM" SG_ 734 Segment_6_X1 0;
BA_ "GenSigTimeoutTime_BCM" SG_ 734 Segment_6_X2 0;
BA_ "GenSigTimeoutTime_BSM2" SG_ 734 Segment_6_X2 0;
BA_ "GenSigTimeoutTime_CVADAS" SG_ 734 Segment_6_X2 0;
BA_ "GenSigTimeoutTime_EPS" SG_ 734 Segment_6_X2 0;
BA_ "GenSigTimeoutTime_ORC" SG_ 734 Segment_6_X2 0;
BA_ "GenSigTimeoutTime_PAM" SG_ 734 Segment_6_X2 0;
BA_ "GenSigTimeoutTime_SGW" SG_ 734 Segment_6_X2 0;
BA_ "GenSigTimeoutTime_TRSKM" SG_ 734 Segment_6_X2 0;
BA_ "GenSigTimeoutTime_BCM" SG_ 734 Segment_6_Y1 0;
BA_ "GenSigTimeoutTime_BSM2" SG_ 734 Segment_6_Y1 0;
BA_ "GenSigTimeoutTime_CVADAS" SG_ 734 Segment_6_Y1 0;
BA_ "GenSigTimeoutTime_EPS" SG_ 734 Segment_6_Y1 0;
BA_ "GenSigTimeoutTime_ORC" SG_ 734 Segment_6_Y1 0;
BA_ "GenSigTimeoutTime_PAM" SG_ 734 Segment_6_Y1 0;
BA_ "GenSigTimeoutTime_SGW" SG_ 734 Segment_6_Y1 0;
BA_ "GenSigTimeoutTime_TRSKM" SG_ 734 Segment_6_Y1 0;
BA_ "GenSigTimeoutTime_BCM" SG_ 734 Segment_6_Y2 0;
BA_ "GenSigTimeoutTime_BSM2" SG_ 734 Segment_6_Y2 0;
BA_ "GenSigTimeoutTime_CVADAS" SG_ 734 Segment_6_Y2 0;
BA_ "GenSigTimeoutTime_EPS" SG_ 734 Segment_6_Y2 0;
BA_ "GenSigTimeoutTime_ORC" SG_ 734 Segment_6_Y2 0;
BA_ "GenSigTimeoutTime_PAM" SG_ 734 Segment_6_Y2 0;
BA_ "GenSigTimeoutTime_SGW" SG_ 734 Segment_6_Y2 0;
BA_ "GenSigTimeoutTime_TRSKM" SG_ 734 Segment_6_Y2 0;
BA_ "GenSigTimeoutTime_BCM" SG_ 734 Segment_7_Confidence 0;
BA_ "GenSigTimeoutTime_BSM2" SG_ 734 Segment_7_Confidence 0;
BA_ "GenSigTimeoutTime_CVADAS" SG_ 734 Segment_7_Confidence 0;
BA_ "GenSigTimeoutTime_EPS" SG_ 734 Segment_7_Confidence 0;
BA_ "GenSigTimeoutTime_ORC" SG_ 734 Segment_7_Confidence 0;
BA_ "GenSigTimeoutTime_PAM" SG_ 734 Segment_7_Confidence 0;
BA_ "GenSigTimeoutTime_SGW" SG_ 734 Segment_7_Confidence 0;
BA_ "GenSigTimeoutTime_TRSKM" SG_ 734 Segment_7_Confidence 0;
BA_ "GenSigTimeoutTime_BCM" SG_ 734 Segment_7_ID 0;
BA_ "GenSigTimeoutTime_BSM2" SG_ 734 Segment_7_ID 0;
BA_ "GenSigTimeoutTime_CVADAS" SG_ 734 Segment_7_ID 0;
BA_ "GenSigTimeoutTime_EPS" SG_ 734 Segment_7_ID 0;
BA_ "GenSigTimeoutTime_ORC" SG_ 734 Segment_7_ID 0;
BA_ "GenSigTimeoutTime_PAM" SG_ 734 Segment_7_ID 0;
BA_ "GenSigTimeoutTime_SGW" SG_ 734 Segment_7_ID 0;
BA_ "GenSigTimeoutTime_TRSKM" SG_ 734 Segment_7_ID 0;
BA_ "GenSigTimeoutTime_BCM" SG_ 734 Segment_7_X1 0;
BA_ "GenSigTimeoutTime_BSM2" SG_ 734 Segment_7_X1 0;
BA_ "GenSigTimeoutTime_CVADAS" SG_ 734 Segment_7_X1 0;
BA_ "GenSigTimeoutTime_EPS" SG_ 734 Segment_7_X1 0;
BA_ "GenSigTimeoutTime_ORC" SG_ 734 Segment_7_X1 0;
BA_ "GenSigTimeoutTime_PAM" SG_ 734 Segment_7_X1 0;
BA_ "GenSigTimeoutTime_SGW" SG_ 734 Segment_7_X1 0;
BA_ "GenSigTimeoutTime_TRSKM" SG_ 734 Segment_7_X1 0;
BA_ "GenSigTimeoutTime_BCM" SG_ 734 Segment_7_X2 0;
BA_ "GenSigTimeoutTime_BSM2" SG_ 734 Segment_7_X2 0;
BA_ "GenSigTimeoutTime_CVADAS" SG_ 734 Segment_7_X2 0;
BA_ "GenSigTimeoutTime_EPS" SG_ 734 Segment_7_X2 0;
BA_ "GenSigTimeoutTime_ORC" SG_ 734 Segment_7_X2 0;
BA_ "GenSigTimeoutTime_PAM" SG_ 734 Segment_7_X2 0;
BA_ "GenSigTimeoutTime_SGW" SG_ 734 Segment_7_X2 0;
BA_ "GenSigTimeoutTime_TRSKM" SG_ 734 Segment_7_X2 0;
BA_ "GenSigTimeoutTime_BCM" SG_ 734 Segment_7_Y1 0;
BA_ "GenSigTimeoutTime_BSM2" SG_ 734 Segment_7_Y1 0;
BA_ "GenSigTimeoutTime_CVADAS" SG_ 734 Segment_7_Y1 0;
BA_ "GenSigTimeoutTime_EPS" SG_ 734 Segment_7_Y1 0;
BA_ "GenSigTimeoutTime_ORC" SG_ 734 Segment_7_Y1 0;
BA_ "GenSigTimeoutTime_PAM" SG_ 734 Segment_7_Y1 0;
BA_ "GenSigTimeoutTime_SGW" SG_ 734 Segment_7_Y1 0;
BA_ "GenSigTimeoutTime_TRSKM" SG_ 734 Segment_7_Y1 0;
BA_ "GenSigTimeoutTime_BCM" SG_ 734 Segment_7_Y2 0;
BA_ "GenSigTimeoutTime_BSM2" SG_ 734 Segment_7_Y2 0;
BA_ "GenSigTimeoutTime_CVADAS" SG_ 734 Segment_7_Y2 0;
BA_ "GenSigTimeoutTime_EPS" SG_ 734 Segment_7_Y2 0;
BA_ "GenSigTimeoutTime_ORC" SG_ 734 Segment_7_Y2 0;
BA_ "GenSigTimeoutTime_PAM" SG_ 734 Segment_7_Y2 0;
BA_ "GenSigTimeoutTime_SGW" SG_ 734 Segment_7_Y2 0;
BA_ "GenSigTimeoutTime_TRSKM" SG_ 734 Segment_7_Y2 0;
BA_ "GenSigTimeoutTime_BCM" SG_ 734 Segment_8_Confidence 0;
BA_ "GenSigTimeoutTime_BSM2" SG_ 734 Segment_8_Confidence 0;
BA_ "GenSigTimeoutTime_CVADAS" SG_ 734 Segment_8_Confidence 0;
BA_ "GenSigTimeoutTime_EPS" SG_ 734 Segment_8_Confidence 0;
BA_ "GenSigTimeoutTime_ORC" SG_ 734 Segment_8_Confidence 0;
BA_ "GenSigTimeoutTime_PAM" SG_ 734 Segment_8_Confidence 0;
BA_ "GenSigTimeoutTime_SGW" SG_ 734 Segment_8_Confidence 0;
BA_ "GenSigTimeoutTime_TRSKM" SG_ 734 Segment_8_Confidence 0;
BA_ "GenSigTimeoutTime_BCM" SG_ 734 Segment_8_ID 0;
BA_ "GenSigTimeoutTime_BSM2" SG_ 734 Segment_8_ID 0;
BA_ "GenSigTimeoutTime_CVADAS" SG_ 734 Segment_8_ID 0;
BA_ "GenSigTimeoutTime_EPS" SG_ 734 Segment_8_ID 0;
BA_ "GenSigTimeoutTime_ORC" SG_ 734 Segment_8_ID 0;
BA_ "GenSigTimeoutTime_PAM" SG_ 734 Segment_8_ID 0;
BA_ "GenSigTimeoutTime_SGW" SG_ 734 Segment_8_ID 0;
BA_ "GenSigTimeoutTime_TRSKM" SG_ 734 Segment_8_ID 0;
BA_ "GenSigTimeoutTime_BCM" SG_ 734 Segment_8_X1 0;
BA_ "GenSigTimeoutTime_BSM2" SG_ 734 Segment_8_X1 0;
BA_ "GenSigTimeoutTime_CVADAS" SG_ 734 Segment_8_X1 0;
BA_ "GenSigTimeoutTime_EPS" SG_ 734 Segment_8_X1 0;
BA_ "GenSigTimeoutTime_ORC" SG_ 734 Segment_8_X1 0;
BA_ "GenSigTimeoutTime_PAM" SG_ 734 Segment_8_X1 0;
BA_ "GenSigTimeoutTime_SGW" SG_ 734 Segment_8_X1 0;
BA_ "GenSigTimeoutTime_TRSKM" SG_ 734 Segment_8_X1 0;
BA_ "GenSigTimeoutTime_BCM" SG_ 734 Segment_8_X2 0;
BA_ "GenSigTimeoutTime_BSM2" SG_ 734 Segment_8_X2 0;
BA_ "GenSigTimeoutTime_CVADAS" SG_ 734 Segment_8_X2 0;
BA_ "GenSigTimeoutTime_EPS" SG_ 734 Segment_8_X2 0;
BA_ "GenSigTimeoutTime_ORC" SG_ 734 Segment_8_X2 0;
BA_ "GenSigTimeoutTime_PAM" SG_ 734 Segment_8_X2 0;
BA_ "GenSigTimeoutTime_SGW" SG_ 734 Segment_8_X2 0;
BA_ "GenSigTimeoutTime_TRSKM" SG_ 734 Segment_8_X2 0;
BA_ "GenSigTimeoutTime_BCM" SG_ 734 Segment_8_Y1 0;
BA_ "GenSigTimeoutTime_BSM2" SG_ 734 Segment_8_Y1 0;
BA_ "GenSigTimeoutTime_CVADAS" SG_ 734 Segment_8_Y1 0;
BA_ "GenSigTimeoutTime_EPS" SG_ 734 Segment_8_Y1 0;
BA_ "GenSigTimeoutTime_ORC" SG_ 734 Segment_8_Y1 0;
BA_ "GenSigTimeoutTime_PAM" SG_ 734 Segment_8_Y1 0;
BA_ "GenSigTimeoutTime_SGW" SG_ 734 Segment_8_Y1 0;
BA_ "GenSigTimeoutTime_TRSKM" SG_ 734 Segment_8_Y1 0;
BA_ "GenSigTimeoutTime_BCM" SG_ 734 Segment_8_Y2 0;
BA_ "GenSigTimeoutTime_BSM2" SG_ 734 Segment_8_Y2 0;
BA_ "GenSigTimeoutTime_CVADAS" SG_ 734 Segment_8_Y2 0;
BA_ "GenSigTimeoutTime_EPS" SG_ 734 Segment_8_Y2 0;
BA_ "GenSigTimeoutTime_ORC" SG_ 734 Segment_8_Y2 0;
BA_ "GenSigTimeoutTime_PAM" SG_ 734 Segment_8_Y2 0;
BA_ "GenSigTimeoutTime_SGW" SG_ 734 Segment_8_Y2 0;
BA_ "GenSigTimeoutTime_TRSKM" SG_ 734 Segment_8_Y2 0;
BA_ "GenSigTimeoutTime_BCM" SG_ 476 CRC_AGSM2 0;
BA_ "GenSigTimeoutTime_BSM2" SG_ 476 CRC_AGSM2 0;
BA_ "GenSigTimeoutTime_CADM2" SG_ 476 CRC_AGSM2 0;
BA_ "GenSigTimeoutTime_EPS" SG_ 476 CRC_AGSM2 0;
BA_ "GenSigTimeoutTime_ORC" SG_ 476 CRC_AGSM2 0;
BA_ "GenSigTimeoutTime_PAM" SG_ 476 CRC_AGSM2 0;
BA_ "GenSigTimeoutTime_SGW" SG_ 476 CRC_AGSM2 0;
BA_ "GenSigTimeoutTime_TRSKM" SG_ 476 CRC_AGSM2 0;
BA_ "GenSigTimeoutTime_BCM" SG_ 476 MessageCounter_AGSM2 0;
BA_ "GenSigTimeoutTime_BSM2" SG_ 476 MessageCounter_AGSM2 0;
BA_ "GenSigTimeoutTime_CADM2" SG_ 476 MessageCounter_AGSM2 0;
BA_ "GenSigTimeoutTime_EPS" SG_ 476 MessageCounter_AGSM2 0;
BA_ "GenSigTimeoutTime_ORC" SG_ 476 MessageCounter_AGSM2 0;
BA_ "GenSigTimeoutTime_PAM" SG_ 476 MessageCounter_AGSM2 0;
BA_ "GenSigTimeoutTime_SGW" SG_ 476 MessageCounter_AGSM2 0;
BA_ "GenSigTimeoutTime_TRSKM" SG_ 476 MessageCounter_AGSM2 0;
BA_ "GenSigTimeoutTime_BCM" SG_ 476 Shifter_ADAS_Inhibit 0;
BA_ "GenSigTimeoutTime_BSM2" SG_ 476 Shifter_ADAS_Inhibit 0;
BA_ "GenSigTimeoutTime_CADM2" SG_ 476 Shifter_ADAS_Inhibit 0;
BA_ "GenSigTimeoutTime_EPS" SG_ 476 Shifter_ADAS_Inhibit 0;
BA_ "GenSigTimeoutTime_ORC" SG_ 476 Shifter_ADAS_Inhibit 0;
BA_ "GenSigTimeoutTime_PAM" SG_ 476 Shifter_ADAS_Inhibit 0;
BA_ "GenSigTimeoutTime_SGW" SG_ 476 Shifter_ADAS_Inhibit 0;
BA_ "GenSigTimeoutTime_TRSKM" SG_ 476 Shifter_ADAS_Inhibit 0;
BA_ "GenSigSendType" SG_ 476 ShiftLeverPositionReq 3;
BA_ "GenSigTimeoutTime_BCM" SG_ 476 ShiftLeverPositionReq 0;
BA_ "GenSigTimeoutTime_BSM2" SG_ 476 ShiftLeverPositionReq 0;
BA_ "GenSigTimeoutTime_CADM2" SG_ 476 ShiftLeverPositionReq 0;
BA_ "GenSigTimeoutTime_EPS" SG_ 476 ShiftLeverPositionReq 0;
BA_ "GenSigTimeoutTime_ORC" SG_ 476 ShiftLeverPositionReq 0;
BA_ "GenSigTimeoutTime_PAM" SG_ 476 ShiftLeverPositionReq 0;
BA_ "GenSigTimeoutTime_SGW" SG_ 476 ShiftLeverPositionReq 0;
BA_ "GenSigTimeoutTime_TRSKM" SG_ 476 ShiftLeverPositionReq 0;
BA_ "GenSigTimeoutTime_TRSKM" SG_ 1327 MessageCounter_ASCM1 0;
BA_ "GenSigTimeoutTime_SGW" SG_ 1327 MessageCounter_ASCM1 0;
BA_ "GenSigTimeoutTime_PAM" SG_ 1327 MessageCounter_ASCM1 0;
BA_ "GenSigTimeoutTime_ORC" SG_ 1327 MessageCounter_ASCM1 0;
BA_ "GenSigTimeoutTime_EPS" SG_ 1327 MessageCounter_ASCM1 0;
BA_ "GenSigTimeoutTime_CADM2" SG_ 1327 MessageCounter_ASCM1 0;
BA_ "GenSigTimeoutTime_BSM2" SG_ 1327 MessageCounter_ASCM1 0;
BA_ "GenSigTimeoutTime_BCM" SG_ 1327 MessageCounter_ASCM1 0;
BA_ "GenSigTimeoutTime_TRSKM" SG_ 1327 CRC_ASCM1 0;
BA_ "GenSigTimeoutTime_SGW" SG_ 1327 CRC_ASCM1 0;
BA_ "GenSigTimeoutTime_PAM" SG_ 1327 CRC_ASCM1 0;
BA_ "GenSigTimeoutTime_ORC" SG_ 1327 CRC_ASCM1 0;
BA_ "GenSigTimeoutTime_EPS" SG_ 1327 CRC_ASCM1 0;
BA_ "GenSigTimeoutTime_CADM2" SG_ 1327 CRC_ASCM1 0;
BA_ "GenSigTimeoutTime_BSM2" SG_ 1327 CRC_ASCM1 0;
BA_ "GenSigTimeoutTime_BCM" SG_ 1327 CRC_ASCM1 0;
BA_ "GenSigStartValue" SG_ 1327 FL_Lvl 254;
BA_ "GenSigTimeoutTime_BCM" SG_ 1327 FL_Lvl 0;
BA_ "GenSigTimeoutTime_BSM2" SG_ 1327 FL_Lvl 0;
BA_ "GenSigTimeoutTime_CADM2" SG_ 1327 FL_Lvl 0;
BA_ "GenSigTimeoutTime_EPS" SG_ 1327 FL_Lvl 0;
BA_ "GenSigTimeoutTime_ORC" SG_ 1327 FL_Lvl 0;
BA_ "GenSigTimeoutTime_PAM" SG_ 1327 FL_Lvl 0;
BA_ "GenSigTimeoutTime_SGW" SG_ 1327 FL_Lvl 0;
BA_ "GenSigTimeoutTime_TRSKM" SG_ 1327 FL_Lvl 0;
BA_ "GenSigTimeoutTime_BCM" SG_ 1327 FL_Lvl_Adj 0;
BA_ "GenSigTimeoutTime_BSM2" SG_ 1327 FL_Lvl_Adj 0;
BA_ "GenSigTimeoutTime_CADM2" SG_ 1327 FL_Lvl_Adj 0;
BA_ "GenSigTimeoutTime_EPS" SG_ 1327 FL_Lvl_Adj 0;
BA_ "GenSigTimeoutTime_ORC" SG_ 1327 FL_Lvl_Adj 0;
BA_ "GenSigTimeoutTime_PAM" SG_ 1327 FL_Lvl_Adj 0;
BA_ "GenSigTimeoutTime_SGW" SG_ 1327 FL_Lvl_Adj 0;
BA_ "GenSigTimeoutTime_TRSKM" SG_ 1327 FL_Lvl_Adj 0;
BA_ "GenSigStartValue" SG_ 1327 FR_Lvl 254;
BA_ "GenSigTimeoutTime_BCM" SG_ 1327 FR_Lvl 0;
BA_ "GenSigTimeoutTime_BSM2" SG_ 1327 FR_Lvl 0;
BA_ "GenSigTimeoutTime_CADM2" SG_ 1327 FR_Lvl 0;
BA_ "GenSigTimeoutTime_EPS" SG_ 1327 FR_Lvl 0;
BA_ "GenSigTimeoutTime_ORC" SG_ 1327 FR_Lvl 0;
BA_ "GenSigTimeoutTime_PAM" SG_ 1327 FR_Lvl 0;
BA_ "GenSigTimeoutTime_SGW" SG_ 1327 FR_Lvl 0;
BA_ "GenSigTimeoutTime_TRSKM" SG_ 1327 FR_Lvl 0;
BA_ "GenSigTimeoutTime_BCM" SG_ 1327 FR_Lvl_Adj 0;
BA_ "GenSigTimeoutTime_BSM2" SG_ 1327 FR_Lvl_Adj 0;
BA_ "GenSigTimeoutTime_CADM2" SG_ 1327 FR_Lvl_Adj 0;
BA_ "GenSigTimeoutTime_EPS" SG_ 1327 FR_Lvl_Adj 0;
BA_ "GenSigTimeoutTime_ORC" SG_ 1327 FR_Lvl_Adj 0;
BA_ "GenSigTimeoutTime_PAM" SG_ 1327 FR_Lvl_Adj 0;
BA_ "GenSigTimeoutTime_SGW" SG_ 1327 FR_Lvl_Adj 0;
BA_ "GenSigTimeoutTime_TRSKM" SG_ 1327 FR_Lvl_Adj 0;
BA_ "GenSigStartValue" SG_ 1327 RL_Lvl 254;
BA_ "GenSigTimeoutTime_BCM" SG_ 1327 RL_Lvl 0;
BA_ "GenSigTimeoutTime_BSM2" SG_ 1327 RL_Lvl 0;
BA_ "GenSigTimeoutTime_CADM2" SG_ 1327 RL_Lvl 0;
BA_ "GenSigTimeoutTime_EPS" SG_ 1327 RL_Lvl 0;
BA_ "GenSigTimeoutTime_ORC" SG_ 1327 RL_Lvl 0;
BA_ "GenSigTimeoutTime_PAM" SG_ 1327 RL_Lvl 0;
BA_ "GenSigTimeoutTime_SGW" SG_ 1327 RL_Lvl 0;
BA_ "GenSigTimeoutTime_TRSKM" SG_ 1327 RL_Lvl 0;
BA_ "GenSigTimeoutTime_BCM" SG_ 1327 RL_Lvl_Adj 0;
BA_ "GenSigTimeoutTime_BSM2" SG_ 1327 RL_Lvl_Adj 0;
BA_ "GenSigTimeoutTime_CADM2" SG_ 1327 RL_Lvl_Adj 0;
BA_ "GenSigTimeoutTime_EPS" SG_ 1327 RL_Lvl_Adj 0;
BA_ "GenSigTimeoutTime_ORC" SG_ 1327 RL_Lvl_Adj 0;
BA_ "GenSigTimeoutTime_PAM" SG_ 1327 RL_Lvl_Adj 0;
BA_ "GenSigTimeoutTime_SGW" SG_ 1327 RL_Lvl_Adj 0;
BA_ "GenSigTimeoutTime_TRSKM" SG_ 1327 RL_Lvl_Adj 0;
BA_ "GenSigStartValue" SG_ 1327 RR_Lvl 254;
BA_ "GenSigTimeoutTime_BCM" SG_ 1327 RR_Lvl 0;
BA_ "GenSigTimeoutTime_BSM2" SG_ 1327 RR_Lvl 0;
BA_ "GenSigTimeoutTime_CADM2" SG_ 1327 RR_Lvl 0;
BA_ "GenSigTimeoutTime_EPS" SG_ 1327 RR_Lvl 0;
BA_ "GenSigTimeoutTime_ORC" SG_ 1327 RR_Lvl 0;
BA_ "GenSigTimeoutTime_PAM" SG_ 1327 RR_Lvl 0;
BA_ "GenSigTimeoutTime_SGW" SG_ 1327 RR_Lvl 0;
BA_ "GenSigTimeoutTime_TRSKM" SG_ 1327 RR_Lvl 0;
BA_ "GenSigTimeoutTime_BCM" SG_ 1327 RR_Lvl_Adj 0;
BA_ "GenSigTimeoutTime_BSM2" SG_ 1327 RR_Lvl_Adj 0;
BA_ "GenSigTimeoutTime_CADM2" SG_ 1327 RR_Lvl_Adj 0;
BA_ "GenSigTimeoutTime_EPS" SG_ 1327 RR_Lvl_Adj 0;
BA_ "GenSigTimeoutTime_ORC" SG_ 1327 RR_Lvl_Adj 0;
BA_ "GenSigTimeoutTime_PAM" SG_ 1327 RR_Lvl_Adj 0;
BA_ "GenSigTimeoutTime_SGW" SG_ 1327 RR_Lvl_Adj 0;
BA_ "GenSigTimeoutTime_TRSKM" SG_ 1327 RR_Lvl_Adj 0;
BA_ "GenSigTimeoutTime_TRSKM" SG_ 1445 MessageCounter_ASCM2 0;
BA_ "GenSigTimeoutTime_SGW" SG_ 1445 MessageCounter_ASCM2 0;
BA_ "GenSigTimeoutTime_PAM" SG_ 1445 MessageCounter_ASCM2 0;
BA_ "GenSigTimeoutTime_ORC" SG_ 1445 MessageCounter_ASCM2 0;
BA_ "GenSigTimeoutTime_EPS" SG_ 1445 MessageCounter_ASCM2 0;
BA_ "GenSigTimeoutTime_CADM2" SG_ 1445 MessageCounter_ASCM2 0;
BA_ "GenSigTimeoutTime_BSM2" SG_ 1445 MessageCounter_ASCM2 0;
BA_ "GenSigTimeoutTime_BCM" SG_ 1445 MessageCounter_ASCM2 0;
BA_ "GenSigTimeoutTime_TRSKM" SG_ 1445 CRC_ASCM2 0;
BA_ "GenSigTimeoutTime_SGW" SG_ 1445 CRC_ASCM2 0;
BA_ "GenSigTimeoutTime_PAM" SG_ 1445 CRC_ASCM2 0;
BA_ "GenSigTimeoutTime_ORC" SG_ 1445 CRC_ASCM2 0;
BA_ "GenSigTimeoutTime_EPS" SG_ 1445 CRC_ASCM2 0;
BA_ "GenSigTimeoutTime_CADM2" SG_ 1445 CRC_ASCM2 0;
BA_ "GenSigTimeoutTime_BSM2" SG_ 1445 CRC_ASCM2 0;
BA_ "GenSigTimeoutTime_BCM" SG_ 1445 CRC_ASCM2 0;
BA_ "GenSigSendType" SG_ 1445 ADC_Stat_2 3;
BA_ "GenSigTimeoutTime_BCM" SG_ 1445 ADC_Stat_2 0;
BA_ "GenSigTimeoutTime_BSM2" SG_ 1445 ADC_Stat_2 0;
BA_ "GenSigTimeoutTime_CADM2" SG_ 1445 ADC_Stat_2 0;
BA_ "GenSigTimeoutTime_CVADAS" SG_ 1445 ADC_Stat_2 0;
BA_ "GenSigTimeoutTime_EPS" SG_ 1445 ADC_Stat_2 0;
BA_ "GenSigTimeoutTime_PAM" SG_ 1445 ADC_Stat_2 0;
BA_ "GenSigTimeoutTime_SGW" SG_ 1445 ADC_Stat_2 0;
BA_ "GenSigTimeoutTime_TRSKM" SG_ 1445 ADC_Stat_2 0;
BA_ "GenSigSendType" SG_ 1445 ASCM_Srv 3;
BA_ "GenSigTimeoutTime_BCM" SG_ 1445 ASCM_Srv 0;
BA_ "GenSigTimeoutTime_BSM2" SG_ 1445 ASCM_Srv 0;
BA_ "GenSigTimeoutTime_CADM2" SG_ 1445 ASCM_Srv 0;
BA_ "GenSigTimeoutTime_CVADAS" SG_ 1445 ASCM_Srv 0;
BA_ "GenSigTimeoutTime_EPS" SG_ 1445 ASCM_Srv 0;
BA_ "GenSigTimeoutTime_PAM" SG_ 1445 ASCM_Srv 0;
BA_ "GenSigTimeoutTime_SGW" SG_ 1445 ASCM_Srv 0;
BA_ "GenSigTimeoutTime_TRSKM" SG_ 1445 ASCM_Srv 0;
BA_ "GenSigSendType" SG_ 1445 ASCM_Stat 3;
BA_ "GenSigTimeoutTime_BCM" SG_ 1445 ASCM_Stat 0;
BA_ "GenSigTimeoutTime_BSM2" SG_ 1445 ASCM_Stat 0;
BA_ "GenSigTimeoutTime_CADM2" SG_ 1445 ASCM_Stat 0;
BA_ "GenSigTimeoutTime_EPS" SG_ 1445 ASCM_Stat 0;
BA_ "GenSigTimeoutTime_ORC" SG_ 1445 ASCM_Stat 0;
BA_ "GenSigTimeoutTime_PAM" SG_ 1445 ASCM_Stat 0;
BA_ "GenSigTimeoutTime_SGW" SG_ 1445 ASCM_Stat 0;
BA_ "GenSigTimeoutTime_TRSKM" SG_ 1445 ASCM_Stat 0;
BA_ "GenSigSendType" SG_ 1445 ASCM_StatDisp 3;
BA_ "GenSigTimeoutTime_BCM" SG_ 1445 ASCM_StatDisp 0;
BA_ "GenSigTimeoutTime_BSM2" SG_ 1445 ASCM_StatDisp 0;
BA_ "GenSigTimeoutTime_CADM2" SG_ 1445 ASCM_StatDisp 0;
BA_ "GenSigTimeoutTime_CVADAS" SG_ 1445 ASCM_StatDisp 0;
BA_ "GenSigTimeoutTime_EPS" SG_ 1445 ASCM_StatDisp 0;
BA_ "GenSigTimeoutTime_PAM" SG_ 1445 ASCM_StatDisp 0;
BA_ "GenSigTimeoutTime_SGW" SG_ 1445 ASCM_StatDisp 0;
BA_ "GenSigTimeoutTime_TRSKM" SG_ 1445 ASCM_StatDisp 0;
BA_ "GenSigSendType" SG_ 1445 ASCM_SysFail 3;
BA_ "GenSigTimeoutTime_BCM" SG_ 1445 ASCM_SysFail 0;
BA_ "GenSigTimeoutTime_BSM2" SG_ 1445 ASCM_SysFail 0;
BA_ "GenSigTimeoutTime_CADM2" SG_ 1445 ASCM_SysFail 0;
BA_ "GenSigTimeoutTime_EPS" SG_ 1445 ASCM_SysFail 0;
BA_ "GenSigTimeoutTime_PAM" SG_ 1445 ASCM_SysFail 0;
BA_ "GenSigTimeoutTime_SGW" SG_ 1445 ASCM_SysFail 0;
BA_ "GenSigTimeoutTime_TRSKM" SG_ 1445 ASCM_SysFail 0;
BA_ "GenSigStartValue" SG_ 204 Axle_Torque_DrvReqMod 32768;
BA_ "GenSigTimeoutTime_BCM" SG_ 204 Axle_Torque_DrvReqMod 0;
BA_ "GenSigTimeoutTime_BSM2" SG_ 204 Axle_Torque_DrvReqMod 0;
BA_ "GenSigTimeoutTime_CADM2" SG_ 204 Axle_Torque_DrvReqMod 0;
BA_ "GenSigTimeoutTime_CVADAS" SG_ 204 Axle_Torque_DrvReqMod 0;
BA_ "GenSigTimeoutTime_EPS" SG_ 204 Axle_Torque_DrvReqMod 0;
BA_ "GenSigTimeoutTime_PAM" SG_ 204 Axle_Torque_DrvReqMod 0;
BA_ "GenSigTimeoutTime_SGW" SG_ 204 Axle_Torque_DrvReqMod 0;
BA_ "GenSigTimeoutTime_TRSKM" SG_ 204 Axle_Torque_DrvReqMod 0;
BA_ "GenSigStartValue" SG_ 204 Axle_TorqueStatic_D_TTC 32767;
BA_ "GenSigTimeoutTime_BCM" SG_ 204 Axle_TorqueStatic_D_TTC 0;
BA_ "GenSigTimeoutTime_BSM2" SG_ 204 Axle_TorqueStatic_D_TTC 0;
BA_ "GenSigTimeoutTime_CADM2" SG_ 204 Axle_TorqueStatic_D_TTC 0;
BA_ "GenSigTimeoutTime_CVADAS" SG_ 204 Axle_TorqueStatic_D_TTC 0;
BA_ "GenSigTimeoutTime_EPS" SG_ 204 Axle_TorqueStatic_D_TTC 0;
BA_ "GenSigTimeoutTime_PAM" SG_ 204 Axle_TorqueStatic_D_TTC 0;
BA_ "GenSigTimeoutTime_SGW" SG_ 204 Axle_TorqueStatic_D_TTC 0;
BA_ "GenSigTimeoutTime_TRSKM" SG_ 204 Axle_TorqueStatic_D_TTC 0;
BA_ "GenSigSendType" SG_ 1153 BSS_LT_Blind_RQSts 3;
BA_ "GenSigTimeoutTime_BCM" SG_ 1153 BSS_LT_Blind_RQSts 0;
BA_ "GenSigTimeoutTime_BSM2" SG_ 1153 BSS_LT_Blind_RQSts 0;
BA_ "GenSigTimeoutTime_CADM2" SG_ 1153 BSS_LT_Blind_RQSts 0;
BA_ "GenSigTimeoutTime_CVADAS" SG_ 1153 BSS_LT_Blind_RQSts 0;
BA_ "GenSigTimeoutTime_EPS" SG_ 1153 BSS_LT_Blind_RQSts 0;
BA_ "GenSigTimeoutTime_PAM" SG_ 1153 BSS_LT_Blind_RQSts 0;
BA_ "GenSigTimeoutTime_SGW" SG_ 1153 BSS_LT_Blind_RQSts 0;
BA_ "GenSigTimeoutTime_TRSKM" SG_ 1153 BSS_LT_Blind_RQSts 0;
BA_ "GenSigSendType" SG_ 1153 BSS_LT_CFG_STATSts 3;
BA_ "GenSigTimeoutTime_BCM" SG_ 1153 BSS_LT_CFG_STATSts 0;
BA_ "GenSigTimeoutTime_BSM2" SG_ 1153 BSS_LT_CFG_STATSts 0;
BA_ "GenSigTimeoutTime_CADM2" SG_ 1153 BSS_LT_CFG_STATSts 0;
BA_ "GenSigTimeoutTime_CVADAS" SG_ 1153 BSS_LT_CFG_STATSts 0;
BA_ "GenSigTimeoutTime_EPS" SG_ 1153 BSS_LT_CFG_STATSts 0;
BA_ "GenSigTimeoutTime_PAM" SG_ 1153 BSS_LT_CFG_STATSts 0;
BA_ "GenSigTimeoutTime_SGW" SG_ 1153 BSS_LT_CFG_STATSts 0;
BA_ "GenSigTimeoutTime_TRSKM" SG_ 1153 BSS_LT_CFG_STATSts 0;
BA_ "GenSigSendType" SG_ 1153 BSS_LT_SRV_RQSts 3;
BA_ "GenSigTimeoutTime_BCM" SG_ 1153 BSS_LT_SRV_RQSts 0;
BA_ "GenSigTimeoutTime_BSM2" SG_ 1153 BSS_LT_SRV_RQSts 0;
BA_ "GenSigTimeoutTime_CADM2" SG_ 1153 BSS_LT_SRV_RQSts 0;
BA_ "GenSigTimeoutTime_CVADAS" SG_ 1153 BSS_LT_SRV_RQSts 0;
BA_ "GenSigTimeoutTime_EPS" SG_ 1153 BSS_LT_SRV_RQSts 0;
BA_ "GenSigTimeoutTime_PAM" SG_ 1153 BSS_LT_SRV_RQSts 0;
BA_ "GenSigTimeoutTime_SGW" SG_ 1153 BSS_LT_SRV_RQSts 0;
BA_ "GenSigTimeoutTime_TRSKM" SG_ 1153 BSS_LT_SRV_RQSts 0;
BA_ "GenSigSendType" SG_ 1153 BSS_RT_Blind_RQSts 3;
BA_ "GenSigTimeoutTime_BCM" SG_ 1153 BSS_RT_Blind_RQSts 0;
BA_ "GenSigTimeoutTime_BSM2" SG_ 1153 BSS_RT_Blind_RQSts 0;
BA_ "GenSigTimeoutTime_CADM2" SG_ 1153 BSS_RT_Blind_RQSts 0;
BA_ "GenSigTimeoutTime_CVADAS" SG_ 1153 BSS_RT_Blind_RQSts 0;
BA_ "GenSigTimeoutTime_EPS" SG_ 1153 BSS_RT_Blind_RQSts 0;
BA_ "GenSigTimeoutTime_PAM" SG_ 1153 BSS_RT_Blind_RQSts 0;
BA_ "GenSigTimeoutTime_SGW" SG_ 1153 BSS_RT_Blind_RQSts 0;
BA_ "GenSigTimeoutTime_TRSKM" SG_ 1153 BSS_RT_Blind_RQSts 0;
BA_ "GenSigSendType" SG_ 1153 BSS_RT_CFG_STATSts 3;
BA_ "GenSigTimeoutTime_BCM" SG_ 1153 BSS_RT_CFG_STATSts 0;
BA_ "GenSigTimeoutTime_BSM2" SG_ 1153 BSS_RT_CFG_STATSts 0;
BA_ "GenSigTimeoutTime_CADM2" SG_ 1153 BSS_RT_CFG_STATSts 0;
BA_ "GenSigTimeoutTime_CVADAS" SG_ 1153 BSS_RT_CFG_STATSts 0;
BA_ "GenSigTimeoutTime_EPS" SG_ 1153 BSS_RT_CFG_STATSts 0;
BA_ "GenSigTimeoutTime_PAM" SG_ 1153 BSS_RT_CFG_STATSts 0;
BA_ "GenSigTimeoutTime_SGW" SG_ 1153 BSS_RT_CFG_STATSts 0;
BA_ "GenSigTimeoutTime_TRSKM" SG_ 1153 BSS_RT_CFG_STATSts 0;
BA_ "GenSigSendType" SG_ 1153 BSS_RT_SRV_RQSts 3;
BA_ "GenSigTimeoutTime_BCM" SG_ 1153 BSS_RT_SRV_RQSts 0;
BA_ "GenSigTimeoutTime_BSM2" SG_ 1153 BSS_RT_SRV_RQSts 0;
BA_ "GenSigTimeoutTime_CADM2" SG_ 1153 BSS_RT_SRV_RQSts 0;
BA_ "GenSigTimeoutTime_CVADAS" SG_ 1153 BSS_RT_SRV_RQSts 0;
BA_ "GenSigTimeoutTime_EPS" SG_ 1153 BSS_RT_SRV_RQSts 0;
BA_ "GenSigTimeoutTime_PAM" SG_ 1153 BSS_RT_SRV_RQSts 0;
BA_ "GenSigTimeoutTime_SGW" SG_ 1153 BSS_RT_SRV_RQSts 0;
BA_ "GenSigTimeoutTime_TRSKM" SG_ 1153 BSS_RT_SRV_RQSts 0;
BA_ "GenSigSendType" SG_ 1153 CmdIgnSts 3;
BA_ "GenSigTimeoutTime_BCM" SG_ 1153 CRC_BCM10 0;
BA_ "GenSigTimeoutTime_ORC" SG_ 1153 CRC_BCM10 0;
BA_ "GenSigTimeoutTime_PAM" SG_ 1153 CRC_BCM10 0;
BA_ "GenSigTimeoutTime_SGW" SG_ 1153 CRC_BCM10 0;
BA_ "GenSigTimeoutTime_TRSKM" SG_ 1153 CRC_BCM10 0;
BA_ "GenSigSendType" SG_ 1153 DAY_LGT_MD 3;
BA_ "GenSigTimeoutTime_BCM" SG_ 1153 DAY_LGT_MD 0;
BA_ "GenSigTimeoutTime_BSM2" SG_ 1153 DAY_LGT_MD 0;
BA_ "GenSigTimeoutTime_CADM2" SG_ 1153 DAY_LGT_MD 0;
BA_ "GenSigTimeoutTime_CVADAS" SG_ 1153 DAY_LGT_MD 0;
BA_ "GenSigTimeoutTime_EPS" SG_ 1153 DAY_LGT_MD 0;
BA_ "GenSigTimeoutTime_ORC" SG_ 1153 DAY_LGT_MD 0;
BA_ "GenSigTimeoutTime_PAM" SG_ 1153 DAY_LGT_MD 0;
BA_ "GenSigTimeoutTime_SGW" SG_ 1153 DAY_LGT_MD 0;
BA_ "GenSigStartValue" SG_ 1153 ExternalTemperatureC 511;
BA_ "GenSigTimeoutTime_BCM" SG_ 1153 ExternalTemperatureC 0;
BA_ "GenSigTimeoutTime_BSM2" SG_ 1153 ExternalTemperatureC 0;
BA_ "GenSigTimeoutTime_CVADAS" SG_ 1153 ExternalTemperatureC 0;
BA_ "GenSigTimeoutTime_EPS" SG_ 1153 ExternalTemperatureC 0;
BA_ "GenSigTimeoutTime_ORC" SG_ 1153 ExternalTemperatureC 0;
BA_ "GenSigTimeoutTime_PAM" SG_ 1153 ExternalTemperatureC 0;
BA_ "GenSigTimeoutTime_SGW" SG_ 1153 ExternalTemperatureC 0;
BA_ "GenSigStartValue" SG_ 1153 ExternalTemperatureF 511;
BA_ "GenSigTimeoutTime_BCM" SG_ 1153 ExternalTemperatureF 0;
BA_ "GenSigTimeoutTime_BSM2" SG_ 1153 ExternalTemperatureF 0;
BA_ "GenSigTimeoutTime_CADM2" SG_ 1153 ExternalTemperatureF 0;
BA_ "GenSigTimeoutTime_CVADAS" SG_ 1153 ExternalTemperatureF 0;
BA_ "GenSigTimeoutTime_EPS" SG_ 1153 ExternalTemperatureF 0;
BA_ "GenSigTimeoutTime_ORC" SG_ 1153 ExternalTemperatureF 0;
BA_ "GenSigTimeoutTime_PAM" SG_ 1153 ExternalTemperatureF 0;
BA_ "GenSigTimeoutTime_SGW" SG_ 1153 ExternalTemperatureF 0;
BA_ "GenSigTimeoutTime_TRSKM" SG_ 1153 ExternalTemperatureF 0;
BA_ "GenSigTimeoutTime_BCM" SG_ 1153 MessageCounter_BCM10 0;
BA_ "GenSigTimeoutTime_ORC" SG_ 1153 MessageCounter_BCM10 0;
BA_ "GenSigTimeoutTime_PAM" SG_ 1153 MessageCounter_BCM10 0;
BA_ "GenSigTimeoutTime_SGW" SG_ 1153 MessageCounter_BCM10 0;
BA_ "GenSigTimeoutTime_TRSKM" SG_ 1153 MessageCounter_BCM10 0;
BA_ "GenSigSendType" SG_ 1153 PANEL_INTS 3;
BA_ "GenSigTimeoutTime_BCM" SG_ 1153 PANEL_INTS 0;
BA_ "GenSigTimeoutTime_BSM2" SG_ 1153 PANEL_INTS 0;
BA_ "GenSigTimeoutTime_CADM2" SG_ 1153 PANEL_INTS 0;
BA_ "GenSigTimeoutTime_CVADAS" SG_ 1153 PANEL_INTS 0;
BA_ "GenSigTimeoutTime_EPS" SG_ 1153 PANEL_INTS 0;
BA_ "GenSigTimeoutTime_ORC" SG_ 1153 PANEL_INTS 0;
BA_ "GenSigTimeoutTime_PAM" SG_ 1153 PANEL_INTS 0;
BA_ "GenSigTimeoutTime_SGW" SG_ 1153 PANEL_INTS 0;
BA_ "GenSigSendType" SG_ 1153 StTypSts 3;
BA_ "GenSigTimeoutTime_BCM" SG_ 1153 StTypSts 0;
BA_ "GenSigTimeoutTime_BSM2" SG_ 1153 StTypSts 0;
BA_ "GenSigTimeoutTime_CADM2" SG_ 1153 StTypSts 0;
BA_ "GenSigTimeoutTime_CVADAS" SG_ 1153 StTypSts 0;
BA_ "GenSigTimeoutTime_EPS" SG_ 1153 StTypSts 0;
BA_ "GenSigTimeoutTime_ORC" SG_ 1153 StTypSts 0;
BA_ "GenSigTimeoutTime_PAM" SG_ 1153 StTypSts 0;
BA_ "GenSigTimeoutTime_SGW" SG_ 1153 StTypSts 0;
BA_ "GenSigTimeoutTime_TRSKM" SG_ 1153 StTypSts 0;
BA_ "GenSigSendType" SG_ 1153 TurnIndicationSts 3;
BA_ "GenSigTimeoutTime_BCM" SG_ 1153 TurnIndicationSts 0;
BA_ "GenSigTimeoutTime_BSM2" SG_ 1153 TurnIndicationSts 0;
BA_ "GenSigTimeoutTime_CADM2" SG_ 1153 TurnIndicationSts 0;
BA_ "GenSigTimeoutTime_CVADAS" SG_ 1153 TurnIndicationSts 0;
BA_ "GenSigTimeoutTime_EPS" SG_ 1153 TurnIndicationSts 0;
BA_ "GenSigTimeoutTime_ORC" SG_ 1153 TurnIndicationSts 0;
BA_ "GenSigTimeoutTime_PAM" SG_ 1153 TurnIndicationSts 0;
BA_ "GenSigTimeoutTime_SGW" SG_ 1153 TurnIndicationSts 0;
BA_ "GenSigTimeoutTime_TRSKM" SG_ 1153 TurnIndicationSts 0;
BA_ "GenSigSendType" SG_ 1153 WPR_SYS_AUTO 3;
BA_ "GenSigTimeoutTime_BCM" SG_ 1153 WPR_SYS_AUTO 0;
BA_ "GenSigTimeoutTime_BSM2" SG_ 1153 WPR_SYS_AUTO 0;
BA_ "GenSigTimeoutTime_CADM2" SG_ 1153 WPR_SYS_AUTO 0;
BA_ "GenSigTimeoutTime_CVADAS" SG_ 1153 WPR_SYS_AUTO 0;
BA_ "GenSigTimeoutTime_EPS" SG_ 1153 WPR_SYS_AUTO 0;
BA_ "GenSigTimeoutTime_ORC" SG_ 1153 WPR_SYS_AUTO 0;
BA_ "GenSigTimeoutTime_PAM" SG_ 1153 WPR_SYS_AUTO 0;
BA_ "GenSigTimeoutTime_SGW" SG_ 1153 WPR_SYS_AUTO 0;
BA_ "GenSigTimeoutTime_TRSKM" SG_ 1153 WPR_SYS_AUTO 0;
BA_ "GenSigTimeoutTime_BCM" SG_ 1430 EngineOffTimer 0;
BA_ "GenSigTimeoutTime_BSM2" SG_ 1430 EngineOffTimer 0;
BA_ "GenSigTimeoutTime_CADM2" SG_ 1430 EngineOffTimer 0;
BA_ "GenSigTimeoutTime_CVADAS" SG_ 1430 EngineOffTimer 0;
BA_ "GenSigTimeoutTime_EPS" SG_ 1430 EngineOffTimer 0;
BA_ "GenSigTimeoutTime_ORC" SG_ 1430 EngineOffTimer 0;
BA_ "GenSigTimeoutTime_PAM" SG_ 1430 EngineOffTimer 0;
BA_ "GenSigTimeoutTime_SGW" SG_ 1430 EngineOffTimer 0;
BA_ "GenSigTimeoutTime_TRSKM" SG_ 1430 EngineOffTimer 0;
BA_ "GenSigStartValue" SG_ 1431 AirTemp_Outsd 255;
BA_ "GenSigSendType" SG_ 1431 AirTemp_Outsd 3;
BA_ "GenSigTimeoutTime_BCM" SG_ 1431 AirTemp_Outsd 0;
BA_ "GenSigTimeoutTime_BSM2" SG_ 1431 AirTemp_Outsd 0;
BA_ "GenSigTimeoutTime_CADM2" SG_ 1431 AirTemp_Outsd 0;
BA_ "GenSigTimeoutTime_CVADAS" SG_ 1431 AirTemp_Outsd 0;
BA_ "GenSigTimeoutTime_EPS" SG_ 1431 AirTemp_Outsd 0;
BA_ "GenSigTimeoutTime_ORC" SG_ 1431 AirTemp_Outsd 0;
BA_ "GenSigTimeoutTime_PAM" SG_ 1431 AirTemp_Outsd 0;
BA_ "GenSigTimeoutTime_SGW" SG_ 1431 AirTemp_Outsd 0;
BA_ "GenSigTimeoutTime_TRSKM" SG_ 1431 AirTemp_Outsd 0;
BA_ "GenSigSendType" SG_ 1431 APARequestSts 3;
BA_ "GenSigTimeoutTime_BCM" SG_ 1431 APARequestSts 0;
BA_ "GenSigTimeoutTime_BSM2" SG_ 1431 APARequestSts 0;
BA_ "GenSigTimeoutTime_CADM2" SG_ 1431 APARequestSts 0;
BA_ "GenSigTimeoutTime_EPS" SG_ 1431 APARequestSts 0;
BA_ "GenSigTimeoutTime_ORC" SG_ 1431 APARequestSts 0;
BA_ "GenSigTimeoutTime_PAM" SG_ 1431 APARequestSts 0;
BA_ "GenSigTimeoutTime_SGW" SG_ 1431 APARequestSts 0;
BA_ "GenSigTimeoutTime_TRSKM" SG_ 1431 APARequestSts 0;
BA_ "GenSigTimeoutTime_BCM" SG_ 1431 CRC_BCM12 0;
BA_ "GenSigTimeoutTime_BSM2" SG_ 1431 CRC_BCM12 0;
BA_ "GenSigTimeoutTime_EPS" SG_ 1431 CRC_BCM12 0;
BA_ "GenSigTimeoutTime_ORC" SG_ 1431 CRC_BCM12 0;
BA_ "GenSigTimeoutTime_PAM" SG_ 1431 CRC_BCM12 0;
BA_ "GenSigTimeoutTime_SGW" SG_ 1431 CRC_BCM12 0;
BA_ "GenSigTimeoutTime_TRSKM" SG_ 1431 CRC_BCM12 0;
BA_ "GenSigSendType" SG_ 1431 DALM_Status 3;
BA_ "GenSigTimeoutTime_BCM" SG_ 1431 DALM_Status 0;
BA_ "GenSigTimeoutTime_BSM2" SG_ 1431 DALM_Status 0;
BA_ "GenSigTimeoutTime_CVADAS" SG_ 1431 DALM_Status 0;
BA_ "GenSigTimeoutTime_EPS" SG_ 1431 DALM_Status 0;
BA_ "GenSigTimeoutTime_ORC" SG_ 1431 DALM_Status 0;
BA_ "GenSigTimeoutTime_PAM" SG_ 1431 DALM_Status 0;
BA_ "GenSigTimeoutTime_SGW" SG_ 1431 DALM_Status 0;
BA_ "GenSigTimeoutTime_TRSKM" SG_ 1431 DALM_Status 0;
BA_ "GenSigSendType" SG_ 1431 EPS_MODE_REQ 3;
BA_ "GenSigTimeoutTime_BCM" SG_ 1431 EPS_MODE_REQ 0;
BA_ "GenSigTimeoutTime_BSM2" SG_ 1431 EPS_MODE_REQ 0;
BA_ "GenSigTimeoutTime_CADM2" SG_ 1431 EPS_MODE_REQ 0;
BA_ "GenSigTimeoutTime_CVADAS" SG_ 1431 EPS_MODE_REQ 0;
BA_ "GenSigTimeoutTime_PAM" SG_ 1431 EPS_MODE_REQ 0;
BA_ "GenSigTimeoutTime_TRSKM" SG_ 1431 EPS_MODE_REQ 0;
BA_ "GenSigSendType" SG_ 1431 FT_PAMRequestSts 3;
BA_ "GenSigTimeoutTime_BCM" SG_ 1431 FT_PAMRequestSts 0;
BA_ "GenSigTimeoutTime_BSM2" SG_ 1431 FT_PAMRequestSts 0;
BA_ "GenSigTimeoutTime_CADM2" SG_ 1431 FT_PAMRequestSts 0;
BA_ "GenSigTimeoutTime_EPS" SG_ 1431 FT_PAMRequestSts 0;
BA_ "GenSigTimeoutTime_ORC" SG_ 1431 FT_PAMRequestSts 0;
BA_ "GenSigTimeoutTime_SGW" SG_ 1431 FT_PAMRequestSts 0;
BA_ "GenSigTimeoutTime_TRSKM" SG_ 1431 FT_PAMRequestSts 0;
BA_ "GenSigStartValue" SG_ 1431 IGN_OFF_TIME_LNG 4095;
BA_ "GenSigTimeoutTime_BCM" SG_ 1431 IGN_OFF_TIME_LNG 0;
BA_ "GenSigTimeoutTime_BSM2" SG_ 1431 IGN_OFF_TIME_LNG 0;
BA_ "GenSigTimeoutTime_CADM2" SG_ 1431 IGN_OFF_TIME_LNG 0;
BA_ "GenSigTimeoutTime_CVADAS" SG_ 1431 IGN_OFF_TIME_LNG 0;
BA_ "GenSigTimeoutTime_EPS" SG_ 1431 IGN_OFF_TIME_LNG 0;
BA_ "GenSigTimeoutTime_ORC" SG_ 1431 IGN_OFF_TIME_LNG 0;
BA_ "GenSigTimeoutTime_PAM" SG_ 1431 IGN_OFF_TIME_LNG 0;
BA_ "GenSigTimeoutTime_SGW" SG_ 1431 IGN_OFF_TIME_LNG 0;
BA_ "GenSigTimeoutTime_TRSKM" SG_ 1431 IGN_OFF_TIME_LNG 0;
BA_ "GenSigTimeoutTime_BCM" SG_ 1431 MessageCounter_BCM12 0;
BA_ "GenSigTimeoutTime_BSM2" SG_ 1431 MessageCounter_BCM12 0;
BA_ "GenSigTimeoutTime_EPS" SG_ 1431 MessageCounter_BCM12 0;
BA_ "GenSigTimeoutTime_ORC" SG_ 1431 MessageCounter_BCM12 0;
BA_ "GenSigTimeoutTime_PAM" SG_ 1431 MessageCounter_BCM12 0;
BA_ "GenSigTimeoutTime_SGW" SG_ 1431 MessageCounter_BCM12 0;
BA_ "GenSigTimeoutTime_TRSKM" SG_ 1431 MessageCounter_BCM12 0;
BA_ "GenSigSendType" SG_ 1431 PAMRequestSts 3;
BA_ "GenSigTimeoutTime_BCM" SG_ 1431 PAMRequestSts 0;
BA_ "GenSigTimeoutTime_BSM2" SG_ 1431 PAMRequestSts 0;
BA_ "GenSigTimeoutTime_CADM2" SG_ 1431 PAMRequestSts 0;
BA_ "GenSigTimeoutTime_EPS" SG_ 1431 PAMRequestSts 0;
BA_ "GenSigTimeoutTime_ORC" SG_ 1431 PAMRequestSts 0;
BA_ "GenSigTimeoutTime_SGW" SG_ 1431 PAMRequestSts 0;
BA_ "GenSigTimeoutTime_TRSKM" SG_ 1431 PAMRequestSts 0;
BA_ "GenSigSendType" SG_ 1431 SeatVib_Sts 3;
BA_ "GenSigTimeoutTime_BCM" SG_ 1431 SeatVib_Sts 0;
BA_ "GenSigTimeoutTime_BSM2" SG_ 1431 SeatVib_Sts 0;
BA_ "GenSigTimeoutTime_CVADAS" SG_ 1431 SeatVib_Sts 0;
BA_ "GenSigTimeoutTime_EPS" SG_ 1431 SeatVib_Sts 0;
BA_ "GenSigTimeoutTime_ORC" SG_ 1431 SeatVib_Sts 0;
BA_ "GenSigTimeoutTime_PAM" SG_ 1431 SeatVib_Sts 0;
BA_ "GenSigTimeoutTime_SGW" SG_ 1431 SeatVib_Sts 0;
BA_ "GenSigTimeoutTime_TRSKM" SG_ 1431 SeatVib_Sts 0;
BA_ "GenSigSendType" SG_ 159 ACC_DistSwDec 1;
BA_ "GenSigTimeoutTime_BCM" SG_ 159 ACC_DistSwDec 0;
BA_ "GenSigTimeoutTime_BSM2" SG_ 159 ACC_DistSwDec 0;
BA_ "GenSigTimeoutTime_CADM2" SG_ 159 ACC_DistSwDec 0;
BA_ "GenSigTimeoutTime_CVADAS" SG_ 159 ACC_DistSwDec 0;
BA_ "GenSigTimeoutTime_EPS" SG_ 159 ACC_DistSwDec 0;
BA_ "GenSigTimeoutTime_ORC" SG_ 159 ACC_DistSwDec 0;
BA_ "GenSigTimeoutTime_PAM" SG_ 159 ACC_DistSwDec 0;
BA_ "GenSigTimeoutTime_SGW" SG_ 159 ACC_DistSwDec 0;
BA_ "GenSigTimeoutTime_TRSKM" SG_ 159 ACC_DistSwDec 0;
BA_ "GenSigSendType" SG_ 159 ACC_DistSwInc 1;
BA_ "GenSigTimeoutTime_BCM" SG_ 159 ACC_DistSwInc 0;
BA_ "GenSigTimeoutTime_BSM2" SG_ 159 ACC_DistSwInc 0;
BA_ "GenSigTimeoutTime_CADM2" SG_ 159 ACC_DistSwInc 0;
BA_ "GenSigTimeoutTime_CVADAS" SG_ 159 ACC_DistSwInc 0;
BA_ "GenSigTimeoutTime_EPS" SG_ 159 ACC_DistSwInc 0;
BA_ "GenSigTimeoutTime_ORC" SG_ 159 ACC_DistSwInc 0;
BA_ "GenSigTimeoutTime_PAM" SG_ 159 ACC_DistSwInc 0;
BA_ "GenSigTimeoutTime_SGW" SG_ 159 ACC_DistSwInc 0;
BA_ "GenSigTimeoutTime_TRSKM" SG_ 159 ACC_DistSwInc 0;
BA_ "GenSigSendType" SG_ 159 ACC_On 1;
BA_ "GenSigTimeoutTime_BCM" SG_ 159 ACC_On 0;
BA_ "GenSigTimeoutTime_BSM2" SG_ 159 ACC_On 0;
BA_ "GenSigTimeoutTime_CVADAS" SG_ 159 ACC_On 0;
BA_ "GenSigTimeoutTime_EPS" SG_ 159 ACC_On 0;
BA_ "GenSigTimeoutTime_ORC" SG_ 159 ACC_On 0;
BA_ "GenSigTimeoutTime_PAM" SG_ 159 ACC_On 0;
BA_ "GenSigTimeoutTime_SGW" SG_ 159 ACC_On 0;
BA_ "GenSigTimeoutTime_TRSKM" SG_ 159 ACC_On 0;
BA_ "GenSigTimeoutTime_BCM" SG_ 159 AcceleratorSts 0;
BA_ "GenSigTimeoutTime_BSM2" SG_ 159 AcceleratorSts 0;
BA_ "GenSigTimeoutTime_CADM2" SG_ 159 AcceleratorSts 0;
BA_ "GenSigTimeoutTime_CVADAS" SG_ 159 AcceleratorSts 0;
BA_ "GenSigTimeoutTime_EPS" SG_ 159 AcceleratorSts 0;
BA_ "GenSigTimeoutTime_ORC" SG_ 159 AcceleratorSts 0;
BA_ "GenSigTimeoutTime_PAM" SG_ 159 AcceleratorSts 0;
BA_ "GenSigTimeoutTime_SGW" SG_ 159 AcceleratorSts 0;
BA_ "GenSigTimeoutTime_TRSKM" SG_ 159 AcceleratorSts 0;
BA_ "GenSigTimeoutTime_BCM" SG_ 159 CRC_BCM13 0;
BA_ "GenSigTimeoutTime_BSM2" SG_ 159 CRC_BCM13 0;
BA_ "GenSigTimeoutTime_CADM2" SG_ 159 CRC_BCM13 0;
BA_ "GenSigTimeoutTime_CVADAS" SG_ 159 CRC_BCM13 0;
BA_ "GenSigTimeoutTime_EPS" SG_ 159 CRC_BCM13 0;
BA_ "GenSigTimeoutTime_ORC" SG_ 159 CRC_BCM13 0;
BA_ "GenSigTimeoutTime_PAM" SG_ 159 CRC_BCM13 0;
BA_ "GenSigTimeoutTime_SGW" SG_ 159 CRC_BCM13 0;
BA_ "GenSigTimeoutTime_TRSKM" SG_ 159 CRC_BCM13 0;
BA_ "GenSigStartValue" SG_ 159 CRC_CSWC_1 255;
BA_ "GenSigTimeoutTime_BCM" SG_ 159 CRC_CSWC_1 0;
BA_ "GenSigTimeoutTime_BSM2" SG_ 159 CRC_CSWC_1 0;
BA_ "GenSigTimeoutTime_CADM2" SG_ 159 CRC_CSWC_1 0;
BA_ "GenSigTimeoutTime_CVADAS" SG_ 159 CRC_CSWC_1 0;
BA_ "GenSigTimeoutTime_EPS" SG_ 159 CRC_CSWC_1 0;
BA_ "GenSigTimeoutTime_ORC" SG_ 159 CRC_CSWC_1 0;
BA_ "GenSigTimeoutTime_PAM" SG_ 159 CRC_CSWC_1 0;
BA_ "GenSigTimeoutTime_SGW" SG_ 159 CRC_CSWC_1 0;
BA_ "GenSigTimeoutTime_TRSKM" SG_ 159 CRC_CSWC_1 0;
BA_ "GenSigTimeoutTime_BCM" SG_ 159 CruiseControlFailSts 0;
BA_ "GenSigTimeoutTime_BSM2" SG_ 159 CruiseControlFailSts 0;
BA_ "GenSigTimeoutTime_CADM2" SG_ 159 CruiseControlFailSts 0;
BA_ "GenSigTimeoutTime_CVADAS" SG_ 159 CruiseControlFailSts 0;
BA_ "GenSigTimeoutTime_EPS" SG_ 159 CruiseControlFailSts 0;
BA_ "GenSigTimeoutTime_PAM" SG_ 159 CruiseControlFailSts 0;
BA_ "GenSigTimeoutTime_SGW" SG_ 159 CruiseControlFailSts 0;
BA_ "GenSigTimeoutTime_TRSKM" SG_ 159 CruiseControlFailSts 0;
BA_ "GenSigTimeoutTime_BCM" SG_ 159 CruiseControlOnOffSts 0;
BA_ "GenSigTimeoutTime_BSM2" SG_ 159 CruiseControlOnOffSts 0;
BA_ "GenSigTimeoutTime_CADM2" SG_ 159 CruiseControlOnOffSts 0;
BA_ "GenSigTimeoutTime_CVADAS" SG_ 159 CruiseControlOnOffSts 0;
BA_ "GenSigTimeoutTime_EPS" SG_ 159 CruiseControlOnOffSts 0;
BA_ "GenSigTimeoutTime_PAM" SG_ 159 CruiseControlOnOffSts 0;
BA_ "GenSigTimeoutTime_SGW" SG_ 159 CruiseControlOnOffSts 0;
BA_ "GenSigTimeoutTime_TRSKM" SG_ 159 CruiseControlOnOffSts 0;
BA_ "GenSigSendType" SG_ 159 CrusCnclSwitch 3;
BA_ "GenSigTimeoutTime_BCM" SG_ 159 CrusCnclSwitch 0;
BA_ "GenSigTimeoutTime_BSM2" SG_ 159 CrusCnclSwitch 0;
BA_ "GenSigTimeoutTime_CVADAS" SG_ 159 CrusCnclSwitch 0;
BA_ "GenSigTimeoutTime_EPS" SG_ 159 CrusCnclSwitch 0;
BA_ "GenSigTimeoutTime_ORC" SG_ 159 CrusCnclSwitch 0;
BA_ "GenSigTimeoutTime_PAM" SG_ 159 CrusCnclSwitch 0;
BA_ "GenSigTimeoutTime_SGW" SG_ 159 CrusCnclSwitch 0;
BA_ "GenSigTimeoutTime_TRSKM" SG_ 159 CrusCnclSwitch 0;
BA_ "GenSigTimeoutTime_BCM" SG_ 159 DeceleratorSts 0;
BA_ "GenSigTimeoutTime_BSM2" SG_ 159 DeceleratorSts 0;
BA_ "GenSigTimeoutTime_CADM2" SG_ 159 DeceleratorSts 0;
BA_ "GenSigTimeoutTime_CVADAS" SG_ 159 DeceleratorSts 0;
BA_ "GenSigTimeoutTime_EPS" SG_ 159 DeceleratorSts 0;
BA_ "GenSigTimeoutTime_ORC" SG_ 159 DeceleratorSts 0;
BA_ "GenSigTimeoutTime_PAM" SG_ 159 DeceleratorSts 0;
BA_ "GenSigTimeoutTime_SGW" SG_ 159 DeceleratorSts 0;
BA_ "GenSigTimeoutTime_TRSKM" SG_ 159 DeceleratorSts 0;
BA_ "GenSigTimeoutTime_BCM" SG_ 159 MC_CSWC_1 0;
BA_ "GenSigTimeoutTime_BSM2" SG_ 159 MC_CSWC_1 0;
BA_ "GenSigTimeoutTime_CADM2" SG_ 159 MC_CSWC_1 0;
BA_ "GenSigTimeoutTime_CVADAS" SG_ 159 MC_CSWC_1 0;
BA_ "GenSigTimeoutTime_EPS" SG_ 159 MC_CSWC_1 0;
BA_ "GenSigTimeoutTime_ORC" SG_ 159 MC_CSWC_1 0;
BA_ "GenSigTimeoutTime_PAM" SG_ 159 MC_CSWC_1 0;
BA_ "GenSigTimeoutTime_SGW" SG_ 159 MC_CSWC_1 0;
BA_ "GenSigTimeoutTime_TRSKM" SG_ 159 MC_CSWC_1 0;
BA_ "GenSigTimeoutTime_BCM" SG_ 159 MessageCounter_BCM13 0;
BA_ "GenSigTimeoutTime_BSM2" SG_ 159 MessageCounter_BCM13 0;
BA_ "GenSigTimeoutTime_CADM2" SG_ 159 MessageCounter_BCM13 0;
BA_ "GenSigTimeoutTime_CVADAS" SG_ 159 MessageCounter_BCM13 0;
BA_ "GenSigTimeoutTime_EPS" SG_ 159 MessageCounter_BCM13 0;
BA_ "GenSigTimeoutTime_ORC" SG_ 159 MessageCounter_BCM13 0;
BA_ "GenSigTimeoutTime_PAM" SG_ 159 MessageCounter_BCM13 0;
BA_ "GenSigTimeoutTime_SGW" SG_ 159 MessageCounter_BCM13 0;
BA_ "GenSigTimeoutTime_TRSKM" SG_ 159 MessageCounter_BCM13 0;
BA_ "GenSigTimeoutTime_BCM" SG_ 159 ResumeSwitch 0;
BA_ "GenSigTimeoutTime_BSM2" SG_ 159 ResumeSwitch 0;
BA_ "GenSigTimeoutTime_CADM2" SG_ 159 ResumeSwitch 0;
BA_ "GenSigTimeoutTime_CVADAS" SG_ 159 ResumeSwitch 0;
BA_ "GenSigTimeoutTime_EPS" SG_ 159 ResumeSwitch 0;
BA_ "GenSigTimeoutTime_ORC" SG_ 159 ResumeSwitch 0;
BA_ "GenSigTimeoutTime_PAM" SG_ 159 ResumeSwitch 0;
BA_ "GenSigTimeoutTime_SGW" SG_ 159 ResumeSwitch 0;
BA_ "GenSigTimeoutTime_TRSKM" SG_ 159 ResumeSwitch 0;
BA_ "GenSigSendType" SG_ 736 Command_01Sts 3;
BA_ "GenSigTimeoutTime_BCM" SG_ 736 Command_01Sts 0;
BA_ "GenSigTimeoutTime_BSM2" SG_ 736 Command_01Sts 0;
BA_ "GenSigTimeoutTime_CADM2" SG_ 736 Command_01Sts 0;
BA_ "GenSigTimeoutTime_CVADAS" SG_ 736 Command_01Sts 0;
BA_ "GenSigTimeoutTime_EPS" SG_ 736 Command_01Sts 0;
BA_ "GenSigTimeoutTime_ORC" SG_ 736 Command_01Sts 0;
BA_ "GenSigTimeoutTime_PAM" SG_ 736 Command_01Sts 0;
BA_ "GenSigTimeoutTime_SGW" SG_ 736 Command_01Sts 0;
BA_ "GenSigTimeoutTime_TRSKM" SG_ 736 Command_01Sts 0;
BA_ "GenSigSendType" SG_ 736 Command_02Sts 3;
BA_ "GenSigTimeoutTime_BCM" SG_ 736 Command_02Sts 0;
BA_ "GenSigTimeoutTime_BSM2" SG_ 736 Command_02Sts 0;
BA_ "GenSigTimeoutTime_CADM2" SG_ 736 Command_02Sts 0;
BA_ "GenSigTimeoutTime_CVADAS" SG_ 736 Command_02Sts 0;
BA_ "GenSigTimeoutTime_EPS" SG_ 736 Command_02Sts 0;
BA_ "GenSigTimeoutTime_ORC" SG_ 736 Command_02Sts 0;
BA_ "GenSigTimeoutTime_PAM" SG_ 736 Command_02Sts 0;
BA_ "GenSigTimeoutTime_SGW" SG_ 736 Command_02Sts 0;
BA_ "GenSigTimeoutTime_TRSKM" SG_ 736 Command_02Sts 0;
BA_ "GenSigSendType" SG_ 736 Command_03Sts 3;
BA_ "GenSigTimeoutTime_BCM" SG_ 736 Command_03Sts 0;
BA_ "GenSigTimeoutTime_BSM2" SG_ 736 Command_03Sts 0;
BA_ "GenSigTimeoutTime_CADM2" SG_ 736 Command_03Sts 0;
BA_ "GenSigTimeoutTime_CVADAS" SG_ 736 Command_03Sts 0;
BA_ "GenSigTimeoutTime_EPS" SG_ 736 Command_03Sts 0;
BA_ "GenSigTimeoutTime_ORC" SG_ 736 Command_03Sts 0;
BA_ "GenSigTimeoutTime_PAM" SG_ 736 Command_03Sts 0;
BA_ "GenSigTimeoutTime_SGW" SG_ 736 Command_03Sts 0;
BA_ "GenSigTimeoutTime_TRSKM" SG_ 736 Command_03Sts 0;
BA_ "GenSigSendType" SG_ 736 Command_04Sts 3;
BA_ "GenSigTimeoutTime_BCM" SG_ 736 Command_04Sts 0;
BA_ "GenSigTimeoutTime_BSM2" SG_ 736 Command_04Sts 0;
BA_ "GenSigTimeoutTime_CADM2" SG_ 736 Command_04Sts 0;
BA_ "GenSigTimeoutTime_CVADAS" SG_ 736 Command_04Sts 0;
BA_ "GenSigTimeoutTime_EPS" SG_ 736 Command_04Sts 0;
BA_ "GenSigTimeoutTime_ORC" SG_ 736 Command_04Sts 0;
BA_ "GenSigTimeoutTime_PAM" SG_ 736 Command_04Sts 0;
BA_ "GenSigTimeoutTime_SGW" SG_ 736 Command_04Sts 0;
BA_ "GenSigTimeoutTime_TRSKM" SG_ 736 Command_04Sts 0;
BA_ "GenSigSendType" SG_ 736 Command_05Sts 3;
BA_ "GenSigTimeoutTime_BCM" SG_ 736 Command_05Sts 0;
BA_ "GenSigTimeoutTime_BSM2" SG_ 736 Command_05Sts 0;
BA_ "GenSigTimeoutTime_CADM2" SG_ 736 Command_05Sts 0;
BA_ "GenSigTimeoutTime_CVADAS" SG_ 736 Command_05Sts 0;
BA_ "GenSigTimeoutTime_EPS" SG_ 736 Command_05Sts 0;
BA_ "GenSigTimeoutTime_ORC" SG_ 736 Command_05Sts 0;
BA_ "GenSigTimeoutTime_PAM" SG_ 736 Command_05Sts 0;
BA_ "GenSigTimeoutTime_SGW" SG_ 736 Command_05Sts 0;
BA_ "GenSigTimeoutTime_TRSKM" SG_ 736 Command_05Sts 0;
BA_ "GenSigSendType" SG_ 736 Command_06Sts 3;
BA_ "GenSigTimeoutTime_BCM" SG_ 736 Command_06Sts 0;
BA_ "GenSigTimeoutTime_BSM2" SG_ 736 Command_06Sts 0;
BA_ "GenSigTimeoutTime_CADM2" SG_ 736 Command_06Sts 0;
BA_ "GenSigTimeoutTime_CVADAS" SG_ 736 Command_06Sts 0;
BA_ "GenSigTimeoutTime_EPS" SG_ 736 Command_06Sts 0;
BA_ "GenSigTimeoutTime_ORC" SG_ 736 Command_06Sts 0;
BA_ "GenSigTimeoutTime_PAM" SG_ 736 Command_06Sts 0;
BA_ "GenSigTimeoutTime_SGW" SG_ 736 Command_06Sts 0;
BA_ "GenSigTimeoutTime_TRSKM" SG_ 736 Command_06Sts 0;
BA_ "GenSigSendType" SG_ 736 Command_07Sts 3;
BA_ "GenSigTimeoutTime_BCM" SG_ 736 Command_07Sts 0;
BA_ "GenSigTimeoutTime_BSM2" SG_ 736 Command_07Sts 0;
BA_ "GenSigTimeoutTime_CADM2" SG_ 736 Command_07Sts 0;
BA_ "GenSigTimeoutTime_CVADAS" SG_ 736 Command_07Sts 0;
BA_ "GenSigTimeoutTime_EPS" SG_ 736 Command_07Sts 0;
BA_ "GenSigTimeoutTime_ORC" SG_ 736 Command_07Sts 0;
BA_ "GenSigTimeoutTime_PAM" SG_ 736 Command_07Sts 0;
BA_ "GenSigTimeoutTime_SGW" SG_ 736 Command_07Sts 0;
BA_ "GenSigTimeoutTime_TRSKM" SG_ 736 Command_07Sts 0;
BA_ "GenSigSendType" SG_ 736 Command_08Sts 3;
BA_ "GenSigTimeoutTime_BCM" SG_ 736 Command_08Sts 0;
BA_ "GenSigTimeoutTime_BSM2" SG_ 736 Command_08Sts 0;
BA_ "GenSigTimeoutTime_CADM2" SG_ 736 Command_08Sts 0;
BA_ "GenSigTimeoutTime_CVADAS" SG_ 736 Command_08Sts 0;
BA_ "GenSigTimeoutTime_EPS" SG_ 736 Command_08Sts 0;
BA_ "GenSigTimeoutTime_ORC" SG_ 736 Command_08Sts 0;
BA_ "GenSigTimeoutTime_PAM" SG_ 736 Command_08Sts 0;
BA_ "GenSigTimeoutTime_SGW" SG_ 736 Command_08Sts 0;
BA_ "GenSigTimeoutTime_TRSKM" SG_ 736 Command_08Sts 0;
BA_ "GenSigSendType" SG_ 736 Command_09Sts 3;
BA_ "GenSigTimeoutTime_BCM" SG_ 736 Command_09Sts 0;
BA_ "GenSigTimeoutTime_BSM2" SG_ 736 Command_09Sts 0;
BA_ "GenSigTimeoutTime_CADM2" SG_ 736 Command_09Sts 0;
BA_ "GenSigTimeoutTime_CVADAS" SG_ 736 Command_09Sts 0;
BA_ "GenSigTimeoutTime_EPS" SG_ 736 Command_09Sts 0;
BA_ "GenSigTimeoutTime_ORC" SG_ 736 Command_09Sts 0;
BA_ "GenSigTimeoutTime_PAM" SG_ 736 Command_09Sts 0;
BA_ "GenSigTimeoutTime_SGW" SG_ 736 Command_09Sts 0;
BA_ "GenSigTimeoutTime_TRSKM" SG_ 736 Command_09Sts 0;
BA_ "GenSigSendType" SG_ 736 Command_10Sts 3;
BA_ "GenSigTimeoutTime_BCM" SG_ 736 Command_10Sts 0;
BA_ "GenSigTimeoutTime_BSM2" SG_ 736 Command_10Sts 0;
BA_ "GenSigTimeoutTime_CADM2" SG_ 736 Command_10Sts 0;
BA_ "GenSigTimeoutTime_CVADAS" SG_ 736 Command_10Sts 0;
BA_ "GenSigTimeoutTime_EPS" SG_ 736 Command_10Sts 0;
BA_ "GenSigTimeoutTime_ORC" SG_ 736 Command_10Sts 0;
BA_ "GenSigTimeoutTime_PAM" SG_ 736 Command_10Sts 0;
BA_ "GenSigTimeoutTime_SGW" SG_ 736 Command_10Sts 0;
BA_ "GenSigTimeoutTime_TRSKM" SG_ 736 Command_10Sts 0;
BA_ "GenSigSendType" SG_ 736 Command_11Sts 3;
BA_ "GenSigTimeoutTime_BCM" SG_ 736 Command_11Sts 0;
BA_ "GenSigTimeoutTime_BSM2" SG_ 736 Command_11Sts 0;
BA_ "GenSigTimeoutTime_CADM2" SG_ 736 Command_11Sts 0;
BA_ "GenSigTimeoutTime_CVADAS" SG_ 736 Command_11Sts 0;
BA_ "GenSigTimeoutTime_EPS" SG_ 736 Command_11Sts 0;
BA_ "GenSigTimeoutTime_ORC" SG_ 736 Command_11Sts 0;
BA_ "GenSigTimeoutTime_PAM" SG_ 736 Command_11Sts 0;
BA_ "GenSigTimeoutTime_SGW" SG_ 736 Command_11Sts 0;
BA_ "GenSigTimeoutTime_TRSKM" SG_ 736 Command_11Sts 0;
BA_ "GenSigSendType" SG_ 736 Command_12Sts 3;
BA_ "GenSigTimeoutTime_BCM" SG_ 736 Command_12Sts 0;
BA_ "GenSigTimeoutTime_BSM2" SG_ 736 Command_12Sts 0;
BA_ "GenSigTimeoutTime_CADM2" SG_ 736 Command_12Sts 0;
BA_ "GenSigTimeoutTime_CVADAS" SG_ 736 Command_12Sts 0;
BA_ "GenSigTimeoutTime_EPS" SG_ 736 Command_12Sts 0;
BA_ "GenSigTimeoutTime_ORC" SG_ 736 Command_12Sts 0;
BA_ "GenSigTimeoutTime_PAM" SG_ 736 Command_12Sts 0;
BA_ "GenSigTimeoutTime_SGW" SG_ 736 Command_12Sts 0;
BA_ "GenSigTimeoutTime_TRSKM" SG_ 736 Command_12Sts 0;
BA_ "GenSigSendType" SG_ 736 Command_13Sts 3;
BA_ "GenSigTimeoutTime_BCM" SG_ 736 Command_13Sts 0;
BA_ "GenSigTimeoutTime_BSM2" SG_ 736 Command_13Sts 0;
BA_ "GenSigTimeoutTime_CADM2" SG_ 736 Command_13Sts 0;
BA_ "GenSigTimeoutTime_CVADAS" SG_ 736 Command_13Sts 0;
BA_ "GenSigTimeoutTime_EPS" SG_ 736 Command_13Sts 0;
BA_ "GenSigTimeoutTime_ORC" SG_ 736 Command_13Sts 0;
BA_ "GenSigTimeoutTime_PAM" SG_ 736 Command_13Sts 0;
BA_ "GenSigTimeoutTime_SGW" SG_ 736 Command_13Sts 0;
BA_ "GenSigTimeoutTime_TRSKM" SG_ 736 Command_13Sts 0;
BA_ "GenSigSendType" SG_ 736 Command_14Sts 3;
BA_ "GenSigTimeoutTime_BCM" SG_ 736 Command_14Sts 0;
BA_ "GenSigTimeoutTime_BSM2" SG_ 736 Command_14Sts 0;
BA_ "GenSigTimeoutTime_CADM2" SG_ 736 Command_14Sts 0;
BA_ "GenSigTimeoutTime_CVADAS" SG_ 736 Command_14Sts 0;
BA_ "GenSigTimeoutTime_EPS" SG_ 736 Command_14Sts 0;
BA_ "GenSigTimeoutTime_ORC" SG_ 736 Command_14Sts 0;
BA_ "GenSigTimeoutTime_PAM" SG_ 736 Command_14Sts 0;
BA_ "GenSigTimeoutTime_SGW" SG_ 736 Command_14Sts 0;
BA_ "GenSigTimeoutTime_TRSKM" SG_ 736 Command_14Sts 0;
BA_ "GenSigSendType" SG_ 736 Command_15Sts 3;
BA_ "GenSigTimeoutTime_BCM" SG_ 736 Command_15Sts 0;
BA_ "GenSigTimeoutTime_BSM2" SG_ 736 Command_15Sts 0;
BA_ "GenSigTimeoutTime_CADM2" SG_ 736 Command_15Sts 0;
BA_ "GenSigTimeoutTime_CVADAS" SG_ 736 Command_15Sts 0;
BA_ "GenSigTimeoutTime_EPS" SG_ 736 Command_15Sts 0;
BA_ "GenSigTimeoutTime_ORC" SG_ 736 Command_15Sts 0;
BA_ "GenSigTimeoutTime_PAM" SG_ 736 Command_15Sts 0;
BA_ "GenSigTimeoutTime_SGW" SG_ 736 Command_15Sts 0;
BA_ "GenSigTimeoutTime_TRSKM" SG_ 736 Command_15Sts 0;
BA_ "GenSigTimeoutTime_BCM" SG_ 736 CRC_BCM14 0;
BA_ "GenSigTimeoutTime_BSM2" SG_ 736 CRC_BCM14 0;
BA_ "GenSigTimeoutTime_CADM2" SG_ 736 CRC_BCM14 0;
BA_ "GenSigTimeoutTime_CVADAS" SG_ 736 CRC_BCM14 0;
BA_ "GenSigTimeoutTime_EPS" SG_ 736 CRC_BCM14 0;
BA_ "GenSigTimeoutTime_ORC" SG_ 736 CRC_BCM14 0;
BA_ "GenSigTimeoutTime_PAM" SG_ 736 CRC_BCM14 0;
BA_ "GenSigTimeoutTime_SGW" SG_ 736 CRC_BCM14 0;
BA_ "GenSigTimeoutTime_TRSKM" SG_ 736 CRC_BCM14 0;
BA_ "GenSigTimeoutTime_BCM" SG_ 736 MessageCounter_BCM14 0;
BA_ "GenSigTimeoutTime_BSM2" SG_ 736 MessageCounter_BCM14 0;
BA_ "GenSigTimeoutTime_CADM2" SG_ 736 MessageCounter_BCM14 0;
BA_ "GenSigTimeoutTime_CVADAS" SG_ 736 MessageCounter_BCM14 0;
BA_ "GenSigTimeoutTime_EPS" SG_ 736 MessageCounter_BCM14 0;
BA_ "GenSigTimeoutTime_ORC" SG_ 736 MessageCounter_BCM14 0;
BA_ "GenSigTimeoutTime_PAM" SG_ 736 MessageCounter_BCM14 0;
BA_ "GenSigTimeoutTime_SGW" SG_ 736 MessageCounter_BCM14 0;
BA_ "GenSigTimeoutTime_TRSKM" SG_ 736 MessageCounter_BCM14 0;
BA_ "GenSigTimeoutTime_BCM" SG_ 512 BonnetAjarRawValSts_8 0;
BA_ "GenSigTimeoutTime_BSM2" SG_ 512 BonnetAjarRawValSts_8 0;
BA_ "GenSigTimeoutTime_CADM2" SG_ 512 BonnetAjarRawValSts_8 0;
BA_ "GenSigTimeoutTime_CVADAS" SG_ 512 BonnetAjarRawValSts_8 0;
BA_ "GenSigTimeoutTime_EPS" SG_ 512 BonnetAjarRawValSts_8 0;
BA_ "GenSigTimeoutTime_PAM" SG_ 512 BonnetAjarRawValSts_8 0;
BA_ "GenSigTimeoutTime_SGW" SG_ 512 BonnetAjarRawValSts_8 0;
BA_ "GenSigTimeoutTime_TRSKM" SG_ 512 BonnetAjarRawValSts_8 0;
BA_ "GenSigTimeoutTime_BCM" SG_ 512 DriverDoor2AjarRawValSts_8 0;
BA_ "GenSigTimeoutTime_BSM2" SG_ 512 DriverDoor2AjarRawValSts_8 0;
BA_ "GenSigTimeoutTime_CADM2" SG_ 512 DriverDoor2AjarRawValSts_8 0;
BA_ "GenSigTimeoutTime_CVADAS" SG_ 512 DriverDoor2AjarRawValSts_8 0;
BA_ "GenSigTimeoutTime_EPS" SG_ 512 DriverDoor2AjarRawValSts_8 0;
BA_ "GenSigTimeoutTime_PAM" SG_ 512 DriverDoor2AjarRawValSts_8 0;
BA_ "GenSigTimeoutTime_SGW" SG_ 512 DriverDoor2AjarRawValSts_8 0;
BA_ "GenSigTimeoutTime_TRSKM" SG_ 512 DriverDoor2AjarRawValSts_8 0;
BA_ "GenSigTimeoutTime_BCM" SG_ 512 DriverDoorAjarRawValSts_8 0;
BA_ "GenSigTimeoutTime_BSM2" SG_ 512 DriverDoorAjarRawValSts_8 0;
BA_ "GenSigTimeoutTime_CADM2" SG_ 512 DriverDoorAjarRawValSts_8 0;
BA_ "GenSigTimeoutTime_CVADAS" SG_ 512 DriverDoorAjarRawValSts_8 0;
BA_ "GenSigTimeoutTime_EPS" SG_ 512 DriverDoorAjarRawValSts_8 0;
BA_ "GenSigTimeoutTime_PAM" SG_ 512 DriverDoorAjarRawValSts_8 0;
BA_ "GenSigTimeoutTime_SGW" SG_ 512 DriverDoorAjarRawValSts_8 0;
BA_ "GenSigTimeoutTime_TRSKM" SG_ 512 DriverDoorAjarRawValSts_8 0;
BA_ "GenSigTimeoutTime_BCM" SG_ 256 CRC_BCM2 0;
BA_ "GenSigTimeoutTime_CADM2" SG_ 256 CRC_BCM2 0;
BA_ "GenSigTimeoutTime_EPS" SG_ 256 CRC_BCM2 0;
BA_ "GenSigTimeoutTime_ORC" SG_ 256 CRC_BCM2 0;
BA_ "GenSigTimeoutTime_PAM" SG_ 256 CRC_BCM2 0;
BA_ "GenSigTimeoutTime_SGW" SG_ 256 CRC_BCM2 0;
BA_ "GenSigTimeoutTime_TRSKM" SG_ 256 CRC_BCM2 0;
BA_ "GenSigTimeoutTime_BCM" SG_ 256 KeyInIgnSts 0;
BA_ "GenSigTimeoutTime_BSM2" SG_ 256 KeyInIgnSts 0;
BA_ "GenSigTimeoutTime_CADM2" SG_ 256 KeyInIgnSts 0;
BA_ "GenSigTimeoutTime_CVADAS" SG_ 256 KeyInIgnSts 0;
BA_ "GenSigTimeoutTime_EPS" SG_ 256 KeyInIgnSts 0;
BA_ "GenSigTimeoutTime_ORC" SG_ 256 KeyInIgnSts 0;
BA_ "GenSigTimeoutTime_PAM" SG_ 256 KeyInIgnSts 0;
BA_ "GenSigTimeoutTime_SGW" SG_ 256 KeyInIgnSts 0;
BA_ "GenSigTimeoutTime_TRSKM" SG_ 256 KeyInIgnSts 0;
BA_ "GenSigTimeoutTime_BCM" SG_ 256 MessageCounter_BCM2 0;
BA_ "GenSigTimeoutTime_CADM2" SG_ 256 MessageCounter_BCM2 0;
BA_ "GenSigTimeoutTime_EPS" SG_ 256 MessageCounter_BCM2 0;
BA_ "GenSigTimeoutTime_ORC" SG_ 256 MessageCounter_BCM2 0;
BA_ "GenSigTimeoutTime_PAM" SG_ 256 MessageCounter_BCM2 0;
BA_ "GenSigTimeoutTime_SGW" SG_ 256 MessageCounter_BCM2 0;
BA_ "GenSigTimeoutTime_TRSKM" SG_ 256 MessageCounter_BCM2 0;
BA_ "GenSigTimeoutTime_BCM" SG_ 256 OperationalModeSts 0;
BA_ "GenSigTimeoutTime_TRSKM" SG_ 256 OperationalModeSts 0;
BA_ "GenSigTimeoutTime_BCM" SG_ 256 RemStActvSts 0;
BA_ "GenSigTimeoutTime_BSM2" SG_ 256 RemStActvSts 0;
BA_ "GenSigTimeoutTime_CADM2" SG_ 256 RemStActvSts 0;
BA_ "GenSigTimeoutTime_EPS" SG_ 256 RemStActvSts 0;
BA_ "GenSigTimeoutTime_ORC" SG_ 256 RemStActvSts 0;
BA_ "GenSigTimeoutTime_SGW" SG_ 256 RemStActvSts 0;
BA_ "GenSigTimeoutTime_TRSKM" SG_ 256 RemStActvSts 0;
BA_ "GenSigTimeoutTime_BCM" SG_ 256 TurnIndicatorSts 0;
BA_ "GenSigTimeoutTime_BSM2" SG_ 256 TurnIndicatorSts 0;
BA_ "GenSigTimeoutTime_CADM2" SG_ 256 TurnIndicatorSts 0;
BA_ "GenSigTimeoutTime_EPS" SG_ 256 TurnIndicatorSts 0;
BA_ "GenSigTimeoutTime_PAM" SG_ 256 TurnIndicatorSts 0;
BA_ "GenSigTimeoutTime_SGW" SG_ 256 TurnIndicatorSts 0;
BA_ "GenSigTimeoutTime_TRSKM" SG_ 256 TurnIndicatorSts 0;
BA_ "GenSigStartValue" SG_ 1826 OCMPsgSeatSBRSts 15;
BA_ "GenSigTimeoutTime_BCM" SG_ 1826 OCMPsgSeatSBRSts 0;
BA_ "GenSigTimeoutTime_BSM2" SG_ 1826 OCMPsgSeatSBRSts 0;
BA_ "GenSigTimeoutTime_CADM2" SG_ 1826 OCMPsgSeatSBRSts 0;
BA_ "GenSigTimeoutTime_CVADAS" SG_ 1826 OCMPsgSeatSBRSts 0;
BA_ "GenSigTimeoutTime_EPS" SG_ 1826 OCMPsgSeatSBRSts 0;
BA_ "GenSigTimeoutTime_PAM" SG_ 1826 OCMPsgSeatSBRSts 0;
BA_ "GenSigTimeoutTime_SGW" SG_ 1826 OCMPsgSeatSBRSts 0;
BA_ "GenSigTimeoutTime_TRSKM" SG_ 1826 OCMPsgSeatSBRSts 0;
BA_ "GenSigTimeoutTime_BCM" SG_ 1826 PsgSeatOCFaultSts 0;
BA_ "GenSigTimeoutTime_BSM2" SG_ 1826 PsgSeatOCFaultSts 0;
BA_ "GenSigTimeoutTime_CADM2" SG_ 1826 PsgSeatOCFaultSts 0;
BA_ "GenSigTimeoutTime_CVADAS" SG_ 1826 PsgSeatOCFaultSts 0;
BA_ "GenSigTimeoutTime_EPS" SG_ 1826 PsgSeatOCFaultSts 0;
BA_ "GenSigTimeoutTime_PAM" SG_ 1826 PsgSeatOCFaultSts 0;
BA_ "GenSigTimeoutTime_SGW" SG_ 1826 PsgSeatOCFaultSts 0;
BA_ "GenSigTimeoutTime_TRSKM" SG_ 1826 PsgSeatOCFaultSts 0;
BA_ "GenSigStartValue" SG_ 1826 PsgSeatOCSts 15;
BA_ "GenSigTimeoutTime_BCM" SG_ 1826 PsgSeatOCSts 0;
BA_ "GenSigTimeoutTime_BSM2" SG_ 1826 PsgSeatOCSts 0;
BA_ "GenSigTimeoutTime_CADM2" SG_ 1826 PsgSeatOCSts 0;
BA_ "GenSigTimeoutTime_CVADAS" SG_ 1826 PsgSeatOCSts 0;
BA_ "GenSigTimeoutTime_EPS" SG_ 1826 PsgSeatOCSts 0;
BA_ "GenSigTimeoutTime_PAM" SG_ 1826 PsgSeatOCSts 0;
BA_ "GenSigTimeoutTime_TRSKM" SG_ 1826 PsgSeatOCSts 0;
BA_ "GenSigTimeoutTime_BCM" SG_ 602 CRC_BCM22 0;
BA_ "GenSigTimeoutTime_BSM2" SG_ 602 CRC_BCM22 0;
BA_ "GenSigTimeoutTime_CVADAS" SG_ 602 CRC_BCM22 0;
BA_ "GenSigTimeoutTime_EPS" SG_ 602 CRC_BCM22 0;
BA_ "GenSigTimeoutTime_ORC" SG_ 602 CRC_BCM22 0;
BA_ "GenSigTimeoutTime_PAM" SG_ 602 CRC_BCM22 0;
BA_ "GenSigTimeoutTime_SGW" SG_ 602 CRC_BCM22 0;
BA_ "GenSigTimeoutTime_TRSKM" SG_ 602 CRC_BCM22 0;
BA_ "GenSigTimeoutTime_BCM" SG_ 602 MessageCounter_BCM22 0;
BA_ "GenSigTimeoutTime_BSM2" SG_ 602 MessageCounter_BCM22 0;
BA_ "GenSigTimeoutTime_CVADAS" SG_ 602 MessageCounter_BCM22 0;
BA_ "GenSigTimeoutTime_EPS" SG_ 602 MessageCounter_BCM22 0;
BA_ "GenSigTimeoutTime_ORC" SG_ 602 MessageCounter_BCM22 0;
BA_ "GenSigTimeoutTime_PAM" SG_ 602 MessageCounter_BCM22 0;
BA_ "GenSigTimeoutTime_SGW" SG_ 602 MessageCounter_BCM22 0;
BA_ "GenSigTimeoutTime_TRSKM" SG_ 602 MessageCounter_BCM22 0;
BA_ "GenSigSendType" SG_ 602 TurnLeverLatched 3;
BA_ "GenSigTimeoutTime_BCM" SG_ 602 TurnLeverLatched 0;
BA_ "GenSigTimeoutTime_BSM2" SG_ 602 TurnLeverLatched 0;
BA_ "GenSigTimeoutTime_CVADAS" SG_ 602 TurnLeverLatched 0;
BA_ "GenSigTimeoutTime_EPS" SG_ 602 TurnLeverLatched 0;
BA_ "GenSigTimeoutTime_ORC" SG_ 602 TurnLeverLatched 0;
BA_ "GenSigTimeoutTime_PAM" SG_ 602 TurnLeverLatched 0;
BA_ "GenSigTimeoutTime_SGW" SG_ 602 TurnLeverLatched 0;
BA_ "GenSigTimeoutTime_TRSKM" SG_ 602 TurnLeverLatched 0;
BA_ "GenSigSendType" SG_ 1434 BCM_AUX1_HLEnbl 3;
BA_ "GenSigTimeoutTime_BCM" SG_ 1434 BCM_AUX1_HLEnbl 0;
BA_ "GenSigTimeoutTime_BSM2" SG_ 1434 BCM_AUX1_HLEnbl 0;
BA_ "GenSigTimeoutTime_CADM2" SG_ 1434 BCM_AUX1_HLEnbl 0;
BA_ "GenSigTimeoutTime_CVADAS" SG_ 1434 BCM_AUX1_HLEnbl 0;
BA_ "GenSigTimeoutTime_EPS" SG_ 1434 BCM_AUX1_HLEnbl 0;
BA_ "GenSigTimeoutTime_ORC" SG_ 1434 BCM_AUX1_HLEnbl 0;
BA_ "GenSigTimeoutTime_PAM" SG_ 1434 BCM_AUX1_HLEnbl 0;
BA_ "GenSigTimeoutTime_SGW" SG_ 1434 BCM_AUX1_HLEnbl 0;
BA_ "GenSigTimeoutTime_TRSKM" SG_ 1434 BCM_AUX1_HLEnbl 0;
BA_ "GenSigSendType" SG_ 1434 BCM_AUX1_PWRMD 3;
BA_ "GenSigTimeoutTime_BCM" SG_ 1434 BCM_AUX1_PWRMD 0;
BA_ "GenSigTimeoutTime_BSM2" SG_ 1434 BCM_AUX1_PWRMD 0;
BA_ "GenSigTimeoutTime_CADM2" SG_ 1434 BCM_AUX1_PWRMD 0;
BA_ "GenSigTimeoutTime_CVADAS" SG_ 1434 BCM_AUX1_PWRMD 0;
BA_ "GenSigTimeoutTime_EPS" SG_ 1434 BCM_AUX1_PWRMD 0;
BA_ "GenSigTimeoutTime_ORC" SG_ 1434 BCM_AUX1_PWRMD 0;
BA_ "GenSigTimeoutTime_PAM" SG_ 1434 BCM_AUX1_PWRMD 0;
BA_ "GenSigTimeoutTime_SGW" SG_ 1434 BCM_AUX1_PWRMD 0;
BA_ "GenSigTimeoutTime_TRSKM" SG_ 1434 BCM_AUX1_PWRMD 0;
BA_ "GenSigSendType" SG_ 1434 BCM_AUX1_Type 3;
BA_ "GenSigTimeoutTime_BCM" SG_ 1434 BCM_AUX1_Type 0;
BA_ "GenSigTimeoutTime_BSM2" SG_ 1434 BCM_AUX1_Type 0;
BA_ "GenSigTimeoutTime_CADM2" SG_ 1434 BCM_AUX1_Type 0;
BA_ "GenSigTimeoutTime_CVADAS" SG_ 1434 BCM_AUX1_Type 0;
BA_ "GenSigTimeoutTime_EPS" SG_ 1434 BCM_AUX1_Type 0;
BA_ "GenSigTimeoutTime_ORC" SG_ 1434 BCM_AUX1_Type 0;
BA_ "GenSigTimeoutTime_PAM" SG_ 1434 BCM_AUX1_Type 0;
BA_ "GenSigTimeoutTime_SGW" SG_ 1434 BCM_AUX1_Type 0;
BA_ "GenSigTimeoutTime_TRSKM" SG_ 1434 BCM_AUX1_Type 0;
BA_ "GenSigSendType" SG_ 1434 BCM_AUX2_HLEnbl 3;
BA_ "GenSigTimeoutTime_BCM" SG_ 1434 BCM_AUX2_HLEnbl 0;
BA_ "GenSigTimeoutTime_BSM2" SG_ 1434 BCM_AUX2_HLEnbl 0;
BA_ "GenSigTimeoutTime_CADM2" SG_ 1434 BCM_AUX2_HLEnbl 0;
BA_ "GenSigTimeoutTime_CVADAS" SG_ 1434 BCM_AUX2_HLEnbl 0;
BA_ "GenSigTimeoutTime_EPS" SG_ 1434 BCM_AUX2_HLEnbl 0;
BA_ "GenSigTimeoutTime_ORC" SG_ 1434 BCM_AUX2_HLEnbl 0;
BA_ "GenSigTimeoutTime_PAM" SG_ 1434 BCM_AUX2_HLEnbl 0;
BA_ "GenSigTimeoutTime_SGW" SG_ 1434 BCM_AUX2_HLEnbl 0;
BA_ "GenSigTimeoutTime_TRSKM" SG_ 1434 BCM_AUX2_HLEnbl 0;
BA_ "GenSigSendType" SG_ 1434 BCM_AUX2_PWRMD 3;
BA_ "GenSigTimeoutTime_BCM" SG_ 1434 BCM_AUX2_PWRMD 0;
BA_ "GenSigTimeoutTime_BSM2" SG_ 1434 BCM_AUX2_PWRMD 0;
BA_ "GenSigTimeoutTime_CADM2" SG_ 1434 BCM_AUX2_PWRMD 0;
BA_ "GenSigTimeoutTime_CVADAS" SG_ 1434 BCM_AUX2_PWRMD 0;
BA_ "GenSigTimeoutTime_EPS" SG_ 1434 BCM_AUX2_PWRMD 0;
BA_ "GenSigTimeoutTime_ORC" SG_ 1434 BCM_AUX2_PWRMD 0;
BA_ "GenSigTimeoutTime_PAM" SG_ 1434 BCM_AUX2_PWRMD 0;
BA_ "GenSigTimeoutTime_SGW" SG_ 1434 BCM_AUX2_PWRMD 0;
BA_ "GenSigTimeoutTime_TRSKM" SG_ 1434 BCM_AUX2_PWRMD 0;
BA_ "GenSigSendType" SG_ 1434 BCM_AUX2_Type 3;
BA_ "GenSigTimeoutTime_BCM" SG_ 1434 BCM_AUX2_Type 0;
BA_ "GenSigTimeoutTime_BSM2" SG_ 1434 BCM_AUX2_Type 0;
BA_ "GenSigTimeoutTime_CADM2" SG_ 1434 BCM_AUX2_Type 0;
BA_ "GenSigTimeoutTime_CVADAS" SG_ 1434 BCM_AUX2_Type 0;
BA_ "GenSigTimeoutTime_EPS" SG_ 1434 BCM_AUX2_Type 0;
BA_ "GenSigTimeoutTime_ORC" SG_ 1434 BCM_AUX2_Type 0;
BA_ "GenSigTimeoutTime_PAM" SG_ 1434 BCM_AUX2_Type 0;
BA_ "GenSigTimeoutTime_SGW" SG_ 1434 BCM_AUX2_Type 0;
BA_ "GenSigTimeoutTime_TRSKM" SG_ 1434 BCM_AUX2_Type 0;
BA_ "GenSigSendType" SG_ 1434 BCM_AUX3_HLEnbl 3;
BA_ "GenSigTimeoutTime_BCM" SG_ 1434 BCM_AUX3_HLEnbl 0;
BA_ "GenSigTimeoutTime_BSM2" SG_ 1434 BCM_AUX3_HLEnbl 0;
BA_ "GenSigTimeoutTime_CADM2" SG_ 1434 BCM_AUX3_HLEnbl 0;
BA_ "GenSigTimeoutTime_CVADAS" SG_ 1434 BCM_AUX3_HLEnbl 0;
BA_ "GenSigTimeoutTime_EPS" SG_ 1434 BCM_AUX3_HLEnbl 0;
BA_ "GenSigTimeoutTime_ORC" SG_ 1434 BCM_AUX3_HLEnbl 0;
BA_ "GenSigTimeoutTime_PAM" SG_ 1434 BCM_AUX3_HLEnbl 0;
BA_ "GenSigTimeoutTime_SGW" SG_ 1434 BCM_AUX3_HLEnbl 0;
BA_ "GenSigTimeoutTime_TRSKM" SG_ 1434 BCM_AUX3_HLEnbl 0;
BA_ "GenSigSendType" SG_ 1434 BCM_AUX3_PWRMD 3;
BA_ "GenSigTimeoutTime_BCM" SG_ 1434 BCM_AUX3_PWRMD 0;
BA_ "GenSigTimeoutTime_BSM2" SG_ 1434 BCM_AUX3_PWRMD 0;
BA_ "GenSigTimeoutTime_CADM2" SG_ 1434 BCM_AUX3_PWRMD 0;
BA_ "GenSigTimeoutTime_CVADAS" SG_ 1434 BCM_AUX3_PWRMD 0;
BA_ "GenSigTimeoutTime_EPS" SG_ 1434 BCM_AUX3_PWRMD 0;
BA_ "GenSigTimeoutTime_ORC" SG_ 1434 BCM_AUX3_PWRMD 0;
BA_ "GenSigTimeoutTime_PAM" SG_ 1434 BCM_AUX3_PWRMD 0;
BA_ "GenSigTimeoutTime_SGW" SG_ 1434 BCM_AUX3_PWRMD 0;
BA_ "GenSigTimeoutTime_TRSKM" SG_ 1434 BCM_AUX3_PWRMD 0;
BA_ "GenSigSendType" SG_ 1434 BCM_AUX3_Type 3;
BA_ "GenSigTimeoutTime_BCM" SG_ 1434 BCM_AUX3_Type 0;
BA_ "GenSigTimeoutTime_BSM2" SG_ 1434 BCM_AUX3_Type 0;
BA_ "GenSigTimeoutTime_CADM2" SG_ 1434 BCM_AUX3_Type 0;
BA_ "GenSigTimeoutTime_CVADAS" SG_ 1434 BCM_AUX3_Type 0;
BA_ "GenSigTimeoutTime_EPS" SG_ 1434 BCM_AUX3_Type 0;
BA_ "GenSigTimeoutTime_ORC" SG_ 1434 BCM_AUX3_Type 0;
BA_ "GenSigTimeoutTime_PAM" SG_ 1434 BCM_AUX3_Type 0;
BA_ "GenSigTimeoutTime_SGW" SG_ 1434 BCM_AUX3_Type 0;
BA_ "GenSigTimeoutTime_TRSKM" SG_ 1434 BCM_AUX3_Type 0;
BA_ "GenSigSendType" SG_ 1434 BCM_AUX4_HLEnbl 3;
BA_ "GenSigTimeoutTime_BCM" SG_ 1434 BCM_AUX4_HLEnbl 0;
BA_ "GenSigTimeoutTime_BSM2" SG_ 1434 BCM_AUX4_HLEnbl 0;
BA_ "GenSigTimeoutTime_CADM2" SG_ 1434 BCM_AUX4_HLEnbl 0;
BA_ "GenSigTimeoutTime_CVADAS" SG_ 1434 BCM_AUX4_HLEnbl 0;
BA_ "GenSigTimeoutTime_EPS" SG_ 1434 BCM_AUX4_HLEnbl 0;
BA_ "GenSigTimeoutTime_ORC" SG_ 1434 BCM_AUX4_HLEnbl 0;
BA_ "GenSigTimeoutTime_PAM" SG_ 1434 BCM_AUX4_HLEnbl 0;
BA_ "GenSigTimeoutTime_SGW" SG_ 1434 BCM_AUX4_HLEnbl 0;
BA_ "GenSigTimeoutTime_TRSKM" SG_ 1434 BCM_AUX4_HLEnbl 0;
BA_ "GenSigSendType" SG_ 1434 BCM_AUX4_PWRMD 3;
BA_ "GenSigTimeoutTime_BCM" SG_ 1434 BCM_AUX4_PWRMD 0;
BA_ "GenSigTimeoutTime_BSM2" SG_ 1434 BCM_AUX4_PWRMD 0;
BA_ "GenSigTimeoutTime_CADM2" SG_ 1434 BCM_AUX4_PWRMD 0;
BA_ "GenSigTimeoutTime_CVADAS" SG_ 1434 BCM_AUX4_PWRMD 0;
BA_ "GenSigTimeoutTime_EPS" SG_ 1434 BCM_AUX4_PWRMD 0;
BA_ "GenSigTimeoutTime_ORC" SG_ 1434 BCM_AUX4_PWRMD 0;
BA_ "GenSigTimeoutTime_PAM" SG_ 1434 BCM_AUX4_PWRMD 0;
BA_ "GenSigTimeoutTime_SGW" SG_ 1434 BCM_AUX4_PWRMD 0;
BA_ "GenSigTimeoutTime_TRSKM" SG_ 1434 BCM_AUX4_PWRMD 0;
BA_ "GenSigSendType" SG_ 1434 BCM_AUX4_Type 3;
BA_ "GenSigTimeoutTime_BCM" SG_ 1434 BCM_AUX4_Type 0;
BA_ "GenSigTimeoutTime_BSM2" SG_ 1434 BCM_AUX4_Type 0;
BA_ "GenSigTimeoutTime_CADM2" SG_ 1434 BCM_AUX4_Type 0;
BA_ "GenSigTimeoutTime_CVADAS" SG_ 1434 BCM_AUX4_Type 0;
BA_ "GenSigTimeoutTime_EPS" SG_ 1434 BCM_AUX4_Type 0;
BA_ "GenSigTimeoutTime_ORC" SG_ 1434 BCM_AUX4_Type 0;
BA_ "GenSigTimeoutTime_PAM" SG_ 1434 BCM_AUX4_Type 0;
BA_ "GenSigTimeoutTime_SGW" SG_ 1434 BCM_AUX4_Type 0;
BA_ "GenSigTimeoutTime_TRSKM" SG_ 1434 BCM_AUX4_Type 0;
BA_ "GenSigSendType" SG_ 1434 BCM_AUX5_HLEnbl 3;
BA_ "GenSigTimeoutTime_BCM" SG_ 1434 BCM_AUX5_HLEnbl 0;
BA_ "GenSigTimeoutTime_BSM2" SG_ 1434 BCM_AUX5_HLEnbl 0;
BA_ "GenSigTimeoutTime_CADM2" SG_ 1434 BCM_AUX5_HLEnbl 0;
BA_ "GenSigTimeoutTime_CVADAS" SG_ 1434 BCM_AUX5_HLEnbl 0;
BA_ "GenSigTimeoutTime_EPS" SG_ 1434 BCM_AUX5_HLEnbl 0;
BA_ "GenSigTimeoutTime_ORC" SG_ 1434 BCM_AUX5_HLEnbl 0;
BA_ "GenSigTimeoutTime_PAM" SG_ 1434 BCM_AUX5_HLEnbl 0;
BA_ "GenSigTimeoutTime_SGW" SG_ 1434 BCM_AUX5_HLEnbl 0;
BA_ "GenSigTimeoutTime_TRSKM" SG_ 1434 BCM_AUX5_HLEnbl 0;
BA_ "GenSigSendType" SG_ 1434 BCM_AUX5_PWRMD 3;
BA_ "GenSigTimeoutTime_BCM" SG_ 1434 BCM_AUX5_PWRMD 0;
BA_ "GenSigTimeoutTime_BSM2" SG_ 1434 BCM_AUX5_PWRMD 0;
BA_ "GenSigTimeoutTime_CADM2" SG_ 1434 BCM_AUX5_PWRMD 0;
BA_ "GenSigTimeoutTime_CVADAS" SG_ 1434 BCM_AUX5_PWRMD 0;
BA_ "GenSigTimeoutTime_EPS" SG_ 1434 BCM_AUX5_PWRMD 0;
BA_ "GenSigTimeoutTime_ORC" SG_ 1434 BCM_AUX5_PWRMD 0;
BA_ "GenSigTimeoutTime_PAM" SG_ 1434 BCM_AUX5_PWRMD 0;
BA_ "GenSigTimeoutTime_SGW" SG_ 1434 BCM_AUX5_PWRMD 0;
BA_ "GenSigTimeoutTime_TRSKM" SG_ 1434 BCM_AUX5_PWRMD 0;
BA_ "GenSigSendType" SG_ 1434 BCM_AUX5_Type 3;
BA_ "GenSigTimeoutTime_BCM" SG_ 1434 BCM_AUX5_Type 0;
BA_ "GenSigTimeoutTime_BSM2" SG_ 1434 BCM_AUX5_Type 0;
BA_ "GenSigTimeoutTime_CADM2" SG_ 1434 BCM_AUX5_Type 0;
BA_ "GenSigTimeoutTime_CVADAS" SG_ 1434 BCM_AUX5_Type 0;
BA_ "GenSigTimeoutTime_EPS" SG_ 1434 BCM_AUX5_Type 0;
BA_ "GenSigTimeoutTime_ORC" SG_ 1434 BCM_AUX5_Type 0;
BA_ "GenSigTimeoutTime_PAM" SG_ 1434 BCM_AUX5_Type 0;
BA_ "GenSigTimeoutTime_SGW" SG_ 1434 BCM_AUX5_Type 0;
BA_ "GenSigTimeoutTime_TRSKM" SG_ 1434 BCM_AUX5_Type 0;
BA_ "GenSigSendType" SG_ 1434 BCM_AUX6_HLEnbl 3;
BA_ "GenSigTimeoutTime_BCM" SG_ 1434 BCM_AUX6_HLEnbl 0;
BA_ "GenSigTimeoutTime_BSM2" SG_ 1434 BCM_AUX6_HLEnbl 0;
BA_ "GenSigTimeoutTime_CADM2" SG_ 1434 BCM_AUX6_HLEnbl 0;
BA_ "GenSigTimeoutTime_CVADAS" SG_ 1434 BCM_AUX6_HLEnbl 0;
BA_ "GenSigTimeoutTime_EPS" SG_ 1434 BCM_AUX6_HLEnbl 0;
BA_ "GenSigTimeoutTime_ORC" SG_ 1434 BCM_AUX6_HLEnbl 0;
BA_ "GenSigTimeoutTime_PAM" SG_ 1434 BCM_AUX6_HLEnbl 0;
BA_ "GenSigTimeoutTime_SGW" SG_ 1434 BCM_AUX6_HLEnbl 0;
BA_ "GenSigTimeoutTime_TRSKM" SG_ 1434 BCM_AUX6_HLEnbl 0;
BA_ "GenSigSendType" SG_ 1434 BCM_AUX6_PWRMD 3;
BA_ "GenSigTimeoutTime_BCM" SG_ 1434 BCM_AUX6_PWRMD 0;
BA_ "GenSigTimeoutTime_BSM2" SG_ 1434 BCM_AUX6_PWRMD 0;
BA_ "GenSigTimeoutTime_CADM2" SG_ 1434 BCM_AUX6_PWRMD 0;
BA_ "GenSigTimeoutTime_CVADAS" SG_ 1434 BCM_AUX6_PWRMD 0;
BA_ "GenSigTimeoutTime_EPS" SG_ 1434 BCM_AUX6_PWRMD 0;
BA_ "GenSigTimeoutTime_ORC" SG_ 1434 BCM_AUX6_PWRMD 0;
BA_ "GenSigTimeoutTime_PAM" SG_ 1434 BCM_AUX6_PWRMD 0;
BA_ "GenSigTimeoutTime_SGW" SG_ 1434 BCM_AUX6_PWRMD 0;
BA_ "GenSigTimeoutTime_TRSKM" SG_ 1434 BCM_AUX6_PWRMD 0;
BA_ "GenSigSendType" SG_ 1434 BCM_AUX6_Type 3;
BA_ "GenSigTimeoutTime_BCM" SG_ 1434 BCM_AUX6_Type 0;
BA_ "GenSigTimeoutTime_BSM2" SG_ 1434 BCM_AUX6_Type 0;
BA_ "GenSigTimeoutTime_CADM2" SG_ 1434 BCM_AUX6_Type 0;
BA_ "GenSigTimeoutTime_CVADAS" SG_ 1434 BCM_AUX6_Type 0;
BA_ "GenSigTimeoutTime_EPS" SG_ 1434 BCM_AUX6_Type 0;
BA_ "GenSigTimeoutTime_ORC" SG_ 1434 BCM_AUX6_Type 0;
BA_ "GenSigTimeoutTime_PAM" SG_ 1434 BCM_AUX6_Type 0;
BA_ "GenSigTimeoutTime_SGW" SG_ 1434 BCM_AUX6_Type 0;
BA_ "GenSigTimeoutTime_TRSKM" SG_ 1434 BCM_AUX6_Type 0;
BA_ "GenSigStartValue" SG_ 1434 Cfg_Aux_PTO 7;
BA_ "GenSigSendType" SG_ 1434 Cfg_Aux_PTO 3;
BA_ "GenSigTimeoutTime_BCM" SG_ 1434 Cfg_Aux_PTO 0;
BA_ "GenSigTimeoutTime_BSM2" SG_ 1434 Cfg_Aux_PTO 0;
BA_ "GenSigTimeoutTime_CADM2" SG_ 1434 Cfg_Aux_PTO 0;
BA_ "GenSigTimeoutTime_CVADAS" SG_ 1434 Cfg_Aux_PTO 0;
BA_ "GenSigTimeoutTime_EPS" SG_ 1434 Cfg_Aux_PTO 0;
BA_ "GenSigTimeoutTime_ORC" SG_ 1434 Cfg_Aux_PTO 0;
BA_ "GenSigTimeoutTime_PAM" SG_ 1434 Cfg_Aux_PTO 0;
BA_ "GenSigTimeoutTime_SGW" SG_ 1434 Cfg_Aux_PTO 0;
BA_ "GenSigTimeoutTime_TRSKM" SG_ 1434 Cfg_Aux_PTO 0;
BA_ "GenSigTimeoutTime_BCM" SG_ 1069 FronWasherSts 0;
BA_ "GenSigTimeoutTime_BSM2" SG_ 1069 FronWasherSts 0;
BA_ "GenSigTimeoutTime_CADM2" SG_ 1069 FronWasherSts 0;
BA_ "GenSigTimeoutTime_CVADAS" SG_ 1069 FronWasherSts 0;
BA_ "GenSigTimeoutTime_EPS" SG_ 1069 FronWasherSts 0;
BA_ "GenSigTimeoutTime_ORC" SG_ 1069 FronWasherSts 0;
BA_ "GenSigTimeoutTime_PAM" SG_ 1069 FronWasherSts 0;
BA_ "GenSigTimeoutTime_SGW" SG_ 1069 FronWasherSts 0;
BA_ "GenSigTimeoutTime_TRSKM" SG_ 1069 FronWasherSts 0;
BA_ "GenSigSendType" SG_ 1435 ADS_MODE_REQ 3;
BA_ "GenSigTimeoutTime_BCM" SG_ 1435 ADS_MODE_REQ 0;
BA_ "GenSigTimeoutTime_BSM2" SG_ 1435 ADS_MODE_REQ 0;
BA_ "GenSigTimeoutTime_CADM2" SG_ 1435 ADS_MODE_REQ 0;
BA_ "GenSigTimeoutTime_CVADAS" SG_ 1435 ADS_MODE_REQ 0;
BA_ "GenSigTimeoutTime_EPS" SG_ 1435 ADS_MODE_REQ 0;
BA_ "GenSigTimeoutTime_PAM" SG_ 1435 ADS_MODE_REQ 0;
BA_ "GenSigTimeoutTime_TRSKM" SG_ 1435 ADS_MODE_REQ 0;
BA_ "GenSigTimeoutTime_BCM" SG_ 1435 CRC_BCM26 0;
BA_ "GenSigTimeoutTime_BSM2" SG_ 1435 CRC_BCM26 0;
BA_ "GenSigTimeoutTime_CADM2" SG_ 1435 CRC_BCM26 0;
BA_ "GenSigTimeoutTime_CVADAS" SG_ 1435 CRC_BCM26 0;
BA_ "GenSigTimeoutTime_EPS" SG_ 1435 CRC_BCM26 0;
BA_ "GenSigTimeoutTime_ORC" SG_ 1435 CRC_BCM26 0;
BA_ "GenSigTimeoutTime_PAM" SG_ 1435 CRC_BCM26 0;
BA_ "GenSigTimeoutTime_SGW" SG_ 1435 CRC_BCM26 0;
BA_ "GenSigTimeoutTime_TRSKM" SG_ 1435 CRC_BCM26 0;
BA_ "GenSigSendType" SG_ 1435 HAS_OnOffSts 3;
BA_ "GenSigTimeoutTime_BCM" SG_ 1435 HAS_OnOffSts 0;
BA_ "GenSigTimeoutTime_BSM2" SG_ 1435 HAS_OnOffSts 0;
BA_ "GenSigTimeoutTime_CVADAS" SG_ 1435 HAS_OnOffSts 0;
BA_ "GenSigTimeoutTime_EPS" SG_ 1435 HAS_OnOffSts 0;
BA_ "GenSigTimeoutTime_ORC" SG_ 1435 HAS_OnOffSts 0;
BA_ "GenSigTimeoutTime_PAM" SG_ 1435 HAS_OnOffSts 0;
BA_ "GenSigTimeoutTime_SGW" SG_ 1435 HAS_OnOffSts 0;
BA_ "GenSigTimeoutTime_TRSKM" SG_ 1435 HAS_OnOffSts 0;
BA_ "GenSigTimeoutTime_BCM" SG_ 1435 MessageCounter_BCM26 0;
BA_ "GenSigTimeoutTime_BSM2" SG_ 1435 MessageCounter_BCM26 0;
BA_ "GenSigTimeoutTime_CADM2" SG_ 1435 MessageCounter_BCM26 0;
BA_ "GenSigTimeoutTime_CVADAS" SG_ 1435 MessageCounter_BCM26 0;
BA_ "GenSigTimeoutTime_EPS" SG_ 1435 MessageCounter_BCM26 0;
BA_ "GenSigTimeoutTime_ORC" SG_ 1435 MessageCounter_BCM26 0;
BA_ "GenSigTimeoutTime_PAM" SG_ 1435 MessageCounter_BCM26 0;
BA_ "GenSigTimeoutTime_SGW" SG_ 1435 MessageCounter_BCM26 0;
BA_ "GenSigTimeoutTime_TRSKM" SG_ 1435 MessageCounter_BCM26 0;
BA_ "GenSigSendType" SG_ 1436 Comfort_Enable_Act 3;
BA_ "GenSigTimeoutTime_BCM" SG_ 1436 Comfort_Enable_Act 0;
BA_ "GenSigTimeoutTime_BSM2" SG_ 1436 Comfort_Enable_Act 0;
BA_ "GenSigTimeoutTime_CADM2" SG_ 1436 Comfort_Enable_Act 0;
BA_ "GenSigTimeoutTime_CVADAS" SG_ 1436 Comfort_Enable_Act 0;
BA_ "GenSigTimeoutTime_EPS" SG_ 1436 Comfort_Enable_Act 0;
BA_ "GenSigTimeoutTime_ORC" SG_ 1436 Comfort_Enable_Act 0;
BA_ "GenSigTimeoutTime_PAM" SG_ 1436 Comfort_Enable_Act 0;
BA_ "GenSigTimeoutTime_SGW" SG_ 1436 Comfort_Enable_Act 0;
BA_ "GenSigTimeoutTime_TRSKM" SG_ 1436 Comfort_Enable_Act 0;
BA_ "GenSigStartValue" SG_ 1436 Comfort_Enable_Time 65535;
BA_ "GenSigSendType" SG_ 1436 Comfort_Enable_Time 3;
BA_ "GenSigTimeoutTime_BCM" SG_ 1436 Comfort_Enable_Time 0;
BA_ "GenSigTimeoutTime_BSM2" SG_ 1436 Comfort_Enable_Time 0;
BA_ "GenSigTimeoutTime_CADM2" SG_ 1436 Comfort_Enable_Time 0;
BA_ "GenSigTimeoutTime_CVADAS" SG_ 1436 Comfort_Enable_Time 0;
BA_ "GenSigTimeoutTime_EPS" SG_ 1436 Comfort_Enable_Time 0;
BA_ "GenSigTimeoutTime_ORC" SG_ 1436 Comfort_Enable_Time 0;
BA_ "GenSigTimeoutTime_PAM" SG_ 1436 Comfort_Enable_Time 0;
BA_ "GenSigTimeoutTime_SGW" SG_ 1436 Comfort_Enable_Time 0;
BA_ "GenSigTimeoutTime_TRSKM" SG_ 1436 Comfort_Enable_Time 0;
BA_ "GenSigTimeoutTime_BCM" SG_ 1436 CRC_BCM27 0;
BA_ "GenSigTimeoutTime_BSM2" SG_ 1436 CRC_BCM27 0;
BA_ "GenSigTimeoutTime_CADM2" SG_ 1436 CRC_BCM27 0;
BA_ "GenSigTimeoutTime_EPS" SG_ 1436 CRC_BCM27 0;
BA_ "GenSigTimeoutTime_ORC" SG_ 1436 CRC_BCM27 0;
BA_ "GenSigTimeoutTime_PAM" SG_ 1436 CRC_BCM27 0;
BA_ "GenSigTimeoutTime_SGW" SG_ 1436 CRC_BCM27 0;
BA_ "GenSigTimeoutTime_TRSKM" SG_ 1436 CRC_BCM27 0;
BA_ "GenSigTimeoutTime_BCM" SG_ 1436 MessageCounter_BCM27 0;
BA_ "GenSigTimeoutTime_BSM2" SG_ 1436 MessageCounter_BCM27 0;
BA_ "GenSigTimeoutTime_CADM2" SG_ 1436 MessageCounter_BCM27 0;
BA_ "GenSigTimeoutTime_EPS" SG_ 1436 MessageCounter_BCM27 0;
BA_ "GenSigTimeoutTime_ORC" SG_ 1436 MessageCounter_BCM27 0;
BA_ "GenSigTimeoutTime_PAM" SG_ 1436 MessageCounter_BCM27 0;
BA_ "GenSigTimeoutTime_SGW" SG_ 1436 MessageCounter_BCM27 0;
BA_ "GenSigTimeoutTime_TRSKM" SG_ 1436 MessageCounter_BCM27 0;
BA_ "GenSigTimeoutTime_BCM" SG_ 1436 TrailerConnectionSts 0;
BA_ "GenSigTimeoutTime_BSM2" SG_ 1436 TrailerConnectionSts 0;
BA_ "GenSigTimeoutTime_CADM2" SG_ 1436 TrailerConnectionSts 0;
BA_ "GenSigTimeoutTime_EPS" SG_ 1436 TrailerConnectionSts 0;
BA_ "GenSigTimeoutTime_ORC" SG_ 1436 TrailerConnectionSts 0;
BA_ "GenSigTimeoutTime_SGW" SG_ 1436 TrailerConnectionSts 0;
BA_ "GenSigTimeoutTime_TRSKM" SG_ 1436 TrailerConnectionSts 0;
BA_ "GenSigTimeoutTime_BCM" SG_ 1470 CRC_BCM29 0;
BA_ "GenSigTimeoutTime_BSM2" SG_ 1470 CRC_BCM29 0;
BA_ "GenSigTimeoutTime_CADM2" SG_ 1470 CRC_BCM29 0;
BA_ "GenSigTimeoutTime_EPS" SG_ 1470 CRC_BCM29 0;
BA_ "GenSigTimeoutTime_ORC" SG_ 1470 CRC_BCM29 0;
BA_ "GenSigTimeoutTime_PAM" SG_ 1470 CRC_BCM29 0;
BA_ "GenSigTimeoutTime_SGW" SG_ 1470 CRC_BCM29 0;
BA_ "GenSigTimeoutTime_TRSKM" SG_ 1470 CRC_BCM29 0;
BA_ "GenSigSendType" SG_ 1470 ITBM_TrlrStat 3;
BA_ "GenSigTimeoutTime_BCM" SG_ 1470 ITBM_TrlrStat 0;
BA_ "GenSigTimeoutTime_BSM2" SG_ 1470 ITBM_TrlrStat 0;
BA_ "GenSigTimeoutTime_CADM2" SG_ 1470 ITBM_TrlrStat 0;
BA_ "GenSigTimeoutTime_EPS" SG_ 1470 ITBM_TrlrStat 0;
BA_ "GenSigTimeoutTime_ORC" SG_ 1470 ITBM_TrlrStat 0;
BA_ "GenSigTimeoutTime_SGW" SG_ 1470 ITBM_TrlrStat 0;
BA_ "GenSigTimeoutTime_TRSKM" SG_ 1470 ITBM_TrlrStat 0;
BA_ "GenSigTimeoutTime_BCM" SG_ 1470 MessageCounter_BCM29 0;
BA_ "GenSigTimeoutTime_BSM2" SG_ 1470 MessageCounter_BCM29 0;
BA_ "GenSigTimeoutTime_CADM2" SG_ 1470 MessageCounter_BCM29 0;
BA_ "GenSigTimeoutTime_EPS" SG_ 1470 MessageCounter_BCM29 0;
BA_ "GenSigTimeoutTime_ORC" SG_ 1470 MessageCounter_BCM29 0;
BA_ "GenSigTimeoutTime_PAM" SG_ 1470 MessageCounter_BCM29 0;
BA_ "GenSigTimeoutTime_SGW" SG_ 1470 MessageCounter_BCM29 0;
BA_ "GenSigTimeoutTime_TRSKM" SG_ 1470 MessageCounter_BCM29 0;
BA_ "GenSigTimeoutTime_BCM" SG_ 750 Battery_Volt_1 0;
BA_ "GenSigTimeoutTime_SGW" SG_ 750 Battery_Volt_1 0;
BA_ "GenSigTimeoutTime_BCM" SG_ 750 Battery_Volt_2 0;
BA_ "GenSigTimeoutTime_BSM2" SG_ 750 Battery_Volt_2 0;
BA_ "GenSigTimeoutTime_CVADAS" SG_ 750 Battery_Volt_2 0;
BA_ "GenSigTimeoutTime_EPS" SG_ 750 Battery_Volt_2 0;
BA_ "GenSigTimeoutTime_ORC" SG_ 750 Battery_Volt_2 0;
BA_ "GenSigTimeoutTime_PAM" SG_ 750 Battery_Volt_2 0;
BA_ "GenSigTimeoutTime_SGW" SG_ 750 Battery_Volt_2 0;
BA_ "GenSigTimeoutTime_TRSKM" SG_ 750 Battery_Volt_2 0;
BA_ "GenSigTimeoutTime_BCM" SG_ 750 CRC_BCM3 0;
BA_ "GenSigTimeoutTime_CADM2" SG_ 750 CRC_BCM3 0;
BA_ "GenSigTimeoutTime_CVADAS" SG_ 750 CRC_BCM3 0;
BA_ "GenSigTimeoutTime_EPS" SG_ 750 CRC_BCM3 0;
BA_ "GenSigTimeoutTime_ORC" SG_ 750 CRC_BCM3 0;
BA_ "GenSigTimeoutTime_PAM" SG_ 750 CRC_BCM3 0;
BA_ "GenSigTimeoutTime_SGW" SG_ 750 CRC_BCM3 0;
BA_ "GenSigTimeoutTime_TRSKM" SG_ 750 CRC_BCM3 0;
BA_ "GenSigTimeoutTime_BCM" SG_ 750 FronWiperFailSts 0;
BA_ "GenSigTimeoutTime_BSM2" SG_ 750 FronWiperFailSts 0;
BA_ "GenSigTimeoutTime_CADM2" SG_ 750 FronWiperFailSts 0;
BA_ "GenSigTimeoutTime_CVADAS" SG_ 750 FronWiperFailSts 0;
BA_ "GenSigTimeoutTime_EPS" SG_ 750 FronWiperFailSts 0;
BA_ "GenSigTimeoutTime_ORC" SG_ 750 FronWiperFailSts 0;
BA_ "GenSigTimeoutTime_PAM" SG_ 750 FronWiperFailSts 0;
BA_ "GenSigTimeoutTime_SGW" SG_ 750 FronWiperFailSts 0;
BA_ "GenSigTimeoutTime_TRSKM" SG_ 750 FronWiperFailSts 0;
BA_ "GenSigTimeoutTime_BCM" SG_ 750 MessageCounter_BCM3 0;
BA_ "GenSigTimeoutTime_CADM2" SG_ 750 MessageCounter_BCM3 0;
BA_ "GenSigTimeoutTime_CVADAS" SG_ 750 MessageCounter_BCM3 0;
BA_ "GenSigTimeoutTime_EPS" SG_ 750 MessageCounter_BCM3 0;
BA_ "GenSigTimeoutTime_ORC" SG_ 750 MessageCounter_BCM3 0;
BA_ "GenSigTimeoutTime_PAM" SG_ 750 MessageCounter_BCM3 0;
BA_ "GenSigTimeoutTime_SGW" SG_ 750 MessageCounter_BCM3 0;
BA_ "GenSigTimeoutTime_TRSKM" SG_ 750 MessageCounter_BCM3 0;
BA_ "NodeLayerModules" BU_ BCM "CANoeILNLVector.dll,AsrNM33.dll";
BA_ "NodeLayerModules" BU_ BSM2 "CANoeILNLVector.dll,AsrNM33.dll";
BA_ "NodeLayerModules" BU_ CADM2 "CANoeILNLVector.dll,AsrNM33.dll";
BA_ "NodeLayerModules" BU_ CVADAS "CANoeILNLVector.dll,AsrNM33.dll";
BA_ "NodeLayerModules" BU_ EPS "CANoeILNLVector.dll,AsrNM33.dll";
BA_ "NodeLayerModules" BU_ ORC "CANoeILNLVector.dll,AsrNM33.dll";
BA_ "NodeLayerModules" BU_ SGW "CANoeILNLVector.dll,AsrNM33.dll";
BA_ "NodeLayerModules" BU_ TRSKM "CANoeILNLVector.dll,AsrNM33.dll";
VAL_ 1458 ACC_DispPopupSts_C2 0 "No_Code" 1 "ACC_Unavailable" 2 "ACC_Unavailable_4WD_Low" 3 "ACC_Unavailable_ESC_Off" 4 "ACC_Unavailable_ESC_Event" 5 "ACC_Unavailable_Brakes_Cooling" 6 "ACC_Unavailable_Below_Min_Speed" 7 "ACC_Unavailable_Above_Max_Speed" 8 "ACC_Unavailable_EPB_Active" 9 "ACC_Unavailable_Shift_D" 10 "ACC_Unavailable_Door_Open" 11 "ACC_Unavailable_Seatbelt_Unbuckled" 12 "ACC_Unavailable_Road_to_Steep" 13 "ACC_Unavailable_Wrong_Gear" 14 "ACC_Unavailable_Low_RPM" 15 "ACC_Unavailable_High_RPM" 16 "ACC_Unavailable_Clutch_Engaged" 17 "ACC_Cancel" 18 "ACC_AEB_Cancel_ESC_Off" 19 "ACC_Cancel_ESC_Off" 20 "ACC_Cancel_ESC_Event" 21 "ACC_Cancel_Brakes_Cooling" 22 "ACC_Cancel_Below_Min_Speed" 23 "ACC_Cancel_Above_Max_Speed" 24 "ACC_Cancel_EPB_Active" 25 "ACC_Cancel_Shift_D" 26 "ACC_Cancel_Door_Open" 27 "ACC_Cancel_Seatbelt_Unbuckled" 28 "ACC_Cancel_Road_to_Steep" 29 "ACC_Cancel_Wrong_gear" 30 "ACC_Cancel_Low_RPM" 31 "ACC_Cancel_High_RPM" 32 "ACC_Stop_Vehicle_Object_Detected" 33 "ACC_Warning_Clutch_Engaged" 34 "ACC_Warning_Neutral_Engaged" 35 "ACC_Off_ESC_Fault" 36 "ACC_Proximity_Warning" 37 "NCC_Unavailable" 38 "NCC_Unavailable_4WD_Low" 39 "NCC_Unavailable_ESC_Off" 40 "NCC_Unavailable_ESC_Event" 41 "NCC_Unavailable_Brakes_Cooling" 42 "NCC_Unavailable_Below_Min_Speed" 43 "NCC_Unavailable_Above_Max_Speed" 44 "NCC_Unavailable_EPB_Active" 45 "NCC_Unavailable_Shift_D" 46 "NCC_Unavailable_Wrong_Gear" 47 "NCC_Unavailable_Low_RPM" 48 "NCC_Unavailable_High_RPM" 49 "NCC_Unavailable_Clutch_Engaged" 50 "NCC_Cancel" 51 "NCC_AEB_Cancel_ESC_Off" 52 "NCC_Cancel_ESC_Off" 53 "NCC_Cancel_ESC_Event" 54 "NCC_Cancel_Brakes_Cooling" 55 "NCC_Cancel_Below_Min_Speed" 56 "NCC_Cancel_Above_Max_Speed" 57 "NCC_Cancel_EPB_Active" 58 "NCC_Cancel_Shift_D" 59 "NCC_Cancel_Wrong_Gear" 60 "NCC_Cancel_Low_RPM" 61 "NCC_Cancel_High_RPM" 62 "NCC_Warning_Clutch_Engaged" 63 "NCC_Warning_Neutral_Engaged" 64 "ACC_User_Enabled_D1" 65 "ACC_User_Enabled_D2" 66 "ACC_User_Enabled_D3" 67 "ACC_User_Enabled_D4" 68 "ACC_Set_D1_Target" 69 "ACC_Set_D2_Target" 70 "ACC_Set_D3_Target" 71 "ACC_Set_D4_Target" 72 "ACC_Set_D1_No_Target" 73 "ACC_Set_D2_No_Target" 74 "ACC_Set_D3_No_Target" 75 "ACC_Set_D4_No_Target" 76 "ACC_Override" 77 "ACC_User_Disabled" 78 "NCC_User_Enabled" 79 "NCC_Set" 80 "NCC_User_Disbaled" 81 "NCC_Override" 82 "Front_Radar_Sensor_Plant_Mode" 83 "ACC_AEB_LKA_Cam_Blind" 84 "ACC_AEB_Cam_Blind" 85 "ACC_LKA_Cam_Blind" 86 "ACC_Cam_Blind" 87 "ACC_AEB_LKA_LIMITED_Fail" 88 "ACC_AEB_LIMITED_Fail" 89 "ACC_LKA_LIMITED_Fail" 90 "ACC_LIMITED_Fail" 91 "ACC_AEB_Radar_Blind" 92 "ACC_Radar_Blind" 93 "ACC_AEB_LKA_Fail" 94 "ACC_AEB_Fail" 95 "ACC_LKA_Fail" 96 "ACC_Fail" 97 "NCC_AEB_LKA_Fail" 98 "NCC_AEB_Fail" 99 "NCC_LKA_Fail" 100 "NCC_Fail" ;
VAL_ 1458 ACC_FailSts_C2 0 "Fail_Not_Present" 1 "Fail_Present" ;
VAL_ 1458 AEB_DispPopupSts_C2 0 "No_Code" 1 "Pre_Intervention_Warning" 4 "Braking_Complete" 5 "AEB_Unavailble_ESC_Off" 6 "AEB_Unavailble_4WD_Low" 7 "Active_Braking_Enabled" 8 "Active_Braking_Disabled" 9 "AEB_User_Disabled" 10 "AEB_Radar_Blind" 11 "Not_used1" 12 "AEB_Fail" 13 "Not_used2" 14 "AEB_Cam_Blind" 15 "Not_used3" 16 "AEB_LIMITED_Fail" 17 "PEB_Off" 18 "PEB_On" 19 "PEB_Radar_Blind" 20 "PEB_Fail" 21 "PEB_Cam_Blind" 22 "FCW_Limited_PEB_Off_Camera_Blinded" 23 "FCW_Limited_PEB_Off_Camera_Fail" 24 "Pre_Intervention_Warning_ICA_L" 25 "Pre_Intervention_Warning_ICA_R" ;
VAL_ 1458 Chime_Priority_C2 0 "A" 1 "B" 2 "C" 3 "D" 4 "E" ;
VAL_ 1458 Chime_TypSts_C2 0 "Default" 1 "Chime 1" 2 "Chime 2" 3 "Chime 3" 4 "Chime 4" 5 "Chime 5" 6 "Chime 6" 7 "Chime 7" 8 "Chime 8" 9 "Chime 9" 10 "Chime 10" ;
VAL_ 1458 DisplaySts_ACC_C2 0 "Off" 1 "Ready_TG1" 2 "Ready_TG2" 3 "Ready_TG3" 4 "Ready_TG4" 5 "ACC_E_NT_TG1" 6 "ACC_E_NT_TG2" 7 "ACC_E_NT_TG3" 8 "ACC_E_NT_TG4" 9 "ACC_E_WT_TG1" 10 "ACC_E_WT_TG2" 11 "ACC_E_WT_TG3" 12 "ACC_E_WT_TG4" 13 "NCC_Ready" 14 "NCC_Engaged" ;
VAL_ 1458 DisplaySts_OFF_C2 0 "No_Code" 1 "ACC_LKA_HAS" 2 "ACC_LKA" 3 "ACC_HAS" 4 "ACC" 5 "LKA" ;
VAL_ 1458 DisplaySts_Veh_C2 0 "Off" 1 "Center_White" 2 "Center_Green" 3 "Right_Crossing_1" 4 "Left_Crossing_1" 5 "Right_Crossing_2" 6 "Left_Crossing_2" ;
VAL_ 1458 HAS_Escalation_Sts_C2 0 "No_State" 1 "State0" 2 "State1" 3 "State2" 4 "State3a" 5 "State3b" 6 "State4a" 7 "State4b" 8 "State5" ;
VAL_ 1458 HAS_Hazard_C2 0 "No_Request" 1 "Request" ;
VAL_ 1458 HAS_TelltaleSts_C2 0 "OFF" 1 "GREY" 2 "GREEN" 3 "YELLOW" 4 "RED" 7 "SNA" ;
VAL_ 1458 Lane_DisplaySts_Left_C2 0 "Off" 1 "Gray" 2 "Green" 3 "Yellow" 4 "Yellow_Flashing" 5 "Red" 6 "Dashed" ;
VAL_ 1458 Lane_DisplaySts_Right_C2 0 "Off" 1 "Gray" 2 "Green" 3 "Yellow" 4 "Yellow_Flashing" 5 "Red" 6 "Dashed" ;
VAL_ 1458 Lane_DispPopupSts_C2 0 "No_Code" 1 "LKA_On" 2 "LKA_Off" 3 "LKA_Hands_Off" 4 "HAS_Eyes_Off_Yellow" 5 "Take_Control_Red" 6 "HAS_Ready_Highway" 7 "Blind_Spot_OFF" 8 "HAS_Ready_ACC_Set" 9 "HAS_Unavailable_Speed_to_High" 10 "HAS_Unavailable_Trailer" 11 "HAS_Unavailable_TempNAP" 12 "HAS_Cancel_FOW" 13 "HAS_Cancel_Lane" 15 "HAS_Cancel_Curve" 16 "Unsupport_Lane_Ahead_Take_Control" 17 "MRM_In_Prog" 18 "MRM_Complete" 19 "HAS_Unavail_Lane" 20 "HAS_Hands_Off_Yellow" 21 "HAS_Hands_Off_Red" 22 "HAS_Cancel_Hands_Off" 23 "HAS_AEB_LKA_Cam_Blind" 24 "HAS_AEB_Cam_Blind" 25 "HAS_LKA_Cam_Blind" 26 "HAS_Cam_Blind" 27 "LKA_AEB_Cam_Blind" 28 "LKA_Cam_Blind" 29 "HAS_AEB_Radar_Blind" 30 "HAS_Radar_Blind" 31 "HAS_AEB_LKA_LIMITED_Fail" 32 "HAS_AEB_LIMITED_Fail" 33 "LKA_AEB_LIMITED_Fail" 34 "HAS_AEB_LKA_Fail" 35 "HAS_AEB_Fail" 36 "HAS_LKA_Fail" 37 "HAS_Fail" 38 "LKA_AEB_Fail" 39 "LKA_Fail" 40 "HAS_Cancel" 42 "HAS_ON" 43 "HAS_OFF" 44 "BSS_Blind_ALM_On" 45 "BSS_Blind_ALM_Off" 46 "BSS_OPR_ALM_Off" 47 "BSS_OPR_ALM_On" 48 "BSS_SRV_ALM_Off" 49 "BSS_SRV_ALM_On" 50 "HAS_Unavail_Road_Data" 51 "HAS_Unavail_No_Eyes_On" 52 "HAS_Unavail_Map_OOD" 53 "HAS_Unavail_Locked_Out" 54 "HAS_Cancel_Road_Data" 55 "HAS_Cancel_Driver_Not_Attent" 56 "HAS_Cancel_Brake_Event" 57 "HAS_Cancel_Speed_Too_High" 58 "HAS_Cancel_5" ;
VAL_ 1458 LF_Chime_RqSts_C2 0 "No_Request" 1 "Request" ;
VAL_ 1458 LR_Chime_RqSts_C2 0 "No_left_rear_chime_on_req" 1 "Left_rear_chime_on_req" ;
VAL_ 1458 RF_Chime_RqSts_C2 0 "No_Request" 1 "Request" ;
VAL_ 1458 RR_Chime_RqSts_C2 0 "No_rght_rear_chime_on_req" 1 "Right_rear_chime_on_req" ;
VAL_ 1458 Set_Speed_KPH_C2 255 "SNA" ;
VAL_ 1458 Set_Speed_MPH_C2 255 "SNA" ;
VAL_ 1458 SVI_Request_C2 0 "OFF" 1 "Green" 2 "YELLOW" 3 "Red" ;
VAL_ 280 HAS_Status 0 "Disabled" 1 "Enabled" 2 "Engaged" 3 "Faulted" ;
VAL_ 281 ACC_Systemsts_C2 0 "OFF" 1 "ACC_Enabled" 2 "ACC_Engaged" 3 "ACC_Engaged_BrakeOnly" 4 "ACC_Cancel" 5 "NCC_Enabled" 6 "NCC_Engaged" 7 "NCC_Cancel" 8 "HAS_BSoC" 15 "SNA" ;
VAL_ 281 AEB_Type_C2 0 "NONE" 1 "ACC" 2 "CMS" 3 "CMS_XTD" 4 "ABA" 5 "LSCM" 6 "PEB" 7 "ICA_L" 8 "ICA_R" 9 "HAS_MRM" 15 "SNA" ;
VAL_ 281 CADM_EPSADAS_FAIL 0 "False" 1 "True" ;
VAL_ 281 CADM2_Mode 0 "Gate" 1 "Control" ;
VAL_ 281 CADM2_OpStat 0 "Inactive" 1 "FullService" 2 "FailOperational" 3 "FailDegraded" 4 "Emergency" 5 "No_Function" ;
VAL_ 281 ESCALATION_TYPE_C2 0 "None" 1 "Driver_Inattention" 2 "Low_Urgency" 3 "Med_Urgency" 4 "High_Urgency" ;
VAL_ 281 HAS_LAT_CTRL_RequestSts_C2 0 "Idle" 1 "Faulted" 2 "HAS_Request" ;
VAL_ 281 HAS_OpStat_Sec 0 "Inactive" 1 "FullService" 2 "FailOperational" 3 "FailDegraded" 4 "Emergency" 5 "No_Function" ;
VAL_ 281 HAS_Status_C2 0 "Disabled" 1 "Enabled" 2 "Engaged" 3 "Faulted" ;
VAL_ 281 HIS_Req_C2 0 "Not_Active" 1 "Active" ;
VAL_ 281 Intervention_C2 4095 "SNA" ;
VAL_ 281 MRM_STATUS_C2 0 "Not_Active" 1 "MRM_in_Process" 2 "Vehicle_Secure_Request" 3 "Vehicle_Securement_Complete" 4 "Canceled" 7 "SNA" ;
VAL_ 613 DALM_Request_C2 0 "No_Req" 1 "Yellow_Solid" 2 "Yellow_Runway" 3 "Red_Solid" 4 "Red_Runway" 5 "Blue_Solid" 6 "Blue_Runway" 7 "Green_Solid" 15 "SNA" ;
VAL_ 613 HAS_OpStat_Sec_DALM 0 "Inactive" 1 "FullService" 2 "FailOperational" 3 "FailDegraded" 4 "Emergency" 5 "No_Function" ;
VAL_ 613 HAS_Status_C2_DALM 0 "Disabled" 1 "Enabled" 2 "Engaged" 3 "Faulted" ;
VAL_ 730 Camera_Status 0 "None_Active" 1 "Left_Right_Front" 2 "Left_Right" 3 "Left_Front" 4 "Right_Front" 5 "Front" 6 "Left" 7 "Right" ;
VAL_ 730 FOD_Confidence 0 "Not_Detected" 1 "Detected_Low_Confidence" 2 "Detected_Medium_Confidence" 3 "Detected_High_Confidence" ;
VAL_ 730 Health_Front_Object_Detection 0 "Faulted" 1 "Blocked" 2 "Unknown" 3 "Healthy" ;
VAL_ 730 Health_Lane_Detection 0 "Faulted" 1 "Blocked" 2 "Unknown" 3 "Healthy" ;
VAL_ 730 Line_1_Type 0 "None" 1 "Solid" 2 "Dashed" 3 "Double" 4 "Road_edge" 5 "Botts_Dotts" 6 "Barrier" ;
VAL_ 730 Line_2_Type 0 "None" 1 "Solid" 2 "Dashed" 3 "Double" 4 "Road_edge" 5 "Botts_Dotts" 6 "Barrier" ;
VAL_ 730 Line_3_Type 0 "None" 1 "Solid" 2 "Dashed" 3 "Double" 4 "Road_edge" 5 "Botts_Dotts" 6 "Barrier" ;
VAL_ 730 Line_4_Type 0 "None" 1 "Solid" 2 "Dashed" 3 "Double" 4 "Road_edge" 5 "Botts_Dotts" 6 "Barrier" ;
VAL_ 476 Shifter_ADAS_Inhibit 0 "Faulted" 1 "Available" ;
VAL_ 476 ShiftLeverPositionReq 0 "No_Selection_Active_Or_Available" 1 "P" 2 "R" 3 "N" 4 "D" 5 "L" 6 "TIP_Autostick" 7 "Plus" 8 "Minus" 9 "Sport" 10 "Not_Used" 11 "Not_Used" 12 "Not_Used" 13 "Not_Used" 14 "Not_Used" 15 "SNA" ;
VAL_ 1327 FL_Lvl 254 "NOT_INIT" 255 "SNA" ;
VAL_ 1327 FL_Lvl_Adj 1 "Adjusting" ;
VAL_ 1327 FR_Lvl 254 "NOT_INIT" 255 "SNA" ;
VAL_ 1327 FR_Lvl_Adj 1 "Adjusting" ;
VAL_ 1327 RL_Lvl 254 "NOT_INIT" 255 "SNA" ;
VAL_ 1327 RL_Lvl_Adj 1 "Adjusting" ;
VAL_ 1327 RR_Lvl 254 "NOT_INIT" 255 "SNA" ;
VAL_ 1327 RR_Lvl_Adj 1 "Adjusting" ;
VAL_ 1445 ADC_Stat_2 0 "MODE_1" 1 "MODE_2" 2 "MODE_3" 3 "MODE_4" 4 "MODE_4" 5 "MODE_5" 6 "MODE_6" 7 "SNA" ;
VAL_ 1445 ASCM_Srv 0 "FALSE" 1 "TRUE" ;
VAL_ 1445 ASCM_Stat 0 "NONE" 1 "DUMP" 2 "PARK" 3 "AERO" 4 "NVL" 5 "OR1" 6 "ORL2" 7 "Lifter" 8 "RAISE" 9 "LOWER" 10 "SYSFAIL" 11 "SRVS" 12 "AERO2" 15 "SNA" ;
VAL_ 1445 ASCM_StatDisp 0 "NONE" 1 "DUMP" 2 "PARK" 3 "AERO" 4 "NVL" 5 "OR1" 6 "ORL2" 7 "Lifter" 8 "RAISE" 9 "LOWER" 10 "BDL" 11 "AERO2" 12 "AUTOMATIC_LEVEL_ONLY" 15 "SNA" ;
VAL_ 1445 ASCM_SysFail 0 "FALSE" 1 "TRUE" ;
VAL_ 204 Axle_Torque_DrvReqMod 65535 "SNA" ;
VAL_ 204 Axle_TorqueStatic_D_TTC 65535 "SNA" ;
VAL_ 1153 BSS_LT_Blind_RQSts 0 "No Sensor Blocked Request" 1 "Sensor Blocked Request" ;
VAL_ 1153 BSS_LT_CFG_STATSts 0 "Not_enabled" 1 "Enabled_for_LED" 2 "Enabled_for_LED_and_Chime" 3 "SNA" ;
VAL_ 1153 BSS_LT_SRV_RQSts 0 "No Service Request" 1 "Service Request" ;
VAL_ 1153 BSS_RT_Blind_RQSts 0 "No Sensor Blocked Request" 1 "Sensor Blocked Request" ;
VAL_ 1153 BSS_RT_CFG_STATSts 0 "Not_enabled" 1 "Enabled_for_LED" 2 "Enabled_for_LED_and_Chime" 3 "SNA" ;
VAL_ 1153 BSS_RT_SRV_RQSts 0 "No Service Request" 1 "Service Request" ;
VAL_ 1153 CmdIgnSts 0 "Initialization" 1 "IGN_LK" 3 "ACC" 4 "RUN" 5 "START" 7 "SNA" ;
VAL_ 1153 DAY_LGT_MD 0 "Night" 1 "Day" ;
VAL_ 1153 ExternalTemperatureC 511 "SNA" ;
VAL_ 1153 ExternalTemperatureF 511 "SNA" ;
VAL_ 1153 PANEL_INTS 255 "SNA" ;
VAL_ 1153 StTypSts 0 "ST_NOT_ACT" 1 "NOR_ST" 2 "TIP_ST" 3 "REM_ST" 7 "SNA" ;
VAL_ 1153 TurnIndicationSts 0 "Center" 1 "Right" 2 "Left" 3 "SNA" ;
VAL_ 1153 WPR_SYS_AUTO 0 "SNA" ;
VAL_ 1430 EngineOffTimer 4095 "SNA" ;
VAL_ 1431 AirTemp_Outsd 255 "SNA" ;
VAL_ 1431 APARequestSts 0 "Not_Pressed" 1 "Pressed" ;
VAL_ 1431 DALM_Status 0 "No_Fault" 1 "Fault" ;
VAL_ 1431 EPS_MODE_REQ 0 "DEFAULT" 1 "DM1" 2 "DM2" 3 "DM3" 4 "MODE_1" 5 "MODE_2" 6 "MODE_3" 7 "SNA" ;
VAL_ 1431 FT_PAMRequestSts 0 "Not_Pressed" 1 "Pressed" ;
VAL_ 1431 IGN_OFF_TIME_LNG 4095 "SNA" ;
VAL_ 1431 PAMRequestSts 0 "Not_Pressed" 1 "Pressed" ;
VAL_ 1431 SeatVib_Sts 0 "INIT" 1 "IDLE" 2 "ACTIVE" 3 "FAULTED" ;
VAL_ 159 ACC_DistSwDec 0 "Not_Active" 1 "Active" ;
VAL_ 159 ACC_DistSwInc 0 "Not_Active" 1 "Active" ;
VAL_ 159 ACC_On 0 "Not_Active" 1 "Active" ;
VAL_ 159 AcceleratorSts 0 "Not_Active" 1 "Active" ;
VAL_ 159 CruiseControlFailSts 0 "Fail_Not_Present" 1 "Fail_Present" ;
VAL_ 159 CruiseControlOnOffSts 0 "Not_Active" 1 "Active" ;
VAL_ 159 CrusCnclSwitch 0 "Not_Active" 1 "Active" ;
VAL_ 159 DeceleratorSts 0 "Not_Active" 1 "Active" ;
VAL_ 159 ResumeSwitch 0 "Not_Active" 1 "Active" ;
VAL_ 736 Command_01Sts 0 "Not_Pressed" 1 "Pressed" 3 "SNA" ;
VAL_ 736 Command_02Sts 0 "Not_Pressed" 1 "Pressed" 3 "SNA" ;
VAL_ 736 Command_03Sts 0 "Not_Pressed" 1 "Pressed" 3 "SNA" ;
VAL_ 736 Command_04Sts 0 "Not_Pressed" 1 "Pressed" 3 "SNA" ;
VAL_ 736 Command_05Sts 0 "Not_Pressed" 1 "Pressed" 3 "SNA" ;
VAL_ 736 Command_06Sts 0 "Not_Pressed" 1 "Pressed" 3 "SNA" ;
VAL_ 736 Command_07Sts 0 "Not_Pressed" 1 "Pressed" 3 "SNA" ;
VAL_ 736 Command_08Sts 0 "Not_Pressed" 1 "Pressed" 3 "SNA" ;
VAL_ 736 Command_09Sts 0 "Not_Pressed" 1 "Pressed" 3 "SNA" ;
VAL_ 736 Command_10Sts 0 "Not_Pressed" 1 "Pressed" 3 "SNA" ;
VAL_ 736 Command_11Sts 0 "Not_Pressed" 1 "Pressed" 3 "SNA" ;
VAL_ 736 Command_12Sts 0 "Not_Pressed" 1 "Pressed" 3 "SNA" ;
VAL_ 736 Command_13Sts 0 "Not_Pressed" 1 "Pressed" 3 "SNA" ;
VAL_ 736 Command_14Sts 0 "Not_Pressed" 1 "Pressed" 3 "SNA" ;
VAL_ 736 Command_15Sts 0 "Not_Pressed" 1 "Pressed" 3 "SNA" ;
VAL_ 256 KeyInIgnSts 0 "KEY_DEF" 1 "KEY_NOT_IN_IGN" 2 "KEY_IN_IGN" 3 "SNA" ;
VAL_ 256 OperationalModeSts 0 "Initialization" 1 "Ignition_Off_WithoutKey" 2 "Ignition_Off" 3 "Ignition_Acc" 4 "Ignition_On" 5 "Ignition_Pre_Start" 6 "Ignition_Start" 7 "Ignition_Cranking" 8 "Ignition_On_EngOn" 9 "Ignition_Pre_Acc" 10 "Ignition_Pre_Off" 11 "Automatic_Cranking" 12 "Automatic_Stop" 13 "Key_Authenticated" 14 "Not_Used" 15 "SNA" ;
VAL_ 256 RemStActvSts 0 "Remote Start Not Active" 1 "Remote Start Active" ;
VAL_ 256 TurnIndicatorSts 0 "Center" 1 "Right" 2 "Left" 3 "SNA" ;
VAL_ 1826 OCMPsgSeatSBRSts 0 "EMPTY_RFIS" 1 "OC_5TH_UP" 2 "Not_Used" 3 "Not_Used" 4 "Not_Used" 5 "Not_Used" 6 "Not_Used" 7 "Not_Used" 8 "Not_Used" 9 "Not_Used" 10 "Not_Used" 11 "Not_Used" 12 "Not_Used" 13 "Not_Used" 14 "Not_Used" 15 "OC_UNDETRMD" ;
VAL_ 1826 PsgSeatOCFaultSts 0 "No_Fault_Present" 1 "Fault_Present" ;
VAL_ 1826 PsgSeatOCSts 0 "EMPTY_RFIS" 1 "OC_5TH_UP" 2 "Not_Used" 3 "Empty no_Light" 4 "OC_5TH_Down" 5 "Not_Used" 6 "Not_Used" 7 "Not_Used" 8 "Not_Used" 9 "Not_Used" 10 "Not_Used" 11 "Not_Used" 12 "Not_Used" 13 "Not_Used" 14 "Not_Used" 15 "OC_UNDETRMD" ;
VAL_ 602 TurnLeverLatched 0 "Not Set" 1 "Set" ;
VAL_ 1434 BCM_AUX1_HLEnbl 1 "Enabled" ;
VAL_ 1434 BCM_AUX1_PWRMD 0 "Ignition" 1 "Battery" ;
VAL_ 1434 BCM_AUX1_Type 0 "Latching" 1 "Momentary" ;
VAL_ 1434 BCM_AUX2_HLEnbl 1 "Enabled" ;
VAL_ 1434 BCM_AUX2_PWRMD 0 "Ignition" 1 "Battery" ;
VAL_ 1434 BCM_AUX2_Type 0 "Latching" 1 "Momentary" ;
VAL_ 1434 BCM_AUX3_HLEnbl 1 "Enabled" ;
VAL_ 1434 BCM_AUX3_PWRMD 0 "Ignition" 1 "Battery" ;
VAL_ 1434 BCM_AUX3_Type 0 "Latching" 1 "Momentary" ;
VAL_ 1434 BCM_AUX4_HLEnbl 1 "Enabled" ;
VAL_ 1434 BCM_AUX4_PWRMD 0 "Ignition" 1 "Battery" ;
VAL_ 1434 BCM_AUX4_Type 0 "Latching" 1 "Momentary" ;
VAL_ 1434 BCM_AUX5_HLEnbl 1 "Enabled" ;
VAL_ 1434 BCM_AUX5_PWRMD 0 "Ignition" 1 "Battery" ;
VAL_ 1434 BCM_AUX5_Type 0 "Latching" 1 "Momentary" ;
VAL_ 1434 BCM_AUX6_HLEnbl 1 "Enabled" ;
VAL_ 1434 BCM_AUX6_PWRMD 0 "Ignition" 1 "Battery" ;
VAL_ 1434 BCM_AUX6_Type 0 "Latching" 1 "Momentary" ;
VAL_ 1434 Cfg_Aux_PTO 0 "NONE" 3 "FOUR_CUTOFF" 4 "FOUR" 5 "FIVE" 6 "SIX" 7 "SNA" ;
VAL_ 1069 FronWasherSts 0 "None" 1 "Wash Request" ;
VAL_ 1435 ADS_MODE_REQ 0 "DEFAULT" 1 "DM1" 2 "DM2" 3 "DM3" 4 "MODE_1" 5 "MODE_2" 6 "MODE_3" 7 "SNA" ;
VAL_ 1435 HAS_OnOffSts 0 "Not_Pressed" 1 "Pressed" ;
VAL_ 1436 Comfort_Enable_Act 0 "Not_Active" 1 "Active" ;
VAL_ 1436 Comfort_Enable_Time 65535 "SNA" ;
VAL_ 1436 TrailerConnectionSts 0 "Not_Connected" 1 "Connected" 2 "Not_Used" 3 "SNA" ;
VAL_ 1470 ITBM_TrlrStat 0 "NO_TRLR" 1 "TRLR_PRSNT" 2 "TRLR_DCONN" 3 "SNA" ;
VAL_ 750 Battery_Volt_1 511 "SNA" ;
VAL_ 750 Battery_Volt_2 511 "SNA" ;
VAL_ 750 FronWiperFailSts 0 "Wiper system Fault Not Present" 1 "Wiper system Fault Present" ;
