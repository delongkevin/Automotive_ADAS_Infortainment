;;;;;;;;;;;;;;;;;;;;;;;;;;;;;;;;;;;;;;;;;;;;;;;;;;;;;;;;;;;;;;;;;;;;;;;;;;;;;;
; Basic CR5 connect for J721S2/TDA4VL
; 13 Oct 21 - Richard Woodruff - Adapt J7ES for J721S2.
;;;;;;;;;;;;;;;;;;;;;;;;;;;;;;;;;;;;;;;;;;;;;;;;;;;;;;;;;;;;;;;;;;;;;;;;;;;;;;
; INPUT PARMS: (R5-MCU, R5-MAIN0, R5-MAIN1) + (SMP, AMP1, AMP2)
;   {default=R5-MCU,AMP1}
; note: when setting lockstep AMP1 should be used 

 LOCAL &WDG_BASE
 &WDG_BASE=0x43936000
 ;GOSUB WATCHDOG_DISABLE
 
 LOCAL &emulation
 &emulation="no"
 
 LOCAL &debug
 &debug="no"

 RESet
 SYStem.RESet
 area.create A000 100 1000
 area

 IF COMBIPROBE()||UTRACE()
    SYStem.CONFIG.CONNECTOR MIPI34 ; because of converter LA-3782

; CM4 (2x1)  : J721S2-CM4-0 J721S2-CM4-1
; A72 (1x2)  : J721S2 (core.assign 1 2)
; CR5 (3x2)  : J721S2-CR5-MCU J721S2-CR5-MAIN0 J721S2-CR5-MAIN1 (core.assign 1 2)
; C7x (2x1)  : J721S2-C71X (core.assign 1 2)

 ; Script parameters: clust, SMP or AMPx operation
 PRIVATE &parameters
 ENTRY %LINE &parameters
 &parameters=STRing.UPpeR("&parameters")

 LOCAL &param_core &param_smp &subnum &corenum

 &param_core=STRing.SCANAndExtract("&parameters","R5-","")
 IF "&param_core"=="MAIN0"
 (
    &corenum=7.
    SYStem.CPU J721S2-CR5-MAIN0
 )
 ELSE IF "&param_core"=="MAIN1"
 (
    &corenum=9.
    SYStem.CPU J721S2-CR5-MAIN1
 )
 ELSE
 (
    &corenum=5.
    SYStem.CPU J721S2-CR5-MCU
 )

 &param_smp=(STRing.SCAN("&parameters","SMP",0)!=-1)
 IF !&param_smp
 (
   &param_core=STRing.SCANAndExtract("&parameters","AMP","")
   IF ("&param_core"=="")
     &subnum=1
   ELSE 
     &subnum=&param_core
 )

 IF &param_smp
    SYStem.CONFIG CORE &corenum 1.
 ELSE
    SYStem.CONFIG CORE (&corenum+&subnum-1) 1.

 IF "&emulation"=="yes"
 (
  System.CONFIG DEBUGTIMESCALE 32.
  System.Option MemStatusCheck ON
  SYStem.POLLING OFF
  setup.urate 2500.ms           ; slow window updates, this can be bigger
  SYStem.polling slow           ; sparse pinging
  SYStem.JTAGCLOCK rtck 100Khz
 )
 ELSE
  system.JTAGCLOCK CTCK 25MHz

 SYStem.Option RESBREAK OFF
 SYStem.Option EnReset OFF

 IF &param_smp
     core.assign 1 2
 ELSE
   core.assign (&subnum)

 SYStem.MemAccess.DAP
 SYStem.Option.imaskasm.on
 SYStem.Option.IMASKHLL.ON

 TPIU.PortMode.Continuous
 IF !SIMULATOR()
 (
   trace.method onchip
   trace.TraceCONNECT.tbr3
   onchip.off
 )
 break.select program onchip
 break.select read onchip
 break.select write onchip

 SYStem.Mode Attach
 
 IF "&debug"=="yes"
 (
 ;TI PDK path
 &ti_path="C:\prjtools\ti-psdk-rtos-j721s2-08_05_00_11\pdk_j721s2_08_05_00_36\packages\ti"
 ;HS boot
 ;Data.LOAD.Elf &ti_path\boot\sbl\binary\j721s2_hyd_hs\mmcsd\bin\sbl_mmcsd_img_mcu1_0_release.xer5f /NoCODE
 ;Data.LOAD.Elf &ti_path\boot\sbl\binary\j721s2_hyd_hs\qspi\bin\sbl_qspi_img_mcu1_0_release.xer5f /NoCODE
 Data.LOAD.Elf &ti_path\boot\sbl\binary\j721s2_hyd_hs\ospi\bin\sbl_ospi_img_mcu1_0_release.xer5f /NoCODE
 ;No HS boot
 ;Data.LOAD.Elf &ti_path\boot\sbl\binary\j721s2_hyd\mmcsd\bin\sbl_mmcsd_img_mcu1_0_release.xer5f /NoCODE
 ;Data.LOAD.Elf &ti_path\boot\sbl\binary\j721s2_hyd\qspi\bin\sbl_qspi_img_mcu1_0_release.xer5f /NoCODE

 sYmbol.SourcePATH.SetRecurseDir &ti_path
 )

 Break

ENDDO

WATCHDOG_DISABLE:
(
//Fill in if >3min burn time needed
Data.Set EZAXI:&WDG_BASE+0x20 %LE %Long 0x4658fc21
Data.Set EZAXI:&WDG_BASE+0x24 %LE %Long 0x3ac4f102
Data.Set EZAXI:&WDG_BASE+0x50 %LE %Long 0xa
Data.Set EZAXI:&WDG_BASE+0x20 %LE %Long 0x0
Data.Set EZAXI:&WDG_BASE+0x24 %LE %Long 0x0

RETURN
)