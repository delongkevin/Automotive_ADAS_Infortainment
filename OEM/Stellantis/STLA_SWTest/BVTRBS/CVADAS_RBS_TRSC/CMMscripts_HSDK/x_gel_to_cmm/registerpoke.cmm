LOCAL &function &args
ENTRY &function %LINE &args

GLOBAL &path_registerpoke_cmm
&path_registerpoke_cmm=OS.PPF()
IF "&function"!=""
(
	GOSUB &function &args
)
ELSE
(
	GOSUB __GeL_MeNu_CrEaTe
)
ENDDO

__GeL_MeNu_CrEaTe:
(
	MENU.ReProgram
	(
		ADD
		MENU
		(
			POPUP "GEL"
			(
				POPUP "read-write register"
				(
					MENUITEM "read_32b_value_32b_address" 
					(
						DO "&path_registerpoke_cmm" read_32b_value_32b_address_dialog
					)
					MENUITEM "write_32b_value_32b_address" 
					(
						DO "&path_registerpoke_cmm" write_32b_value_32b_address_dialog
					)
				)
			)
		)
	)
	RETURN
)

read_32b_value_32b_address_dialog:
(
	LOCAL &address
	&address=0
	DIALOG
	(
		HEADER "read_32b_value_32b_address"
		POS 0. 0. 11.
		TEXT "Address: "
		POS 11. 0. 10.
		EDIT "" "&address=*"
		POS 0. 1. 21.
		BUTTON "Execute" 
		(
			DO &path_registerpoke_cmm read_32b_value_32b_address &address
		)
	)
	RETURN
)

read_32b_value_32b_address:
(
	ENTRY &__VF0
	
	Var.NEW unsigned long long \address
	VAR.ASSIGN \address=&__VF0
	
	
	Var.NEW unsigned int * \p_address
	Var.Assign \p_address=((unsigned int *)\address)
	AREA.Select
	PRINT "Address " %HEX Var.VALUE(\address) ":      " %HEX Var.VALUE(*\p_address) ""
	PRINT ""
	RETURN
)

write_32b_value_32b_address_dialog:
(
	LOCAL &address &value
	&address=0
	&value=0
	DIALOG
	(
		HEADER "write_32b_value_32b_address"
		POS 0. 0. 11.
		TEXT "Address: "
		POS 0. 1. 11.
		TEXT "Value: "
		POS 11. 0. 10.
		EDIT "" "&address=*"
		POS 11. 1. 10.
		EDIT "" "&value=*"
		POS 0. 2. 21.
		BUTTON "Execute" 
		(
			DO &path_registerpoke_cmm write_32b_value_32b_address &address &value
		)
	)
	RETURN
)

write_32b_value_32b_address:
(
	ENTRY &__VF0 &__VF1
	
	Var.NEW unsigned long long \address
	VAR.ASSIGN \address=&__VF0
	
	Var.NEW unsigned long long \value
	VAR.ASSIGN \value=&__VF1
	
	
	Var.NEW unsigned int * \p_address
	Var.Assign \p_address=((unsigned int *)\address)
	Data.Set D:(Var.VALUE(\p_address)) %Long Var.VALUE(\value)
	AREA.Select
	PRINT "writing " %HEX Var.VALUE(\value) " to address: " %HEX Var.VALUE(\address) ""
	PRINT ""
	RETURN
)
