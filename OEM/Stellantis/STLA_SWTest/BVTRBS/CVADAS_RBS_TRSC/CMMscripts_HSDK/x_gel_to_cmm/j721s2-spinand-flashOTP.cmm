; --------------------------------------------------------------------------------
; @Title: SPINAND FLASH Program script for the j721s2 custom board (MAGNA)
; @Description:
; The SPINAND flash is connected to the OSPI_CS0 controller.
; Supported SPINAND flash memories:
; - W25N01JWxxxG
;
; SRAM:
; OSPI(controller) Base: 0x47040000
; OSPI memory mapped ADDRESS: 0x50000000
;
; @Chip: AM752X, DRA829*, TDA4*
; @Board:
; @Author: CMO, JIM
; @Keywords: SPINAND
; @Copyright: (C) 1989-2022 Lauterbach GmbH, licensed for use with TRACE32(R) only
; --------------------------------------------------------------------------------
; $Id: j721s2-spinand.cmm 10720 2022-03-16 11:26:39Z jjeong $

WinCLEAR

PRIVATE &parameters
ENTRY %LINE &parameters

PRIVATE &param_prepareonly &param_dualport
&parameters=STRing.UPpeR("&parameters")
&param_prepareonly=(STRing.SCAN("&parameters","PREPAREONLY",0)!=-1)
&param_dualport=STRing.SCANAndExtract("&parameters","DUALPORT=","1")

&img=STRing.SCANAndExtract("&parameters", "img=", "")
&addr=STRing.SCANAndExtract("&parameters", "addr=", "-1")

LOCAL &pdd
&pdd=OS.PresentDemoDirectory()

; --------------------------------------------------------------------------------
LOCAL &OSPI_BASE &OSPI_MEMORY_BASE
&OSPI_BASE=0x47040000
&OSPI_MEMORY_BASE=0x50000000  ; flash contents memory mapped address

; --------------------------------------------------------------------------------
; Open the master core(CM3) to configure system

; Basic attach via CortexM3
RESet
SYStem.RESet

; Close leftover GUIs
InterCom OTHERS QUIT

; Open all SLAVE GUIs
IF !InterCom.PING(CM3)
  TargetSystem.NewInstance CM3 /ARCHitecture ARM

; The following CPU selections are equivalent:
; AM752X-CM3
; DRA829V-CM3
; TDA4VM-CM3
InterCom CM3 SYStem.CPU TDA4VM-CM3
InterCom CM3 SYStem.Option ResBreak OFF
InterCom CM3 SYStem.Option EnReset OFF
InterCom CM3 SYStem.CONFIG Slave OFF
InterCom CM3 SYStem.JtagClock CTCK 10MHz

IF hardware.COMBIPROBE()||hardware.UTRACE()
(
  InterCom CM3 SYStem.CONFIG.CONNECTOR MIPI34 ; because of converter LA-3782
)


; --------------------------------------------------------------------------------
; Use Power-AP to signal initial states
InterCom CM3 SYStem.Mode Prepare
InterCom CM3 Data.Set EDBG:0x400003f0 %Long 0x00190000    ; Ensure Power-AP unlocked
InterCom CM3 Data.Set EDBG:0x400003f0 %Long 0yxxxxxxxxxxxxxxxxxxxxxxxxxxxxxxx1    ; Soft reset system
WAIT 500.ms                                               ; Wait some time for the system to stabilize
InterCom CM3 Data.Set EDBG:0x400003f0 %Long 0x00190000    ; Ensure Power-AP unlocked
InterCom CM3 Data.Set EDBG:0x40000344 %Long 0x00102098    ; J721e: Force M3 Power & Clock to active
InterCom CM3 Data.Set EDBG:0x40000320 %Long 0x00224003    ; c7-wir
InterCom CM3 Data.Set EDBG:0x40000334 %Long 0x00224003    ; c66.1-wir
InterCom CM3 Data.Set EDBG:0x40000338 %Long 0x00224003    ; c66-2-wir
InterCom CM3 Data.Set EDBG:0x40000364 %Long 0x00224003    ; dmpac-wir
InterCom CM3 Data.Set EDBG:0x40000368 %Long 0x00224003    ; vmpac-wir

InterCom CM3 SYStem.Up

; work around LVCMOS IOdelay Issue
InterCom CM3 Data.Set EZAXI:0x43005008 %LE %Long 0x68EF3490
InterCom CM3 Data.Set EZAXI:0x4300500C %LE %Long 0xD172BC5A
InterCom CM3 Data.Set EZAXI:0x430060c0 %LE %Long 0xd
InterCom CM3 Data.Set EZAXI:0x430060d0 %LE %Long 0xd

; Enable GTC for debug timestamps, 0x3=freeze in debug halt
InterCom CM3 Data.Set EZAXI:0x00A90000 %LE %Long 0x1


; --------------------------------------------------------------------------------
; Basic board setup via CortexM3

; Disbale CR5-MCU lockstep
InterCom CM3 Data.Set EZAXI:0x45A50040 %Long 0x00000000

; Enable necessary clock domains
InterCom CM3 DO &pdd/hardware/j721e/scripts/configure_psc 0. 0. 4. 0x1 0x3 ; LPSC_WKUPMCU2MAIN
InterCom.WAIT CM3

; Configure PLLs
InterCom CM3 DO &pdd/hardware/j721e/scripts/configure_pll MAIN
InterCom.WAIT CM3
InterCom CM3 DO &pdd/hardware/j721e/scripts/configure_pll DEBUG
InterCom.WAIT CM3
InterCom CM3 DO &pdd/hardware/j721e/scripts/configure_pll MCU0
InterCom.WAIT CM3
InterCom CM3 DO &pdd/hardware/j721e/scripts/configure_pll MCU1
InterCom.WAIT CM3
InterCom CM3 DO &pdd/hardware/j721e/scripts/configure_pll MCU2
InterCom.WAIT CM3

; Enable Power
InterCom CM3 DO &pdd/hardware/j721e/scripts/configure_psc 0. 0.  0. 0x1 0x3 ; LPSC_WKUP_ALWAYSON
InterCom.WAIT CM3
InterCom CM3 DO &pdd/hardware/j721e/scripts/configure_psc 0. 0.  1. 0x1 0x3 ; LPSC_DMSC
InterCom.WAIT CM3
InterCom CM3 DO &pdd/hardware/j721e/scripts/configure_psc 0. 0.  2. 0x1 0x3 ; LPSC_DEBUG2DMSC
InterCom.WAIT CM3
InterCom CM3 DO &pdd/hardware/j721e/scripts/configure_psc 0. 0.  7. 0x1 0x3 ; LPSC_MCU_DEBUG
InterCom.WAIT CM3
InterCom CM3 DO &pdd/hardware/j721e/scripts/configure_psc 0. 0. 10. 0x1 0x3 ; LPSC_MCU_OSPI_0
InterCom.WAIT CM3
InterCom CM3 DO &pdd/hardware/j721e/scripts/configure_psc 0. 0. 11. 0x1 0x3 ; LPSC_MCU_OSPI_1
InterCom.WAIT CM3

; Close CM3 GUI
InterCom OTHERS QUIT

; --------------------------------------------------------------------------------
; Connect to MCU-CR5 to program flash

; The following CPU selections are equivalent:
; AM752X-CR5-MCU
; DRA829V-CR5-MCU
; TDA4VM-CR5-MCU
SYStem.CPU TDA4VM-CR5-MCU
SYStem.CONFIG.CORE 3. 1.
CORE.ASSIGN 1.
SYStem.Option.ResBreak OFF
SYStem.Option.EnReset OFF
SYStem.MemAccess DAP    ;Enable to use the dualport

SYStem.Option.TRST OFF
SYStem.Attach
Break

; ------------------------------------------------------------------------------
; Flash Controller Power & Clock Enable
GOSUB CLK_INIT
; ------------------------------------------------------------------------------
; Flash Pin Mux Configuration
GOSUB PIN_MUX
; ------------------------------------------------------------------------------
; Flash Controller Init
GOSUB OSPI_INIT
GOSUB CACHE_MMU_INIT

; ------------------------------------------------------------------------------
; Flash Read ID Test
GOSUB READ_ID_TEST

; ------------------------------------------------------------------------------
; Flash declaration
&pdd=OS.PresentDemoDirectory()

Break.RESet

FLASHFILE.RESet

FLASHFILE.Create 0x0--0x7FFFFFF   0x40000  ; W35N01JWxxxG, 256KB uniform blocks
    //FLASFILE.CONFIG <MCU_FSS0_OSPI0_CTRL>
    FLASHFILE.CONFIG &OSPI_BASE
    FLASHFILE.TARGET 0x41C00000++0x1FFF    E:0x41C02000++0x23FF   ~~/demo/arm/flash/byte/spinand4k6p_tiospi.bin   /KEEP  /DualPort

// Read FLASH Manufacturer and Device ID
FLASHFILE.GETID
;GOSUB FLASHFILE_ONFI_TEST  ;Read out the onfi registers in spinand flash

; ------------------------------------------------------------------------------
; SPINAND specific function to read memory
GOSUB FLASHFILE_CHECK_SPINAND_READMODE  ;Check BUF flag in the SR-2[3], it changes the spinand read method

//End of the test prepareonly
IF "&arg1"=="PREPAREONLY"
  ENDDO

; ------------------------------------------------------------------------------
; Flash programming example

//Dump window for Serial FLASH
FLASHFILE.DUMP 0x0
;FLASHFILE.DUMP 0x0 /SPARE /Track

//Unlock SPI NAND FLASH
FLASHFILE.UNLOCK 0x0--0x7FFFFFF

//Write Serial FLASH
FLASHFILE.ERASE 0x0--0x7FFFFFF

// You can modify this variable to point toward
// where your app images are stored. This can be used
// for convenience in the following section.
&IMAGE_STAGING_DIR= "C:\T32\binaries"

//Write Serial FLASH
// Load each required image here (in ascending location):
FLASHFILE.LOAD * 0x0



//Reset device
PRINT "Please power-cycle the board after flash program is complete"

ENDDO


READ_ID_TEST:
(
  ; In case of errors you can try to read the ID via:
  ; GOSUB READ_ID_TEST
  ;
  ; Check the output of the AREA window.
  ; Expected output ID:
  ; 0x2C
  ; 0x5A (or 0x5B)
  ; 0x1A
  ; 0x10
  ; 0x41
  ; 0x00 (or 0x04)
  ; ...  (Unique ID code)


  LOCAL &rdata
  &CTRLREG=&OSPI_BASE+0x090
  &RXDATA0=&OSPI_BASE+0x0A0
  &RXDATA1=&OSPI_BASE+0x0A4

  &cmd=0x9f<<24.     //cmd
  &rd=0x1<<23.       //rd data enable
  &rd_num=0x7<<20.   //7+1==8bytes
  &cmd_exec=0x1      //cmd execution

  Data.Set EZAXI:&CTRLREG %LE %Long (&cmd|&cmd_exec|&rd_num|&rd)   ;write cmd + write data
  WAIT 100.ms

  &rdata=Data.Long(EZAXI:&RXDATA0)  ;read lower  , 8byte fifo
  PRINT "1st 0x" (&rdata)&0xFF " (Dummy)"      ; //RXFIFO0
  PRINT "2nd 0x" (&rdata>>8.)&0xFF " (Manufacture)"
  PRINT "3rd 0x" (&rdata>>16.)&0xFF " (Device ID)[15:8]"
  PRINT "4th 0x" (&rdata>>24.)&0xFF " (Device ID)[7:0]"
  &rdata=Data.Long(EZAXI:&RXDATA1)  ;read upper , 8byte fifo
  PRINT "5th 0x" (&rdata)&0xFF
  PRINT "6th 0x" (&rdata>>8.)&0xFF
  PRINT "7th 0x" (&rdata>>16.)&0xFF
  PRINT "8th 0x" (&rdata>>24.)&0xFF

  RETURN
)


FLASHFILE_ONFI_TEST:
(
  FLASHFILE.GETONFI /VM

  PRINT "A page size: " %Decimal Data.Long(VM:0x50) "./" Data.Long(VM:0x54) ".Bytes (main/spare)"
  PRINT "A block size: 0x" Data.Long(VM:0x50)*Data.Long(VM:0x5C)  " (" %Decimal Data.Long(VM:0x5C) ".Pages)"
  PRINT "A device size: 0x" Data.Long(VM:0x50)*Data.Long(VM:0x5C)*Data.Long(VM:0x60)  " Bytes"
  RETURN
)


FLASHFILE_CHECK_SPINAND_READMODE:
(
  //The Buffer Read Mode (BUF=1) requires a Column Address to start outputting the existing data inside
  //the Data Buffer, and once it reaches the end of the data buffer (Byte 2,111), DO (IO1) pin will become
  //high-Z state.
  //The Continuous Read Mode (BUF=0) doesn\A1\AFt require the starting Column Address. The device will
  //always start output the data from the first column (Byte 0) of the Data buffer, and once the end of the
  //data buffer (Byte 2,048) is reached, the data output will continue through the next memory page.

  //2048+64, Buffer Read Mode (BUF=1), bcz the OSPI RX buffer is not large enough (Not A nand page size)
  FLASHFILE.SPI.CMD 0x0F 0xB0 /READ 0x4 VM:0
  IF Data.Byte(VM:0x0)!=0x18
  (
    FLASHFILE.SPI.CMD 0x1F 0xB0 0x18   ;Set ECC[4]=1, BUF[3]=1 in Status Register-2
  )
  RETURN
)


OSPI_INIT:
(
  Data.Set EZAXI:&OSPI_BASE+0x0  %LE %Long 0x0
  Data.Set EZAXI:&OSPI_BASE+0x4  %LE %Long 0x00000013 ; 4B Addr Read
  Data.Set EZAXI:&OSPI_BASE+0x8  %LE %Long 0x00000012 ; 4B Addr Write

  Data.Set EZAXI:&OSPI_BASE+0x0  %LE %Long 0x80800000
  Data.Set EZAXI:&OSPI_BASE+0x14 %LE %Long 0x1003; 4B Address mode, 3B Addr: 0x1002
  Data.Set EZAXI:&OSPI_BASE+0x10 %LE %Long 0x21

  Data.Set EZAXI:&OSPI_BASE+0x1C %LE %Long 0xFFFFFFFF
  //Data.Set EZAXI:&OSPI_BASE+0xC  %LE %Long (0xFF<<16.)|(0xFF<<8.) ; !!!!! OSPI_DEV_DELAY_REG because of writing !!!!!
  Data.Set EZAXI:&OSPI_BASE+0x0  %LE %Long 0x00000081|(0x1<<19.)|(0xE<<10.) ; 0x1==baudrate_div4, enable usage of OSPI_CS0
  Data.Set EZAXI:&OSPI_BASE+0x1C %LE %Long 0x04000000 ;ospi_setdirectcutoff, end of the flash address

  RETURN
)

PIN_MUX:
(
  ;MMR_unlock
  Data.Set EZAXI:0x4301D008 %Long 0x68EF3490  ;CTRLMMR_WKUP_LOCK7_KICK0
  Data.Set EZAXI:0x4301D00C %Long 0xD172BC5A

  Data.Set EZAXI:0x4301C000 %Long 0x00040000  ;CTRLMMR_WKUP_PADCONFIG0
  Data.Set EZAXI:0x4301C004 %Long 0x00040000
  Data.Set EZAXI:0x4301C008 %Long 0x00040000
  Data.Set EZAXI:0x4301C00C %Long 0x00040000
  Data.Set EZAXI:0x4301C010 %Long 0x00040000
  Data.Set EZAXI:0x4301C014 %Long 0x00040000
  Data.Set EZAXI:0x4301C018 %Long 0x00040000
  Data.Set EZAXI:0x4301C01C %Long 0x00040000
  Data.Set EZAXI:0x4301C020 %Long 0x00040000
  Data.Set EZAXI:0x4301C024 %Long 0x00040000
  Data.Set EZAXI:0x4301C028 %Long 0x00040000
  Data.Set EZAXI:0x4301C02C %Long 0x00040000
  Data.Set EZAXI:0x4301C030 %Long 0x00040000
  Data.Set EZAXI:0x4301C038 %Long 0x00040001
  Data.Set EZAXI:0x4301C03C %Long 0x00040001

  RETURN
)

CLK_INIT:
(
  PRIVATE &HSDIV_OPTION

  ; If there are flashing issues or if it fails, try to modfy the following value.
  ; The valid range is:      0x3 <= &HSDIV_OPTION <= 0x8
  &HSDIV_OPTION=0x5

  ; Set clock source
  Data.Set EZAXI:0x40F09008 %Long 0x68EF3490  ; CTRLMMR_MCU_LOCK2_KICK0
  Data.Set EZAXI:0x40F0900C %Long 0xD172BC5A

  Data.Set EZAXI:0x40F08030 %Long 0x1         ; CTRLMMR_MCU_OSPI0_CLKSEL: 0x1 = MCU_PLL2_HSDIV4_CLKOUT

  ; Adjust PLL for MCU_PLL2_HSDIV4_CLKOUT
  DO &pdd/hardware/j721e/scripts/configure_pll _CFG_ BYPASS MCU 2.
  DO &pdd/hardware/j721e/scripts/configure_pll _CFG_ DIV    MCU 2. 0x2 0x1 0x1 0x68 0x2AAAAB
  DO &pdd/hardware/j721e/scripts/configure_pll _CFG_ HSDIV  MCU 2. 4. &HSDIV_OPTION
  DO &pdd/hardware/j721e/scripts/configure_pll _CFG_ ENABLE MCU 2.

  RETURN
)


CACHE_MMU_INIT:
(
  PRIVATE &i &tmpReg

  ; Enable MPU and disable I and D caches
  &tmpReg=Data.Long(C15:0x1)
  &tmpReg=&tmpReg|0x1             ; enable MPU
  &tmpReg=(&tmpReg&(~(0x1<<2.)))  ; disable D cache
  &tmpReg=(&tmpReg&(~(0x1<<12.))) ; disable I cache
  Data.Set C15:0x1 %Long &tmpReg

  ; Configure small region setup for flash programming
  PER.Set.SaveIndex C15:0x026 %Long 0x0 C15:0x016 %Long 0x00000000 ; set default
  PER.Set.SaveIndex C15:0x026 %Long 0x0 C15:0x216 %Long 0x0000003F
  PER.Set.SaveIndex C15:0x026 %Long 0x0 C15:0x416 %Long 0x00001310
  PER.Set.SaveIndex C15:0x026 %Long 0x1 C15:0x016 %Long 0x50000000 ; setup flash window
  PER.Set.SaveIndex C15:0x026 %Long 0x1 C15:0x216 %Long 0x00000035
  PER.Set.SaveIndex C15:0x026 %Long 0x1 C15:0x416 %Long 0x00001301
  PER.Set.SaveIndex C15:0x026 %Long 0x2 C15:0x016 %Long 0x41C00000 ; setup buffer space
  PER.Set.SaveIndex C15:0x026 %Long 0x2 C15:0x216 %Long 0x00000027
  PER.Set.SaveIndex C15:0x026 %Long 0x2 C15:0x416 %Long 0x0000030C
  ; Reset all other MPU regions
  &i=3.
  WHILE &i<16.
  (
    PER.Set.SaveIndex C15:0x026 %Long &i C15:0x016 %Long 0x0
    PER.Set.SaveIndex C15:0x026 %Long &i C15:0x216 %Long 0x0
    PER.Set.SaveIndex C15:0x026 %Long &i C15:0x416 %Long 0x0
    &i=&i+1.
  )

  RETURN
)

// detect the flash address mode by the internal flash register (0x0080_0003)
// CR2V : should come 0x08(3B) or 0x88(4B)
SPI_4B_ADDRMODE_ENABLE:
(
  SILENT.FLASH.SPI.CMD 1.  0x06
  SILENT.FLASH.SPI.CMD 1.  0x71 0x80 0x00 0x03 0x88   ; write  0x88 to CR2V , switch 3B->4B address mode

  Data.Set VM:0x0--0xFF %Long 0x0
  SILENT.FLASH.SPI.CMD 1.  0x65 0x00 0x80 0x00 0x03 0x0    /READ 0x4 vm:0x0 ;4Bytes Address mode
  &regData=Data.Byte(vm:0x0)
  IF &regData!=0x88
  (
    PRINT "We expect 0x08 latency(dummy) cycles but we got the dummy cycle 0x" %Hex &regData
    ENDDO
  )
  RETURN
)
