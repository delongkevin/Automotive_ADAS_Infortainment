LOCAL &function &args
ENTRY &function %LINE &args
LOCAL &__MCU_SEC_MMR_BASE
&__MCU_SEC_MMR_BASE=(0x45A50000)
LOCAL &__MAIN_SEC_MMR_BASE
&__MAIN_SEC_MMR_BASE=(0x45A40000)

GLOBAL &path_J7AEP_R5LOCKSTEP_cmm
&path_J7AEP_R5LOCKSTEP_cmm=OS.PPF()
IF "&function"!=""
(
	GOSUB &function &args
)
ELSE
(
	GOSUB __GeL_MeNu_CrEaTe
)
ENDDO

__GeL_MeNu_CrEaTe:
(
	MENU.ReProgram
	(
		ADD
		MENU
		(
			POPUP "GEL"
			(
				POPUP "R5 Lockstep Control"
				(
					MENUITEM "MCU_R5_Cluster_0_split" 
					(
						DO "&path_J7AEP_R5LOCKSTEP_cmm" MCU_R5_Cluster_0_split
					)
					MENUITEM "MCU_R5_Cluster_0_lock" 
					(
						DO "&path_J7AEP_R5LOCKSTEP_cmm" MCU_R5_Cluster_0_lock
					)
					MENUITEM "MAIN_R5_Cluster_0_split" 
					(
						DO "&path_J7AEP_R5LOCKSTEP_cmm" MAIN_R5_Cluster_0_split
					)
					MENUITEM "MAIN_R5_Cluster_0_lock" 
					(
						DO "&path_J7AEP_R5LOCKSTEP_cmm" MAIN_R5_Cluster_0_lock
					)
					MENUITEM "MAIN_R5_Cluster_1_split" 
					(
						DO "&path_J7AEP_R5LOCKSTEP_cmm" MAIN_R5_Cluster_1_split
					)
					MENUITEM "MAIN_R5_Cluster_1_lock" 
					(
						DO "&path_J7AEP_R5LOCKSTEP_cmm" MAIN_R5_Cluster_1_lock
					)
				)
			)
		)
	)
	RETURN
)

MCU_R5_Cluster_0_split:
(
	Var.NEWLOCAL unsigned int * \sec_mmr
	Var.Assign \sec_mmr=((unsigned int *)(&__MCU_SEC_MMR_BASE+0x40))
	Data.Set D:(Var.VALUE(\sec_mmr)) %Long Var.VALUE(0x00000008)
	PRINT "MCU R5F Cluster set to split mode."
	PRINT ""
	RETURN
	
)

MCU_R5_Cluster_0_lock:
(
	Var.NEWLOCAL unsigned int * \sec_mmr
	Var.Assign \sec_mmr=((unsigned int *)(&__MCU_SEC_MMR_BASE+0x40))
	Data.Set D:(Var.VALUE(\sec_mmr)) %Long Var.VALUE(0x00000009)
	PRINT "MCU R5F Cluster set to lockstep mode."
	PRINT ""
	RETURN
	
)

MAIN_R5_Cluster_0_split:
(
	Var.NEWLOCAL unsigned int * \sec_mmr
	Var.Assign \sec_mmr=((unsigned int *)(&__MAIN_SEC_MMR_BASE+0x40))
	Data.Set D:(Var.VALUE(\sec_mmr)) %Long Var.VALUE(0x00000008)
	PRINT "Main R5F Cluster 0 set to split mode."
	PRINT ""
	RETURN
	
)

MAIN_R5_Cluster_0_lock:
(
	Var.NEWLOCAL unsigned int * \sec_mmr
	Var.Assign \sec_mmr=((unsigned int *)(&__MAIN_SEC_MMR_BASE+0x40))
	Data.Set D:(Var.VALUE(\sec_mmr)) %Long Var.VALUE(0x00000009)
	PRINT "Main R5F Cluster 0 set to lockstep mode."
	PRINT ""
	RETURN
	
)

MAIN_R5_Cluster_1_split:
(
	Var.NEWLOCAL unsigned int * \sec_mmr
	Var.Assign \sec_mmr=((unsigned int *)(&__MAIN_SEC_MMR_BASE+0x1040))
	Data.Set D:(Var.VALUE(\sec_mmr)) %Long Var.VALUE(0x00000008)
	PRINT "Main R5F Cluster 1 set to split mode."
	PRINT ""
	RETURN
	
)

MAIN_R5_Cluster_1_lock:
(
	Var.NEWLOCAL unsigned int * \sec_mmr
	Var.Assign \sec_mmr=((unsigned int *)(&__MAIN_SEC_MMR_BASE+0x1040))
	Data.Set D:(Var.VALUE(\sec_mmr)) %Long Var.VALUE(0x00000009)
	PRINT "Main R5F Cluster 1 set to lockstep mode."
	PRINT ""
	RETURN
	
)
