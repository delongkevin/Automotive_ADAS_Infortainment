LOCAL &function &args
ENTRY &function %LINE &args
// -- *
// --  * \file  J7AM_PLL_MMR.gel
// --  *
// --  * \brief GEL File with register definitions for J7AM_PLL.gel
// --  Copyright (c) 2020, Texas Instruments Incorporated
// --  * All rights reserved.
// --  *
// --  * Redistribution and use in source and binary forms, with or without
// --  * modification, are permitted provided that the following conditions
// --  * are met:
// --  *
// --  * *  Redistributions of source code must retain the above copyright
// --  *    notice, this list of conditions and the following disclaimer.
// --  *
// --  * *  Redistributions in binary form must reproduce the above copyright
// --  *    notice, this list of conditions and the following disclaimer in the
// --  *    documentation and/or other materials provided with the distribution.
// --  *
// --  * *  Neither the name of Texas Instruments Incorporated nor the names of
// --  *    its contributors may be used to endorse or promote products derived
// --  *    from this software without specific prior written permission.
// --  *
// --  * THIS SOFTWARE IS PROVIDED BY THE COPYRIGHT HOLDERS AND CONTRIBUTORS "AS IS"
// --  * AND ANY EXPRESS OR IMPLIED WARRANTIES, INCLUDING, BUT NOT LIMITED TO,
// --  * THE IMPLIED WARRANTIES OF MERCHANTABILITY AND FITNESS FOR A PARTICULAR
// --  * PURPOSE ARE DISCLAIMED. IN NO EVENT SHALL THE COPYRIGHT OWNER OR
// --  * CONTRIBUTORS BE LIABLE FOR ANY DIRECT, INDIRECT, INCIDENTAL, SPECIAL,
// --  * EXEMPLARY, OR CONSEQUENTIAL DAMAGES (INCLUDING, BUT NOT LIMITED TO,
// --  * PROCUREMENT OF SUBSTITUTE GOODS OR SERVICES; LOSS OF USE, DATA, OR PROFITS;
// --  * OR BUSINESS INTERRUPTION) HOWEVER CAUSED AND ON ANY THEORY OF LIABILITY,
// --  * WHETHER IN CONTRACT, STRICT LIABILITY, OR TORT (INCLUDING NEGLIGENCE OR
// --  * OTHERWISE) ARISING IN ANY WAY OUT OF THE USE OF THIS SOFTWARE,
// --  * EVEN IF ADVISED OF THE POSSIBILITY OF SUCH DAMAGE. 
// -- Main PLLs--------------------------------------------------------------------
LOCAL &__CSL_MAIN_PLL_MMR_CFG_PLL0_PID
&__CSL_MAIN_PLL_MMR_CFG_PLL0_PID=(0x00000000)
LOCAL &__CSL_MAIN_PLL_MMR_CFG_PLL0_MMR_CFG
&__CSL_MAIN_PLL_MMR_CFG_PLL0_MMR_CFG=(0x00000008)
LOCAL &__CSL_MAIN_PLL_MMR_CFG_PLL0_LOCKKEY0
&__CSL_MAIN_PLL_MMR_CFG_PLL0_LOCKKEY0=(0x00000010)
LOCAL &__CSL_MAIN_PLL_MMR_CFG_PLL0_LOCKKEY1
&__CSL_MAIN_PLL_MMR_CFG_PLL0_LOCKKEY1=(0x00000014)
LOCAL &__CSL_MAIN_PLL_MMR_CFG_PLL0_CTRL
&__CSL_MAIN_PLL_MMR_CFG_PLL0_CTRL=(0x00000020)
LOCAL &__CSL_MAIN_PLL_MMR_CFG_PLL0_STAT
&__CSL_MAIN_PLL_MMR_CFG_PLL0_STAT=(0x00000024)
LOCAL &__CSL_MAIN_PLL_MMR_CFG_PLL0_FREQ_CTRL0
&__CSL_MAIN_PLL_MMR_CFG_PLL0_FREQ_CTRL0=(0x00000030)
LOCAL &__CSL_MAIN_PLL_MMR_CFG_PLL0_FREQ_CTRL1
&__CSL_MAIN_PLL_MMR_CFG_PLL0_FREQ_CTRL1=(0x00000034)
LOCAL &__CSL_MAIN_PLL_MMR_CFG_PLL0_DIV_CTRL
&__CSL_MAIN_PLL_MMR_CFG_PLL0_DIV_CTRL=(0x00000038)
LOCAL &__CSL_MAIN_PLL_MMR_CFG_PLL0_SS_CTRL
&__CSL_MAIN_PLL_MMR_CFG_PLL0_SS_CTRL=(0x00000040)
LOCAL &__CSL_MAIN_PLL_MMR_CFG_PLL0_SS_SPREAD
&__CSL_MAIN_PLL_MMR_CFG_PLL0_SS_SPREAD=(0x00000044)
LOCAL &__CSL_MAIN_PLL_MMR_CFG_PLL0_HSDIV_CTRL0
&__CSL_MAIN_PLL_MMR_CFG_PLL0_HSDIV_CTRL0=(0x00000080)
LOCAL &__CSL_MAIN_PLL_MMR_CFG_PLL0_HSDIV_CTRL1
&__CSL_MAIN_PLL_MMR_CFG_PLL0_HSDIV_CTRL1=(0x00000084)
LOCAL &__CSL_MAIN_PLL_MMR_CFG_PLL0_HSDIV_CTRL2
&__CSL_MAIN_PLL_MMR_CFG_PLL0_HSDIV_CTRL2=(0x00000088)
LOCAL &__CSL_MAIN_PLL_MMR_CFG_PLL0_HSDIV_CTRL3
&__CSL_MAIN_PLL_MMR_CFG_PLL0_HSDIV_CTRL3=(0x0000008C)
LOCAL &__CSL_MAIN_PLL_MMR_CFG_PLL0_HSDIV_CTRL4
&__CSL_MAIN_PLL_MMR_CFG_PLL0_HSDIV_CTRL4=(0x00000090)
LOCAL &__CSL_MAIN_PLL_MMR_CFG_PLL0_HSDIV_CTRL5
&__CSL_MAIN_PLL_MMR_CFG_PLL0_HSDIV_CTRL5=(0x00000094)
LOCAL &__CSL_MAIN_PLL_MMR_CFG_PLL0_HSDIV_CTRL6
&__CSL_MAIN_PLL_MMR_CFG_PLL0_HSDIV_CTRL6=(0x00000098)
LOCAL &__CSL_MAIN_PLL_MMR_CFG_PLL0_HSDIV_CTRL7
&__CSL_MAIN_PLL_MMR_CFG_PLL0_HSDIV_CTRL7=(0x0000009C)
LOCAL &__CSL_MAIN_PLL_MMR_CFG_PLL0_HSDIV_CTRL8
&__CSL_MAIN_PLL_MMR_CFG_PLL0_HSDIV_CTRL8=(0x000000A0)
LOCAL &__CSL_MAIN_PLL_MMR_CFG_PLL1_PID
&__CSL_MAIN_PLL_MMR_CFG_PLL1_PID=(0x00001000)
LOCAL &__CSL_MAIN_PLL_MMR_CFG_PLL1_MMR_CFG
&__CSL_MAIN_PLL_MMR_CFG_PLL1_MMR_CFG=(0x00001008)
LOCAL &__CSL_MAIN_PLL_MMR_CFG_PLL1_LOCKKEY0
&__CSL_MAIN_PLL_MMR_CFG_PLL1_LOCKKEY0=(0x00001010)
LOCAL &__CSL_MAIN_PLL_MMR_CFG_PLL1_LOCKKEY1
&__CSL_MAIN_PLL_MMR_CFG_PLL1_LOCKKEY1=(0x00001014)
LOCAL &__CSL_MAIN_PLL_MMR_CFG_PLL1_CTRL
&__CSL_MAIN_PLL_MMR_CFG_PLL1_CTRL=(0x00001020)
LOCAL &__CSL_MAIN_PLL_MMR_CFG_PLL1_STAT
&__CSL_MAIN_PLL_MMR_CFG_PLL1_STAT=(0x00001024)
LOCAL &__CSL_MAIN_PLL_MMR_CFG_PLL1_FREQ_CTRL0
&__CSL_MAIN_PLL_MMR_CFG_PLL1_FREQ_CTRL0=(0x00001030)
LOCAL &__CSL_MAIN_PLL_MMR_CFG_PLL1_FREQ_CTRL1
&__CSL_MAIN_PLL_MMR_CFG_PLL1_FREQ_CTRL1=(0x00001034)
LOCAL &__CSL_MAIN_PLL_MMR_CFG_PLL1_DIV_CTRL
&__CSL_MAIN_PLL_MMR_CFG_PLL1_DIV_CTRL=(0x00001038)
LOCAL &__CSL_MAIN_PLL_MMR_CFG_PLL1_SS_CTRL
&__CSL_MAIN_PLL_MMR_CFG_PLL1_SS_CTRL=(0x00001040)
LOCAL &__CSL_MAIN_PLL_MMR_CFG_PLL1_SS_SPREAD
&__CSL_MAIN_PLL_MMR_CFG_PLL1_SS_SPREAD=(0x00001044)
LOCAL &__CSL_MAIN_PLL_MMR_CFG_PLL1_HSDIV_CTRL0
&__CSL_MAIN_PLL_MMR_CFG_PLL1_HSDIV_CTRL0=(0x00001080)
LOCAL &__CSL_MAIN_PLL_MMR_CFG_PLL1_HSDIV_CTRL1
&__CSL_MAIN_PLL_MMR_CFG_PLL1_HSDIV_CTRL1=(0x00001084)
LOCAL &__CSL_MAIN_PLL_MMR_CFG_PLL1_HSDIV_CTRL2
&__CSL_MAIN_PLL_MMR_CFG_PLL1_HSDIV_CTRL2=(0x00001088)
LOCAL &__CSL_MAIN_PLL_MMR_CFG_PLL1_HSDIV_CTRL3
&__CSL_MAIN_PLL_MMR_CFG_PLL1_HSDIV_CTRL3=(0x0000108C)
LOCAL &__CSL_MAIN_PLL_MMR_CFG_PLL1_HSDIV_CTRL4
&__CSL_MAIN_PLL_MMR_CFG_PLL1_HSDIV_CTRL4=(0x00001090)
LOCAL &__CSL_MAIN_PLL_MMR_CFG_PLL1_HSDIV_CTRL5
&__CSL_MAIN_PLL_MMR_CFG_PLL1_HSDIV_CTRL5=(0x00001094)
LOCAL &__CSL_MAIN_PLL_MMR_CFG_PLL1_HSDIV_CTRL6
&__CSL_MAIN_PLL_MMR_CFG_PLL1_HSDIV_CTRL6=(0x00001098)
LOCAL &__CSL_MAIN_PLL_MMR_CFG_PLL1_HSDIV_CTRL7
&__CSL_MAIN_PLL_MMR_CFG_PLL1_HSDIV_CTRL7=(0x0000109C)
LOCAL &__CSL_MAIN_PLL_MMR_CFG_PLL1_HSDIV_CTRL8
&__CSL_MAIN_PLL_MMR_CFG_PLL1_HSDIV_CTRL8=(0x000010A0)
LOCAL &__CSL_MAIN_PLL_MMR_CFG_PLL2_PID
&__CSL_MAIN_PLL_MMR_CFG_PLL2_PID=(0x00002000)
LOCAL &__CSL_MAIN_PLL_MMR_CFG_PLL2_MMR_CFG
&__CSL_MAIN_PLL_MMR_CFG_PLL2_MMR_CFG=(0x00002008)
LOCAL &__CSL_MAIN_PLL_MMR_CFG_PLL2_LOCKKEY0
&__CSL_MAIN_PLL_MMR_CFG_PLL2_LOCKKEY0=(0x00002010)
LOCAL &__CSL_MAIN_PLL_MMR_CFG_PLL2_LOCKKEY1
&__CSL_MAIN_PLL_MMR_CFG_PLL2_LOCKKEY1=(0x00002014)
LOCAL &__CSL_MAIN_PLL_MMR_CFG_PLL2_CTRL
&__CSL_MAIN_PLL_MMR_CFG_PLL2_CTRL=(0x00002020)
LOCAL &__CSL_MAIN_PLL_MMR_CFG_PLL2_STAT
&__CSL_MAIN_PLL_MMR_CFG_PLL2_STAT=(0x00002024)
LOCAL &__CSL_MAIN_PLL_MMR_CFG_PLL2_FREQ_CTRL0
&__CSL_MAIN_PLL_MMR_CFG_PLL2_FREQ_CTRL0=(0x00002030)
LOCAL &__CSL_MAIN_PLL_MMR_CFG_PLL2_FREQ_CTRL1
&__CSL_MAIN_PLL_MMR_CFG_PLL2_FREQ_CTRL1=(0x00002034)
LOCAL &__CSL_MAIN_PLL_MMR_CFG_PLL2_DIV_CTRL
&__CSL_MAIN_PLL_MMR_CFG_PLL2_DIV_CTRL=(0x00002038)
LOCAL &__CSL_MAIN_PLL_MMR_CFG_PLL2_SS_CTRL
&__CSL_MAIN_PLL_MMR_CFG_PLL2_SS_CTRL=(0x00002040)
LOCAL &__CSL_MAIN_PLL_MMR_CFG_PLL2_SS_SPREAD
&__CSL_MAIN_PLL_MMR_CFG_PLL2_SS_SPREAD=(0x00002044)
LOCAL &__CSL_MAIN_PLL_MMR_CFG_PLL2_HSDIV_CTRL0
&__CSL_MAIN_PLL_MMR_CFG_PLL2_HSDIV_CTRL0=(0x00002080)
LOCAL &__CSL_MAIN_PLL_MMR_CFG_PLL2_HSDIV_CTRL1
&__CSL_MAIN_PLL_MMR_CFG_PLL2_HSDIV_CTRL1=(0x00002084)
LOCAL &__CSL_MAIN_PLL_MMR_CFG_PLL2_HSDIV_CTRL2
&__CSL_MAIN_PLL_MMR_CFG_PLL2_HSDIV_CTRL2=(0x00002088)
LOCAL &__CSL_MAIN_PLL_MMR_CFG_PLL2_HSDIV_CTRL3
&__CSL_MAIN_PLL_MMR_CFG_PLL2_HSDIV_CTRL3=(0x0000208C)
LOCAL &__CSL_MAIN_PLL_MMR_CFG_PLL2_HSDIV_CTRL4
&__CSL_MAIN_PLL_MMR_CFG_PLL2_HSDIV_CTRL4=(0x00002090)
LOCAL &__CSL_MAIN_PLL_MMR_CFG_PLL2_HSDIV_CTRL5
&__CSL_MAIN_PLL_MMR_CFG_PLL2_HSDIV_CTRL5=(0x00002094)
LOCAL &__CSL_MAIN_PLL_MMR_CFG_PLL2_HSDIV_CTRL6
&__CSL_MAIN_PLL_MMR_CFG_PLL2_HSDIV_CTRL6=(0x00002098)
LOCAL &__CSL_MAIN_PLL_MMR_CFG_PLL2_HSDIV_CTRL7
&__CSL_MAIN_PLL_MMR_CFG_PLL2_HSDIV_CTRL7=(0x0000209C)
LOCAL &__CSL_MAIN_PLL_MMR_CFG_PLL3_PID
&__CSL_MAIN_PLL_MMR_CFG_PLL3_PID=(0x00003000)
LOCAL &__CSL_MAIN_PLL_MMR_CFG_PLL3_MMR_CFG
&__CSL_MAIN_PLL_MMR_CFG_PLL3_MMR_CFG=(0x00003008)
LOCAL &__CSL_MAIN_PLL_MMR_CFG_PLL3_LOCKKEY0
&__CSL_MAIN_PLL_MMR_CFG_PLL3_LOCKKEY0=(0x00003010)
LOCAL &__CSL_MAIN_PLL_MMR_CFG_PLL3_LOCKKEY1
&__CSL_MAIN_PLL_MMR_CFG_PLL3_LOCKKEY1=(0x00003014)
LOCAL &__CSL_MAIN_PLL_MMR_CFG_PLL3_CTRL
&__CSL_MAIN_PLL_MMR_CFG_PLL3_CTRL=(0x00003020)
LOCAL &__CSL_MAIN_PLL_MMR_CFG_PLL3_STAT
&__CSL_MAIN_PLL_MMR_CFG_PLL3_STAT=(0x00003024)
LOCAL &__CSL_MAIN_PLL_MMR_CFG_PLL3_FREQ_CTRL0
&__CSL_MAIN_PLL_MMR_CFG_PLL3_FREQ_CTRL0=(0x00003030)
LOCAL &__CSL_MAIN_PLL_MMR_CFG_PLL3_FREQ_CTRL1
&__CSL_MAIN_PLL_MMR_CFG_PLL3_FREQ_CTRL1=(0x00003034)
LOCAL &__CSL_MAIN_PLL_MMR_CFG_PLL3_DIV_CTRL
&__CSL_MAIN_PLL_MMR_CFG_PLL3_DIV_CTRL=(0x00003038)
LOCAL &__CSL_MAIN_PLL_MMR_CFG_PLL3_SS_CTRL
&__CSL_MAIN_PLL_MMR_CFG_PLL3_SS_CTRL=(0x00003040)
LOCAL &__CSL_MAIN_PLL_MMR_CFG_PLL3_SS_SPREAD
&__CSL_MAIN_PLL_MMR_CFG_PLL3_SS_SPREAD=(0x00003044)
LOCAL &__CSL_MAIN_PLL_MMR_CFG_PLL3_HSDIV_CTRL0
&__CSL_MAIN_PLL_MMR_CFG_PLL3_HSDIV_CTRL0=(0x00003080)
LOCAL &__CSL_MAIN_PLL_MMR_CFG_PLL3_HSDIV_CTRL1
&__CSL_MAIN_PLL_MMR_CFG_PLL3_HSDIV_CTRL1=(0x00003084)
LOCAL &__CSL_MAIN_PLL_MMR_CFG_PLL3_HSDIV_CTRL2
&__CSL_MAIN_PLL_MMR_CFG_PLL3_HSDIV_CTRL2=(0x00003088)
LOCAL &__CSL_MAIN_PLL_MMR_CFG_PLL3_HSDIV_CTRL3
&__CSL_MAIN_PLL_MMR_CFG_PLL3_HSDIV_CTRL3=(0x0000308C)
LOCAL &__CSL_MAIN_PLL_MMR_CFG_PLL3_HSDIV_CTRL4
&__CSL_MAIN_PLL_MMR_CFG_PLL3_HSDIV_CTRL4=(0x00003090)
LOCAL &__CSL_MAIN_PLL_MMR_CFG_PLL4_PID
&__CSL_MAIN_PLL_MMR_CFG_PLL4_PID=(0x00004000)
LOCAL &__CSL_MAIN_PLL_MMR_CFG_PLL4_MMR_CFG
&__CSL_MAIN_PLL_MMR_CFG_PLL4_MMR_CFG=(0x00004008)
LOCAL &__CSL_MAIN_PLL_MMR_CFG_PLL4_LOCKKEY0
&__CSL_MAIN_PLL_MMR_CFG_PLL4_LOCKKEY0=(0x00004010)
LOCAL &__CSL_MAIN_PLL_MMR_CFG_PLL4_LOCKKEY1
&__CSL_MAIN_PLL_MMR_CFG_PLL4_LOCKKEY1=(0x00004014)
LOCAL &__CSL_MAIN_PLL_MMR_CFG_PLL4_CTRL
&__CSL_MAIN_PLL_MMR_CFG_PLL4_CTRL=(0x00004020)
LOCAL &__CSL_MAIN_PLL_MMR_CFG_PLL4_STAT
&__CSL_MAIN_PLL_MMR_CFG_PLL4_STAT=(0x00004024)
LOCAL &__CSL_MAIN_PLL_MMR_CFG_PLL4_FREQ_CTRL0
&__CSL_MAIN_PLL_MMR_CFG_PLL4_FREQ_CTRL0=(0x00004030)
LOCAL &__CSL_MAIN_PLL_MMR_CFG_PLL4_FREQ_CTRL1
&__CSL_MAIN_PLL_MMR_CFG_PLL4_FREQ_CTRL1=(0x00004034)
LOCAL &__CSL_MAIN_PLL_MMR_CFG_PLL4_DIV_CTRL
&__CSL_MAIN_PLL_MMR_CFG_PLL4_DIV_CTRL=(0x00004038)
LOCAL &__CSL_MAIN_PLL_MMR_CFG_PLL4_SS_CTRL
&__CSL_MAIN_PLL_MMR_CFG_PLL4_SS_CTRL=(0x00004040)
LOCAL &__CSL_MAIN_PLL_MMR_CFG_PLL4_SS_SPREAD
&__CSL_MAIN_PLL_MMR_CFG_PLL4_SS_SPREAD=(0x00004044)
LOCAL &__CSL_MAIN_PLL_MMR_CFG_PLL4_HSDIV_CTRL0
&__CSL_MAIN_PLL_MMR_CFG_PLL4_HSDIV_CTRL0=(0x00004080)
LOCAL &__CSL_MAIN_PLL_MMR_CFG_PLL4_HSDIV_CTRL1
&__CSL_MAIN_PLL_MMR_CFG_PLL4_HSDIV_CTRL1=(0x00004084)
LOCAL &__CSL_MAIN_PLL_MMR_CFG_PLL4_HSDIV_CTRL2
&__CSL_MAIN_PLL_MMR_CFG_PLL4_HSDIV_CTRL2=(0x00004088)
LOCAL &__CSL_MAIN_PLL_MMR_CFG_PLL4_HSDIV_CTRL3
&__CSL_MAIN_PLL_MMR_CFG_PLL4_HSDIV_CTRL3=(0x0000408C)
LOCAL &__CSL_MAIN_PLL_MMR_CFG_PLL5_PID
&__CSL_MAIN_PLL_MMR_CFG_PLL5_PID=(0x00005000)
LOCAL &__CSL_MAIN_PLL_MMR_CFG_PLL5_MMR_CFG
&__CSL_MAIN_PLL_MMR_CFG_PLL5_MMR_CFG=(0x00005008)
LOCAL &__CSL_MAIN_PLL_MMR_CFG_PLL5_LOCKKEY0
&__CSL_MAIN_PLL_MMR_CFG_PLL5_LOCKKEY0=(0x00005010)
LOCAL &__CSL_MAIN_PLL_MMR_CFG_PLL5_LOCKKEY1
&__CSL_MAIN_PLL_MMR_CFG_PLL5_LOCKKEY1=(0x00005014)
LOCAL &__CSL_MAIN_PLL_MMR_CFG_PLL5_CTRL
&__CSL_MAIN_PLL_MMR_CFG_PLL5_CTRL=(0x00005020)
LOCAL &__CSL_MAIN_PLL_MMR_CFG_PLL5_STAT
&__CSL_MAIN_PLL_MMR_CFG_PLL5_STAT=(0x00005024)
LOCAL &__CSL_MAIN_PLL_MMR_CFG_PLL5_FREQ_CTRL0
&__CSL_MAIN_PLL_MMR_CFG_PLL5_FREQ_CTRL0=(0x00005030)
LOCAL &__CSL_MAIN_PLL_MMR_CFG_PLL5_FREQ_CTRL1
&__CSL_MAIN_PLL_MMR_CFG_PLL5_FREQ_CTRL1=(0x00005034)
LOCAL &__CSL_MAIN_PLL_MMR_CFG_PLL5_DIV_CTRL
&__CSL_MAIN_PLL_MMR_CFG_PLL5_DIV_CTRL=(0x00005038)
LOCAL &__CSL_MAIN_PLL_MMR_CFG_PLL5_SS_CTRL
&__CSL_MAIN_PLL_MMR_CFG_PLL5_SS_CTRL=(0x00005040)
LOCAL &__CSL_MAIN_PLL_MMR_CFG_PLL5_SS_SPREAD
&__CSL_MAIN_PLL_MMR_CFG_PLL5_SS_SPREAD=(0x00005044)
LOCAL &__CSL_MAIN_PLL_MMR_CFG_PLL5_HSDIV_CTRL0
&__CSL_MAIN_PLL_MMR_CFG_PLL5_HSDIV_CTRL0=(0x00005080)
LOCAL &__CSL_MAIN_PLL_MMR_CFG_PLL5_HSDIV_CTRL1
&__CSL_MAIN_PLL_MMR_CFG_PLL5_HSDIV_CTRL1=(0x00005084)
LOCAL &__CSL_MAIN_PLL_MMR_CFG_PLL5_HSDIV_CTRL2
&__CSL_MAIN_PLL_MMR_CFG_PLL5_HSDIV_CTRL2=(0x00005088)
LOCAL &__CSL_MAIN_PLL_MMR_CFG_PLL5_HSDIV_CTRL3
&__CSL_MAIN_PLL_MMR_CFG_PLL5_HSDIV_CTRL3=(0x0000508C)
LOCAL &__CSL_MAIN_PLL_MMR_CFG_PLL6_PID
&__CSL_MAIN_PLL_MMR_CFG_PLL6_PID=(0x00006000)
LOCAL &__CSL_MAIN_PLL_MMR_CFG_PLL6_MMR_CFG
&__CSL_MAIN_PLL_MMR_CFG_PLL6_MMR_CFG=(0x00006008)
LOCAL &__CSL_MAIN_PLL_MMR_CFG_PLL6_LOCKKEY0
&__CSL_MAIN_PLL_MMR_CFG_PLL6_LOCKKEY0=(0x00006010)
LOCAL &__CSL_MAIN_PLL_MMR_CFG_PLL6_LOCKKEY1
&__CSL_MAIN_PLL_MMR_CFG_PLL6_LOCKKEY1=(0x00006014)
LOCAL &__CSL_MAIN_PLL_MMR_CFG_PLL6_CTRL
&__CSL_MAIN_PLL_MMR_CFG_PLL6_CTRL=(0x00006020)
LOCAL &__CSL_MAIN_PLL_MMR_CFG_PLL6_STAT
&__CSL_MAIN_PLL_MMR_CFG_PLL6_STAT=(0x00006024)
LOCAL &__CSL_MAIN_PLL_MMR_CFG_PLL6_FREQ_CTRL0
&__CSL_MAIN_PLL_MMR_CFG_PLL6_FREQ_CTRL0=(0x00006030)
LOCAL &__CSL_MAIN_PLL_MMR_CFG_PLL6_FREQ_CTRL1
&__CSL_MAIN_PLL_MMR_CFG_PLL6_FREQ_CTRL1=(0x00006034)
LOCAL &__CSL_MAIN_PLL_MMR_CFG_PLL6_DIV_CTRL
&__CSL_MAIN_PLL_MMR_CFG_PLL6_DIV_CTRL=(0x00006038)
LOCAL &__CSL_MAIN_PLL_MMR_CFG_PLL6_SS_CTRL
&__CSL_MAIN_PLL_MMR_CFG_PLL6_SS_CTRL=(0x00006040)
LOCAL &__CSL_MAIN_PLL_MMR_CFG_PLL6_SS_SPREAD
&__CSL_MAIN_PLL_MMR_CFG_PLL6_SS_SPREAD=(0x00006044)
LOCAL &__CSL_MAIN_PLL_MMR_CFG_PLL6_HSDIV_CTRL0
&__CSL_MAIN_PLL_MMR_CFG_PLL6_HSDIV_CTRL0=(0x00006080)
LOCAL &__CSL_MAIN_PLL_MMR_CFG_PLL7_PID
&__CSL_MAIN_PLL_MMR_CFG_PLL7_PID=(0x00007000)
LOCAL &__CSL_MAIN_PLL_MMR_CFG_PLL7_MMR_CFG
&__CSL_MAIN_PLL_MMR_CFG_PLL7_MMR_CFG=(0x00007008)
LOCAL &__CSL_MAIN_PLL_MMR_CFG_PLL7_LOCKKEY0
&__CSL_MAIN_PLL_MMR_CFG_PLL7_LOCKKEY0=(0x00007010)
LOCAL &__CSL_MAIN_PLL_MMR_CFG_PLL7_LOCKKEY1
&__CSL_MAIN_PLL_MMR_CFG_PLL7_LOCKKEY1=(0x00007014)
LOCAL &__CSL_MAIN_PLL_MMR_CFG_PLL7_CTRL
&__CSL_MAIN_PLL_MMR_CFG_PLL7_CTRL=(0x00007020)
LOCAL &__CSL_MAIN_PLL_MMR_CFG_PLL7_STAT
&__CSL_MAIN_PLL_MMR_CFG_PLL7_STAT=(0x00007024)
LOCAL &__CSL_MAIN_PLL_MMR_CFG_PLL7_FREQ_CTRL0
&__CSL_MAIN_PLL_MMR_CFG_PLL7_FREQ_CTRL0=(0x00007030)
LOCAL &__CSL_MAIN_PLL_MMR_CFG_PLL7_FREQ_CTRL1
&__CSL_MAIN_PLL_MMR_CFG_PLL7_FREQ_CTRL1=(0x00007034)
LOCAL &__CSL_MAIN_PLL_MMR_CFG_PLL7_DIV_CTRL
&__CSL_MAIN_PLL_MMR_CFG_PLL7_DIV_CTRL=(0x00007038)
LOCAL &__CSL_MAIN_PLL_MMR_CFG_PLL7_SS_CTRL
&__CSL_MAIN_PLL_MMR_CFG_PLL7_SS_CTRL=(0x00007040)
LOCAL &__CSL_MAIN_PLL_MMR_CFG_PLL7_SS_SPREAD
&__CSL_MAIN_PLL_MMR_CFG_PLL7_SS_SPREAD=(0x00007044)
LOCAL &__CSL_MAIN_PLL_MMR_CFG_PLL7_HSDIV_CTRL0
&__CSL_MAIN_PLL_MMR_CFG_PLL7_HSDIV_CTRL0=(0x00007080)
LOCAL &__CSL_MAIN_PLL_MMR_CFG_PLL8_PID
&__CSL_MAIN_PLL_MMR_CFG_PLL8_PID=(0x00008000)
LOCAL &__CSL_MAIN_PLL_MMR_CFG_PLL8_MMR_CFG
&__CSL_MAIN_PLL_MMR_CFG_PLL8_MMR_CFG=(0x00008008)
LOCAL &__CSL_MAIN_PLL_MMR_CFG_PLL8_LOCKKEY0
&__CSL_MAIN_PLL_MMR_CFG_PLL8_LOCKKEY0=(0x00008010)
LOCAL &__CSL_MAIN_PLL_MMR_CFG_PLL8_LOCKKEY1
&__CSL_MAIN_PLL_MMR_CFG_PLL8_LOCKKEY1=(0x00008014)
LOCAL &__CSL_MAIN_PLL_MMR_CFG_PLL8_CTRL
&__CSL_MAIN_PLL_MMR_CFG_PLL8_CTRL=(0x00008020)
LOCAL &__CSL_MAIN_PLL_MMR_CFG_PLL8_STAT
&__CSL_MAIN_PLL_MMR_CFG_PLL8_STAT=(0x00008024)
LOCAL &__CSL_MAIN_PLL_MMR_CFG_PLL8_FREQ_CTRL0
&__CSL_MAIN_PLL_MMR_CFG_PLL8_FREQ_CTRL0=(0x00008030)
LOCAL &__CSL_MAIN_PLL_MMR_CFG_PLL8_FREQ_CTRL1
&__CSL_MAIN_PLL_MMR_CFG_PLL8_FREQ_CTRL1=(0x00008034)
LOCAL &__CSL_MAIN_PLL_MMR_CFG_PLL8_DIV_CTRL
&__CSL_MAIN_PLL_MMR_CFG_PLL8_DIV_CTRL=(0x00008038)
LOCAL &__CSL_MAIN_PLL_MMR_CFG_PLL8_SS_CTRL
&__CSL_MAIN_PLL_MMR_CFG_PLL8_SS_CTRL=(0x00008040)
LOCAL &__CSL_MAIN_PLL_MMR_CFG_PLL8_SS_SPREAD
&__CSL_MAIN_PLL_MMR_CFG_PLL8_SS_SPREAD=(0x00008044)
LOCAL &__CSL_MAIN_PLL_MMR_CFG_PLL8_HSDIV_CTRL0
&__CSL_MAIN_PLL_MMR_CFG_PLL8_HSDIV_CTRL0=(0x00008080)
LOCAL &__CSL_MAIN_PLL_MMR_CFG_PLL9_PID
&__CSL_MAIN_PLL_MMR_CFG_PLL9_PID=(0x00009000)
LOCAL &__CSL_MAIN_PLL_MMR_CFG_PLL9_MMR_CFG
&__CSL_MAIN_PLL_MMR_CFG_PLL9_MMR_CFG=(0x00009008)
LOCAL &__CSL_MAIN_PLL_MMR_CFG_PLL9_LOCKKEY0
&__CSL_MAIN_PLL_MMR_CFG_PLL9_LOCKKEY0=(0x00009010)
LOCAL &__CSL_MAIN_PLL_MMR_CFG_PLL9_LOCKKEY1
&__CSL_MAIN_PLL_MMR_CFG_PLL9_LOCKKEY1=(0x00009014)
LOCAL &__CSL_MAIN_PLL_MMR_CFG_PLL9_CTRL
&__CSL_MAIN_PLL_MMR_CFG_PLL9_CTRL=(0x00009020)
LOCAL &__CSL_MAIN_PLL_MMR_CFG_PLL9_STAT
&__CSL_MAIN_PLL_MMR_CFG_PLL9_STAT=(0x00009024)
LOCAL &__CSL_MAIN_PLL_MMR_CFG_PLL9_FREQ_CTRL0
&__CSL_MAIN_PLL_MMR_CFG_PLL9_FREQ_CTRL0=(0x00009030)
LOCAL &__CSL_MAIN_PLL_MMR_CFG_PLL9_FREQ_CTRL1
&__CSL_MAIN_PLL_MMR_CFG_PLL9_FREQ_CTRL1=(0x00009034)
LOCAL &__CSL_MAIN_PLL_MMR_CFG_PLL9_DIV_CTRL
&__CSL_MAIN_PLL_MMR_CFG_PLL9_DIV_CTRL=(0x00009038)
LOCAL &__CSL_MAIN_PLL_MMR_CFG_PLL9_SS_CTRL
&__CSL_MAIN_PLL_MMR_CFG_PLL9_SS_CTRL=(0x00009040)
LOCAL &__CSL_MAIN_PLL_MMR_CFG_PLL9_SS_SPREAD
&__CSL_MAIN_PLL_MMR_CFG_PLL9_SS_SPREAD=(0x00009044)
LOCAL &__CSL_MAIN_PLL_MMR_CFG_PLL9_HSDIV_CTRL0
&__CSL_MAIN_PLL_MMR_CFG_PLL9_HSDIV_CTRL0=(0x00009080)
LOCAL &__CSL_MAIN_PLL_MMR_CFG_PLL12_PID
&__CSL_MAIN_PLL_MMR_CFG_PLL12_PID=(0x0000C000)
LOCAL &__CSL_MAIN_PLL_MMR_CFG_PLL12_MMR_CFG
&__CSL_MAIN_PLL_MMR_CFG_PLL12_MMR_CFG=(0x0000C008)
LOCAL &__CSL_MAIN_PLL_MMR_CFG_PLL12_LOCKKEY0
&__CSL_MAIN_PLL_MMR_CFG_PLL12_LOCKKEY0=(0x0000C010)
LOCAL &__CSL_MAIN_PLL_MMR_CFG_PLL12_LOCKKEY1
&__CSL_MAIN_PLL_MMR_CFG_PLL12_LOCKKEY1=(0x0000C014)
LOCAL &__CSL_MAIN_PLL_MMR_CFG_PLL12_CTRL
&__CSL_MAIN_PLL_MMR_CFG_PLL12_CTRL=(0x0000C020)
LOCAL &__CSL_MAIN_PLL_MMR_CFG_PLL12_STAT
&__CSL_MAIN_PLL_MMR_CFG_PLL12_STAT=(0x0000C024)
LOCAL &__CSL_MAIN_PLL_MMR_CFG_PLL12_FREQ_CTRL0
&__CSL_MAIN_PLL_MMR_CFG_PLL12_FREQ_CTRL0=(0x0000C030)
LOCAL &__CSL_MAIN_PLL_MMR_CFG_PLL12_FREQ_CTRL1
&__CSL_MAIN_PLL_MMR_CFG_PLL12_FREQ_CTRL1=(0x0000C034)
LOCAL &__CSL_MAIN_PLL_MMR_CFG_PLL12_DIV_CTRL
&__CSL_MAIN_PLL_MMR_CFG_PLL12_DIV_CTRL=(0x0000C038)
LOCAL &__CSL_MAIN_PLL_MMR_CFG_PLL12_SS_CTRL
&__CSL_MAIN_PLL_MMR_CFG_PLL12_SS_CTRL=(0x0000C040)
LOCAL &__CSL_MAIN_PLL_MMR_CFG_PLL12_SS_SPREAD
&__CSL_MAIN_PLL_MMR_CFG_PLL12_SS_SPREAD=(0x0000C044)
LOCAL &__CSL_MAIN_PLL_MMR_CFG_PLL12_CAL_CTRL
&__CSL_MAIN_PLL_MMR_CFG_PLL12_CAL_CTRL=(0x0000C060)
LOCAL &__CSL_MAIN_PLL_MMR_CFG_PLL12_CAL_STAT
&__CSL_MAIN_PLL_MMR_CFG_PLL12_CAL_STAT=(0x0000C064)
LOCAL &__CSL_MAIN_PLL_MMR_CFG_PLL12_HSDIV_CTRL0
&__CSL_MAIN_PLL_MMR_CFG_PLL12_HSDIV_CTRL0=(0x0000C080)
LOCAL &__CSL_MAIN_PLL_MMR_CFG_PLL13_PID
&__CSL_MAIN_PLL_MMR_CFG_PLL13_PID=(0x0000D000)
LOCAL &__CSL_MAIN_PLL_MMR_CFG_PLL13_MMR_CFG
&__CSL_MAIN_PLL_MMR_CFG_PLL13_MMR_CFG=(0x0000D008)
LOCAL &__CSL_MAIN_PLL_MMR_CFG_PLL13_LOCKKEY0
&__CSL_MAIN_PLL_MMR_CFG_PLL13_LOCKKEY0=(0x0000D010)
LOCAL &__CSL_MAIN_PLL_MMR_CFG_PLL13_LOCKKEY1
&__CSL_MAIN_PLL_MMR_CFG_PLL13_LOCKKEY1=(0x0000D014)
LOCAL &__CSL_MAIN_PLL_MMR_CFG_PLL13_CTRL
&__CSL_MAIN_PLL_MMR_CFG_PLL13_CTRL=(0x0000D020)
LOCAL &__CSL_MAIN_PLL_MMR_CFG_PLL13_STAT
&__CSL_MAIN_PLL_MMR_CFG_PLL13_STAT=(0x0000D024)
LOCAL &__CSL_MAIN_PLL_MMR_CFG_PLL13_FREQ_CTRL0
&__CSL_MAIN_PLL_MMR_CFG_PLL13_FREQ_CTRL0=(0x0000D030)
LOCAL &__CSL_MAIN_PLL_MMR_CFG_PLL13_FREQ_CTRL1
&__CSL_MAIN_PLL_MMR_CFG_PLL13_FREQ_CTRL1=(0x0000D034)
LOCAL &__CSL_MAIN_PLL_MMR_CFG_PLL13_DIV_CTRL
&__CSL_MAIN_PLL_MMR_CFG_PLL13_DIV_CTRL=(0x0000D038)
LOCAL &__CSL_MAIN_PLL_MMR_CFG_PLL13_SS_CTRL
&__CSL_MAIN_PLL_MMR_CFG_PLL13_SS_CTRL=(0x0000D040)
LOCAL &__CSL_MAIN_PLL_MMR_CFG_PLL13_SS_SPREAD
&__CSL_MAIN_PLL_MMR_CFG_PLL13_SS_SPREAD=(0x0000D044)
LOCAL &__CSL_MAIN_PLL_MMR_CFG_PLL13_HSDIV_CTRL0
&__CSL_MAIN_PLL_MMR_CFG_PLL13_HSDIV_CTRL0=(0x0000D080)
LOCAL &__CSL_MAIN_PLL_MMR_CFG_PLL13_HSDIV_CTRL1
&__CSL_MAIN_PLL_MMR_CFG_PLL13_HSDIV_CTRL1=(0x0000D084)
LOCAL &__CSL_MAIN_PLL_MMR_CFG_PLL13_HSDIV_CTRL2
&__CSL_MAIN_PLL_MMR_CFG_PLL13_HSDIV_CTRL2=(0x0000D088)
LOCAL &__CSL_MAIN_PLL_MMR_CFG_PLL13_HSDIV_CTRL3
&__CSL_MAIN_PLL_MMR_CFG_PLL13_HSDIV_CTRL3=(0x0000D08C)
LOCAL &__CSL_MAIN_PLL_MMR_CFG_PLL14_PID
&__CSL_MAIN_PLL_MMR_CFG_PLL14_PID=(0x0000E000)
LOCAL &__CSL_MAIN_PLL_MMR_CFG_PLL14_MMR_CFG
&__CSL_MAIN_PLL_MMR_CFG_PLL14_MMR_CFG=(0x0000E008)
LOCAL &__CSL_MAIN_PLL_MMR_CFG_PLL14_LOCKKEY0
&__CSL_MAIN_PLL_MMR_CFG_PLL14_LOCKKEY0=(0x0000E010)
LOCAL &__CSL_MAIN_PLL_MMR_CFG_PLL14_LOCKKEY1
&__CSL_MAIN_PLL_MMR_CFG_PLL14_LOCKKEY1=(0x0000E014)
LOCAL &__CSL_MAIN_PLL_MMR_CFG_PLL14_CTRL
&__CSL_MAIN_PLL_MMR_CFG_PLL14_CTRL=(0x0000E020)
LOCAL &__CSL_MAIN_PLL_MMR_CFG_PLL14_STAT
&__CSL_MAIN_PLL_MMR_CFG_PLL14_STAT=(0x0000E024)
LOCAL &__CSL_MAIN_PLL_MMR_CFG_PLL14_FREQ_CTRL0
&__CSL_MAIN_PLL_MMR_CFG_PLL14_FREQ_CTRL0=(0x0000E030)
LOCAL &__CSL_MAIN_PLL_MMR_CFG_PLL14_FREQ_CTRL1
&__CSL_MAIN_PLL_MMR_CFG_PLL14_FREQ_CTRL1=(0x0000E034)
LOCAL &__CSL_MAIN_PLL_MMR_CFG_PLL14_DIV_CTRL
&__CSL_MAIN_PLL_MMR_CFG_PLL14_DIV_CTRL=(0x0000E038)
LOCAL &__CSL_MAIN_PLL_MMR_CFG_PLL14_SS_CTRL
&__CSL_MAIN_PLL_MMR_CFG_PLL14_SS_CTRL=(0x0000E040)
LOCAL &__CSL_MAIN_PLL_MMR_CFG_PLL14_SS_SPREAD
&__CSL_MAIN_PLL_MMR_CFG_PLL14_SS_SPREAD=(0x0000E044)
LOCAL &__CSL_MAIN_PLL_MMR_CFG_PLL14_HSDIV_CTRL0
&__CSL_MAIN_PLL_MMR_CFG_PLL14_HSDIV_CTRL0=(0x0000E080)
LOCAL &__CSL_MAIN_PLL_MMR_CFG_PLL14_HSDIV_CTRL1
&__CSL_MAIN_PLL_MMR_CFG_PLL14_HSDIV_CTRL1=(0x0000E084)
LOCAL &__CSL_MAIN_PLL_MMR_CFG_PLL15_PID
&__CSL_MAIN_PLL_MMR_CFG_PLL15_PID=(0x0000F000)
LOCAL &__CSL_MAIN_PLL_MMR_CFG_PLL15_MMR_CFG
&__CSL_MAIN_PLL_MMR_CFG_PLL15_MMR_CFG=(0x0000F008)
LOCAL &__CSL_MAIN_PLL_MMR_CFG_PLL15_LOCKKEY0
&__CSL_MAIN_PLL_MMR_CFG_PLL15_LOCKKEY0=(0x0000F010)
LOCAL &__CSL_MAIN_PLL_MMR_CFG_PLL15_LOCKKEY1
&__CSL_MAIN_PLL_MMR_CFG_PLL15_LOCKKEY1=(0x0000F014)
LOCAL &__CSL_MAIN_PLL_MMR_CFG_PLL15_CTRL
&__CSL_MAIN_PLL_MMR_CFG_PLL15_CTRL=(0x0000F020)
LOCAL &__CSL_MAIN_PLL_MMR_CFG_PLL15_STAT
&__CSL_MAIN_PLL_MMR_CFG_PLL15_STAT=(0x0000F024)
LOCAL &__CSL_MAIN_PLL_MMR_CFG_PLL15_FREQ_CTRL0
&__CSL_MAIN_PLL_MMR_CFG_PLL15_FREQ_CTRL0=(0x0000F030)
LOCAL &__CSL_MAIN_PLL_MMR_CFG_PLL15_FREQ_CTRL1
&__CSL_MAIN_PLL_MMR_CFG_PLL15_FREQ_CTRL1=(0x0000F034)
LOCAL &__CSL_MAIN_PLL_MMR_CFG_PLL15_DIV_CTRL
&__CSL_MAIN_PLL_MMR_CFG_PLL15_DIV_CTRL=(0x0000F038)
LOCAL &__CSL_MAIN_PLL_MMR_CFG_PLL15_SS_CTRL
&__CSL_MAIN_PLL_MMR_CFG_PLL15_SS_CTRL=(0x0000F040)
LOCAL &__CSL_MAIN_PLL_MMR_CFG_PLL15_SS_SPREAD
&__CSL_MAIN_PLL_MMR_CFG_PLL15_SS_SPREAD=(0x0000F044)
LOCAL &__CSL_MAIN_PLL_MMR_CFG_PLL15_HSDIV_CTRL0
&__CSL_MAIN_PLL_MMR_CFG_PLL15_HSDIV_CTRL0=(0x0000F080)
LOCAL &__CSL_MAIN_PLL_MMR_CFG_PLL15_HSDIV_CTRL1
&__CSL_MAIN_PLL_MMR_CFG_PLL15_HSDIV_CTRL1=(0x0000F084)
LOCAL &__CSL_MAIN_PLL_MMR_CFG_PLL15_HSDIV_CTRL2
&__CSL_MAIN_PLL_MMR_CFG_PLL15_HSDIV_CTRL2=(0x0000F088)
LOCAL &__CSL_MAIN_PLL_MMR_CFG_PLL15_HSDIV_CTRL3
&__CSL_MAIN_PLL_MMR_CFG_PLL15_HSDIV_CTRL3=(0x0000F08C)
LOCAL &__CSL_MAIN_PLL_MMR_CFG_PLL16_PID
&__CSL_MAIN_PLL_MMR_CFG_PLL16_PID=(0x00010000)
LOCAL &__CSL_MAIN_PLL_MMR_CFG_PLL16_MMR_CFG
&__CSL_MAIN_PLL_MMR_CFG_PLL16_MMR_CFG=(0x00010008)
LOCAL &__CSL_MAIN_PLL_MMR_CFG_PLL16_LOCKKEY0
&__CSL_MAIN_PLL_MMR_CFG_PLL16_LOCKKEY0=(0x00010010)
LOCAL &__CSL_MAIN_PLL_MMR_CFG_PLL16_LOCKKEY1
&__CSL_MAIN_PLL_MMR_CFG_PLL16_LOCKKEY1=(0x00010014)
LOCAL &__CSL_MAIN_PLL_MMR_CFG_PLL16_CTRL
&__CSL_MAIN_PLL_MMR_CFG_PLL16_CTRL=(0x00010020)
LOCAL &__CSL_MAIN_PLL_MMR_CFG_PLL16_STAT
&__CSL_MAIN_PLL_MMR_CFG_PLL16_STAT=(0x00010024)
LOCAL &__CSL_MAIN_PLL_MMR_CFG_PLL16_FREQ_CTRL0
&__CSL_MAIN_PLL_MMR_CFG_PLL16_FREQ_CTRL0=(0x00010030)
LOCAL &__CSL_MAIN_PLL_MMR_CFG_PLL16_FREQ_CTRL1
&__CSL_MAIN_PLL_MMR_CFG_PLL16_FREQ_CTRL1=(0x00010034)
LOCAL &__CSL_MAIN_PLL_MMR_CFG_PLL16_DIV_CTRL
&__CSL_MAIN_PLL_MMR_CFG_PLL16_DIV_CTRL=(0x00010038)
LOCAL &__CSL_MAIN_PLL_MMR_CFG_PLL16_SS_CTRL
&__CSL_MAIN_PLL_MMR_CFG_PLL16_SS_CTRL=(0x00010040)
LOCAL &__CSL_MAIN_PLL_MMR_CFG_PLL16_SS_SPREAD
&__CSL_MAIN_PLL_MMR_CFG_PLL16_SS_SPREAD=(0x00010044)
LOCAL &__CSL_MAIN_PLL_MMR_CFG_PLL16_HSDIV_CTRL0
&__CSL_MAIN_PLL_MMR_CFG_PLL16_HSDIV_CTRL0=(0x00010080)
LOCAL &__CSL_MAIN_PLL_MMR_CFG_PLL16_HSDIV_CTRL1
&__CSL_MAIN_PLL_MMR_CFG_PLL16_HSDIV_CTRL1=(0x00010084)
LOCAL &__CSL_MAIN_PLL_MMR_CFG_PLL17_PID
&__CSL_MAIN_PLL_MMR_CFG_PLL17_PID=(0x00011000)
LOCAL &__CSL_MAIN_PLL_MMR_CFG_PLL17_MMR_CFG
&__CSL_MAIN_PLL_MMR_CFG_PLL17_MMR_CFG=(0x00011008)
LOCAL &__CSL_MAIN_PLL_MMR_CFG_PLL17_LOCKKEY0
&__CSL_MAIN_PLL_MMR_CFG_PLL17_LOCKKEY0=(0x00011010)
LOCAL &__CSL_MAIN_PLL_MMR_CFG_PLL17_LOCKKEY1
&__CSL_MAIN_PLL_MMR_CFG_PLL17_LOCKKEY1=(0x00011014)
LOCAL &__CSL_MAIN_PLL_MMR_CFG_PLL17_CTRL
&__CSL_MAIN_PLL_MMR_CFG_PLL17_CTRL=(0x00011020)
LOCAL &__CSL_MAIN_PLL_MMR_CFG_PLL17_STAT
&__CSL_MAIN_PLL_MMR_CFG_PLL17_STAT=(0x00011024)
LOCAL &__CSL_MAIN_PLL_MMR_CFG_PLL17_FREQ_CTRL0
&__CSL_MAIN_PLL_MMR_CFG_PLL17_FREQ_CTRL0=(0x00011030)
LOCAL &__CSL_MAIN_PLL_MMR_CFG_PLL17_FREQ_CTRL1
&__CSL_MAIN_PLL_MMR_CFG_PLL17_FREQ_CTRL1=(0x00011034)
LOCAL &__CSL_MAIN_PLL_MMR_CFG_PLL17_DIV_CTRL
&__CSL_MAIN_PLL_MMR_CFG_PLL17_DIV_CTRL=(0x00011038)
LOCAL &__CSL_MAIN_PLL_MMR_CFG_PLL17_SS_CTRL
&__CSL_MAIN_PLL_MMR_CFG_PLL17_SS_CTRL=(0x00011040)
LOCAL &__CSL_MAIN_PLL_MMR_CFG_PLL17_SS_SPREAD
&__CSL_MAIN_PLL_MMR_CFG_PLL17_SS_SPREAD=(0x00011044)
LOCAL &__CSL_MAIN_PLL_MMR_CFG_PLL17_HSDIV_CTRL0
&__CSL_MAIN_PLL_MMR_CFG_PLL17_HSDIV_CTRL0=(0x00011080)
LOCAL &__CSL_MAIN_PLL_MMR_CFG_PLL17_HSDIV_CTRL1
&__CSL_MAIN_PLL_MMR_CFG_PLL17_HSDIV_CTRL1=(0x00011084)
LOCAL &__CSL_MAIN_PLL_MMR_CFG_PLL18_PID
&__CSL_MAIN_PLL_MMR_CFG_PLL18_PID=(0x00012000)
LOCAL &__CSL_MAIN_PLL_MMR_CFG_PLL18_MMR_CFG
&__CSL_MAIN_PLL_MMR_CFG_PLL18_MMR_CFG=(0x00012008)
LOCAL &__CSL_MAIN_PLL_MMR_CFG_PLL18_LOCKKEY0
&__CSL_MAIN_PLL_MMR_CFG_PLL18_LOCKKEY0=(0x00012010)
LOCAL &__CSL_MAIN_PLL_MMR_CFG_PLL18_LOCKKEY1
&__CSL_MAIN_PLL_MMR_CFG_PLL18_LOCKKEY1=(0x00012014)
LOCAL &__CSL_MAIN_PLL_MMR_CFG_PLL18_CTRL
&__CSL_MAIN_PLL_MMR_CFG_PLL18_CTRL=(0x00012020)
LOCAL &__CSL_MAIN_PLL_MMR_CFG_PLL18_STAT
&__CSL_MAIN_PLL_MMR_CFG_PLL18_STAT=(0x00012024)
LOCAL &__CSL_MAIN_PLL_MMR_CFG_PLL18_FREQ_CTRL0
&__CSL_MAIN_PLL_MMR_CFG_PLL18_FREQ_CTRL0=(0x00012030)
LOCAL &__CSL_MAIN_PLL_MMR_CFG_PLL18_FREQ_CTRL1
&__CSL_MAIN_PLL_MMR_CFG_PLL18_FREQ_CTRL1=(0x00012034)
LOCAL &__CSL_MAIN_PLL_MMR_CFG_PLL18_DIV_CTRL
&__CSL_MAIN_PLL_MMR_CFG_PLL18_DIV_CTRL=(0x00012038)
LOCAL &__CSL_MAIN_PLL_MMR_CFG_PLL18_SS_CTRL
&__CSL_MAIN_PLL_MMR_CFG_PLL18_SS_CTRL=(0x00012040)
LOCAL &__CSL_MAIN_PLL_MMR_CFG_PLL18_SS_SPREAD
&__CSL_MAIN_PLL_MMR_CFG_PLL18_SS_SPREAD=(0x00012044)
LOCAL &__CSL_MAIN_PLL_MMR_CFG_PLL18_HSDIV_CTRL0
&__CSL_MAIN_PLL_MMR_CFG_PLL18_HSDIV_CTRL0=(0x00012080)
LOCAL &__CSL_MAIN_PLL_MMR_CFG_PLL18_HSDIV_CTRL1
&__CSL_MAIN_PLL_MMR_CFG_PLL18_HSDIV_CTRL1=(0x00012084)
LOCAL &__CSL_MAIN_PLL_MMR_CFG_PLL19_PID
&__CSL_MAIN_PLL_MMR_CFG_PLL19_PID=(0x00013000)
LOCAL &__CSL_MAIN_PLL_MMR_CFG_PLL19_MMR_CFG
&__CSL_MAIN_PLL_MMR_CFG_PLL19_MMR_CFG=(0x00013008)
LOCAL &__CSL_MAIN_PLL_MMR_CFG_PLL19_LOCKKEY0
&__CSL_MAIN_PLL_MMR_CFG_PLL19_LOCKKEY0=(0x00013010)
LOCAL &__CSL_MAIN_PLL_MMR_CFG_PLL19_LOCKKEY1
&__CSL_MAIN_PLL_MMR_CFG_PLL19_LOCKKEY1=(0x00013014)
LOCAL &__CSL_MAIN_PLL_MMR_CFG_PLL19_CTRL
&__CSL_MAIN_PLL_MMR_CFG_PLL19_CTRL=(0x00013020)
LOCAL &__CSL_MAIN_PLL_MMR_CFG_PLL19_STAT
&__CSL_MAIN_PLL_MMR_CFG_PLL19_STAT=(0x00013024)
LOCAL &__CSL_MAIN_PLL_MMR_CFG_PLL19_FREQ_CTRL0
&__CSL_MAIN_PLL_MMR_CFG_PLL19_FREQ_CTRL0=(0x00013030)
LOCAL &__CSL_MAIN_PLL_MMR_CFG_PLL19_FREQ_CTRL1
&__CSL_MAIN_PLL_MMR_CFG_PLL19_FREQ_CTRL1=(0x00013034)
LOCAL &__CSL_MAIN_PLL_MMR_CFG_PLL19_DIV_CTRL
&__CSL_MAIN_PLL_MMR_CFG_PLL19_DIV_CTRL=(0x00013038)
LOCAL &__CSL_MAIN_PLL_MMR_CFG_PLL19_SS_CTRL
&__CSL_MAIN_PLL_MMR_CFG_PLL19_SS_CTRL=(0x00013040)
LOCAL &__CSL_MAIN_PLL_MMR_CFG_PLL19_SS_SPREAD
&__CSL_MAIN_PLL_MMR_CFG_PLL19_SS_SPREAD=(0x00013044)
LOCAL &__CSL_MAIN_PLL_MMR_CFG_PLL19_HSDIV_CTRL0
&__CSL_MAIN_PLL_MMR_CFG_PLL19_HSDIV_CTRL0=(0x00013080)
LOCAL &__CSL_MAIN_PLL_MMR_CFG_PLL19_HSDIV_CTRL1
&__CSL_MAIN_PLL_MMR_CFG_PLL19_HSDIV_CTRL1=(0x00013084)
LOCAL &__CSL_MAIN_PLL_MMR_CFG_PLL20_PID
&__CSL_MAIN_PLL_MMR_CFG_PLL20_PID=(0x00014000)
LOCAL &__CSL_MAIN_PLL_MMR_CFG_PLL20_MMR_CFG
&__CSL_MAIN_PLL_MMR_CFG_PLL20_MMR_CFG=(0x00014008)
LOCAL &__CSL_MAIN_PLL_MMR_CFG_PLL20_LOCKKEY0
&__CSL_MAIN_PLL_MMR_CFG_PLL20_LOCKKEY0=(0x00014010)
LOCAL &__CSL_MAIN_PLL_MMR_CFG_PLL20_LOCKKEY1
&__CSL_MAIN_PLL_MMR_CFG_PLL20_LOCKKEY1=(0x00014014)
LOCAL &__CSL_MAIN_PLL_MMR_CFG_PLL20_CTRL
&__CSL_MAIN_PLL_MMR_CFG_PLL20_CTRL=(0x00014020)
LOCAL &__CSL_MAIN_PLL_MMR_CFG_PLL20_STAT
&__CSL_MAIN_PLL_MMR_CFG_PLL20_STAT=(0x00014024)
LOCAL &__CSL_MAIN_PLL_MMR_CFG_PLL20_FREQ_CTRL0
&__CSL_MAIN_PLL_MMR_CFG_PLL20_FREQ_CTRL0=(0x00014030)
LOCAL &__CSL_MAIN_PLL_MMR_CFG_PLL20_FREQ_CTRL1
&__CSL_MAIN_PLL_MMR_CFG_PLL20_FREQ_CTRL1=(0x00014034)
LOCAL &__CSL_MAIN_PLL_MMR_CFG_PLL20_DIV_CTRL
&__CSL_MAIN_PLL_MMR_CFG_PLL20_DIV_CTRL=(0x00014038)
LOCAL &__CSL_MAIN_PLL_MMR_CFG_PLL20_SS_CTRL
&__CSL_MAIN_PLL_MMR_CFG_PLL20_SS_CTRL=(0x00014040)
LOCAL &__CSL_MAIN_PLL_MMR_CFG_PLL20_SS_SPREAD
&__CSL_MAIN_PLL_MMR_CFG_PLL20_SS_SPREAD=(0x00014044)
LOCAL &__CSL_MAIN_PLL_MMR_CFG_PLL20_HSDIV_CTRL0
&__CSL_MAIN_PLL_MMR_CFG_PLL20_HSDIV_CTRL0=(0x00014080)
LOCAL &__CSL_MAIN_PLL_MMR_CFG_PLL20_HSDIV_CTRL1
&__CSL_MAIN_PLL_MMR_CFG_PLL20_HSDIV_CTRL1=(0x00014084)
LOCAL &__CSL_MAIN_PLL_MMR_CFG_PLL21_PID
&__CSL_MAIN_PLL_MMR_CFG_PLL21_PID=(0x00015000)
LOCAL &__CSL_MAIN_PLL_MMR_CFG_PLL21_MMR_CFG
&__CSL_MAIN_PLL_MMR_CFG_PLL21_MMR_CFG=(0x00015008)
LOCAL &__CSL_MAIN_PLL_MMR_CFG_PLL21_LOCKKEY0
&__CSL_MAIN_PLL_MMR_CFG_PLL21_LOCKKEY0=(0x00015010)
LOCAL &__CSL_MAIN_PLL_MMR_CFG_PLL21_LOCKKEY1
&__CSL_MAIN_PLL_MMR_CFG_PLL21_LOCKKEY1=(0x00015014)
LOCAL &__CSL_MAIN_PLL_MMR_CFG_PLL21_CTRL
&__CSL_MAIN_PLL_MMR_CFG_PLL21_CTRL=(0x00015020)
LOCAL &__CSL_MAIN_PLL_MMR_CFG_PLL21_STAT
&__CSL_MAIN_PLL_MMR_CFG_PLL21_STAT=(0x00015024)
LOCAL &__CSL_MAIN_PLL_MMR_CFG_PLL21_FREQ_CTRL0
&__CSL_MAIN_PLL_MMR_CFG_PLL21_FREQ_CTRL0=(0x00015030)
LOCAL &__CSL_MAIN_PLL_MMR_CFG_PLL21_FREQ_CTRL1
&__CSL_MAIN_PLL_MMR_CFG_PLL21_FREQ_CTRL1=(0x00015034)
LOCAL &__CSL_MAIN_PLL_MMR_CFG_PLL21_DIV_CTRL
&__CSL_MAIN_PLL_MMR_CFG_PLL21_DIV_CTRL=(0x00015038)
LOCAL &__CSL_MAIN_PLL_MMR_CFG_PLL21_SS_CTRL
&__CSL_MAIN_PLL_MMR_CFG_PLL21_SS_CTRL=(0x00015040)
LOCAL &__CSL_MAIN_PLL_MMR_CFG_PLL21_SS_SPREAD
&__CSL_MAIN_PLL_MMR_CFG_PLL21_SS_SPREAD=(0x00015044)
LOCAL &__CSL_MAIN_PLL_MMR_CFG_PLL21_HSDIV_CTRL0
&__CSL_MAIN_PLL_MMR_CFG_PLL21_HSDIV_CTRL0=(0x00015080)
LOCAL &__CSL_MAIN_PLL_MMR_CFG_PLL21_HSDIV_CTRL1
&__CSL_MAIN_PLL_MMR_CFG_PLL21_HSDIV_CTRL1=(0x00015084)
LOCAL &__CSL_MAIN_PLL_MMR_CFG_PLL22_PID
&__CSL_MAIN_PLL_MMR_CFG_PLL22_PID=(0x00016000)
LOCAL &__CSL_MAIN_PLL_MMR_CFG_PLL22_MMR_CFG
&__CSL_MAIN_PLL_MMR_CFG_PLL22_MMR_CFG=(0x00016008)
LOCAL &__CSL_MAIN_PLL_MMR_CFG_PLL22_LOCKKEY0
&__CSL_MAIN_PLL_MMR_CFG_PLL22_LOCKKEY0=(0x00016010)
LOCAL &__CSL_MAIN_PLL_MMR_CFG_PLL22_LOCKKEY1
&__CSL_MAIN_PLL_MMR_CFG_PLL22_LOCKKEY1=(0x00016014)
LOCAL &__CSL_MAIN_PLL_MMR_CFG_PLL22_CTRL
&__CSL_MAIN_PLL_MMR_CFG_PLL22_CTRL=(0x00016020)
LOCAL &__CSL_MAIN_PLL_MMR_CFG_PLL22_STAT
&__CSL_MAIN_PLL_MMR_CFG_PLL22_STAT=(0x00016024)
LOCAL &__CSL_MAIN_PLL_MMR_CFG_PLL22_FREQ_CTRL0
&__CSL_MAIN_PLL_MMR_CFG_PLL22_FREQ_CTRL0=(0x00016030)
LOCAL &__CSL_MAIN_PLL_MMR_CFG_PLL22_FREQ_CTRL1
&__CSL_MAIN_PLL_MMR_CFG_PLL22_FREQ_CTRL1=(0x00016034)
LOCAL &__CSL_MAIN_PLL_MMR_CFG_PLL22_DIV_CTRL
&__CSL_MAIN_PLL_MMR_CFG_PLL22_DIV_CTRL=(0x00016038)
LOCAL &__CSL_MAIN_PLL_MMR_CFG_PLL22_SS_CTRL
&__CSL_MAIN_PLL_MMR_CFG_PLL22_SS_CTRL=(0x00016040)
LOCAL &__CSL_MAIN_PLL_MMR_CFG_PLL22_SS_SPREAD
&__CSL_MAIN_PLL_MMR_CFG_PLL22_SS_SPREAD=(0x00016044)
LOCAL &__CSL_MAIN_PLL_MMR_CFG_PLL22_HSDIV_CTRL0
&__CSL_MAIN_PLL_MMR_CFG_PLL22_HSDIV_CTRL0=(0x00016080)
LOCAL &__CSL_MAIN_PLL_MMR_CFG_PLL22_HSDIV_CTRL1
&__CSL_MAIN_PLL_MMR_CFG_PLL22_HSDIV_CTRL1=(0x00016084)
LOCAL &__CSL_MAIN_PLL_MMR_CFG_PLL23_PID
&__CSL_MAIN_PLL_MMR_CFG_PLL23_PID=(0x00017000)
LOCAL &__CSL_MAIN_PLL_MMR_CFG_PLL23_MMR_CFG
&__CSL_MAIN_PLL_MMR_CFG_PLL23_MMR_CFG=(0x00017008)
LOCAL &__CSL_MAIN_PLL_MMR_CFG_PLL23_LOCKKEY0
&__CSL_MAIN_PLL_MMR_CFG_PLL23_LOCKKEY0=(0x00017010)
LOCAL &__CSL_MAIN_PLL_MMR_CFG_PLL23_LOCKKEY1
&__CSL_MAIN_PLL_MMR_CFG_PLL23_LOCKKEY1=(0x00017014)
LOCAL &__CSL_MAIN_PLL_MMR_CFG_PLL23_CTRL
&__CSL_MAIN_PLL_MMR_CFG_PLL23_CTRL=(0x00017020)
LOCAL &__CSL_MAIN_PLL_MMR_CFG_PLL23_STAT
&__CSL_MAIN_PLL_MMR_CFG_PLL23_STAT=(0x00017024)
LOCAL &__CSL_MAIN_PLL_MMR_CFG_PLL23_FREQ_CTRL0
&__CSL_MAIN_PLL_MMR_CFG_PLL23_FREQ_CTRL0=(0x00017030)
LOCAL &__CSL_MAIN_PLL_MMR_CFG_PLL23_FREQ_CTRL1
&__CSL_MAIN_PLL_MMR_CFG_PLL23_FREQ_CTRL1=(0x00017034)
LOCAL &__CSL_MAIN_PLL_MMR_CFG_PLL23_DIV_CTRL
&__CSL_MAIN_PLL_MMR_CFG_PLL23_DIV_CTRL=(0x00017038)
LOCAL &__CSL_MAIN_PLL_MMR_CFG_PLL23_SS_CTRL
&__CSL_MAIN_PLL_MMR_CFG_PLL23_SS_CTRL=(0x00017040)
LOCAL &__CSL_MAIN_PLL_MMR_CFG_PLL23_SS_SPREAD
&__CSL_MAIN_PLL_MMR_CFG_PLL23_SS_SPREAD=(0x00017044)
LOCAL &__CSL_MAIN_PLL_MMR_CFG_PLL23_HSDIV_CTRL0
&__CSL_MAIN_PLL_MMR_CFG_PLL23_HSDIV_CTRL0=(0x00017080)
LOCAL &__CSL_MAIN_PLL_MMR_CFG_PLL23_HSDIV_CTRL1
&__CSL_MAIN_PLL_MMR_CFG_PLL23_HSDIV_CTRL1=(0x00017084)
LOCAL &__CSL_MAIN_PLL_MMR_CFG_PLL24_PID
&__CSL_MAIN_PLL_MMR_CFG_PLL24_PID=(0x00018000)
LOCAL &__CSL_MAIN_PLL_MMR_CFG_PLL24_MMR_CFG
&__CSL_MAIN_PLL_MMR_CFG_PLL24_MMR_CFG=(0x00018008)
LOCAL &__CSL_MAIN_PLL_MMR_CFG_PLL24_LOCKKEY0
&__CSL_MAIN_PLL_MMR_CFG_PLL24_LOCKKEY0=(0x00018010)
LOCAL &__CSL_MAIN_PLL_MMR_CFG_PLL24_LOCKKEY1
&__CSL_MAIN_PLL_MMR_CFG_PLL24_LOCKKEY1=(0x00018014)
LOCAL &__CSL_MAIN_PLL_MMR_CFG_PLL24_PLL_CTRL
&__CSL_MAIN_PLL_MMR_CFG_PLL24_PLL_CTRL=(0x00018020)
LOCAL &__CSL_MAIN_PLL_MMR_CFG_PLL24_DSPLL_STAT
&__CSL_MAIN_PLL_MMR_CFG_PLL24_DSPLL_STAT=(0x00018024)
LOCAL &__CSL_MAIN_PLL_MMR_CFG_PLL24_PLL_DIV_CTRL
&__CSL_MAIN_PLL_MMR_CFG_PLL24_PLL_DIV_CTRL=(0x00018038)
LOCAL &__CSL_MAIN_PLL_MMR_CFG_PLL24_PLL_TEST_CTRL
&__CSL_MAIN_PLL_MMR_CFG_PLL24_PLL_TEST_CTRL=(0x00018050)
LOCAL &__CSL_MAIN_PLL_MMR_CFG_PLL24_DSCAL_CTRL
&__CSL_MAIN_PLL_MMR_CFG_PLL24_DSCAL_CTRL=(0x00018060)
LOCAL &__CSL_MAIN_PLL_MMR_CFG_PLL24_DSCAL_STAT
&__CSL_MAIN_PLL_MMR_CFG_PLL24_DSCAL_STAT=(0x00018064)
LOCAL &__CSL_MAIN_PLL_MMR_CFG_PLL24_HSDIV_CTRL0
&__CSL_MAIN_PLL_MMR_CFG_PLL24_HSDIV_CTRL0=(0x00018080)
LOCAL &__CSL_MAIN_PLL_MMR_CFG_PLL25_PID
&__CSL_MAIN_PLL_MMR_CFG_PLL25_PID=(0x00019000)
LOCAL &__CSL_MAIN_PLL_MMR_CFG_PLL25_MMR_CFG
&__CSL_MAIN_PLL_MMR_CFG_PLL25_MMR_CFG=(0x00019008)
LOCAL &__CSL_MAIN_PLL_MMR_CFG_PLL25_LOCKKEY0
&__CSL_MAIN_PLL_MMR_CFG_PLL25_LOCKKEY0=(0x00019010)
LOCAL &__CSL_MAIN_PLL_MMR_CFG_PLL25_LOCKKEY1
&__CSL_MAIN_PLL_MMR_CFG_PLL25_LOCKKEY1=(0x00019014)
LOCAL &__CSL_MAIN_PLL_MMR_CFG_PLL25_CTRL
&__CSL_MAIN_PLL_MMR_CFG_PLL25_CTRL=(0x00019020)
LOCAL &__CSL_MAIN_PLL_MMR_CFG_PLL25_STAT
&__CSL_MAIN_PLL_MMR_CFG_PLL25_STAT=(0x00019024)
LOCAL &__CSL_MAIN_PLL_MMR_CFG_PLL25_FREQ_CTRL0
&__CSL_MAIN_PLL_MMR_CFG_PLL25_FREQ_CTRL0=(0x00019030)
LOCAL &__CSL_MAIN_PLL_MMR_CFG_PLL25_FREQ_CTRL1
&__CSL_MAIN_PLL_MMR_CFG_PLL25_FREQ_CTRL1=(0x00019034)
LOCAL &__CSL_MAIN_PLL_MMR_CFG_PLL25_DIV_CTRL
&__CSL_MAIN_PLL_MMR_CFG_PLL25_DIV_CTRL=(0x00019038)
LOCAL &__CSL_MAIN_PLL_MMR_CFG_PLL25_SS_CTRL
&__CSL_MAIN_PLL_MMR_CFG_PLL25_SS_CTRL=(0x00019040)
LOCAL &__CSL_MAIN_PLL_MMR_CFG_PLL25_SS_SPREAD
&__CSL_MAIN_PLL_MMR_CFG_PLL25_SS_SPREAD=(0x00019044)
LOCAL &__CSL_MAIN_PLL_MMR_CFG_PLL25_HSDIV_CTRL0
&__CSL_MAIN_PLL_MMR_CFG_PLL25_HSDIV_CTRL0=(0x00019080)
LOCAL &__CSL_MAIN_PLL_MMR_CFG_PLL25_HSDIV_CTRL1
&__CSL_MAIN_PLL_MMR_CFG_PLL25_HSDIV_CTRL1=(0x00019084)
// -- MCU PLL ---------------------------------------------------------------------
LOCAL &__CSL_MCU_PLL_MMR_CFG_PLL0_PID
&__CSL_MCU_PLL_MMR_CFG_PLL0_PID=(0x00000000)
LOCAL &__CSL_MCU_PLL_MMR_CFG_PLL0_MMR_CFG
&__CSL_MCU_PLL_MMR_CFG_PLL0_MMR_CFG=(0x00000008)
LOCAL &__CSL_MCU_PLL_MMR_CFG_PLL0_LOCKKEY0
&__CSL_MCU_PLL_MMR_CFG_PLL0_LOCKKEY0=(0x00000010)
LOCAL &__CSL_MCU_PLL_MMR_CFG_PLL0_LOCKKEY1
&__CSL_MCU_PLL_MMR_CFG_PLL0_LOCKKEY1=(0x00000014)
LOCAL &__CSL_MCU_PLL_MMR_CFG_PLL0_CTRL
&__CSL_MCU_PLL_MMR_CFG_PLL0_CTRL=(0x00000020)
LOCAL &__CSL_MCU_PLL_MMR_CFG_PLL0_STAT
&__CSL_MCU_PLL_MMR_CFG_PLL0_STAT=(0x00000024)
LOCAL &__CSL_MCU_PLL_MMR_CFG_PLL0_FREQ_CTRL0
&__CSL_MCU_PLL_MMR_CFG_PLL0_FREQ_CTRL0=(0x00000030)
LOCAL &__CSL_MCU_PLL_MMR_CFG_PLL0_FREQ_CTRL1
&__CSL_MCU_PLL_MMR_CFG_PLL0_FREQ_CTRL1=(0x00000034)
LOCAL &__CSL_MCU_PLL_MMR_CFG_PLL0_DIV_CTRL
&__CSL_MCU_PLL_MMR_CFG_PLL0_DIV_CTRL=(0x00000038)
LOCAL &__CSL_MCU_PLL_MMR_CFG_PLL0_SS_CTRL
&__CSL_MCU_PLL_MMR_CFG_PLL0_SS_CTRL=(0x00000040)
LOCAL &__CSL_MCU_PLL_MMR_CFG_PLL0_SS_SPREAD
&__CSL_MCU_PLL_MMR_CFG_PLL0_SS_SPREAD=(0x00000044)
LOCAL &__CSL_MCU_PLL_MMR_CFG_PLL0_HSDIV_CTRL0
&__CSL_MCU_PLL_MMR_CFG_PLL0_HSDIV_CTRL0=(0x00000080)
LOCAL &__CSL_MCU_PLL_MMR_CFG_PLL0_HSDIV_CTRL1
&__CSL_MCU_PLL_MMR_CFG_PLL0_HSDIV_CTRL1=(0x00000084)
LOCAL &__CSL_MCU_PLL_MMR_CFG_PLL1_PID
&__CSL_MCU_PLL_MMR_CFG_PLL1_PID=(0x00001000)
LOCAL &__CSL_MCU_PLL_MMR_CFG_PLL1_MMR_CFG
&__CSL_MCU_PLL_MMR_CFG_PLL1_MMR_CFG=(0x00001008)
LOCAL &__CSL_MCU_PLL_MMR_CFG_PLL1_LOCKKEY0
&__CSL_MCU_PLL_MMR_CFG_PLL1_LOCKKEY0=(0x00001010)
LOCAL &__CSL_MCU_PLL_MMR_CFG_PLL1_LOCKKEY1
&__CSL_MCU_PLL_MMR_CFG_PLL1_LOCKKEY1=(0x00001014)
LOCAL &__CSL_MCU_PLL_MMR_CFG_PLL1_CTRL
&__CSL_MCU_PLL_MMR_CFG_PLL1_CTRL=(0x00001020)
LOCAL &__CSL_MCU_PLL_MMR_CFG_PLL1_STAT
&__CSL_MCU_PLL_MMR_CFG_PLL1_STAT=(0x00001024)
LOCAL &__CSL_MCU_PLL_MMR_CFG_PLL1_FREQ_CTRL0
&__CSL_MCU_PLL_MMR_CFG_PLL1_FREQ_CTRL0=(0x00001030)
LOCAL &__CSL_MCU_PLL_MMR_CFG_PLL1_FREQ_CTRL1
&__CSL_MCU_PLL_MMR_CFG_PLL1_FREQ_CTRL1=(0x00001034)
LOCAL &__CSL_MCU_PLL_MMR_CFG_PLL1_DIV_CTRL
&__CSL_MCU_PLL_MMR_CFG_PLL1_DIV_CTRL=(0x00001038)
LOCAL &__CSL_MCU_PLL_MMR_CFG_PLL1_SS_CTRL
&__CSL_MCU_PLL_MMR_CFG_PLL1_SS_CTRL=(0x00001040)
LOCAL &__CSL_MCU_PLL_MMR_CFG_PLL1_SS_SPREAD
&__CSL_MCU_PLL_MMR_CFG_PLL1_SS_SPREAD=(0x00001044)
LOCAL &__CSL_MCU_PLL_MMR_CFG_PLL1_HSDIV_CTRL0
&__CSL_MCU_PLL_MMR_CFG_PLL1_HSDIV_CTRL0=(0x00001080)
LOCAL &__CSL_MCU_PLL_MMR_CFG_PLL1_HSDIV_CTRL1
&__CSL_MCU_PLL_MMR_CFG_PLL1_HSDIV_CTRL1=(0x00001084)
LOCAL &__CSL_MCU_PLL_MMR_CFG_PLL1_HSDIV_CTRL2
&__CSL_MCU_PLL_MMR_CFG_PLL1_HSDIV_CTRL2=(0x00001088)
LOCAL &__CSL_MCU_PLL_MMR_CFG_PLL1_HSDIV_CTRL3
&__CSL_MCU_PLL_MMR_CFG_PLL1_HSDIV_CTRL3=(0x0000108C)
LOCAL &__CSL_MCU_PLL_MMR_CFG_PLL1_HSDIV_CTRL4
&__CSL_MCU_PLL_MMR_CFG_PLL1_HSDIV_CTRL4=(0x00001090)
LOCAL &__CSL_MCU_PLL_MMR_CFG_PLL2_PID
&__CSL_MCU_PLL_MMR_CFG_PLL2_PID=(0x00002000)
LOCAL &__CSL_MCU_PLL_MMR_CFG_PLL2_MMR_CFG
&__CSL_MCU_PLL_MMR_CFG_PLL2_MMR_CFG=(0x00002008)
LOCAL &__CSL_MCU_PLL_MMR_CFG_PLL2_LOCKKEY0
&__CSL_MCU_PLL_MMR_CFG_PLL2_LOCKKEY0=(0x00002010)
LOCAL &__CSL_MCU_PLL_MMR_CFG_PLL2_LOCKKEY1
&__CSL_MCU_PLL_MMR_CFG_PLL2_LOCKKEY1=(0x00002014)
LOCAL &__CSL_MCU_PLL_MMR_CFG_PLL2_CTRL
&__CSL_MCU_PLL_MMR_CFG_PLL2_CTRL=(0x00002020)
LOCAL &__CSL_MCU_PLL_MMR_CFG_PLL2_STAT
&__CSL_MCU_PLL_MMR_CFG_PLL2_STAT=(0x00002024)
LOCAL &__CSL_MCU_PLL_MMR_CFG_PLL2_FREQ_CTRL0
&__CSL_MCU_PLL_MMR_CFG_PLL2_FREQ_CTRL0=(0x00002030)
LOCAL &__CSL_MCU_PLL_MMR_CFG_PLL2_FREQ_CTRL1
&__CSL_MCU_PLL_MMR_CFG_PLL2_FREQ_CTRL1=(0x00002034)
LOCAL &__CSL_MCU_PLL_MMR_CFG_PLL2_DIV_CTRL
&__CSL_MCU_PLL_MMR_CFG_PLL2_DIV_CTRL=(0x00002038)
LOCAL &__CSL_MCU_PLL_MMR_CFG_PLL2_SS_CTRL
&__CSL_MCU_PLL_MMR_CFG_PLL2_SS_CTRL=(0x00002040)
LOCAL &__CSL_MCU_PLL_MMR_CFG_PLL2_SS_SPREAD
&__CSL_MCU_PLL_MMR_CFG_PLL2_SS_SPREAD=(0x00002044)
LOCAL &__CSL_MCU_PLL_MMR_CFG_PLL2_HSDIV_CTRL0
&__CSL_MCU_PLL_MMR_CFG_PLL2_HSDIV_CTRL0=(0x00002080)
LOCAL &__CSL_MCU_PLL_MMR_CFG_PLL2_HSDIV_CTRL1
&__CSL_MCU_PLL_MMR_CFG_PLL2_HSDIV_CTRL1=(0x00002084)
LOCAL &__CSL_MCU_PLL_MMR_CFG_PLL2_HSDIV_CTRL2
&__CSL_MCU_PLL_MMR_CFG_PLL2_HSDIV_CTRL2=(0x00002088)
LOCAL &__CSL_MCU_PLL_MMR_CFG_PLL2_HSDIV_CTRL3
&__CSL_MCU_PLL_MMR_CFG_PLL2_HSDIV_CTRL3=(0x0000208C)
LOCAL &__CSL_MCU_PLL_MMR_CFG_PLL2_HSDIV_CTRL4
&__CSL_MCU_PLL_MMR_CFG_PLL2_HSDIV_CTRL4=(0x00002090)
// -- PLL controller register offsets
LOCAL &__PLL_CTRL_PLLCTL_OFFSET
&__PLL_CTRL_PLLCTL_OFFSET=(0x0100)
LOCAL &__PLL_CTRL_OCSEL_OFFSET
&__PLL_CTRL_OCSEL_OFFSET=(0x0104)
LOCAL &__PLL_CTRL_PREDIV_OFFSET
&__PLL_CTRL_PREDIV_OFFSET=(0x0114)
LOCAL &__PLL_CTRL_PLLDIV1_OFFSET
&__PLL_CTRL_PLLDIV1_OFFSET=(0x0118)
LOCAL &__PLL_CTRL_PLLDIV2_OFFSET
&__PLL_CTRL_PLLDIV2_OFFSET=(0x011C)
LOCAL &__PLL_CTRL_PLLDIV3_OFFSET
&__PLL_CTRL_PLLDIV3_OFFSET=(0x0120)
LOCAL &__PLL_CTRL_OSCDIV1_OFFSET
&__PLL_CTRL_OSCDIV1_OFFSET=(0x0124)
LOCAL &__PLL_CTRL_POSTDIV_OFFSET
&__PLL_CTRL_POSTDIV_OFFSET=(0x0128)
LOCAL &__PLL_CTRL_BPDIV_OFFSET
&__PLL_CTRL_BPDIV_OFFSET=(0x012C)
LOCAL &__PLL_CTRL_PLLCMD_OFFSET
&__PLL_CTRL_PLLCMD_OFFSET=(0x0138)
LOCAL &__PLL_CTRL_PLLSTAT_OFFSET
&__PLL_CTRL_PLLSTAT_OFFSET=(0x013C)
LOCAL &__PLL_CTRL_ALNCTL_OFFSET
&__PLL_CTRL_ALNCTL_OFFSET=(0x0140)
LOCAL &__PLL_CTRL_CKEN_OFFSET
&__PLL_CTRL_CKEN_OFFSET=(0x0148)
LOCAL &__PLL_CTRL_CKSTAT_OFFSET
&__PLL_CTRL_CKSTAT_OFFSET=(0x014C)
LOCAL &__PLL_CTRL_SYSTAT_OFFSET
&__PLL_CTRL_SYSTAT_OFFSET=(0x0150)
LOCAL &__PLL_CTRL_PLLDIV4_OFFSET
&__PLL_CTRL_PLLDIV4_OFFSET=(0x0160)
LOCAL &__PLL_CTRL_PLLDIV5_OFFSET
&__PLL_CTRL_PLLDIV5_OFFSET=(0x0164)
LOCAL &__PLL_CTRL_PLLDIV6_OFFSET
&__PLL_CTRL_PLLDIV6_OFFSET=(0x0168)
LOCAL &__PLL_CTRL_PLLDIV7_OFFSET
&__PLL_CTRL_PLLDIV7_OFFSET=(0x016C)
LOCAL &__PLL_CTRL_PLLDIV8_OFFSET
&__PLL_CTRL_PLLDIV8_OFFSET=(0x0170)
LOCAL &__PLL_CTRL_PLLDIV9_OFFSET
&__PLL_CTRL_PLLDIV9_OFFSET=(0x0174)
LOCAL &__PLL_CTRL_PLLDIV10_OFFSET
&__PLL_CTRL_PLLDIV10_OFFSET=(0x0178)
LOCAL &__PLL_CTRL_PLLDIV11_OFFSET
&__PLL_CTRL_PLLDIV11_OFFSET=(0x017C)
LOCAL &__PLL_CTRL_PLLDIV12_OFFSET
&__PLL_CTRL_PLLDIV12_OFFSET=(0x0180)
LOCAL &__PLL_CTRL_PLLDIV13_OFFSET
&__PLL_CTRL_PLLDIV13_OFFSET=(0x0184)
LOCAL &__PLL_CTRL_PLLDIV14_OFFSET
&__PLL_CTRL_PLLDIV14_OFFSET=(0x0188)
LOCAL &__PLL_CTRL_PLLDIV15_OFFSET
&__PLL_CTRL_PLLDIV15_OFFSET=(0x018C)
LOCAL &__PLL_CTRL_PLLDIV16_OFFSET
&__PLL_CTRL_PLLDIV16_OFFSET=(0x0190)
// -- PLL Index Map
LOCAL &__MAIN_PLL_INDEX
&__MAIN_PLL_INDEX=(0.)
LOCAL &__PER0_PLL_INDEX
&__PER0_PLL_INDEX=(1.)
LOCAL &__PER1_PLL_INDEX
&__PER1_PLL_INDEX=(2.)
LOCAL &__CPSW5X_PLL_INDEX
&__CPSW5X_PLL_INDEX=(3.)
LOCAL &__AUDIO0_PLL_INDEX
&__AUDIO0_PLL_INDEX=(4.)
LOCAL &__VIDEO_PLL_INDEX
&__VIDEO_PLL_INDEX=(5.)
LOCAL &__MSMC_PLL_INDEX
&__MSMC_PLL_INDEX=(7.)
LOCAL &__ARM0_PLL_INDEX
&__ARM0_PLL_INDEX=(8.)
LOCAL &__DDR0_PLL_INDEX
&__DDR0_PLL_INDEX=(12.)
LOCAL &__MAIN_R5F_PLL_INDEX
&__MAIN_R5F_PLL_INDEX=(14.)
LOCAL &__DSS0_PLL_INDEX
&__DSS0_PLL_INDEX=(16.)
LOCAL &__DSS1_PLL_INDEX
&__DSS1_PLL_INDEX=(17.)
LOCAL &__DSS3_PLL_INDEX
&__DSS3_PLL_INDEX=(19.)
LOCAL &__VISION_PLL_INDEX
&__VISION_PLL_INDEX=(25.)
LOCAL &__DDR1_PLL_INDEX
&__DDR1_PLL_INDEX=(26.)
LOCAL &__MCU_R5F_PLL_INDEX
&__MCU_R5F_PLL_INDEX=(0.)
LOCAL &__MCU_PER1_PLL_INDEX
&__MCU_PER1_PLL_INDEX=(1.)
LOCAL &__MCU_PER2_PLL_INDEX
&__MCU_PER2_PLL_INDEX=(2.)
// -- PLL Register Offsets
LOCAL &__PLL_PID
&__PLL_PID=(0x00)
LOCAL &__PLL_CONFIG
&__PLL_CONFIG=(0x08)
LOCAL &__CONTROL
&__CONTROL=(0x20)
LOCAL &__STATUS
&__STATUS=(0x24)
LOCAL &__FREQ_CONTROL_0
&__FREQ_CONTROL_0=(0x30)
LOCAL &__FREQ_CONTROL_1
&__FREQ_CONTROL_1=(0x34)
LOCAL &__OUTPUT_DIV_CONTROL
&__OUTPUT_DIV_CONTROL=(0x38)
LOCAL &__SSMOD_CONTROL
&__SSMOD_CONTROL=(0x40)
LOCAL &__SSMOD_SPREAD
&__SSMOD_SPREAD=(0x44)
LOCAL &__CAL_CONTROL
&__CAL_CONTROL=(0x60)
LOCAL &__CAL_STATUS
&__CAL_STATUS=(0x64)
LOCAL &__HSDIV_0_CONTROL
&__HSDIV_0_CONTROL=(0x80)
LOCAL &__HSDIV_1_CONTROL
&__HSDIV_1_CONTROL=(0x84)
LOCAL &__HSDIV_2_CONTROL
&__HSDIV_2_CONTROL=(0x88)
LOCAL &__HSDIV_3_CONTROL
&__HSDIV_3_CONTROL=(0x8C)
LOCAL &__HSDIV_4_CONTROL
&__HSDIV_4_CONTROL=(0x90)
LOCAL &__HSDIV_5_CONTROL
&__HSDIV_5_CONTROL=(0x94)
LOCAL &__HSDIV_6_CONTROL
&__HSDIV_6_CONTROL=(0x98)
LOCAL &__HSDIV_7_CONTROL
&__HSDIV_7_CONTROL=(0x9C)
// -- Special Programming Scheme Indices
LOCAL &__OFC1
&__OFC1=(0.)
LOCAL &__ARM_250MHZ
&__ARM_250MHZ=(1.)
LOCAL &__ARM_500MHZ
&__ARM_500MHZ=(2.)
LOCAL &__ARM_1GHZ
&__ARM_1GHZ=(3.)
LOCAL &__ARM_2GHZ
&__ARM_2GHZ=(4.)
LOCAL &__VPAC_720
&__VPAC_720=(5.)
LOCAL &__DMPAC_520
&__DMPAC_520=(6.)
LOCAL &__DDR_BYPASS
&__DDR_BYPASS=(7.)
LOCAL &__DDR_400
&__DDR_400=(8.)
// -- CONVERTER INFO: DDR_800 expanded
LOCAL &__DDR_1066
&__DDR_1066=(10.)
LOCAL &__DDR_1600
&__DDR_1600=(11.)
LOCAL &__DDR_1866
&__DDR_1866=(12.)
LOCAL &__DDR_2133
&__DDR_2133=(13.)
LOCAL &__DDR_3200
&__DDR_3200=(14.)
LOCAL &__DDR_2400
&__DDR_2400=(15.)
LOCAL &__DSS_2970
&__DSS_2970=(16.)
LOCAL &__DSS_2345
&__DSS_2345=(17.)
LOCAL &__DSS_2898
&__DSS_2898=(18.)
LOCAL &__DSS_2613
&__DSS_2613=(19.)
LOCAL &__DSS_2133
&__DSS_2133=(20.)
LOCAL &__DSS_2000
&__DSS_2000=(21.)
LOCAL &__DSS_2500
&__DSS_2500=(22.)
LOCAL &__DSS_3000
&__DSS_3000=(23.)
LOCAL &__VIDEO_2400
&__VIDEO_2400=(24.)
// --  END OF FILE 
// --  Copyright (c) 2020, Texas Instruments Incorporated
// --  * All rights reserved.
// --  *
// --  * Redistribution and use in source and binary forms, with or without
// --  * modification, are permitted provided that the following conditions
// --  * are met:
// --  *
// --  * *  Redistributions of source code must retain the above copyright
// --  *    notice, this list of conditions and the following disclaimer.
// --  *
// --  * *  Redistributions in binary form must reproduce the above copyright
// --  *    notice, this list of conditions and the following disclaimer in the
// --  *    documentation and/or other materials provided with the distribution.
// --  *
// --  * *  Neither the name of Texas Instruments Incorporated nor the names of
// --  *    its contributors may be used to endorse or promote products derived
// --  *    from this software without specific prior written permission.
// --  *
// --  * THIS SOFTWARE IS PROVIDED BY THE COPYRIGHT HOLDERS AND CONTRIBUTORS "AS IS"
// --  * AND ANY EXPRESS OR IMPLIED WARRANTIES, INCLUDING, BUT NOT LIMITED TO,
// --  * THE IMPLIED WARRANTIES OF MERCHANTABILITY AND FITNESS FOR A PARTICULAR
// --  * PURPOSE ARE DISCLAIMED. IN NO EVENT SHALL THE COPYRIGHT OWNER OR
// --  * CONTRIBUTORS BE LIABLE FOR ANY DIRECT, INDIRECT, INCIDENTAL, SPECIAL,
// --  * EXEMPLARY, OR CONSEQUENTIAL DAMAGES (INCLUDING, BUT NOT LIMITED TO,
// --  * PROCUREMENT OF SUBSTITUTE GOODS OR SERVICES; LOSS OF USE, DATA, OR PROFITS;
// --  * OR BUSINESS INTERRUPTION) HOWEVER CAUSED AND ON ANY THEORY OF LIABILITY,
// --  * WHETHER IN CONTRACT, STRICT LIABILITY, OR TORT (INCLUDING NEGLIGENCE OR
// --  * OTHERWISE) ARISING IN ANY WAY OUT OF THE USE OF THIS SOFTWARE,
// --  * EVEN IF ADVISED OF THE POSSIBILITY OF SUCH DAMAGE. 
// -- Note: if the HSDIV value is -1 that means it's either nonexistent or not used. 
// -- Note: if the mod_div value is -1 that means it isn't programmed beyond the default value of "1", which means the input divider is set to divide-by-1.
// -- Note: the divider values here are directly programmed tothe HSDIV control MMR. They don't factor in the +1 that's added in the hardware. 
// --     Users should add +1 to the HSDIV divider values they add in here for any calculations they make outside of the GEL framework and the hardware.
// -- Note: This is configured for OFC1 as defined by SOCDV + Venkat.
// -- CONVERTER INFO: FREF expanded
// -- 20MHz HFOSC0 reference clock on QT
// -- CONVERTER INFO: FREF_SVB expanded
// -- 19.2MHz HFOSC0 reference clock on SVB
// -- #define CLKINP_QT           20.0
// -- #define CLKINP_SVB          19.2
// -- PLL0: Main PLL
// --  Frequencies:
// -- PLL input:          19.2MHz
// -- VCO output:         2GHz
// -- POSTDIV output:     1GHz
// -- HSDIV0 output:      500MHz
// -- HSDIV1 output:      400MHz
// -- HSDIV2 output:      200MHz
// -- HSDIV3 output:      133.33MHz
// -- HSDIV4 output:      80MHz
// -- HSDIV5 output:      50MHz
// -- HSDIV6 output:      250MHz
// -- HSDIV7 output:      200MHz
// -- HSDIV8 output:      250MHz
// -- MODSS configuration: 
// -- - Spread: 3.125%
// -- - Modulator Divider: %-by-1
// -- - Downspread or centerspread: downspread
LOCAL &__MAIN_PLL0_FBDIV
&__MAIN_PLL0_FBDIV=104.
// -- fbdiv
LOCAL &__MAIN_PLL0_FRACDIV
&__MAIN_PLL0_FRACDIV=2796203.
// -- fracdiv
LOCAL &__MAIN_PLL0_PREDIV
&__MAIN_PLL0_PREDIV=1.
// -- prediv
LOCAL &__MAIN_PLL0_POSTDIV1
&__MAIN_PLL0_POSTDIV1=2.
// -- postdiv1
LOCAL &__MAIN_PLL0_POSTDIV2
&__MAIN_PLL0_POSTDIV2=1.
// -- postdiv2
LOCAL &__MAIN_PLL0_HSDIV0_DIV_VAL
&__MAIN_PLL0_HSDIV0_DIV_VAL=3.
// -- 4
LOCAL &__MAIN_PLL0_HSDIV1_DIV_VAL
&__MAIN_PLL0_HSDIV1_DIV_VAL=4.
// -- 5
LOCAL &__MAIN_PLL0_HSDIV2_DIV_VAL
&__MAIN_PLL0_HSDIV2_DIV_VAL=9.
// -- 10
LOCAL &__MAIN_PLL0_HSDIV3_DIV_VAL
&__MAIN_PLL0_HSDIV3_DIV_VAL=14.
// -- 15
LOCAL &__MAIN_PLL0_HSDIV4_DIV_VAL
&__MAIN_PLL0_HSDIV4_DIV_VAL=24.
// -- 25
LOCAL &__MAIN_PLL0_HSDIV5_DIV_VAL
&__MAIN_PLL0_HSDIV5_DIV_VAL=19.
// -- 20
LOCAL &__MAIN_PLL0_HSDIV6_DIV_VAL
&__MAIN_PLL0_HSDIV6_DIV_VAL=3.
// -- 4
LOCAL &__MAIN_PLL0_HSDIV7_DIV_VAL
&__MAIN_PLL0_HSDIV7_DIV_VAL=4.
// -- 5
LOCAL &__MAIN_PLL0_HSDIV8_DIV_VAL
&__MAIN_PLL0_HSDIV8_DIV_VAL=3.
// -- 4
LOCAL &__MAIN_PLL0_SSMOD_SPREAD
&__MAIN_PLL0_SSMOD_SPREAD=0x1F
// -- spread
LOCAL &__MAIN_PLL0_SSMOD_MODDIV
&__MAIN_PLL0_SSMOD_MODDIV=-1.
// -- mod_div
LOCAL &__MAIN_PLL0_SSMOD_DOWNSPREAD
&__MAIN_PLL0_SSMOD_DOWNSPREAD=1.
// -- downspread
// -- Main PLL0 PLL Controller Parameters
LOCAL &__MAIN_CTRL_BPDIV
&__MAIN_CTRL_BPDIV=0.
// -- AUXCLK=BPCLK=REFCLK for controller
LOCAL &__MAIN_CTRL_OD1
&__MAIN_CTRL_OD1=0.
// -- OBSCLK=REFCLK for controller
LOCAL &__MAIN_CTRL_DIV1
&__MAIN_CTRL_DIV1=1.
// -- 500MHZ SYSCLK1 from HSDIV_CLKOUT1
// -- PLL1:  Peripheral 0 PLL
// --  Frequencies:
// -- PLL input:          19.2MHz
// -- VCO output:         1920MHz
// -- POSTDIV output:     960MHz
// -- HSDIV0 output:      192MHz
// -- HSDIV1 output:      320MHz
// -- HSDIV2 output:      192MHz
// -- HSDIV3 output:      192MHz
// -- HSDIV4 output:      N/A
// -- HSDIV5 output:      192MHz
// -- HSDIV6 output:      N/A
// -- HSDIV7 output:      24MHz
// -- HSDIV8 output:      20MHz
// -- MODSS configuration: 
// -- - Spread: 3.125%
// -- - Modulator Divider: %-by-1
// -- - Downspread or centerspread: downspread
LOCAL &__MAIN_PLL1_FBDIV
&__MAIN_PLL1_FBDIV=100.
LOCAL &__MAIN_PLL1_FRACDIV
&__MAIN_PLL1_FRACDIV=0.
LOCAL &__MAIN_PLL1_PREDIV
&__MAIN_PLL1_PREDIV=1.
LOCAL &__MAIN_PLL1_POSTDIV1
&__MAIN_PLL1_POSTDIV1=2.
LOCAL &__MAIN_PLL1_POSTDIV2
&__MAIN_PLL1_POSTDIV2=1.
LOCAL &__MAIN_PLL1_HSDIV0_DIV_VAL
&__MAIN_PLL1_HSDIV0_DIV_VAL=9.
// -- 10
LOCAL &__MAIN_PLL1_HSDIV1_DIV_VAL
&__MAIN_PLL1_HSDIV1_DIV_VAL=5.
// -- 6
LOCAL &__MAIN_PLL1_HSDIV2_DIV_VAL
&__MAIN_PLL1_HSDIV2_DIV_VAL=9.
// -- 10
LOCAL &__MAIN_PLL1_HSDIV3_DIV_VAL
&__MAIN_PLL1_HSDIV3_DIV_VAL=9.
// -- 10
LOCAL &__MAIN_PLL1_HSDIV4_DIV_VAL
&__MAIN_PLL1_HSDIV4_DIV_VAL=-1.
// -- No HSDIV
LOCAL &__MAIN_PLL1_HSDIV5_DIV_VAL
&__MAIN_PLL1_HSDIV5_DIV_VAL=4.
// -- 5
LOCAL &__MAIN_PLL1_HSDIV6_DIV_VAL
&__MAIN_PLL1_HSDIV6_DIV_VAL=-1.
// -- Reserved for UFS
LOCAL &__MAIN_PLL1_HSDIV7_DIV_VAL
&__MAIN_PLL1_HSDIV7_DIV_VAL=39.
// -- 40
LOCAL &__MAIN_PLL1_HSDIV8_DIV_VAL
&__MAIN_PLL1_HSDIV8_DIV_VAL=47.
// -- 48
LOCAL &__MAIN_PLL1_SSMOD_SPREAD
&__MAIN_PLL1_SSMOD_SPREAD=0x1F
LOCAL &__MAIN_PLL1_SSMOD_MODDIV
&__MAIN_PLL1_SSMOD_MODDIV=-1.
LOCAL &__MAIN_PLL1_SSMOD_DOWNSPREAD
&__MAIN_PLL1_SSMOD_DOWNSPREAD=1.
// -- PLL2: Peripheral 1 PLL
// --  Frequencies:
// -- PLL input:          19.2MHz
// -- VCO output:         1800MHz
// -- POSTDIV output:     900MHz
// -- HSDIV0 output:      N/A
// -- HSDIV1 output:      600MHz
// -- HSDIV2 output:      200MHz
// -- HSDIV3 output:      300MHz
// -- HSDIV4 output:      100MHz
// -- HSDIV5 output:      N/A
// -- HSDIV6 output:      225MHz
// -- HSDIV7 output:      N/A
// -- MODSS configuration: 
// -- - Spread: 3.125%
// -- - Modulator Divider: %-by-1
// -- - Downspread or centerspread: downspread
LOCAL &__MAIN_PLL2_FBDIV
&__MAIN_PLL2_FBDIV=93.
LOCAL &__MAIN_PLL2_FRACDIV
&__MAIN_PLL2_FRACDIV=12582912.
LOCAL &__MAIN_PLL2_PREDIV
&__MAIN_PLL2_PREDIV=1.
LOCAL &__MAIN_PLL2_POSTDIV1
&__MAIN_PLL2_POSTDIV1=2.
LOCAL &__MAIN_PLL2_POSTDIV2
&__MAIN_PLL2_POSTDIV2=1.
LOCAL &__MAIN_PLL2_HSDIV0_DIV_VAL
&__MAIN_PLL2_HSDIV0_DIV_VAL=-1.
// -- N/A
LOCAL &__MAIN_PLL2_HSDIV1_DIV_VAL
&__MAIN_PLL2_HSDIV1_DIV_VAL=2.
// -- 3
LOCAL &__MAIN_PLL2_HSDIV2_DIV_VAL
&__MAIN_PLL2_HSDIV2_DIV_VAL=8.
// -- 9
LOCAL &__MAIN_PLL2_HSDIV3_DIV_VAL
&__MAIN_PLL2_HSDIV3_DIV_VAL=5.
// -- 6
LOCAL &__MAIN_PLL2_HSDIV4_DIV_VAL
&__MAIN_PLL2_HSDIV4_DIV_VAL=17.
// -- 18
LOCAL &__MAIN_PLL2_HSDIV5_DIV_VAL
&__MAIN_PLL2_HSDIV5_DIV_VAL=-1.
// -- 1
LOCAL &__MAIN_PLL2_HSDIV6_DIV_VAL
&__MAIN_PLL2_HSDIV6_DIV_VAL=7.
// -- 8
LOCAL &__MAIN_PLL2_HSDIV7_DIV_VAL
&__MAIN_PLL2_HSDIV7_DIV_VAL=-1.
// -- 14
LOCAL &__MAIN_PLL2_HSDIV8_DIV_VAL
&__MAIN_PLL2_HSDIV8_DIV_VAL=-1.
// -- No HSDIV8
LOCAL &__MAIN_PLL2_SSMOD_SPREAD
&__MAIN_PLL2_SSMOD_SPREAD=0x1F
LOCAL &__MAIN_PLL2_SSMOD_MODDIV
&__MAIN_PLL2_SSMOD_MODDIV=-1.
LOCAL &__MAIN_PLL2_SSMOD_DOWNSPREAD
&__MAIN_PLL2_SSMOD_DOWNSPREAD=1.
// -- PLL3: CPSW PLL
// --  Frequencies:
// -- PLL input:          19.2MHz
// -- VCO output:         2000MHz
// -- POSTDIV output:     2000MHz
// -- HSDIV0 output:      250MHz
// -- HSDIV1 output:      250MHz
// -- HSDIV2 output:      200MHz
// -- HSDIV3 output:      250MHz
// -- HSDIV4 output:      N/A (not noted on J7AEP clocking spec)
// -- HSDIV5 output:      N/A
// -- HSDIV6 output:      N/A
// -- HSDIV7 output:      N/A
// -- HSDIV8 output:      N/A
// -- MODSS configuration: 
// -- - Spread: 3.125%
// -- - Modulator Divider: %-by-1
// -- - Downspread or centerspread: downspread
LOCAL &__MAIN_PLL3_FBDIV
&__MAIN_PLL3_FBDIV=104.
LOCAL &__MAIN_PLL3_FRACDIV
&__MAIN_PLL3_FRACDIV=2796203.
LOCAL &__MAIN_PLL3_PREDIV
&__MAIN_PLL3_PREDIV=1.
LOCAL &__MAIN_PLL3_POSTDIV1
&__MAIN_PLL3_POSTDIV1=1.
LOCAL &__MAIN_PLL3_POSTDIV2
&__MAIN_PLL3_POSTDIV2=1.
LOCAL &__MAIN_PLL3_HSDIV0_DIV_VAL
&__MAIN_PLL3_HSDIV0_DIV_VAL=7.
// -- 8
LOCAL &__MAIN_PLL3_HSDIV1_DIV_VAL
&__MAIN_PLL3_HSDIV1_DIV_VAL=7.
// -- 8
LOCAL &__MAIN_PLL3_HSDIV2_DIV_VAL
&__MAIN_PLL3_HSDIV2_DIV_VAL=9.
// -- 10
LOCAL &__MAIN_PLL3_HSDIV3_DIV_VAL
&__MAIN_PLL3_HSDIV3_DIV_VAL=7.
// -- 8
LOCAL &__MAIN_PLL3_HSDIV4_DIV_VAL
&__MAIN_PLL3_HSDIV4_DIV_VAL=-1.
// -- N/A on J7AEP spec
LOCAL &__MAIN_PLL3_HSDIV5_DIV_VAL
&__MAIN_PLL3_HSDIV5_DIV_VAL=-1.
LOCAL &__MAIN_PLL3_HSDIV6_DIV_VAL
&__MAIN_PLL3_HSDIV6_DIV_VAL=-1.
LOCAL &__MAIN_PLL3_HSDIV7_DIV_VAL
&__MAIN_PLL3_HSDIV7_DIV_VAL=-1.
LOCAL &__MAIN_PLL3_HSDIV8_DIV_VAL
&__MAIN_PLL3_HSDIV8_DIV_VAL=-1.
LOCAL &__MAIN_PLL3_SSMOD_SPREAD
&__MAIN_PLL3_SSMOD_SPREAD=0x1F
LOCAL &__MAIN_PLL3_SSMOD_MODDIV
&__MAIN_PLL3_SSMOD_MODDIV=-1.
LOCAL &__MAIN_PLL3_SSMOD_DOWNSPREAD
&__MAIN_PLL3_SSMOD_DOWNSPREAD=1.
// -- PLL4: Audio PLL 0
// --  Frequencies:
// -- PLL input:          19.2MHz
// -- VCO output:         2360MHz
// -- POSTDIV output:     1180MHz
// -- HSDIV0 output:      196.67MHz
// -- HSDIV1 output:      295MHz
// -- HSDIV2 output:      196.67MHz
// -- HSDIV3 output:      N/A
// -- HSDIV4 output:      N/A
// -- HSDIV5 output:      N/A
// -- HSDIV6 output:      N/A
// -- HSDIV7 output:      N/A
// -- HSDIV8 output:      N/A
// -- MODSS configuration:
// -- - Spread: 3.125%
// -- - Modulator Divider: %-by-1
// -- - Downspread or centerspread: downspread
LOCAL &__MAIN_PLL4_FBDIV
&__MAIN_PLL4_FBDIV=122.
LOCAL &__MAIN_PLL4_FRACDIV
&__MAIN_PLL4_FRACDIV=15379114.
LOCAL &__MAIN_PLL4_PREDIV
&__MAIN_PLL4_PREDIV=1.
LOCAL &__MAIN_PLL4_POSTDIV1
&__MAIN_PLL4_POSTDIV1=1.
LOCAL &__MAIN_PLL4_POSTDIV2
&__MAIN_PLL4_POSTDIV2=2.
LOCAL &__MAIN_PLL4_HSDIV0_DIV_VAL
&__MAIN_PLL4_HSDIV0_DIV_VAL=11.
// -- 12
LOCAL &__MAIN_PLL4_HSDIV1_DIV_VAL
&__MAIN_PLL4_HSDIV1_DIV_VAL=7.
// -- 8
LOCAL &__MAIN_PLL4_HSDIV2_DIV_VAL
&__MAIN_PLL4_HSDIV2_DIV_VAL=11.
// -- 12
LOCAL &__MAIN_PLL4_HSDIV3_DIV_VAL
&__MAIN_PLL4_HSDIV3_DIV_VAL=-1.
LOCAL &__MAIN_PLL4_HSDIV4_DIV_VAL
&__MAIN_PLL4_HSDIV4_DIV_VAL=-1.
LOCAL &__MAIN_PLL4_HSDIV5_DIV_VAL
&__MAIN_PLL4_HSDIV5_DIV_VAL=-1.
LOCAL &__MAIN_PLL4_HSDIV6_DIV_VAL
&__MAIN_PLL4_HSDIV6_DIV_VAL=-1.
LOCAL &__MAIN_PLL4_HSDIV7_DIV_VAL
&__MAIN_PLL4_HSDIV7_DIV_VAL=-1.
LOCAL &__MAIN_PLL4_HSDIV8_DIV_VAL
&__MAIN_PLL4_HSDIV8_DIV_VAL=-1.
LOCAL &__MAIN_PLL4_SSMOD_SPREAD
&__MAIN_PLL4_SSMOD_SPREAD=0x1F
LOCAL &__MAIN_PLL4_SSMOD_MODDIV
&__MAIN_PLL4_SSMOD_MODDIV=-1.
LOCAL &__MAIN_PLL4_SSMOD_DOWNSPREAD
&__MAIN_PLL4_SSMOD_DOWNSPREAD=1.
// -- PLL5: Video PLL
// --  Frequencies:
// -- PLL input:		19.2MHz
// -- VCO output:		1650MHz
// -- POSTDIV output: 	1650MHz
// -- HSDIV0 output:		412.5MHz
// -- HSDIV1 output: 		550MHz
// -- HSDIV2 output: 		N/A
// -- HSDIV3 output: 		N/A
// -- HSDIV4 output: 		N/A
// -- HSDIV5 output: 		N/A
// -- HSDIV6 output: 		N/A
// -- HSDIV7 output: 		N/A
// -- HSDIV8 output:  	N/A
// -- MODSS configuration: 
// -- - Spread: 3.125%
// -- - Modulator Divider: %-by-1
// -- - Downspread or centerspread: downspread
LOCAL &__MAIN_PLL5_FBDIV
&__MAIN_PLL5_FBDIV=85.
LOCAL &__MAIN_PLL5_FRACDIV
&__MAIN_PLL5_FRACDIV=15728640.
LOCAL &__MAIN_PLL5_PREDIV
&__MAIN_PLL5_PREDIV=1.
LOCAL &__MAIN_PLL5_POSTDIV1
&__MAIN_PLL5_POSTDIV1=1.
LOCAL &__MAIN_PLL5_POSTDIV2
&__MAIN_PLL5_POSTDIV2=1.
LOCAL &__MAIN_PLL5_HSDIV0_DIV_VAL
&__MAIN_PLL5_HSDIV0_DIV_VAL=3.
// -- 4
LOCAL &__MAIN_PLL5_HSDIV1_DIV_VAL
&__MAIN_PLL5_HSDIV1_DIV_VAL=2.
// -- 3
LOCAL &__MAIN_PLL5_HSDIV2_DIV_VAL
&__MAIN_PLL5_HSDIV2_DIV_VAL=-1.
LOCAL &__MAIN_PLL5_HSDIV3_DIV_VAL
&__MAIN_PLL5_HSDIV3_DIV_VAL=-1.
LOCAL &__MAIN_PLL5_HSDIV4_DIV_VAL
&__MAIN_PLL5_HSDIV4_DIV_VAL=-1.
LOCAL &__MAIN_PLL5_HSDIV5_DIV_VAL
&__MAIN_PLL5_HSDIV5_DIV_VAL=-1.
LOCAL &__MAIN_PLL5_HSDIV6_DIV_VAL
&__MAIN_PLL5_HSDIV6_DIV_VAL=-1.
LOCAL &__MAIN_PLL5_HSDIV7_DIV_VAL
&__MAIN_PLL5_HSDIV7_DIV_VAL=-1.
LOCAL &__MAIN_PLL5_HSDIV8_DIV_VAL
&__MAIN_PLL5_HSDIV8_DIV_VAL=-1.
LOCAL &__MAIN_PLL5_SSMOD_SPREAD
&__MAIN_PLL5_SSMOD_SPREAD=0x1F
LOCAL &__MAIN_PLL5_SSMOD_MODDIV
&__MAIN_PLL5_SSMOD_MODDIV=-1.
LOCAL &__MAIN_PLL5_SSMOD_DOWNSPREAD
&__MAIN_PLL5_SSMOD_DOWNSPREAD=1.
LOCAL &__MAIN_PLL5_FBDIV_2400
&__MAIN_PLL5_FBDIV_2400=125.
LOCAL &__MAIN_PLL5_FRACDIV_2400
&__MAIN_PLL5_FRACDIV_2400=0.
// -- PLL6: GPU PLL
// --  Frequencies:
// -- PLL input: 		19.2MHz
// -- VCO output:		3GHz (spec is 2750MHz but that doesn't work for output)
// -- POSTDIV output: 	3GHz
// -- HSDIV0 output: 		750MHz
// -- HSDIV1 output: 		N/A
// -- HSDIV2 output: 		N/A
// -- HSDIV3 output: 		N/A
// -- HSDIV4 output: 		N/A
// -- HSDIV5 output: 		N/A
// -- HSDIV6 output: 		N/A
// -- HSDIV7 output: 		N/A
// -- HSDIV8 output:  	N/A
// -- MODSS configuration: 
// -- - Spread: 3.125%
// -- - Modulator Divider: %-by-1
// -- - Downspread or centerspread: downspread
LOCAL &__MAIN_PLL6_FBDIV
&__MAIN_PLL6_FBDIV=156.
LOCAL &__MAIN_PLL6_FRACDIV
&__MAIN_PLL6_FRACDIV=4194304.
LOCAL &__MAIN_PLL6_PREDIV
&__MAIN_PLL6_PREDIV=1.
LOCAL &__MAIN_PLL6_POSTDIV1
&__MAIN_PLL6_POSTDIV1=1.
LOCAL &__MAIN_PLL6_POSTDIV2
&__MAIN_PLL6_POSTDIV2=1.
LOCAL &__MAIN_PLL6_HSDIV0_DIV_VAL
&__MAIN_PLL6_HSDIV0_DIV_VAL=3.
// -- 4
LOCAL &__MAIN_PLL6_HSDIV1_DIV_VAL
&__MAIN_PLL6_HSDIV1_DIV_VAL=-1.
LOCAL &__MAIN_PLL6_HSDIV2_DIV_VAL
&__MAIN_PLL6_HSDIV2_DIV_VAL=-1.
LOCAL &__MAIN_PLL6_HSDIV3_DIV_VAL
&__MAIN_PLL6_HSDIV3_DIV_VAL=-1.
LOCAL &__MAIN_PLL6_HSDIV4_DIV_VAL
&__MAIN_PLL6_HSDIV4_DIV_VAL=-1.
LOCAL &__MAIN_PLL6_HSDIV5_DIV_VAL
&__MAIN_PLL6_HSDIV5_DIV_VAL=-1.
LOCAL &__MAIN_PLL6_HSDIV6_DIV_VAL
&__MAIN_PLL6_HSDIV6_DIV_VAL=-1.
LOCAL &__MAIN_PLL6_HSDIV7_DIV_VAL
&__MAIN_PLL6_HSDIV7_DIV_VAL=-1.
LOCAL &__MAIN_PLL6_HSDIV8_DIV_VAL
&__MAIN_PLL6_HSDIV8_DIV_VAL=-1.
LOCAL &__MAIN_PLL6_SSMOD_SPREAD
&__MAIN_PLL6_SSMOD_SPREAD=0x1F
LOCAL &__MAIN_PLL6_SSMOD_MODDIV
&__MAIN_PLL6_SSMOD_MODDIV=-1.
LOCAL &__MAIN_PLL6_SSMOD_DOWNSPREAD
&__MAIN_PLL6_SSMOD_DOWNSPREAD=1.
// -- PLL7: MSMC PLL
// --  Frequencies:
// -- PLL input:          19.2MHz
// -- VCO output:         3GHz
// -- POSTDIV output:     3GHz
// -- HSDIV0 output:      1GHz
// -- HSDIV1 output:      N/A
// -- HSDIV2 output:      N/A
// -- HSDIV3 output:      N/A
// -- HSDIV4 output:      N/A
// -- HSDIV5 output:      N/A
// -- HSDIV6 output:      N/A
// -- HSDIV7 output:      N/A
// -- HSDIV8 output:      N/A
// -- MODSS configuration: 
// -- - Spread: 3.125%
// -- - Modulator Divider: %-by-1
// -- - Downspread or centerspread: downspread
LOCAL &__MAIN_PLL7_FBDIV
&__MAIN_PLL7_FBDIV=156.
LOCAL &__MAIN_PLL7_FRACDIV
&__MAIN_PLL7_FRACDIV=4194304.
LOCAL &__MAIN_PLL7_PREDIV
&__MAIN_PLL7_PREDIV=1.
LOCAL &__MAIN_PLL7_POSTDIV1
&__MAIN_PLL7_POSTDIV1=1.
LOCAL &__MAIN_PLL7_POSTDIV2
&__MAIN_PLL7_POSTDIV2=1.
LOCAL &__MAIN_PLL7_HSDIV0_DIV_VAL
&__MAIN_PLL7_HSDIV0_DIV_VAL=2.
// -- 3
LOCAL &__MAIN_PLL7_HSDIV1_DIV_VAL
&__MAIN_PLL7_HSDIV1_DIV_VAL=-1.
LOCAL &__MAIN_PLL7_HSDIV2_DIV_VAL
&__MAIN_PLL7_HSDIV2_DIV_VAL=-1.
LOCAL &__MAIN_PLL7_HSDIV3_DIV_VAL
&__MAIN_PLL7_HSDIV3_DIV_VAL=-1.
LOCAL &__MAIN_PLL7_HSDIV4_DIV_VAL
&__MAIN_PLL7_HSDIV4_DIV_VAL=-1.
LOCAL &__MAIN_PLL7_HSDIV5_DIV_VAL
&__MAIN_PLL7_HSDIV5_DIV_VAL=-1.
LOCAL &__MAIN_PLL7_HSDIV6_DIV_VAL
&__MAIN_PLL7_HSDIV6_DIV_VAL=-1.
LOCAL &__MAIN_PLL7_HSDIV7_DIV_VAL
&__MAIN_PLL7_HSDIV7_DIV_VAL=-1.
LOCAL &__MAIN_PLL7_HSDIV8_DIV_VAL
&__MAIN_PLL7_HSDIV8_DIV_VAL=-1.
LOCAL &__MAIN_PLL7_SSMOD_SPREAD
&__MAIN_PLL7_SSMOD_SPREAD=0x1F
LOCAL &__MAIN_PLL7_SSMOD_MODDIV
&__MAIN_PLL7_SSMOD_MODDIV=-1.
LOCAL &__MAIN_PLL7_SSMOD_DOWNSPREAD
&__MAIN_PLL7_SSMOD_DOWNSPREAD=1.
// -- PLL8: ARM0 PLL
// --  Frequencies:
// -- PLL input:          19.2MHz
// -- VCO output:         2GHz
// -- POSTDIV output:     2GHz
// -- HSDIV0 output:      2GHz
// -- HSDIV1 output:      N/A
// -- HSDIV2 output:      N/A
// -- HSDIV3 output:      N/A
// -- HSDIV4 output:      N/A
// -- HSDIV5 output:      N/A
// -- HSDIV6 output:      N/A
// -- HSDIV7 output:      N/A
// -- HSDIV8 output:      N/A
// -- MODSS configuration: 
// -- - Spread: 3.125%
// -- - Modulator Divider: %-by-1
// -- - Downspread or centerspread: downspread
LOCAL &__MAIN_PLL8_FBDIV
&__MAIN_PLL8_FBDIV=104.
LOCAL &__MAIN_PLL8_FRACDIV
&__MAIN_PLL8_FRACDIV=2796203.
LOCAL &__MAIN_PLL8_PREDIV
&__MAIN_PLL8_PREDIV=1.
LOCAL &__MAIN_PLL8_POSTDIV1
&__MAIN_PLL8_POSTDIV1=1.
LOCAL &__MAIN_PLL8_POSTDIV2
&__MAIN_PLL8_POSTDIV2=1.
LOCAL &__MAIN_PLL8_HSDIV0_DIV_VAL
&__MAIN_PLL8_HSDIV0_DIV_VAL=0.
// -- 1
LOCAL &__MAIN_PLL8_HSDIV1_DIV_VAL
&__MAIN_PLL8_HSDIV1_DIV_VAL=-1.
LOCAL &__MAIN_PLL8_HSDIV2_DIV_VAL
&__MAIN_PLL8_HSDIV2_DIV_VAL=-1.
LOCAL &__MAIN_PLL8_HSDIV3_DIV_VAL
&__MAIN_PLL8_HSDIV3_DIV_VAL=-1.
LOCAL &__MAIN_PLL8_HSDIV4_DIV_VAL
&__MAIN_PLL8_HSDIV4_DIV_VAL=-1.
LOCAL &__MAIN_PLL8_HSDIV5_DIV_VAL
&__MAIN_PLL8_HSDIV5_DIV_VAL=-1.
LOCAL &__MAIN_PLL8_HSDIV6_DIV_VAL
&__MAIN_PLL8_HSDIV6_DIV_VAL=-1.
LOCAL &__MAIN_PLL8_HSDIV7_DIV_VAL
&__MAIN_PLL8_HSDIV7_DIV_VAL=-1.
LOCAL &__MAIN_PLL8_HSDIV8_DIV_VAL
&__MAIN_PLL8_HSDIV8_DIV_VAL=-1.
LOCAL &__MAIN_PLL8_SSMOD_SPREAD
&__MAIN_PLL8_SSMOD_SPREAD=0x1F
LOCAL &__MAIN_PLL8_SSMOD_MODDIV
&__MAIN_PLL8_SSMOD_MODDIV=-1.
LOCAL &__MAIN_PLL8_SSMOD_DOWNSPREAD
&__MAIN_PLL8_SSMOD_DOWNSPREAD=1.
// -- PLL9 : Not Present *************************************
// -- PLL10: Not Present *************************************
// -- PLL11: Not Present *************************************
// -- PLL12: DDR0 FracF PLL
// --  Frequencies:
// -- PLL input:          19.2MHz
// -- VCO output:         2133MHz
// -- POSTDIV output:     2133MHz
// -- HSDIV0 output:      1066MHz
// -- HSDIV1 output:      N/A
// -- HSDIV2 output:      N/A
// -- HSDIV3 output:      N/A
// -- HSDIV4 output:      N/A
// -- HSDIV5 output:      N/A
// -- HSDIV6 output:      N/A
// -- HSDIV7 output:      N/A
// -- HSDIV8 output:      N/A
// -- MODSS configuration: 
// -- - Spread: 3.125%
// -- - Modulator Divider: %-by-1
// -- - Downspread or centerspread: downspread
LOCAL &__MAIN_PLL12_FBDIV
&__MAIN_PLL12_FBDIV=111.
LOCAL &__MAIN_PLL12_FRACDIV
&__MAIN_PLL12_FRACDIV=1572864.
LOCAL &__MAIN_PLL12_PREDIV
&__MAIN_PLL12_PREDIV=1.
LOCAL &__MAIN_PLL12_POSTDIV1
&__MAIN_PLL12_POSTDIV1=1.
LOCAL &__MAIN_PLL12_POSTDIV2
&__MAIN_PLL12_POSTDIV2=1.
LOCAL &__MAIN_PLL12_HSDIV0_DIV_VAL
&__MAIN_PLL12_HSDIV0_DIV_VAL=1.
// -- 2
LOCAL &__MAIN_PLL12_HSDIV1_DIV_VAL
&__MAIN_PLL12_HSDIV1_DIV_VAL=-1.
LOCAL &__MAIN_PLL12_HSDIV2_DIV_VAL
&__MAIN_PLL12_HSDIV2_DIV_VAL=-1.
LOCAL &__MAIN_PLL12_HSDIV3_DIV_VAL
&__MAIN_PLL12_HSDIV3_DIV_VAL=-1.
LOCAL &__MAIN_PLL12_HSDIV4_DIV_VAL
&__MAIN_PLL12_HSDIV4_DIV_VAL=-1.
LOCAL &__MAIN_PLL12_HSDIV5_DIV_VAL
&__MAIN_PLL12_HSDIV5_DIV_VAL=-1.
LOCAL &__MAIN_PLL12_HSDIV6_DIV_VAL
&__MAIN_PLL12_HSDIV6_DIV_VAL=-1.
LOCAL &__MAIN_PLL12_HSDIV7_DIV_VAL
&__MAIN_PLL12_HSDIV7_DIV_VAL=-1.
LOCAL &__MAIN_PLL12_HSDIV8_DIV_VAL
&__MAIN_PLL12_HSDIV8_DIV_VAL=-1.
LOCAL &__MAIN_PLL12_SSMOD_SPREAD
&__MAIN_PLL12_SSMOD_SPREAD=-1.
LOCAL &__MAIN_PLL12_SSMOD_MODDIV
&__MAIN_PLL12_SSMOD_MODDIV=-1.
LOCAL &__MAIN_PLL12_SSMOD_DOWNSPREAD
&__MAIN_PLL12_SSMOD_DOWNSPREAD=-1.
LOCAL &__MAIN_PLL12_FBDIV_DDR_2400
&__MAIN_PLL12_FBDIV_DDR_2400=120.
LOCAL &__MAIN_PLL12_FRACDIV_DDR_2400
&__MAIN_PLL12_FRACDIV_DDR_2400=0.
// -- PLL13: Not present *********************************************
// -- PLL14: Main Pulsar PLL
// --  Frequencies:
// -- PLL input:          19.2MHz
// -- VCO output:         3GHz
// -- POSTDIV output:     3GHz
// -- HSDIV0 output:      1GHz
// -- HSDIV1 output:      1GHz
// -- HSDIV2 output:      1GHz
// -- HSDIV3 output:      N/A
// -- HSDIV4 output:      N/A
// -- HSDIV5 output:      N/A
// -- HSDIV6 output:      N/A
// -- HSDIV7 output:      N/A
// -- HSDIV8 output:      N/A
// -- MODSS configuration: 
// -- - Spread: 3.125%
// -- - Modulator Divider: %-by-1
// -- - Downspread or centerspread: downspread
LOCAL &__MAIN_PLL14_FBDIV
&__MAIN_PLL14_FBDIV=156.
LOCAL &__MAIN_PLL14_FRACDIV
&__MAIN_PLL14_FRACDIV=4194304.
LOCAL &__MAIN_PLL14_PREDIV
&__MAIN_PLL14_PREDIV=1.
LOCAL &__MAIN_PLL14_POSTDIV1
&__MAIN_PLL14_POSTDIV1=1.
LOCAL &__MAIN_PLL14_POSTDIV2
&__MAIN_PLL14_POSTDIV2=1.
LOCAL &__MAIN_PLL14_HSDIV0_DIV_VAL
&__MAIN_PLL14_HSDIV0_DIV_VAL=2.
// -- 3
LOCAL &__MAIN_PLL14_HSDIV1_DIV_VAL
&__MAIN_PLL14_HSDIV1_DIV_VAL=2.
// -- 3      
LOCAL &__MAIN_PLL14_HSDIV2_DIV_VAL
&__MAIN_PLL14_HSDIV2_DIV_VAL=2.
// -- 3
LOCAL &__MAIN_PLL14_HSDIV3_DIV_VAL
&__MAIN_PLL14_HSDIV3_DIV_VAL=-1.
LOCAL &__MAIN_PLL14_HSDIV4_DIV_VAL
&__MAIN_PLL14_HSDIV4_DIV_VAL=-1.
LOCAL &__MAIN_PLL14_HSDIV5_DIV_VAL
&__MAIN_PLL14_HSDIV5_DIV_VAL=-1.
LOCAL &__MAIN_PLL14_HSDIV6_DIV_VAL
&__MAIN_PLL14_HSDIV6_DIV_VAL=-1.
LOCAL &__MAIN_PLL14_HSDIV7_DIV_VAL
&__MAIN_PLL14_HSDIV7_DIV_VAL=-1.
LOCAL &__MAIN_PLL14_HSDIV8_DIV_VAL
&__MAIN_PLL14_HSDIV8_DIV_VAL=-1.
LOCAL &__MAIN_PLL14_SSMOD_SPREAD
&__MAIN_PLL14_SSMOD_SPREAD=0x1F
LOCAL &__MAIN_PLL14_SSMOD_MODDIV
&__MAIN_PLL14_SSMOD_MODDIV=-1.
LOCAL &__MAIN_PLL14_SSMOD_DOWNSPREAD
&__MAIN_PLL14_SSMOD_DOWNSPREAD=1.
// -- PLL15: Not present *********************************************
// -- PLL16: DSS PLL0
// --  Frequencies:
// -- PLL input: 		19.2MHz
// -- VCO output:		3GHz (2x Pixel Clock)
// -- POSTDIV output: 	3GHz
// -- HSDIV0 output: 		600MHz
// -- HSDIV1 output: 		600MHz
// -- HSDIV2 output: 		N/A
// -- HSDIV3 output: 		N/A
// -- HSDIV4 output: 		N/A
// -- HSDIV5 output: 		N/A
// -- HSDIV6 output: 		N/A
// -- HSDIV7 output: 		N/A
// -- HSDIV8 output: 		N/A
// -- MODSS configuration: 
// -- - Spread: 3.125%
// -- - Modulator Divider: %-by-1
// -- - Downspread or centerspread: downspread
LOCAL &__MAIN_PLL16_FBDIV
&__MAIN_PLL16_FBDIV=156.
LOCAL &__MAIN_PLL16_FRACDIV
&__MAIN_PLL16_FRACDIV=4194304.
LOCAL &__MAIN_PLL16_PREDIV
&__MAIN_PLL16_PREDIV=1.
LOCAL &__MAIN_PLL16_POSTDIV1
&__MAIN_PLL16_POSTDIV1=1.
LOCAL &__MAIN_PLL16_POSTDIV2
&__MAIN_PLL16_POSTDIV2=1.
LOCAL &__MAIN_PLL16_HSDIV0_DIV_VAL
&__MAIN_PLL16_HSDIV0_DIV_VAL=4.
// -- 5
LOCAL &__MAIN_PLL16_HSDIV1_DIV_VAL
&__MAIN_PLL16_HSDIV1_DIV_VAL=4.
// -- 5
LOCAL &__MAIN_PLL16_HSDIV2_DIV_VAL
&__MAIN_PLL16_HSDIV2_DIV_VAL=-1.
LOCAL &__MAIN_PLL16_HSDIV3_DIV_VAL
&__MAIN_PLL16_HSDIV3_DIV_VAL=-1.
LOCAL &__MAIN_PLL16_HSDIV4_DIV_VAL
&__MAIN_PLL16_HSDIV4_DIV_VAL=-1.
LOCAL &__MAIN_PLL16_HSDIV5_DIV_VAL
&__MAIN_PLL16_HSDIV5_DIV_VAL=-1.
LOCAL &__MAIN_PLL16_HSDIV6_DIV_VAL
&__MAIN_PLL16_HSDIV6_DIV_VAL=-1.
LOCAL &__MAIN_PLL16_HSDIV7_DIV_VAL
&__MAIN_PLL16_HSDIV7_DIV_VAL=-1.
LOCAL &__MAIN_PLL16_HSDIV8_DIV_VAL
&__MAIN_PLL16_HSDIV8_DIV_VAL=-1.
LOCAL &__MAIN_PLL16_SSMOD_SPREAD
&__MAIN_PLL16_SSMOD_SPREAD=0x1F
LOCAL &__MAIN_PLL16_SSMOD_MODDIV
&__MAIN_PLL16_SSMOD_MODDIV=-1.
LOCAL &__MAIN_PLL16_SSMOD_DOWNSPREAD
&__MAIN_PLL16_SSMOD_DOWNSPREAD=1.
LOCAL &__MAIN_PLL16_FBDIV_DSS_2970
&__MAIN_PLL16_FBDIV_DSS_2970=154.
LOCAL &__MAIN_PLL16_FRACDIV_DSS_2970
&__MAIN_PLL16_FRACDIV_DSS_2970=11534336.
LOCAL &__MAIN_PLL16_FBDIV_DSS_2345
&__MAIN_PLL16_FBDIV_DSS_2345=122.
LOCAL &__MAIN_PLL16_FRACDIV_DSS_2345
&__MAIN_PLL16_FRACDIV_DSS_2345=3058346.
LOCAL &__MAIN_PLL16_FBDIV_DSS_2898
&__MAIN_PLL16_FBDIV_DSS_2898=150.
LOCAL &__MAIN_PLL16_FRACDIV_DSS_2898
&__MAIN_PLL16_FRACDIV_DSS_2898=15728640.
LOCAL &__MAIN_PLL16_FBDIV_DSS_2613
&__MAIN_PLL16_FBDIV_DSS_2613=136.
LOCAL &__MAIN_PLL16_FRACDIV_DSS_2613
&__MAIN_PLL16_FRACDIV_DSS_2613=1634031.
LOCAL &__MAIN_PLL16_FBDIV_DSS_2133
&__MAIN_PLL16_FBDIV_DSS_2133=111.
LOCAL &__MAIN_PLL16_FRACDIV_DSS_2133
&__MAIN_PLL16_FRACDIV_DSS_2133=1572864.
// -- PLL17: DSS PLL1
// --  Frequencies:
// -- PLL input: 		19.2MHz
// -- VCO output:		3GHz
// -- POSTDIV output: 	3GHz
// -- HSDIV0 output: 		600MHz
// -- HSDIV1 output: 		600MHz
// -- HSDIV2 output: 		N/A
// -- HSDIV3 output: 		N/A
// -- HSDIV4 output: 		N/A
// -- HSDIV5 output: 		N/A
// -- HSDIV6 output: 		N/A
// -- HSDIV7 output: 		N/A
// -- HSDIV8 output: 		N/A
// -- MODSS configuration: 
// -- - Spread: 3.125%
// -- - Modulator Divider: %-by-1
// -- - Downspread or centerspread: downspread
LOCAL &__MAIN_PLL17_FBDIV
&__MAIN_PLL17_FBDIV=156.
LOCAL &__MAIN_PLL17_FRACDIV
&__MAIN_PLL17_FRACDIV=4194304.
LOCAL &__MAIN_PLL17_PREDIV
&__MAIN_PLL17_PREDIV=1.
LOCAL &__MAIN_PLL17_POSTDIV1
&__MAIN_PLL17_POSTDIV1=1.
LOCAL &__MAIN_PLL17_POSTDIV2
&__MAIN_PLL17_POSTDIV2=1.
LOCAL &__MAIN_PLL17_HSDIV0_DIV_VAL
&__MAIN_PLL17_HSDIV0_DIV_VAL=4.
// -- 5
LOCAL &__MAIN_PLL17_HSDIV1_DIV_VAL
&__MAIN_PLL17_HSDIV1_DIV_VAL=4.
// -- 5
LOCAL &__MAIN_PLL17_HSDIV2_DIV_VAL
&__MAIN_PLL17_HSDIV2_DIV_VAL=-1.
LOCAL &__MAIN_PLL17_HSDIV3_DIV_VAL
&__MAIN_PLL17_HSDIV3_DIV_VAL=-1.
LOCAL &__MAIN_PLL17_HSDIV4_DIV_VAL
&__MAIN_PLL17_HSDIV4_DIV_VAL=-1.
LOCAL &__MAIN_PLL17_HSDIV5_DIV_VAL
&__MAIN_PLL17_HSDIV5_DIV_VAL=-1.
LOCAL &__MAIN_PLL17_HSDIV6_DIV_VAL
&__MAIN_PLL17_HSDIV6_DIV_VAL=-1.
LOCAL &__MAIN_PLL17_HSDIV7_DIV_VAL
&__MAIN_PLL17_HSDIV7_DIV_VAL=-1.
LOCAL &__MAIN_PLL17_HSDIV8_DIV_VAL
&__MAIN_PLL17_HSDIV8_DIV_VAL=-1.
LOCAL &__MAIN_PLL17_SSMOD_SPREAD
&__MAIN_PLL17_SSMOD_SPREAD=0x1F
LOCAL &__MAIN_PLL17_SSMOD_MODDIV
&__MAIN_PLL17_SSMOD_MODDIV=-1.
LOCAL &__MAIN_PLL17_SSMOD_DOWNSPREAD
&__MAIN_PLL17_SSMOD_DOWNSPREAD=1.
LOCAL &__MAIN_PLL17_FBDIV_DSS_2970
&__MAIN_PLL17_FBDIV_DSS_2970=154.
LOCAL &__MAIN_PLL17_FRACDIV_DSS_2970
&__MAIN_PLL17_FRACDIV_DSS_2970=11534336.
LOCAL &__MAIN_PLL17_FBDIV_DSS_2345
&__MAIN_PLL17_FBDIV_DSS_2345=122.
LOCAL &__MAIN_PLL17_FRACDIV_DSS_2345
&__MAIN_PLL17_FRACDIV_DSS_2345=3058346.
LOCAL &__MAIN_PLL17_FBDIV_DSS_2898
&__MAIN_PLL17_FBDIV_DSS_2898=150.
LOCAL &__MAIN_PLL17_FRACDIV_DSS_2898
&__MAIN_PLL17_FRACDIV_DSS_2898=15728640.
LOCAL &__MAIN_PLL17_FBDIV_DSS_2613
&__MAIN_PLL17_FBDIV_DSS_2613=136.
LOCAL &__MAIN_PLL17_FRACDIV_DSS_2613
&__MAIN_PLL17_FRACDIV_DSS_2613=1634031.
LOCAL &__MAIN_PLL17_FBDIV_DSS_2133
&__MAIN_PLL17_FBDIV_DSS_2133=111.
LOCAL &__MAIN_PLL17_FRACDIV_DSS_2133
&__MAIN_PLL17_FRACDIV_DSS_2133=1572864.
// -- PLL18: Not present *********************************************
// -- PLL19: DSS PLL3
// --  Frequencies:
// -- PLL input: 		19.2MHz
// -- VCO output:		3GHz
// -- POSTDIV output: 	3GHz
// -- HSDIV0 output: 		600MHz
// -- HSDIV1 output: 		600MHz
// -- HSDIV2 output: 		N/A
// -- HSDIV3 output: 		N/A
// -- HSDIV4 output: 		N/A
// -- HSDIV5 output: 		N/A
// -- HSDIV6 output: 		N/A
// -- HSDIV7 output: 		N/A
// -- HSDIV8 output: 		N/A
// -- MODSS configuration: 
// -- - Spread: 3.125%
// -- - Modulator Divider: %-by-1
// -- - Downspread or centerspread: downspread
LOCAL &__MAIN_PLL19_FBDIV
&__MAIN_PLL19_FBDIV=156.
LOCAL &__MAIN_PLL19_FRACDIV
&__MAIN_PLL19_FRACDIV=4194304.
LOCAL &__MAIN_PLL19_PREDIV
&__MAIN_PLL19_PREDIV=1.
LOCAL &__MAIN_PLL19_POSTDIV1
&__MAIN_PLL19_POSTDIV1=1.
LOCAL &__MAIN_PLL19_POSTDIV2
&__MAIN_PLL19_POSTDIV2=1.
LOCAL &__MAIN_PLL19_HSDIV0_DIV_VAL
&__MAIN_PLL19_HSDIV0_DIV_VAL=4.
// -- 5
LOCAL &__MAIN_PLL19_HSDIV1_DIV_VAL
&__MAIN_PLL19_HSDIV1_DIV_VAL=4.
// -- 5
LOCAL &__MAIN_PLL19_HSDIV2_DIV_VAL
&__MAIN_PLL19_HSDIV2_DIV_VAL=-1.
LOCAL &__MAIN_PLL19_HSDIV3_DIV_VAL
&__MAIN_PLL19_HSDIV3_DIV_VAL=-1.
LOCAL &__MAIN_PLL19_HSDIV4_DIV_VAL
&__MAIN_PLL19_HSDIV4_DIV_VAL=-1.
LOCAL &__MAIN_PLL19_HSDIV5_DIV_VAL
&__MAIN_PLL19_HSDIV5_DIV_VAL=-1.
LOCAL &__MAIN_PLL19_HSDIV6_DIV_VAL
&__MAIN_PLL19_HSDIV6_DIV_VAL=-1.
LOCAL &__MAIN_PLL19_HSDIV7_DIV_VAL
&__MAIN_PLL19_HSDIV7_DIV_VAL=-1.
LOCAL &__MAIN_PLL19_HSDIV8_DIV_VAL
&__MAIN_PLL19_HSDIV8_DIV_VAL=-1.
LOCAL &__MAIN_PLL19_SSMOD_SPREAD
&__MAIN_PLL19_SSMOD_SPREAD=0x1F
LOCAL &__MAIN_PLL19_SSMOD_MODDIV
&__MAIN_PLL19_SSMOD_MODDIV=-1.
LOCAL &__MAIN_PLL19_SSMOD_DOWNSPREAD
&__MAIN_PLL19_SSMOD_DOWNSPREAD=1.
LOCAL &__MAIN_PLL19_FBDIV_DSS_2970
&__MAIN_PLL19_FBDIV_DSS_2970=154.
LOCAL &__MAIN_PLL19_FRACDIV_DSS_2970
&__MAIN_PLL19_FRACDIV_DSS_2970=11534336.
// -- PLL20: Not present *********************************************
// -- PLL21: Not present *********************************************
// -- PLL22: Not present *********************************************
// -- PLL23: Not present *********************************************
// -- PLL24: Not present *********************************************
// -- PLL25: Image Processing PLL
// --  Frequencies:
// -- PLL input: 		19.2MHz
// -- VCO output:		2880MHz
// -- POSTDIV output: 	2880MHz
// -- HSDIV0 output: 		480MHz
// -- HSDIV1 output: 		720MHz
// -- HSDIV2 output: 		N/A
// -- HSDIV3 output: 		N/A
// -- HSDIV4 output: 		N/A
// -- HSDIV5 output: 		N/A
// -- HSDIV6 output: 		N/A
// -- HSDIV7 output: 		N/A
// -- HSDIV8 output: 		N/A
// -- MODSS configuration: 
// -- - Spread: 3.125%
// -- - Modulator Divider: %-by-1
// -- - Downspread or centerspread: downspread
LOCAL &__MAIN_PLL25_FBDIV
&__MAIN_PLL25_FBDIV=150.
LOCAL &__MAIN_PLL25_FRACDIV
&__MAIN_PLL25_FRACDIV=0.
LOCAL &__MAIN_PLL25_PREDIV
&__MAIN_PLL25_PREDIV=1.
LOCAL &__MAIN_PLL25_POSTDIV1
&__MAIN_PLL25_POSTDIV1=1.
LOCAL &__MAIN_PLL25_POSTDIV2
&__MAIN_PLL25_POSTDIV2=1.
LOCAL &__MAIN_PLL25_HSDIV0_DIV_VAL
&__MAIN_PLL25_HSDIV0_DIV_VAL=5.
// -- 6
LOCAL &__MAIN_PLL25_HSDIV1_DIV_VAL
&__MAIN_PLL25_HSDIV1_DIV_VAL=3.
// -- 4
LOCAL &__MAIN_PLL25_HSDIV2_DIV_VAL
&__MAIN_PLL25_HSDIV2_DIV_VAL=-1.
LOCAL &__MAIN_PLL25_HSDIV3_DIV_VAL
&__MAIN_PLL25_HSDIV3_DIV_VAL=-1.
LOCAL &__MAIN_PLL25_HSDIV4_DIV_VAL
&__MAIN_PLL25_HSDIV4_DIV_VAL=-1.
LOCAL &__MAIN_PLL25_HSDIV5_DIV_VAL
&__MAIN_PLL25_HSDIV5_DIV_VAL=-1.
LOCAL &__MAIN_PLL25_HSDIV6_DIV_VAL
&__MAIN_PLL25_HSDIV6_DIV_VAL=-1.
LOCAL &__MAIN_PLL25_HSDIV7_DIV_VAL
&__MAIN_PLL25_HSDIV7_DIV_VAL=-1.
LOCAL &__MAIN_PLL25_HSDIV8_DIV_VAL
&__MAIN_PLL25_HSDIV8_DIV_VAL=-1.
LOCAL &__MAIN_PLL25_SSMOD_SPREAD
&__MAIN_PLL25_SSMOD_SPREAD=0x1F
LOCAL &__MAIN_PLL25_SSMOD_MODDIV
&__MAIN_PLL25_SSMOD_MODDIV=-1.
LOCAL &__MAIN_PLL25_SSMOD_DOWNSPREAD
&__MAIN_PLL25_SSMOD_DOWNSPREAD=1.
LOCAL &__MAIN_PLL25_FBDIV_DMPAC_520
&__MAIN_PLL25_FBDIV_DMPAC_520=135.
// --  2600MHz VCO output
LOCAL &__MAIN_PLL25_FRACDIV_DMPAC_520
&__MAIN_PLL25_FRACDIV_DMPAC_520=6990506.
// --  2600MHz VCO output
LOCAL &__MAIN_PLL25_HSDIV0_DMPAC_520_DIV_VAL
&__MAIN_PLL25_HSDIV0_DMPAC_520_DIV_VAL=4.
// -- 5 (this is going to DMPAC)
LOCAL &__MAIN_PLL25_HSDIV1_DMPAC_520_DIV_VAL
&__MAIN_PLL25_HSDIV1_DMPAC_520_DIV_VAL=3.
// -- 4 (this is going to VPAC)
// -- PLL26: DDR1 FracF PLL
// --  Frequencies:
// -- PLL input:          19.2MHz
// -- VCO output:         2133MHz
// -- POSTDIV output:     2133MHz
// -- HSDIV0 output:      1066MHz
// -- HSDIV1 output:      N/A
// -- HSDIV2 output:      N/A
// -- HSDIV3 output:      N/A
// -- HSDIV4 output:      N/A
// -- HSDIV5 output:      N/A
// -- HSDIV6 output:      N/A
// -- HSDIV7 output:      N/A
// -- HSDIV8 output:      N/A
// -- MODSS configuration: 
// -- - Spread: 3.125%
// -- - Modulator Divider: %-by-1
// -- - Downspread or centerspread: downspread
LOCAL &__MAIN_PLL26_FBDIV
&__MAIN_PLL26_FBDIV=111.
LOCAL &__MAIN_PLL26_FRACDIV
&__MAIN_PLL26_FRACDIV=1572864.
LOCAL &__MAIN_PLL26_PREDIV
&__MAIN_PLL26_PREDIV=1.
LOCAL &__MAIN_PLL26_POSTDIV1
&__MAIN_PLL26_POSTDIV1=1.
LOCAL &__MAIN_PLL26_POSTDIV2
&__MAIN_PLL26_POSTDIV2=1.
LOCAL &__MAIN_PLL26_HSDIV0_DIV_VAL
&__MAIN_PLL26_HSDIV0_DIV_VAL=1.
// -- 2
LOCAL &__MAIN_PLL26_HSDIV1_DIV_VAL
&__MAIN_PLL26_HSDIV1_DIV_VAL=-1.
LOCAL &__MAIN_PLL26_HSDIV2_DIV_VAL
&__MAIN_PLL26_HSDIV2_DIV_VAL=-1.
LOCAL &__MAIN_PLL26_HSDIV3_DIV_VAL
&__MAIN_PLL26_HSDIV3_DIV_VAL=-1.
LOCAL &__MAIN_PLL26_HSDIV4_DIV_VAL
&__MAIN_PLL26_HSDIV4_DIV_VAL=-1.
LOCAL &__MAIN_PLL26_HSDIV5_DIV_VAL
&__MAIN_PLL26_HSDIV5_DIV_VAL=-1.
LOCAL &__MAIN_PLL26_HSDIV6_DIV_VAL
&__MAIN_PLL26_HSDIV6_DIV_VAL=-1.
LOCAL &__MAIN_PLL26_HSDIV7_DIV_VAL
&__MAIN_PLL26_HSDIV7_DIV_VAL=-1.
LOCAL &__MAIN_PLL26_HSDIV8_DIV_VAL
&__MAIN_PLL26_HSDIV8_DIV_VAL=-1.
LOCAL &__MAIN_PLL26_SSMOD_SPREAD
&__MAIN_PLL26_SSMOD_SPREAD=-1.
LOCAL &__MAIN_PLL26_SSMOD_MODDIV
&__MAIN_PLL26_SSMOD_MODDIV=-1.
LOCAL &__MAIN_PLL26_SSMOD_DOWNSPREAD
&__MAIN_PLL26_SSMOD_DOWNSPREAD=-1.
LOCAL &__MAIN_PLL26_FBDIV_DDR_2400
&__MAIN_PLL26_FBDIV_DDR_2400=120.
LOCAL &__MAIN_PLL26_FRACDIV_DDR_2400
&__MAIN_PLL26_FRACDIV_DDR_2400=0.
// -- MCU PLL0: MCU PLL
// --  Frequencies:
// -- PLL input:          19.2MHz
// -- VCO output:         2000MHz
// -- POSTDIV output:     2GHz
// -- HSDIV0 output:      1GHz
// -- HSDIV1 output:      58.82MHz
// -- HSDIV2 output:      N/A
// -- HSDIV3 output:      N/A
// -- HSDIV4 output:      N/A
// -- HSDIV5 output:      N/A
// -- HSDIV6 output:      N/A
// -- HSDIV7 output:      N/A
// -- HSDIV8 output:      N/A
// -- MODSS configuration: 
// -- - Spread: 3.125%
// -- - Modulator Divider: %-by-1
// -- - Downspread or centerspread: downspread
LOCAL &__MCU_PLL0_FBDIV
&__MCU_PLL0_FBDIV=104.
LOCAL &__MCU_PLL0_FRACDIV
&__MCU_PLL0_FRACDIV=2796203.
LOCAL &__MCU_PLL0_PREDIV
&__MCU_PLL0_PREDIV=1.
LOCAL &__MCU_PLL0_POSTDIV1
&__MCU_PLL0_POSTDIV1=1.
LOCAL &__MCU_PLL0_POSTDIV2
&__MCU_PLL0_POSTDIV2=1.
LOCAL &__MCU_PLL0_HSDIV0_DIV_VAL
&__MCU_PLL0_HSDIV0_DIV_VAL=1.
// -- 2
LOCAL &__MCU_PLL0_HSDIV1_DIV_VAL
&__MCU_PLL0_HSDIV1_DIV_VAL=33.
// -- 34
LOCAL &__MCU_PLL0_HSDIV2_DIV_VAL
&__MCU_PLL0_HSDIV2_DIV_VAL=-1.
LOCAL &__MCU_PLL0_HSDIV3_DIV_VAL
&__MCU_PLL0_HSDIV3_DIV_VAL=-1.
LOCAL &__MCU_PLL0_HSDIV4_DIV_VAL
&__MCU_PLL0_HSDIV4_DIV_VAL=-1.
LOCAL &__MCU_PLL0_HSDIV5_DIV_VAL
&__MCU_PLL0_HSDIV5_DIV_VAL=-1.
LOCAL &__MCU_PLL0_HSDIV6_DIV_VAL
&__MCU_PLL0_HSDIV6_DIV_VAL=-1.
LOCAL &__MCU_PLL0_HSDIV7_DIV_VAL
&__MCU_PLL0_HSDIV7_DIV_VAL=-1.
LOCAL &__MCU_PLL0_HSDIV8_DIV_VAL
&__MCU_PLL0_HSDIV8_DIV_VAL=-1.
LOCAL &__MCU_PLL0_SSMOD_SPREAD
&__MCU_PLL0_SSMOD_SPREAD=0x1F
LOCAL &__MCU_PLL0_SSMOD_MODDIV
&__MCU_PLL0_SSMOD_MODDIV=-1.
LOCAL &__MCU_PLL0_SSMOD_DOWNSPREAD
&__MCU_PLL0_SSMOD_DOWNSPREAD=1.
// -- MCU0 PLL PLL Controller Parameters
LOCAL &__MCU_CTRL_BPDIV
&__MCU_CTRL_BPDIV=0.
// -- AUXCLK=BPCLK=REFCLK for controller
LOCAL &__MCU_CTRL_OD1
&__MCU_CTRL_OD1=0.
// -- OBSCLK=REFCLK for controller
LOCAL &__MCU_CTRL_DIV1
&__MCU_CTRL_DIV1=1.
// -- 1000MHZ SYSCLK1 from MCU PLL CLKOUT
// -- MCU PLL1: MCU Pulsar PLL
// --  Frequencies:
// -- PLL input:          19.2MHz
// -- VCO output:         2400MHz
// -- POSTDIV output:     2400MHz
// -- HSDIV0 output:      400MHz
// -- HSDIV1 output:      60MHz
// -- HSDIV2 output:      80MHz
// -- HSDIV3 output:      96MHz
// -- HSDIV4 output:      400MHz
// -- HSDIV5 output:      N/A
// -- HSDIV6 output:      N/A
// -- HSDIV7 output:      N/A
// -- HSDIV8 output:      N/A
// -- MODSS configuration: 
// -- - Spread: 3.125%
// -- - Modulator Divider: %-by-1
// -- - Downspread or centerspread: downspread
LOCAL &__MCU_PLL1_FBDIV
&__MCU_PLL1_FBDIV=125.
LOCAL &__MCU_PLL1_FRACDIV
&__MCU_PLL1_FRACDIV=0.
LOCAL &__MCU_PLL1_PREDIV
&__MCU_PLL1_PREDIV=1.
LOCAL &__MCU_PLL1_POSTDIV1
&__MCU_PLL1_POSTDIV1=1.
LOCAL &__MCU_PLL1_POSTDIV2
&__MCU_PLL1_POSTDIV2=1.
LOCAL &__MCU_PLL1_HSDIV0_DIV_VAL
&__MCU_PLL1_HSDIV0_DIV_VAL=5.
// -- 6
LOCAL &__MCU_PLL1_HSDIV1_DIV_VAL
&__MCU_PLL1_HSDIV1_DIV_VAL=39.
// -- 40
LOCAL &__MCU_PLL1_HSDIV2_DIV_VAL
&__MCU_PLL1_HSDIV2_DIV_VAL=29.
// -- 30
LOCAL &__MCU_PLL1_HSDIV3_DIV_VAL
&__MCU_PLL1_HSDIV3_DIV_VAL=24.
// -- 25
LOCAL &__MCU_PLL1_HSDIV4_DIV_VAL
&__MCU_PLL1_HSDIV4_DIV_VAL=5.
// -- 6
LOCAL &__MCU_PLL1_HSDIV5_DIV_VAL
&__MCU_PLL1_HSDIV5_DIV_VAL=-1.
LOCAL &__MCU_PLL1_HSDIV6_DIV_VAL
&__MCU_PLL1_HSDIV6_DIV_VAL=-1.
LOCAL &__MCU_PLL1_HSDIV7_DIV_VAL
&__MCU_PLL1_HSDIV7_DIV_VAL=-1.
LOCAL &__MCU_PLL1_HSDIV8_DIV_VAL
&__MCU_PLL1_HSDIV8_DIV_VAL=-1.
LOCAL &__MCU_PLL1_SSMOD_SPREAD
&__MCU_PLL1_SSMOD_SPREAD=0x1F
LOCAL &__MCU_PLL1_SSMOD_MODDIV
&__MCU_PLL1_SSMOD_MODDIV=-1.
LOCAL &__MCU_PLL1_SSMOD_DOWNSPREAD
&__MCU_PLL1_SSMOD_DOWNSPREAD=1.
// -- MCU PLL2: MCU Peripheral 2 (CPSW) PLL
// --  Frequencies:
// -- PLL input:          19.2MHz
// -- VCO output:         2000MHz
// -- POSTDIV output:     2000MHz
// -- HSDIV0 output:      250MHz
// -- HSDIV1 output:      500MHz
// -- HSDIV2 output:      80MHz
// -- HSDIV3 output:      96MHz (approx ~95MHz)
// -- HSDIV4 output:      400MHz
// -- HSDIV5 output:      N/A
// -- HSDIV6 output:      N/A
// -- HSDIV7 output:      N/A
// -- HSDIV8 output:      N/A
// -- MODSS configuration: 
// -- - Spread: 3.125%
// -- - Modulator Divider: %-by-1
// -- - Downspread or centerspread: downspread
LOCAL &__MCU_PLL2_FBDIV
&__MCU_PLL2_FBDIV=104.
LOCAL &__MCU_PLL2_FRACDIV
&__MCU_PLL2_FRACDIV=2796203.
LOCAL &__MCU_PLL2_PREDIV
&__MCU_PLL2_PREDIV=1.
LOCAL &__MCU_PLL2_POSTDIV1
&__MCU_PLL2_POSTDIV1=1.
LOCAL &__MCU_PLL2_POSTDIV2
&__MCU_PLL2_POSTDIV2=1.
LOCAL &__MCU_PLL2_HSDIV0_DIV_VAL
&__MCU_PLL2_HSDIV0_DIV_VAL=7.
// -- 8
LOCAL &__MCU_PLL2_HSDIV1_DIV_VAL
&__MCU_PLL2_HSDIV1_DIV_VAL=3.
// -- 4
LOCAL &__MCU_PLL2_HSDIV2_DIV_VAL
&__MCU_PLL2_HSDIV2_DIV_VAL=24.
// -- 25
LOCAL &__MCU_PLL2_HSDIV3_DIV_VAL
&__MCU_PLL2_HSDIV3_DIV_VAL=20.
// -- 21
LOCAL &__MCU_PLL2_HSDIV4_DIV_VAL
&__MCU_PLL2_HSDIV4_DIV_VAL=4.
// -- 5
LOCAL &__MCU_PLL2_HSDIV5_DIV_VAL
&__MCU_PLL2_HSDIV5_DIV_VAL=-1.
LOCAL &__MCU_PLL2_HSDIV6_DIV_VAL
&__MCU_PLL2_HSDIV6_DIV_VAL=-1.
LOCAL &__MCU_PLL2_HSDIV7_DIV_VAL
&__MCU_PLL2_HSDIV7_DIV_VAL=-1.
LOCAL &__MCU_PLL2_HSDIV8_DIV_VAL
&__MCU_PLL2_HSDIV8_DIV_VAL=-1.
LOCAL &__MCU_PLL2_SSMOD_SPREAD
&__MCU_PLL2_SSMOD_SPREAD=0x1F
LOCAL &__MCU_PLL2_SSMOD_MODDIV
&__MCU_PLL2_SSMOD_MODDIV=-1.
LOCAL &__MCU_PLL2_SSMOD_DOWNSPREAD
&__MCU_PLL2_SSMOD_DOWNSPREAD=1.
// --  END OF FILE 
// -- *
// --  * \file  J7AM_PLL.gel
// --  *
// --  * \brief GEL File to configure the clocking infrastructure on J7VCL
// --  Copyright (c) 2020, Texas Instruments Incorporated
// --  * All rights reserved.
// --  *
// --  * Redistribution and use in source and binary forms, with or without
// --  * modification, are permitted provided that the following conditions
// --  * are met:
// --  *
// --  * *  Redistributions of source code must retain the above copyright
// --  *    notice, this list of conditions and the following disclaimer.
// --  *
// --  * *  Redistributions in binary form must reproduce the above copyright
// --  *    notice, this list of conditions and the following disclaimer in the
// --  *    documentation and/or other materials provided with the distribution.
// --  *
// --  * *  Neither the name of Texas Instruments Incorporated nor the names of
// --  *    its contributors may be used to endorse or promote products derived
// --  *    from this software without specific prior written permission.
// --  *
// --  * THIS SOFTWARE IS PROVIDED BY THE COPYRIGHT HOLDERS AND CONTRIBUTORS "AS IS"
// --  * AND ANY EXPRESS OR IMPLIED WARRANTIES, INCLUDING, BUT NOT LIMITED TO,
// --  * THE IMPLIED WARRANTIES OF MERCHANTABILITY AND FITNESS FOR A PARTICULAR
// --  * PURPOSE ARE DISCLAIMED. IN NO EVENT SHALL THE COPYRIGHT OWNER OR
// --  * CONTRIBUTORS BE LIABLE FOR ANY DIRECT, INDIRECT, INCIDENTAL, SPECIAL,
// --  * EXEMPLARY, OR CONSEQUENTIAL DAMAGES (INCLUDING, BUT NOT LIMITED TO,
// --  * PROCUREMENT OF SUBSTITUTE GOODS OR SERVICES; LOSS OF USE, DATA, OR PROFITS;
// --  * OR BUSINESS INTERRUPTION) HOWEVER CAUSED AND ON ANY THEORY OF LIABILITY,
// --  * WHETHER IN CONTRACT, STRICT LIABILITY, OR TORT (INCLUDING NEGLIGENCE OR
// --  * OTHERWISE) ARISING IN ANY WAY OUT OF THE USE OF THIS SOFTWARE,
// --  * EVEN IF ADVISED OF THE POSSIBILITY OF SUCH DAMAGE. 
// --  Revision history:
// --  * 
// -- Global definitions
LOCAL &__DEBUG
&__DEBUG=(0.)
// -- turn on this for debugging messages
LOCAL &__IF_SILICON
&__IF_SILICON=(0.)
// -- enables calibration for fractional PLLs w/ calibration
LOCAL &__MAIN_PSC_BASE
&__MAIN_PSC_BASE=(0x00400000)
LOCAL &__PSC_PID
&__PSC_PID=(0x44827A00)
LOCAL &__M3_MCU_OFFSET
&__M3_MCU_OFFSET=(0x20000000)
LOCAL &__M3_MAIN_OFFSET
&__M3_MAIN_OFFSET=(0x80000000)
// -- PLL Locations
LOCAL &__CSL_PLL0_CFG_BASE
&__CSL_PLL0_CFG_BASE=(0x680000)
LOCAL &__CSL_MCU_PLL0_CFG_BASE
&__CSL_MCU_PLL0_CFG_BASE=(0x40D00000)
// -- PLL Controller Locations
LOCAL &__CSL_PLLCTRL0_BASE
&__CSL_PLLCTRL0_BASE=(0x410000)
LOCAL &__CSL_WKUP_PLLCTRL0_BASE
&__CSL_WKUP_PLLCTRL0_BASE=(0x42010000)
LOCAL &__KICK0_UNLOCK
&__KICK0_UNLOCK=(0x68EF3490)
LOCAL &__KICK1_UNLOCK
&__KICK1_UNLOCK=(0xD172BC5A)
LOCAL &__KICK_LOCK
&__KICK_LOCK=(0x00000000)
LOCAL &__MAIN_DOMAIN
&__MAIN_DOMAIN=(0.)
LOCAL &__MCU_DOMAIN
&__MCU_DOMAIN=(1.)
LOCAL &__CENTER_SPREAD
&__CENTER_SPREAD=(0.)
LOCAL &__DOWN_SPREAD
&__DOWN_SPREAD=(1.)
LOCAL &__FRAC_PLL
&__FRAC_PLL=(0.)
LOCAL &__FRAC_F_PLL
&__FRAC_F_PLL=(1.)
LOCAL &__DESKEW_PLL
&__DESKEW_PLL=(2.)

GLOBAL &path_J7AEP_PLL_MMR_PARAMS_PLL_cmm
&path_J7AEP_PLL_MMR_PARAMS_PLL_cmm=OS.PPF()
Var.NEW unsigned int \address_offset
Var.Assign \address_offset=0x0
IF "&function"!=""
(
	GOSUB &function &args
)
ELSE
(
	GOSUB __GeL_MeNu_CrEaTe
)
ENDDO
// -- *
// --  * \brief   Program the PLL, any associated HSDIVs, PLL Controllers, and SSMODs.
// --  *
// --  * \param   Base_Address        The base address of the PLL registers. This
// --  *                              changes depending on which domain the PLL is in.
// --  *
// --  * \param   address_offset      Address offset for M3 RAT compatibility.
// --  * 
// --  * \param   PLL_index           The PLL's index, ranges from 0-25. These are
// --  *                              defined in J7_PLL_MMR.GEL.
// --  * 
// --  * \param   Clocking_Scheme     The operating frequency condition specified.
// --  *                              Changing this will change the OFC of the chip.
// --  *
// --  * \return  none

Program_PLL:
(
	PRIVATE &__VF0 &__VF1 &__VF2 &__VF3
	ENTRY &__VF0 &__VF1 &__VF2 &__VF3
	
	&__VF0=&__VF0 // evaluation of passed expressions 
	&__VF1=&__VF1
	&__VF2=&__VF2
	&__VF3=&__VF3
	
	Var.NEWLOCAL unsigned int \Base_Address=&__VF0
	Var.NEWLOCAL unsigned int \address_offset=&__VF1
	Var.NEWLOCAL unsigned int \PLL_index=&__VF2
	Var.NEWLOCAL unsigned int \Clocking_Scheme=&__VF3
	Var.NEWLOCAL int \debug_info
	Var.Assign \debug_info=&__DEBUG
	Var.NEWLOCAL int \if_silicon
	Var.Assign \if_silicon=&__IF_SILICON
	Var.NEWLOCAL unsigned int \fout
	Var.Assign \fout=0x0
	Var.NEWLOCAL unsigned int \fref
	Var.Assign \fref=0x0
	Var.NEWLOCAL unsigned int \frefdiv
	Var.Assign \frefdiv=0x0
	Var.NEWLOCAL unsigned int \fbdiv
	Var.Assign \fbdiv=0x0
	Var.NEWLOCAL signed int \frac
	Var.Assign \frac=0x0
	Var.NEWLOCAL unsigned int \refdiv
	Var.Assign \refdiv=0x0
	Var.NEWLOCAL unsigned int \postdiv1
	Var.Assign \postdiv1=0x0
	Var.NEWLOCAL unsigned int \postdiv2
	Var.Assign \postdiv2=0x0
	Var.NEWLOCAL signed int \div_val_0
	Var.Assign \div_val_0=0x0
	Var.NEWLOCAL signed int \div_val_1
	Var.Assign \div_val_1=0x0
	Var.NEWLOCAL signed int \div_val_2
	Var.Assign \div_val_2=0x0
	Var.NEWLOCAL signed int \div_val_3
	Var.Assign \div_val_3=0x0
	Var.NEWLOCAL signed int \div_val_4
	Var.Assign \div_val_4=0x0
	Var.NEWLOCAL signed int \div_val_5
	Var.Assign \div_val_5=0x0
	Var.NEWLOCAL signed int \div_val_6
	Var.Assign \div_val_6=0x0
	Var.NEWLOCAL signed int \div_val_7
	Var.Assign \div_val_7=0x0
	Var.NEWLOCAL signed int \div_val_8
	Var.Assign \div_val_8=0x0
	Var.NEWLOCAL unsigned int \ssmod_spreadval
	Var.Assign \ssmod_spreadval=0x0
	Var.NEWLOCAL unsigned int \ssmod_input_div
	Var.Assign \ssmod_input_div=0x0
	Var.NEWLOCAL unsigned int \ssmod_spreadtype
	Var.Assign \ssmod_spreadtype=0x0
	Var.NEWLOCAL unsigned int \PLL_config_info
	Var.NEWLOCAL unsigned int \HSDIV_Presence
	Var.Assign \HSDIV_Presence=0x0
	Var.NEWLOCAL unsigned int \Num_HSDIV
	Var.Assign \Num_HSDIV=0x0
	Var.NEWLOCAL unsigned int \hsdiv_value
	Var.Assign \hsdiv_value=0x0
	Var.NEWLOCAL unsigned int \SSM_Type
	Var.Assign \SSM_Type=0x0
	Var.NEWLOCAL unsigned int \SSM_Wavetable_Presence
	Var.Assign \SSM_Wavetable_Presence=0x0
	Var.NEWLOCAL unsigned int \PLL_Type
	Var.Assign \PLL_Type=0x0
	Var.NEWLOCAL unsigned int \Is_PLL_Locked
	Var.NEWLOCAL unsigned int \i
	Var.Assign \i=0x0
	Var.NEWLOCAL unsigned int \temp
	Var.Assign \temp=0x0
	GOSUB Unlock_PLL_MMR Var.VALUE(\Base_Address) Var.VALUE(\address_offset) Var.VALUE(\PLL_index)
	Var.IF (\debug_info!=0)
	(
		PRINT "Unlocked PLL MMRs."
		PRINT ""
	)
	// -- Grab the PLL configuration from memory.
	GOSUB Read_MMR (((Var.VALUE(\Base_Address)+Var.VALUE(\address_offset))+(Var.VALUE(\PLL_index)*0x1000))+&__PLL_CONFIG)
	ENTRY &__V1
	Var.Assign \PLL_config_info=&__V1
	Var.IF (\debug_info!=0)
	(
		PRINT "Read configuration MMRs."
		PRINT ""
	)
	// -- Extract the PLL configuration from the register value.
	Var.Assign \HSDIV_Presence=((\PLL_config_info&0xFFFF0000)>>0x10)
	Var.Assign \SSM_Type=((\PLL_config_info&0x00001800)>>0xB)
	Var.Assign \SSM_Wavetable_Presence=(\PLL_config_info&(0x00000100>>0x8))
	Var.Assign \PLL_Type=(\PLL_config_info&0x00000003)
	Var.Assign \temp=\HSDIV_Presence
	Var.IF (\debug_info!=0)
	(
		AREA.Select
		PRINT "temp value (HSDIV_Presence) = " %HEX Var.VALUE(\temp) ""
		PRINT ""
		AREA.Select
		PRINT "HSDIV presence value = " %HEX Var.VALUE(\HSDIV_Presence) ""
		PRINT ""
	)
	WHILE (Var.VALUE(\temp)!=0x0)
	(
		Var.Assign \temp=(\temp>>0x1)
		Var.Assign \Num_HSDIV=\Num_HSDIV+1
	)
	Var.IF (\debug_info!=0)
	(
		AREA.Select
		PRINT "Number of hsidvs: " %DECIMAL Var.VALUE(\Num_HSDIV) ""
		PRINT ""
		PRINT "Parsed PLL configuration information."
		PRINT ""
	)
	// -- *************************************************************************
	// -- Gather the PLL divider values for the speific PLL. Special programming modes will be provided later.
	Var.IF (((\PLL_index)==0x0)&&((\Base_Address)==&__CSL_PLL0_CFG_BASE))
	(
		Var.Assign \fbdiv=&__MAIN_PLL0_FBDIV
		Var.Assign \frac=&__MAIN_PLL0_FRACDIV
		Var.Assign \frefdiv=&__MAIN_PLL0_PREDIV
		Var.Assign \postdiv1=&__MAIN_PLL0_POSTDIV1
		Var.Assign \postdiv2=&__MAIN_PLL0_POSTDIV2
		Var.Assign \div_val_0=&__MAIN_PLL0_HSDIV0_DIV_VAL
		Var.Assign \div_val_1=&__MAIN_PLL0_HSDIV1_DIV_VAL
		Var.Assign \div_val_2=&__MAIN_PLL0_HSDIV2_DIV_VAL
		Var.Assign \div_val_3=&__MAIN_PLL0_HSDIV3_DIV_VAL
		Var.Assign \div_val_4=&__MAIN_PLL0_HSDIV4_DIV_VAL
		Var.Assign \div_val_5=&__MAIN_PLL0_HSDIV5_DIV_VAL
		Var.Assign \div_val_6=&__MAIN_PLL0_HSDIV6_DIV_VAL
		Var.Assign \div_val_7=&__MAIN_PLL0_HSDIV7_DIV_VAL
		Var.Assign \div_val_8=&__MAIN_PLL0_HSDIV8_DIV_VAL
		Var.Assign \ssmod_spreadval=&__MAIN_PLL0_SSMOD_SPREAD
		Var.Assign \ssmod_input_div=&__MAIN_PLL0_SSMOD_MODDIV
		Var.Assign \ssmod_spreadtype=&__MAIN_PLL0_SSMOD_DOWNSPREAD
	)
	ELSE
	(
		Var.IF (((\PLL_index)==0x1)&&((\Base_Address)==&__CSL_PLL0_CFG_BASE))
		(
			Var.Assign \fbdiv=&__MAIN_PLL1_FBDIV
			Var.Assign \frac=&__MAIN_PLL1_FRACDIV
			Var.Assign \frefdiv=&__MAIN_PLL1_PREDIV
			Var.Assign \postdiv1=&__MAIN_PLL1_POSTDIV1
			Var.Assign \postdiv2=&__MAIN_PLL1_POSTDIV2
			Var.Assign \div_val_0=&__MAIN_PLL1_HSDIV0_DIV_VAL
			Var.Assign \div_val_1=&__MAIN_PLL1_HSDIV1_DIV_VAL
			Var.Assign \div_val_2=&__MAIN_PLL1_HSDIV2_DIV_VAL
			Var.Assign \div_val_3=&__MAIN_PLL1_HSDIV3_DIV_VAL
			Var.Assign \div_val_4=&__MAIN_PLL1_HSDIV4_DIV_VAL
			Var.Assign \div_val_5=&__MAIN_PLL1_HSDIV5_DIV_VAL
			Var.Assign \div_val_6=&__MAIN_PLL1_HSDIV6_DIV_VAL
			Var.Assign \div_val_7=&__MAIN_PLL1_HSDIV7_DIV_VAL
			Var.Assign \div_val_8=&__MAIN_PLL1_HSDIV8_DIV_VAL
			Var.Assign \ssmod_spreadval=&__MAIN_PLL1_SSMOD_SPREAD
			Var.Assign \ssmod_input_div=&__MAIN_PLL1_SSMOD_MODDIV
			Var.Assign \ssmod_spreadtype=&__MAIN_PLL1_SSMOD_DOWNSPREAD
		)
		ELSE
		(
			Var.IF (((\PLL_index)==0x2)&&((\Base_Address)==&__CSL_PLL0_CFG_BASE))
			(
				Var.Assign \fbdiv=&__MAIN_PLL2_FBDIV
				Var.Assign \frac=&__MAIN_PLL2_FRACDIV
				Var.Assign \frefdiv=&__MAIN_PLL2_PREDIV
				Var.Assign \postdiv1=&__MAIN_PLL2_POSTDIV1
				Var.Assign \postdiv2=&__MAIN_PLL2_POSTDIV2
				Var.Assign \div_val_0=&__MAIN_PLL2_HSDIV0_DIV_VAL
				Var.Assign \div_val_1=&__MAIN_PLL2_HSDIV1_DIV_VAL
				Var.Assign \div_val_2=&__MAIN_PLL2_HSDIV2_DIV_VAL
				Var.Assign \div_val_3=&__MAIN_PLL2_HSDIV3_DIV_VAL
				Var.Assign \div_val_4=&__MAIN_PLL2_HSDIV4_DIV_VAL
				Var.Assign \div_val_5=&__MAIN_PLL2_HSDIV5_DIV_VAL
				Var.Assign \div_val_6=&__MAIN_PLL2_HSDIV6_DIV_VAL
				Var.Assign \div_val_7=&__MAIN_PLL2_HSDIV7_DIV_VAL
				Var.Assign \div_val_8=&__MAIN_PLL2_HSDIV8_DIV_VAL
				Var.Assign \ssmod_spreadval=&__MAIN_PLL2_SSMOD_SPREAD
				Var.Assign \ssmod_input_div=&__MAIN_PLL2_SSMOD_MODDIV
				Var.Assign \ssmod_spreadtype=&__MAIN_PLL2_SSMOD_DOWNSPREAD
			)
			ELSE
			(
				Var.IF ((\PLL_index)==0x3)
				(
					Var.Assign \fbdiv=&__MAIN_PLL3_FBDIV
					Var.Assign \frac=&__MAIN_PLL3_FRACDIV
					Var.Assign \frefdiv=&__MAIN_PLL3_PREDIV
					Var.Assign \postdiv1=&__MAIN_PLL3_POSTDIV1
					Var.Assign \postdiv2=&__MAIN_PLL3_POSTDIV2
					Var.Assign \div_val_0=&__MAIN_PLL3_HSDIV0_DIV_VAL
					Var.Assign \div_val_1=&__MAIN_PLL3_HSDIV1_DIV_VAL
					Var.Assign \div_val_2=&__MAIN_PLL3_HSDIV2_DIV_VAL
					Var.Assign \div_val_3=&__MAIN_PLL3_HSDIV3_DIV_VAL
					Var.Assign \div_val_4=&__MAIN_PLL3_HSDIV4_DIV_VAL
					Var.Assign \div_val_5=&__MAIN_PLL3_HSDIV5_DIV_VAL
					Var.Assign \div_val_6=&__MAIN_PLL3_HSDIV6_DIV_VAL
					Var.Assign \div_val_7=&__MAIN_PLL3_HSDIV7_DIV_VAL
					Var.Assign \div_val_8=&__MAIN_PLL3_HSDIV8_DIV_VAL
					Var.Assign \ssmod_spreadval=&__MAIN_PLL3_SSMOD_SPREAD
					Var.Assign \ssmod_input_div=&__MAIN_PLL3_SSMOD_MODDIV
					Var.Assign \ssmod_spreadtype=&__MAIN_PLL3_SSMOD_DOWNSPREAD
				)
				ELSE
				(
					Var.IF ((\PLL_index)==0x4)
					(
						Var.Assign \fbdiv=&__MAIN_PLL4_FBDIV
						Var.Assign \frac=&__MAIN_PLL4_FRACDIV
						Var.Assign \frefdiv=&__MAIN_PLL4_PREDIV
						Var.Assign \postdiv1=&__MAIN_PLL4_POSTDIV1
						Var.Assign \postdiv2=&__MAIN_PLL4_POSTDIV2
						Var.Assign \div_val_0=&__MAIN_PLL4_HSDIV0_DIV_VAL
						Var.Assign \div_val_1=&__MAIN_PLL4_HSDIV1_DIV_VAL
						Var.Assign \div_val_2=&__MAIN_PLL4_HSDIV2_DIV_VAL
						Var.Assign \div_val_3=&__MAIN_PLL4_HSDIV3_DIV_VAL
						Var.Assign \div_val_4=&__MAIN_PLL4_HSDIV4_DIV_VAL
						Var.Assign \div_val_5=&__MAIN_PLL4_HSDIV5_DIV_VAL
						Var.Assign \div_val_6=&__MAIN_PLL4_HSDIV6_DIV_VAL
						Var.Assign \div_val_7=&__MAIN_PLL4_HSDIV7_DIV_VAL
						Var.Assign \div_val_8=&__MAIN_PLL4_HSDIV8_DIV_VAL
						Var.Assign \ssmod_spreadval=&__MAIN_PLL4_SSMOD_SPREAD
						Var.Assign \ssmod_input_div=&__MAIN_PLL4_SSMOD_MODDIV
						Var.Assign \ssmod_spreadtype=&__MAIN_PLL4_SSMOD_DOWNSPREAD
					)
					ELSE
					(
						Var.IF ((\PLL_index)==0x5)
						(
							Var.IF ((\Clocking_Scheme)==&__VIDEO_2400)
							(
								Var.Assign \fbdiv=&__MAIN_PLL5_FBDIV_2400
								Var.Assign \frac=&__MAIN_PLL5_FRACDIV_2400
							)
							ELSE
							(
								Var.IF ((\Clocking_Scheme)==&__OFC1)
								(
									Var.Assign \fbdiv=&__MAIN_PLL5_FBDIV
									Var.Assign \frac=&__MAIN_PLL5_FRACDIV
								)
								ELSE
								(
									// -- Default is OFC1 anyways
									Var.Assign \fbdiv=&__MAIN_PLL5_FBDIV
									Var.Assign \frac=&__MAIN_PLL5_FRACDIV
								)
							)
							Var.Assign \frefdiv=&__MAIN_PLL5_PREDIV
							Var.Assign \postdiv1=&__MAIN_PLL5_POSTDIV1
							Var.Assign \postdiv2=&__MAIN_PLL5_POSTDIV2
							Var.Assign \div_val_0=&__MAIN_PLL5_HSDIV0_DIV_VAL
							Var.Assign \div_val_1=&__MAIN_PLL5_HSDIV1_DIV_VAL
							Var.Assign \div_val_2=&__MAIN_PLL5_HSDIV2_DIV_VAL
							Var.Assign \div_val_3=&__MAIN_PLL5_HSDIV3_DIV_VAL
							Var.Assign \div_val_4=&__MAIN_PLL5_HSDIV4_DIV_VAL
							Var.Assign \div_val_5=&__MAIN_PLL5_HSDIV5_DIV_VAL
							Var.Assign \div_val_6=&__MAIN_PLL5_HSDIV6_DIV_VAL
							Var.Assign \div_val_7=&__MAIN_PLL5_HSDIV7_DIV_VAL
							Var.Assign \div_val_8=&__MAIN_PLL5_HSDIV8_DIV_VAL
							Var.Assign \ssmod_spreadval=&__MAIN_PLL5_SSMOD_SPREAD
							Var.Assign \ssmod_input_div=&__MAIN_PLL5_SSMOD_MODDIV
							Var.Assign \ssmod_spreadtype=&__MAIN_PLL5_SSMOD_DOWNSPREAD
						)
						ELSE
						(
							Var.IF ((\PLL_index)==0x7)
							(
								Var.Assign \fbdiv=&__MAIN_PLL7_FBDIV
								Var.Assign \frac=&__MAIN_PLL7_FRACDIV
								Var.Assign \frefdiv=&__MAIN_PLL7_PREDIV
								Var.Assign \postdiv1=&__MAIN_PLL7_POSTDIV1
								Var.Assign \postdiv2=&__MAIN_PLL7_POSTDIV2
								Var.Assign \div_val_0=&__MAIN_PLL7_HSDIV0_DIV_VAL
								Var.Assign \div_val_1=&__MAIN_PLL7_HSDIV1_DIV_VAL
								Var.Assign \div_val_2=&__MAIN_PLL7_HSDIV2_DIV_VAL
								Var.Assign \div_val_3=&__MAIN_PLL7_HSDIV3_DIV_VAL
								Var.Assign \div_val_4=&__MAIN_PLL7_HSDIV4_DIV_VAL
								Var.Assign \div_val_5=&__MAIN_PLL7_HSDIV5_DIV_VAL
								Var.Assign \div_val_6=&__MAIN_PLL7_HSDIV6_DIV_VAL
								Var.Assign \div_val_7=&__MAIN_PLL7_HSDIV7_DIV_VAL
								Var.Assign \div_val_8=&__MAIN_PLL7_HSDIV8_DIV_VAL
								Var.Assign \ssmod_spreadval=&__MAIN_PLL7_SSMOD_SPREAD
								Var.Assign \ssmod_input_div=&__MAIN_PLL7_SSMOD_MODDIV
								Var.Assign \ssmod_spreadtype=&__MAIN_PLL7_SSMOD_DOWNSPREAD
							)
							ELSE
							(
								Var.IF ((\PLL_index)==0x8)
								(
									Var.Assign \fbdiv=&__MAIN_PLL8_FBDIV
									Var.Assign \frac=&__MAIN_PLL8_FRACDIV
									Var.Assign \frefdiv=&__MAIN_PLL8_PREDIV
									Var.Assign \postdiv1=&__MAIN_PLL8_POSTDIV1
									Var.Assign \postdiv2=&__MAIN_PLL8_POSTDIV2
									Var.Assign \div_val_0=&__MAIN_PLL8_HSDIV0_DIV_VAL
									Var.Assign \div_val_1=&__MAIN_PLL8_HSDIV1_DIV_VAL
									Var.Assign \div_val_2=&__MAIN_PLL8_HSDIV2_DIV_VAL
									Var.Assign \div_val_3=&__MAIN_PLL8_HSDIV3_DIV_VAL
									Var.Assign \div_val_4=&__MAIN_PLL8_HSDIV4_DIV_VAL
									Var.Assign \div_val_5=&__MAIN_PLL8_HSDIV5_DIV_VAL
									Var.Assign \div_val_6=&__MAIN_PLL8_HSDIV6_DIV_VAL
									Var.Assign \div_val_7=&__MAIN_PLL8_HSDIV7_DIV_VAL
									Var.Assign \div_val_8=&__MAIN_PLL8_HSDIV8_DIV_VAL
									Var.Assign \ssmod_spreadval=&__MAIN_PLL8_SSMOD_SPREAD
									Var.Assign \ssmod_input_div=&__MAIN_PLL8_SSMOD_MODDIV
									Var.Assign \ssmod_spreadtype=&__MAIN_PLL8_SSMOD_DOWNSPREAD
								)
								ELSE
								(
									Var.IF ((\PLL_index)==0xC)
									(
										Var.Assign \fbdiv=&__MAIN_PLL12_FBDIV
										Var.Assign \frac=&__MAIN_PLL12_FRACDIV
										Var.Assign \frefdiv=&__MAIN_PLL12_PREDIV
										Var.Assign \postdiv1=&__MAIN_PLL12_POSTDIV1
										Var.Assign \postdiv2=&__MAIN_PLL12_POSTDIV2
										Var.Assign \div_val_0=&__MAIN_PLL12_HSDIV0_DIV_VAL
										Var.Assign \div_val_1=&__MAIN_PLL12_HSDIV1_DIV_VAL
										Var.Assign \div_val_2=&__MAIN_PLL12_HSDIV2_DIV_VAL
										Var.Assign \div_val_3=&__MAIN_PLL12_HSDIV3_DIV_VAL
										Var.Assign \div_val_4=&__MAIN_PLL12_HSDIV4_DIV_VAL
										Var.Assign \div_val_5=&__MAIN_PLL12_HSDIV5_DIV_VAL
										Var.Assign \div_val_6=&__MAIN_PLL12_HSDIV6_DIV_VAL
										Var.Assign \div_val_7=&__MAIN_PLL12_HSDIV7_DIV_VAL
										Var.Assign \div_val_8=&__MAIN_PLL12_HSDIV8_DIV_VAL
										Var.Assign \ssmod_spreadval=&__MAIN_PLL12_SSMOD_SPREAD
										Var.Assign \ssmod_input_div=&__MAIN_PLL12_SSMOD_MODDIV
										Var.Assign \ssmod_spreadtype=&__MAIN_PLL12_SSMOD_DOWNSPREAD
										Var.IF ((\Clocking_Scheme)==&__OFC1)
										(
											Var.Assign \fbdiv=&__MAIN_PLL12_FBDIV
											Var.Assign \frac=&__MAIN_PLL12_FRACDIV
										)
										Var.IF ((\Clocking_Scheme)==&__DDR_2400)
										(
											Var.Assign \fbdiv=&__MAIN_PLL12_FBDIV_DDR_2400
											Var.Assign \frac=&__MAIN_PLL12_FRACDIV_DDR_2400
										)
									)
									ELSE
									(
										Var.IF ((\PLL_index)==0xE)
										(
											Var.Assign \fbdiv=&__MAIN_PLL14_FBDIV
											Var.Assign \frac=&__MAIN_PLL14_FRACDIV
											Var.Assign \frefdiv=&__MAIN_PLL14_PREDIV
											Var.Assign \postdiv1=&__MAIN_PLL14_POSTDIV1
											Var.Assign \postdiv2=&__MAIN_PLL14_POSTDIV2
											Var.Assign \div_val_0=&__MAIN_PLL14_HSDIV0_DIV_VAL
											Var.Assign \div_val_1=&__MAIN_PLL14_HSDIV1_DIV_VAL
											Var.Assign \div_val_2=&__MAIN_PLL14_HSDIV2_DIV_VAL
											Var.Assign \div_val_3=&__MAIN_PLL14_HSDIV3_DIV_VAL
											Var.Assign \div_val_4=&__MAIN_PLL14_HSDIV4_DIV_VAL
											Var.Assign \div_val_5=&__MAIN_PLL14_HSDIV5_DIV_VAL
											Var.Assign \div_val_6=&__MAIN_PLL14_HSDIV6_DIV_VAL
											Var.Assign \div_val_7=&__MAIN_PLL14_HSDIV7_DIV_VAL
											Var.Assign \div_val_8=&__MAIN_PLL14_HSDIV8_DIV_VAL
											Var.Assign \ssmod_spreadval=&__MAIN_PLL14_SSMOD_SPREAD
											Var.Assign \ssmod_input_div=&__MAIN_PLL14_SSMOD_MODDIV
											Var.Assign \ssmod_spreadtype=&__MAIN_PLL14_SSMOD_DOWNSPREAD
										)
										ELSE
										(
											Var.IF ((\PLL_index)==0x10)
											(
												Var.Assign \fbdiv=&__MAIN_PLL16_FBDIV
												Var.Assign \frac=&__MAIN_PLL16_FRACDIV
												Var.Assign \frefdiv=&__MAIN_PLL16_PREDIV
												Var.Assign \postdiv1=&__MAIN_PLL16_POSTDIV1
												Var.Assign \postdiv2=&__MAIN_PLL16_POSTDIV2
												Var.Assign \div_val_0=&__MAIN_PLL16_HSDIV0_DIV_VAL
												Var.Assign \div_val_1=&__MAIN_PLL16_HSDIV1_DIV_VAL
												Var.Assign \div_val_2=&__MAIN_PLL16_HSDIV2_DIV_VAL
												Var.Assign \div_val_3=&__MAIN_PLL16_HSDIV3_DIV_VAL
												Var.Assign \div_val_4=&__MAIN_PLL16_HSDIV4_DIV_VAL
												Var.Assign \div_val_5=&__MAIN_PLL16_HSDIV5_DIV_VAL
												Var.Assign \div_val_6=&__MAIN_PLL16_HSDIV6_DIV_VAL
												Var.Assign \div_val_7=&__MAIN_PLL16_HSDIV7_DIV_VAL
												Var.Assign \div_val_8=&__MAIN_PLL16_HSDIV8_DIV_VAL
												Var.Assign \ssmod_spreadval=&__MAIN_PLL16_SSMOD_SPREAD
												Var.Assign \ssmod_input_div=&__MAIN_PLL16_SSMOD_MODDIV
												Var.Assign \ssmod_spreadtype=&__MAIN_PLL16_SSMOD_DOWNSPREAD
												Var.IF ((\Clocking_Scheme)==&__DSS_2970)
												(
													Var.Assign \fbdiv=&__MAIN_PLL16_FBDIV_DSS_2970
													Var.Assign \frac=&__MAIN_PLL16_FRACDIV_DSS_2970
												)
												ELSE
												(
													Var.IF ((\Clocking_Scheme)==&__DSS_2345)
													(
														Var.Assign \fbdiv=&__MAIN_PLL16_FBDIV_DSS_2345
														Var.Assign \frac=&__MAIN_PLL16_FRACDIV_DSS_2345
													)
													ELSE
													(
														Var.IF ((\Clocking_Scheme)==&__DSS_2898)
														(
															Var.Assign \fbdiv=&__MAIN_PLL16_FBDIV_DSS_2898
															Var.Assign \frac=&__MAIN_PLL16_FRACDIV_DSS_2898
														)
														ELSE
														(
															Var.IF ((\Clocking_Scheme)==&__DSS_2613)
															(
																Var.Assign \fbdiv=&__MAIN_PLL16_FBDIV_DSS_2613
																Var.Assign \frac=&__MAIN_PLL16_FRACDIV_DSS_2613
															)
															ELSE
															(
																Var.IF ((\Clocking_Scheme)==&__DSS_2133)
																(
																	Var.Assign \fbdiv=&__MAIN_PLL16_FBDIV_DSS_2133
																	Var.Assign \frac=&__MAIN_PLL16_FRACDIV_DSS_2133
																)
															)
														)
													)
												)
											)
											ELSE
											(
												Var.IF ((\PLL_index)==0x11)
												(
													Var.Assign \fbdiv=&__MAIN_PLL17_FBDIV
													Var.Assign \frac=&__MAIN_PLL17_FRACDIV
													Var.Assign \frefdiv=&__MAIN_PLL17_PREDIV
													Var.Assign \postdiv1=&__MAIN_PLL17_POSTDIV1
													Var.Assign \postdiv2=&__MAIN_PLL17_POSTDIV2
													Var.Assign \div_val_0=&__MAIN_PLL17_HSDIV0_DIV_VAL
													Var.Assign \div_val_1=&__MAIN_PLL17_HSDIV1_DIV_VAL
													Var.Assign \div_val_2=&__MAIN_PLL17_HSDIV2_DIV_VAL
													Var.Assign \div_val_3=&__MAIN_PLL17_HSDIV3_DIV_VAL
													Var.Assign \div_val_4=&__MAIN_PLL17_HSDIV4_DIV_VAL
													Var.Assign \div_val_5=&__MAIN_PLL17_HSDIV5_DIV_VAL
													Var.Assign \div_val_6=&__MAIN_PLL17_HSDIV6_DIV_VAL
													Var.Assign \div_val_7=&__MAIN_PLL17_HSDIV7_DIV_VAL
													Var.Assign \div_val_8=&__MAIN_PLL17_HSDIV8_DIV_VAL
													Var.Assign \ssmod_spreadval=&__MAIN_PLL17_SSMOD_SPREAD
													Var.Assign \ssmod_input_div=&__MAIN_PLL17_SSMOD_MODDIV
													Var.Assign \ssmod_spreadtype=&__MAIN_PLL17_SSMOD_DOWNSPREAD
													Var.IF ((\Clocking_Scheme)==&__DSS_2970)
													(
														Var.Assign \fbdiv=&__MAIN_PLL17_FBDIV_DSS_2970
														Var.Assign \frac=&__MAIN_PLL17_FRACDIV_DSS_2970
													)
													ELSE
													(
														Var.IF ((\Clocking_Scheme)==&__DSS_2345)
														(
															Var.Assign \fbdiv=&__MAIN_PLL17_FBDIV_DSS_2345
															Var.Assign \frac=&__MAIN_PLL17_FRACDIV_DSS_2345
														)
														ELSE
														(
															Var.IF ((\Clocking_Scheme)==&__DSS_2898)
															(
																Var.Assign \fbdiv=&__MAIN_PLL17_FBDIV_DSS_2898
																Var.Assign \frac=&__MAIN_PLL17_FRACDIV_DSS_2898
															)
															ELSE
															(
																Var.IF ((\Clocking_Scheme)==&__DSS_2613)
																(
																	Var.Assign \fbdiv=&__MAIN_PLL17_FBDIV_DSS_2613
																	Var.Assign \frac=&__MAIN_PLL17_FRACDIV_DSS_2613
																)
																ELSE
																(
																	Var.IF ((\Clocking_Scheme)==&__DSS_2133)
																	(
																		Var.Assign \fbdiv=&__MAIN_PLL17_FBDIV_DSS_2133
																		Var.Assign \frac=&__MAIN_PLL17_FRACDIV_DSS_2133
																	)
																)
															)
														)
													)
												)
												ELSE
												(
													Var.IF ((\PLL_index)==0x13)
													(
														Var.Assign \fbdiv=&__MAIN_PLL19_FBDIV
														Var.Assign \frac=&__MAIN_PLL19_FRACDIV
														Var.Assign \frefdiv=&__MAIN_PLL19_PREDIV
														Var.Assign \postdiv1=&__MAIN_PLL19_POSTDIV1
														Var.Assign \postdiv2=&__MAIN_PLL19_POSTDIV2
														Var.Assign \div_val_0=&__MAIN_PLL19_HSDIV0_DIV_VAL
														Var.Assign \div_val_1=&__MAIN_PLL19_HSDIV1_DIV_VAL
														Var.Assign \div_val_2=&__MAIN_PLL19_HSDIV2_DIV_VAL
														Var.Assign \div_val_3=&__MAIN_PLL19_HSDIV3_DIV_VAL
														Var.Assign \div_val_4=&__MAIN_PLL19_HSDIV4_DIV_VAL
														Var.Assign \div_val_5=&__MAIN_PLL19_HSDIV5_DIV_VAL
														Var.Assign \div_val_6=&__MAIN_PLL19_HSDIV6_DIV_VAL
														Var.Assign \div_val_7=&__MAIN_PLL19_HSDIV7_DIV_VAL
														Var.Assign \div_val_8=&__MAIN_PLL19_HSDIV8_DIV_VAL
														Var.Assign \ssmod_spreadval=&__MAIN_PLL19_SSMOD_SPREAD
														Var.Assign \ssmod_input_div=&__MAIN_PLL19_SSMOD_MODDIV
														Var.Assign \ssmod_spreadtype=&__MAIN_PLL19_SSMOD_DOWNSPREAD
														Var.IF ((\Clocking_Scheme)==&__DSS_2970)
														(
															Var.Assign \fbdiv=&__MAIN_PLL19_FBDIV_DSS_2970
															Var.Assign \frac=&__MAIN_PLL19_FRACDIV_DSS_2970
														)
													)
													ELSE
													(
														Var.IF ((\PLL_index)==0x19)
														(
															Var.Assign \fbdiv=&__MAIN_PLL25_FBDIV
															Var.Assign \frac=&__MAIN_PLL25_FRACDIV
															Var.Assign \frefdiv=&__MAIN_PLL25_PREDIV
															Var.Assign \postdiv1=&__MAIN_PLL25_POSTDIV1
															Var.Assign \postdiv2=&__MAIN_PLL25_POSTDIV2
															Var.Assign \div_val_0=&__MAIN_PLL25_HSDIV0_DIV_VAL
															Var.Assign \div_val_1=&__MAIN_PLL25_HSDIV1_DIV_VAL
															Var.Assign \div_val_2=&__MAIN_PLL25_HSDIV2_DIV_VAL
															Var.Assign \div_val_3=&__MAIN_PLL25_HSDIV3_DIV_VAL
															Var.Assign \div_val_4=&__MAIN_PLL25_HSDIV4_DIV_VAL
															Var.Assign \div_val_5=&__MAIN_PLL25_HSDIV5_DIV_VAL
															Var.Assign \div_val_6=&__MAIN_PLL25_HSDIV6_DIV_VAL
															Var.Assign \div_val_7=&__MAIN_PLL25_HSDIV7_DIV_VAL
															Var.Assign \div_val_8=&__MAIN_PLL25_HSDIV8_DIV_VAL
															Var.Assign \ssmod_spreadval=&__MAIN_PLL25_SSMOD_SPREAD
															Var.Assign \ssmod_input_div=&__MAIN_PLL25_SSMOD_MODDIV
															Var.Assign \ssmod_spreadtype=&__MAIN_PLL25_SSMOD_DOWNSPREAD
															Var.IF ((\Clocking_Scheme)==&__DMPAC_520)
															(
																// -- Set the Feedback divider and the HSDIV divider values.
																Var.Assign \fbdiv=&__MAIN_PLL25_FBDIV_DMPAC_520
																Var.Assign \frac=&__MAIN_PLL25_FRACDIV_DMPAC_520
																Var.Assign \div_val_0=&__MAIN_PLL25_HSDIV0_DMPAC_520_DIV_VAL
																Var.Assign \div_val_1=&__MAIN_PLL25_HSDIV1_DMPAC_520_DIV_VAL
															)
														)
														ELSE
														(
															Var.IF ((\PLL_index)==0x1A)
															(
																Var.Assign \fbdiv=&__MAIN_PLL26_FBDIV
																Var.Assign \frac=&__MAIN_PLL26_FRACDIV
																Var.Assign \frefdiv=&__MAIN_PLL26_PREDIV
																Var.Assign \postdiv1=&__MAIN_PLL26_POSTDIV1
																Var.Assign \postdiv2=&__MAIN_PLL26_POSTDIV2
																Var.Assign \div_val_0=&__MAIN_PLL26_HSDIV0_DIV_VAL
																Var.Assign \div_val_1=&__MAIN_PLL26_HSDIV1_DIV_VAL
																Var.Assign \div_val_2=&__MAIN_PLL26_HSDIV2_DIV_VAL
																Var.Assign \div_val_3=&__MAIN_PLL26_HSDIV3_DIV_VAL
																Var.Assign \div_val_4=&__MAIN_PLL26_HSDIV4_DIV_VAL
																Var.Assign \div_val_5=&__MAIN_PLL26_HSDIV5_DIV_VAL
																Var.Assign \div_val_6=&__MAIN_PLL26_HSDIV6_DIV_VAL
																Var.Assign \div_val_7=&__MAIN_PLL26_HSDIV7_DIV_VAL
																Var.Assign \div_val_8=&__MAIN_PLL26_HSDIV8_DIV_VAL
																Var.Assign \ssmod_spreadval=&__MAIN_PLL26_SSMOD_SPREAD
																Var.Assign \ssmod_input_div=&__MAIN_PLL26_SSMOD_MODDIV
																Var.Assign \ssmod_spreadtype=&__MAIN_PLL26_SSMOD_DOWNSPREAD
																Var.IF ((\Clocking_Scheme)==&__OFC1)
																(
																	Var.Assign \fbdiv=&__MAIN_PLL26_FBDIV
																	Var.Assign \frac=&__MAIN_PLL26_FRACDIV
																)
																Var.IF ((\Clocking_Scheme)==&__DDR_2400)
																(
																	Var.Assign \fbdiv=&__MAIN_PLL26_FBDIV_DDR_2400
																	Var.Assign \frac=&__MAIN_PLL26_FRACDIV_DDR_2400
																)
															)
															ELSE
															(
																Var.IF (((\PLL_index)==0x0)&&((\Base_Address)==&__CSL_MCU_PLL0_CFG_BASE))
																(
																	Var.Assign \fbdiv=&__MCU_PLL0_FBDIV
																	Var.Assign \frac=&__MCU_PLL0_FRACDIV
																	Var.Assign \frefdiv=&__MCU_PLL0_PREDIV
																	Var.Assign \postdiv1=&__MCU_PLL0_POSTDIV1
																	Var.Assign \postdiv2=&__MCU_PLL0_POSTDIV2
																	Var.Assign \div_val_0=&__MCU_PLL0_HSDIV0_DIV_VAL
																	Var.Assign \div_val_1=&__MCU_PLL0_HSDIV1_DIV_VAL
																	Var.Assign \div_val_2=&__MCU_PLL0_HSDIV2_DIV_VAL
																	Var.Assign \div_val_3=&__MCU_PLL0_HSDIV3_DIV_VAL
																	Var.Assign \div_val_4=&__MCU_PLL0_HSDIV4_DIV_VAL
																	Var.Assign \div_val_5=&__MCU_PLL0_HSDIV5_DIV_VAL
																	Var.Assign \div_val_6=&__MCU_PLL0_HSDIV6_DIV_VAL
																	Var.Assign \div_val_7=&__MCU_PLL0_HSDIV7_DIV_VAL
																	Var.Assign \div_val_8=&__MCU_PLL0_HSDIV8_DIV_VAL
																	Var.Assign \ssmod_spreadval=&__MCU_PLL0_SSMOD_SPREAD
																	Var.Assign \ssmod_input_div=&__MCU_PLL0_SSMOD_MODDIV
																	Var.Assign \ssmod_spreadtype=&__MCU_PLL0_SSMOD_DOWNSPREAD
																)
																ELSE
																(
																	Var.IF (((\PLL_index)==0x1)&&((\Base_Address)==&__CSL_MCU_PLL0_CFG_BASE))
																	(
																		Var.Assign \fbdiv=&__MCU_PLL1_FBDIV
																		Var.Assign \frac=&__MCU_PLL1_FRACDIV
																		Var.Assign \frefdiv=&__MCU_PLL1_PREDIV
																		Var.Assign \postdiv1=&__MCU_PLL1_POSTDIV1
																		Var.Assign \postdiv2=&__MCU_PLL1_POSTDIV2
																		Var.Assign \div_val_0=&__MCU_PLL1_HSDIV0_DIV_VAL
																		Var.Assign \div_val_1=&__MCU_PLL1_HSDIV1_DIV_VAL
																		Var.Assign \div_val_2=&__MCU_PLL1_HSDIV2_DIV_VAL
																		Var.Assign \div_val_3=&__MCU_PLL1_HSDIV3_DIV_VAL
																		Var.Assign \div_val_4=&__MCU_PLL1_HSDIV4_DIV_VAL
																		Var.Assign \div_val_5=&__MCU_PLL1_HSDIV5_DIV_VAL
																		Var.Assign \div_val_6=&__MCU_PLL1_HSDIV6_DIV_VAL
																		Var.Assign \div_val_7=&__MCU_PLL1_HSDIV7_DIV_VAL
																		Var.Assign \div_val_8=&__MCU_PLL1_HSDIV8_DIV_VAL
																		Var.Assign \ssmod_spreadval=&__MCU_PLL1_SSMOD_SPREAD
																		Var.Assign \ssmod_input_div=&__MCU_PLL1_SSMOD_MODDIV
																		Var.Assign \ssmod_spreadtype=&__MCU_PLL1_SSMOD_DOWNSPREAD
																	)
																	ELSE
																	(
																		Var.IF (((\PLL_index)==0x2)&&((\Base_Address)==&__CSL_MCU_PLL0_CFG_BASE))
																		(
																			Var.Assign \fbdiv=&__MCU_PLL2_FBDIV
																			Var.Assign \frac=&__MCU_PLL2_FRACDIV
																			Var.Assign \frefdiv=&__MCU_PLL2_PREDIV
																			Var.Assign \postdiv1=&__MCU_PLL2_POSTDIV1
																			Var.Assign \postdiv2=&__MCU_PLL2_POSTDIV2
																			Var.Assign \div_val_0=&__MCU_PLL2_HSDIV0_DIV_VAL
																			Var.Assign \div_val_1=&__MCU_PLL2_HSDIV1_DIV_VAL
																			Var.Assign \div_val_2=&__MCU_PLL2_HSDIV2_DIV_VAL
																			Var.Assign \div_val_3=&__MCU_PLL2_HSDIV3_DIV_VAL
																			Var.Assign \div_val_4=&__MCU_PLL2_HSDIV4_DIV_VAL
																			Var.Assign \div_val_5=&__MCU_PLL2_HSDIV5_DIV_VAL
																			Var.Assign \div_val_6=&__MCU_PLL2_HSDIV6_DIV_VAL
																			Var.Assign \div_val_7=&__MCU_PLL2_HSDIV7_DIV_VAL
																			Var.Assign \div_val_8=&__MCU_PLL2_HSDIV8_DIV_VAL
																			Var.Assign \ssmod_spreadval=&__MCU_PLL2_SSMOD_SPREAD
																			Var.Assign \ssmod_input_div=&__MCU_PLL2_SSMOD_MODDIV
																			Var.Assign \ssmod_spreadtype=&__MCU_PLL2_SSMOD_DOWNSPREAD
																		)
																	)
																)
															)
														)
													)
												)
											)
										)
									)
								)
							)
						)
					)
				)
			)
		)
	)
	Var.IF (\debug_info!=0)
	(
		PRINT "Note: deskew PLL programming isn't implemented yet"
		PRINT ""
	)
	Var.IF ((\PLL_Type)==&__DESKEW_PLL)
	(
		// -- Program the Deskew PLL
		Var.IF (\debug_info!=0)
		(
			PRINT "Put deskew PLL programming here"
			PRINT ""
		)
	)
	ELSE
	(
		// -- Program the fractional PLL. 
		Var.IF (\debug_info!=0)
		(
			PRINT "This is a fractional PLL, continuing on with normal programming."
			PRINT ""
		)
	)
	// -- Debugging information for ensuring the GEL is writing to the right areas.
	Var.IF (\debug_info!=0)
	(
		PRINT "For debugging: "
		PRINT ""
		AREA.Select
		PRINT "Base address: " %HEX Var.VALUE(\Base_Address) ""
		PRINT ""
		AREA.Select
		PRINT "PLL index: " %HEX Var.VALUE(\PLL_index) ""
		PRINT ""
		AREA.Select
		PRINT "PLL index register base: " %HEX Var.VALUE((\PLL_index*0x1000)) ""
		PRINT ""
		AREA.Select
		PRINT "Register: " %HEX Var.VALUE(&__CONTROL) ""
		PRINT ""
		AREA.Select
		PRINT "Clocking scheme: " %DECIMAL Var.VALUE(\Clocking_Scheme) ""
		PRINT ""
	)
	// -- Put the PLL in external bypass first. Write "1" to bit #31 in the control register. 
	GOSUB Write_MMR_Field (((Var.VALUE(\Base_Address)+Var.VALUE(\address_offset))+(Var.VALUE(\PLL_index)*0x1000))+&__CONTROL) 0x1 0x1 0x1F
	Var.IF (\debug_info!=0)
	(
		PRINT "Set PLL to external bypass via Control MMR."
		PRINT ""
	)
	// -- Disable PLL
	GOSUB Write_MMR_Field (((Var.VALUE(\Base_Address)+Var.VALUE(\address_offset))+(Var.VALUE(\PLL_index)*0x1000))+&__CONTROL) 0x0 0x1 0xF
	Var.IF (\debug_info!=0)
	(
		PRINT "Disabled PLL"
		PRINT ""
	)
	// -- Set DACEN (Enable Factional DAC)
	GOSUB Write_MMR_Field (((Var.VALUE(\Base_Address)+Var.VALUE(\address_offset))+(Var.VALUE(\PLL_index)*0x1000))+&__CONTROL) 0x1 0x1 0x0
	Var.IF (\debug_info!=0)
	(
		PRINT "Enabled noise-cancelling DAC."
		PRINT ""
	)
	// -- Set DMEN (Enable Delta-Sigma Modulator)
	GOSUB Write_MMR_Field (((Var.VALUE(\Base_Address)+Var.VALUE(\address_offset))+(Var.VALUE(\PLL_index)*0x1000))+&__CONTROL) 0x1 0x1 0x1
	Var.IF (\debug_info!=0)
	(
		PRINT "Enabled the Delta-Sigma modulator."
		PRINT ""
	)
	// -- Set the reference divider value
	GOSUB Write_MMR_Field (((Var.VALUE(\Base_Address)+Var.VALUE(\address_offset))+(Var.VALUE(\PLL_index)*0x1000))+&__OUTPUT_DIV_CONTROL) Var.VALUE(\frefdiv) 0x6 0x0
	Var.IF (\debug_info!=0)
	(
		PRINT "Programmed Reference clock pre-divider in output clock divider register."
		PRINT ""
	)
	// -- Set the Feedback divider value (12-bit)
	GOSUB Write_MMR_Field (((Var.VALUE(\Base_Address)+Var.VALUE(\address_offset))+(Var.VALUE(\PLL_index)*0x1000))+&__FREQ_CONTROL_0) Var.VALUE(\fbdiv) 0xC 0x0
	Var.IF (\debug_info!=0)
	(
		PRINT "Programmed the integer feedback divider value in Freq Control 0 register."
		PRINT ""
	)
	// -- Set the fractional multipler/divider value (24-bit)
	Var.IF ((\frac)>=0x0)
	(
		// -- Sometimes, the fractional divider value will be set to a negative number.
		GOSUB Write_MMR_Field (((Var.VALUE(\Base_Address)+Var.VALUE(\address_offset))+(Var.VALUE(\PLL_index)*0x1000))+&__FREQ_CONTROL_1) Var.VALUE(\frac) 0x18 0x0
	)
	ELSE
	(
		Var.IF (\debug_info!=0)
		(
			PRINT "Fractional Divider Value is -1, don't set the fractional divider."
			PRINT ""
		)
	)
	Var.IF (\debug_info!=0)
	(
		PRINT "Programmed the fractional feedback divider in Freq Control 0 register."
		PRINT ""
	)
	// -- Disable the 4-phase clock generator
	GOSUB Write_MMR_Field (((Var.VALUE(\Base_Address)+Var.VALUE(\address_offset))+(Var.VALUE(\PLL_index)*0x1000))+&__CONTROL) 0x0 0x1 0x5
	Var.IF (\debug_info!=0)
	(
		PRINT "Disabled the 4-phase clock generator (clk_4ph_en) in the control register."
		PRINT ""
	)
	// -- Set clk_postdiv_en (enables all the post-divider clocks, 4-phase, and synch. clocks)
	GOSUB Write_MMR_Field (((Var.VALUE(\Base_Address)+Var.VALUE(\address_offset))+(Var.VALUE(\PLL_index)*0x1000))+&__CONTROL) 0x1 0x1 0x4
	Var.IF (\debug_info!=0)
	(
		PRINT "Enabled the FOUT4PHASE clocks in the control register."
		PRINT ""
	)
	// -- Set POSTDIV1
	GOSUB Write_MMR_Field (((Var.VALUE(\Base_Address)+Var.VALUE(\address_offset))+(Var.VALUE(\PLL_index)*0x1000))+&__OUTPUT_DIV_CONTROL) Var.VALUE(\postdiv1) 0x3 0x10
	Var.IF (\debug_info!=0)
	(
		PRINT "Set the first post-divider value (POSTDIV1) in the output divider control register."
		PRINT ""
	)
	// -- Set POSTDIV2
	GOSUB Write_MMR_Field (((Var.VALUE(\Base_Address)+Var.VALUE(\address_offset))+(Var.VALUE(\PLL_index)*0x1000))+&__OUTPUT_DIV_CONTROL) Var.VALUE(\postdiv2) 0x3 0x18
	Var.IF (\debug_info!=0)
	(
		PRINT "Set the second post-divider value (POSTDIV2) in the output divider control register."
		PRINT ""
	)
	// -- Program HSDIVs
	// -- HSDIV clocking scheme will already be present.
	Var.IF (\Num_HSDIV!=0)
	(
		Var.Assign \i=0x0
		WHILE (Var.VALUE(\i)<Var.VALUE(\Num_HSDIV))
		(
			// -- Program the HSDIVs.
			Var.IF (\debug_info!=0)
			(
				AREA.Select
				PRINT "Programming HSDIV #" %DECIMAL Var.VALUE(\i) ""
				PRINT ""
			)
			// -- hsdiv_value is 0. Need to set it to the right value.
			Var.IF ((\i)==0x0)
			(
				Var.Assign \hsdiv_value=\div_val_0
			)
			ELSE
			(
				Var.IF ((\i)==0x1)
				(
					Var.Assign \hsdiv_value=\div_val_1
				)
				ELSE
				(
					Var.IF ((\i)==0x2)
					(
						Var.Assign \hsdiv_value=\div_val_2
					)
					ELSE
					(
						Var.IF ((\i)==0x3)
						(
							Var.Assign \hsdiv_value=\div_val_3
						)
						ELSE
						(
							Var.IF ((\i)==0x4)
							(
								Var.Assign \hsdiv_value=\div_val_4
							)
							ELSE
							(
								Var.IF ((\i)==0x5)
								(
									Var.Assign \hsdiv_value=\div_val_5
								)
								ELSE
								(
									Var.IF ((\i)==0x6)
									(
										Var.Assign \hsdiv_value=\div_val_6
									)
									ELSE
									(
										Var.IF ((\i)==0x7)
										(
											Var.Assign \hsdiv_value=\div_val_7
										)
										ELSE
										(
											Var.IF ((\i)==0x8)
											(
												Var.Assign \hsdiv_value=\div_val_8
											)
										)
									)
								)
							)
						)
					)
				)
			)
			Var.IF (((signed int)(\hsdiv_value))>=((signed int)0x0))
			(
				// -- If the HSDIV value is -1 then don't program the specific HSDIV.
				GOSUB Program_HSDIV Var.VALUE(\Base_Address) Var.VALUE(\address_offset) Var.VALUE(\PLL_index) Var.VALUE(\i) Var.VALUE(\hsdiv_value)
			)
			ELSE
			(
				Var.IF (\debug_info!=0)
				(
					AREA.Select
					PRINT "i: " %DECIMAL Var.VALUE(\i) ", HSDIV value is -1, don't program this one"
					PRINT ""
				)
			)
			Var.IF (\debug_info!=0)
			(
				AREA.Select
				PRINT "HSDIV #" %DECIMAL Var.VALUE(\i) " programmed."
				PRINT ""
			)
			Var.Assign \i=\i+1
		)
		// -- end of iterative loop over all existing HSDIVs
	)
	// -- Wait 1us
	Var.Assign \i=0x0
	Var.Assign \i=0x0
	WHILE (Var.VALUE(\i)<0x2710)
	(
		Var.Assign \i=\i+1
	)
	// -- If the PLL has a PLL controller connected to it, configure the PLL controller as well. 
	Var.IF (((\PLL_index)==0x0)||((\PLL_index)==0x1A))
	(
		Var.IF (\debug_info!=0)
		(
			Var.IF ((\Base_Address)==&__CSL_PLL0_CFG_BASE)
			(
				PRINT "Selected Main Domain PLL Controller."
				PRINT ""
			)
			ELSE
			(
				Var.IF ((\Base_Address)==&__CSL_MCU_PLL0_CFG_BASE)
				(
					PRINT "Selected MCU Domain PLL Conntroller."
					PRINT ""
				)
			)
		)
		Var.IF (((\PLL_index)==0x0)&&((\Base_Address)==&__CSL_PLL0_CFG_BASE))
		(
			GOSUB Program_PLLCTRL &__CSL_PLLCTRL0_BASE Var.VALUE(\address_offset)
		)
		ELSE
		(
			Var.IF (((\PLL_index)==0x0)&&((\Base_Address)==&__CSL_MCU_PLL0_CFG_BASE))
			(
				GOSUB Program_PLLCTRL &__CSL_WKUP_PLLCTRL0_BASE Var.VALUE(\address_offset)
			)
		)
	)
	// -- Set the PLL enable bit.
	GOSUB Write_MMR_Field (((Var.VALUE(\Base_Address)+Var.VALUE(\address_offset))+(Var.VALUE(\PLL_index)*0x1000))+&__CONTROL) 0x1 0x1 0xF
	Var.IF (\debug_info!=0)
	(
		PRINT "Set the enable bit in the control register."
		PRINT ""
	)
	// -- Wait for the lock by polling on the lock bit to be set to "1"
	GOSUB Read_MMR ((((Var.VALUE(\Base_Address)+Var.VALUE(\address_offset))+(Var.VALUE(\PLL_index)*0x1000))+&__STATUS))
	ENTRY &__V19
	WHILE (Var.VALUE(&__V19)==0)
	(
		GOSUB Read_MMR ((((Var.VALUE(\Base_Address)+Var.VALUE(\address_offset))+(Var.VALUE(\PLL_index)*0x1000))+&__STATUS))
		ENTRY &__V19
	)
	// -- TODO: Need to add a timeout period if the PLL doesn't lock
	Var.IF (\debug_info!=0)
	(
		PRINT "PLL is locked."
		PRINT ""
	)
	// -- Re-enable all HSDIVs
	// --   if(Num_HSDIV){
	// --         for(i = 0; i < Num_HSDIV; i++){
	// --             //Set the enable bit.
	// --             Write_MMR_Field((Base_Address + address_offset + (PLL_index * 0x1000) + (i*0x4 + 0x80)), 1, 1, 15);
	// --             if(debug_info){
	// --                 GEL_TextOut("Enabling HSDIV #%d\n",,,,, i);
	// --             }
	// --         }
	// --     }
	// -- De-assert the PLL_EXTBYPASS bit to engage the PLL and HSDIV outputs with the rest of the SoC.
	GOSUB Write_MMR_Field (((Var.VALUE(\Base_Address)+Var.VALUE(\address_offset))+(Var.VALUE(\PLL_index)*0x1000))+&__CONTROL) 0x0 0x1 0x1F
	Var.IF (\debug_info!=0)
	(
		PRINT "External bypass is disabled '0'. PLL and HSDIV clocks are engaging the rest of the SoC."
		PRINT ""
	)
	// -- DDR PLL Calibration starts here.
	Var.IF (((\PLL_Type)==&__FRAC_F_PLL)&&((\if_silicon)==0x1))
	(
		// -- Enable fast calibration
		GOSUB Write_MMR_Field (((Var.VALUE(\Base_Address)+Var.VALUE(\address_offset))+(Var.VALUE(\PLL_index)*0x1000))+&__CAL_CONTROL) 0x1 0x1 0x14
		GOSUB Write_MMR_Field (((Var.VALUE(\Base_Address)+Var.VALUE(\address_offset))+(Var.VALUE(\PLL_index)*0x1000))+&__CAL_CONTROL) 0x3 0x3 0x10
		GOSUB Write_MMR_Field (((Var.VALUE(\Base_Address)+Var.VALUE(\address_offset))+(Var.VALUE(\PLL_index)*0x1000))+&__CAL_CONTROL) 0x0 0xC 0x0
		GOSUB Write_MMR_Field (((Var.VALUE(\Base_Address)+Var.VALUE(\address_offset))+(Var.VALUE(\PLL_index)*0x1000))+&__CAL_CONTROL) 0x0 0x1 0xF
		GOSUB Write_MMR_Field (((Var.VALUE(\Base_Address)+Var.VALUE(\address_offset))+(Var.VALUE(\PLL_index)*0x1000))+&__CAL_CONTROL) 0x1 0x1 0x1F
		GOSUB Read_MMR_Field (((Var.VALUE(\Base_Address)+Var.VALUE(\address_offset))+(Var.VALUE(\PLL_index)*0x1000))+&__CAL_STATUS) 0x1 0x1F
		ENTRY &__V27
		WHILE (Var.VALUE(&__V27)==0)
		(
			GOSUB Read_MMR_Field (((Var.VALUE(\Base_Address)+Var.VALUE(\address_offset))+(Var.VALUE(\PLL_index)*0x1000))+&__CAL_STATUS) 0x1 0x1F
			ENTRY &__V27
		)
		// -- Set calibration to the maximum value (CALCNT = 7)
		GOSUB Write_MMR_Field (((Var.VALUE(\Base_Address)+Var.VALUE(\address_offset))+(Var.VALUE(\PLL_index)*0x1000))+&__CAL_CONTROL) 0x7 0x3 0x10
		Var.Assign \temp=0x0
		GOSUB Read_MMR (((Var.VALUE(\Base_Address)+Var.VALUE(\address_offset))+(Var.VALUE(\PLL_index)*0x1000))+&__CAL_CONTROL)
		ENTRY &__V30
		Var.Assign \temp=&__V30
		AREA.Select
		PRINT "PLL Calibration Control MMR value: " %HEX Var.VALUE(\temp) ""
		PRINT ""
		Var.Assign \temp=0x0
		GOSUB Read_MMR (((Var.VALUE(\Base_Address)+Var.VALUE(\address_offset))+(Var.VALUE(\PLL_index)*0x1000))+&__CAL_STATUS)
		ENTRY &__V31
		Var.Assign \temp=&__V31
		AREA.Select
		PRINT "PLL Calibration Status MMR value: " %HEX Var.VALUE(\temp) ""
		PRINT ""
	)
	RETURN
)
// -- *
// --  * \brief   Program a high-speed divider.
// --  *
// --  * \param   Base_Address        The base address of the PLL MMR instance. This
// --  *                              will change depending on which PLL and HSDIV
// --  *                              the user wants to program.
// --  *
// --  * \param   address_offset      Address offset for M3 RAT compatibility.
// --  *
// --  * \param   PLL_index           The PLL's index, ranges from 0-25. These are
// --  *                              defined in J7_PLL_MMR.GEL.
// --  *
// --  * \param   HSDIV_index         The index of the high speed divider. This is
// --  *                              used to calculate the address of the HSDIV
// --  *                              registers for programming. This parameter will
// --  *                              range from 0-9.
// --  *
// --  * \param   hsdiv_value         The value for the high speed divider. An
// --  *                              additional factor of +1 should be factored into
// --  *                              the raw value here.
// --  *
// --  * \return  none

Program_HSDIV:
(
	PRIVATE &__VF0 &__VF1 &__VF2 &__VF3 &__VF4
	ENTRY &__VF0 &__VF1 &__VF2 &__VF3 &__VF4
	
	&__VF0=&__VF0 // evaluation of passed expressions 
	&__VF1=&__VF1
	&__VF2=&__VF2
	&__VF3=&__VF3
	&__VF4=&__VF4
	
	Var.NEWLOCAL unsigned int \Base_Address=&__VF0
	Var.NEWLOCAL unsigned int \address_offset=&__VF1
	Var.NEWLOCAL unsigned int \PLL_index=&__VF2
	Var.NEWLOCAL unsigned int \HSDIV_index=&__VF3
	Var.NEWLOCAL unsigned int \hsdiv_value=&__VF4
	Var.NEWLOCAL int \debug_info
	Var.Assign \debug_info=&__DEBUG
	// -- To calculate the correct register, grab the HSDIV index (from 0 to 7, there will only ever be a max of 8 HSDIVs), and then multiply the offset by 0x4 and add 0x80 to get the right HSDIV offset.
	Var.IF (\debug_info!=0)
	(
		AREA.Select
		PRINT "hsdiv_value: " %DECIMAL Var.VALUE(\hsdiv_value) ""
		PRINT ""
	)
	// -- Set the reset value high.
	GOSUB Write_MMR_Field (((Var.VALUE(\Base_Address)+Var.VALUE(\address_offset))+(Var.VALUE(\PLL_index)*0x1000))+((Var.VALUE(\HSDIV_index)*0x4)+0x80)) 0x1 0x1 0x1F
	Var.IF (\debug_info!=0)
	(
		PRINT "HSDIV reset asserted"
		PRINT ""
	)
	// -- Set the divider value to the desired value. it's the bottom 7 bits. 
	GOSUB Write_MMR_Field (((Var.VALUE(\Base_Address)+Var.VALUE(\address_offset))+(Var.VALUE(\PLL_index)*0x1000))+((Var.VALUE(\HSDIV_index)*0x4)+0x80)) Var.VALUE(\hsdiv_value) 0x7 0x0
	Var.IF (\debug_info!=0)
	(
		PRINT "HSDIV divider value programmed."
		PRINT ""
	)
	// -- Check the enable bit HSDIV_CLKOUT_EN, bit 15 in the HSDIV control register. If it's set don't do anything. If it's cleared, set it.
	GOSUB Read_MMR_Field (((Var.VALUE(\Base_Address)+Var.VALUE(\address_offset))+(Var.VALUE(\PLL_index)*0x1000))+((Var.VALUE(\HSDIV_index)*0x4)+0x80)) 0x1 0xF
	ENTRY &__V34
	Var.IF !&__V34
	(
		// -- Set the enable bit.
		GOSUB Write_MMR_Field (((Var.VALUE(\Base_Address)+Var.VALUE(\address_offset))+(Var.VALUE(\PLL_index)*0x1000))+((Var.VALUE(\HSDIV_index)*0x4)+0x80)) 0x1 0x1 0xF
		Var.IF (\debug_info!=0)
		(
			PRINT "HSDIV clock output enabled. Reset automatically de-asserted."
			PRINT ""
		)
	)
	// -- Explicitly clear the reset.
	GOSUB Write_MMR_Field (((Var.VALUE(\Base_Address)+Var.VALUE(\address_offset))+(Var.VALUE(\PLL_index)*0x1000))+((Var.VALUE(\HSDIV_index)*0x4)+0x80)) 0x0 0x1 0x1F
	Var.IF (\debug_info!=0)
	(
		PRINT "HSDIV reset de-asserted"
		PRINT ""
	)
	// -- Reset will be released.
	RETURN
)
// -- *
// --  * \brief   Program a Spread-Spectrum Modulator. This is done to reduce EMI.
// --  *
// --  * \param   Downspread_Value        The type of spreading behavior that the 
// --  *                                  SSMOD will use. Currently, only
// --  *                                  center-spreading is supported.
// --  *
// --  * \param   Mod_In_Div              The divider for the input clock.
// --  *
// --  * \param   spread_depth            The amount that the frequency will vary
// --  *                                  from the center frequency.
// --  *
// --  * \param   address_offset          Address offset for M3 RAT compatibility.
// --  *
// --  * \return  none

Program_SSMOD:
(
	PRIVATE &__VF0 &__VF1 &__VF2 &__VF3
	ENTRY &__VF0 &__VF1 &__VF2 &__VF3
	
	&__VF0=&__VF0 // evaluation of passed expressions 
	&__VF1=&__VF1
	&__VF2=&__VF2
	&__VF3=&__VF3
	
	Var.NEWLOCAL unsigned int \Downspread_Value=&__VF0
	Var.NEWLOCAL unsigned int \Mod_In_Div=&__VF1
	Var.NEWLOCAL unsigned int \spread_depth=&__VF2
	Var.NEWLOCAL unsigned int \address_offset=&__VF3
	Var.NEWLOCAL int \debug_info
	Var.Assign \debug_info=&__DEBUG
	Var.NEWLOCAL unsigned int \Control_regVal
	Var.NEWLOCAL unsigned int \Frequency_regVal
	GOSUB Read_MMR (((Var.VALUE(\Base_Address)+Var.VALUE(\address_offset))+(Var.VALUE(\PLL_index)*0x1000))+&__SSMOD_CONTROL)
	ENTRY &__V37
	Var.Assign \Control_regVal=&__V37
	GOSUB Read_MMR (((Var.VALUE(\Base_Address)+Var.VALUE(\address_offset))+(Var.VALUE(\PLL_index)*0x1000))+&__SSMOD_SPREAD)
	ENTRY &__V38
	Var.Assign \Frequency_regVal=&__V38
	Var.Assign (\Control_regVal|=(0x1<<0xF))
	GOSUB Write_MMR (((Var.VALUE(\Base_Address)+Var.VALUE(\address_offset))+(Var.VALUE(\PLL_index)*0x1000))+Var.Value(\SSMOD_Control)) Var.VALUE(\Control_regVal)
	GOSUB Read_MMR (((Var.VALUE(\Base_Address)+Var.VALUE(\address_offset))+(Var.VALUE(\PLL_index)*0x1000))+&__SSMOD_CONTROL)
	ENTRY &__V40
	Var.Assign \Control_regVal=&__V40
	Var.IF (\debug_info!=0)
	(
		PRINT "Asserted SSMOD reset."
		PRINT ""
	)
	// -- Set Downspread
	Var.Assign (\Control_regVal|=(Var.VALUE(\Downspread_Value)<<0x4))
	Var.IF (\debug_info!=0)
	(
		PRINT "Set spread type."
		PRINT ""
	)
	// -- set modulator divisor
	Var.IF ((\Mod_In_Div)>=0x0)
	(
		// -- If this is -1 then don't set it.
		Var.Assign (\Frequency_regVal|=(Var.VALUE(\Mod_In_Div)<<0x10))
		Var.IF (\debug_info!=0)
		(
			PRINT "Set input divider for SSMOD clock."
			PRINT ""
		)
		ELSE
		(
			PRINT "Not setting input divider for SSMOD clock, value is -1"
			PRINT ""
		)
	)
	// -- Set SS spread value
	Var.Assign (\Frequency_regVal|=\spread_depth)
	Var.IF (\debug_info!=0)
	(
		PRINT "Set the spread width."
		PRINT ""
	)
	// -- Write to the SSMOD control + frequency control MMRs
	GOSUB Write_MMR (((Var.VALUE(\Base_Address)+Var.VALUE(\address_offset))+(Var.VALUE(\PLL_index)+0x1000))+&__SSMOD_CONTROL) Var.VALUE(\Control_regVal)
	GOSUB Write_MMR (((Var.VALUE(\Base_Address)+Var.VALUE(\address_offset))+(Var.VALUE(\PLL_index)+0x1000))+&__SSMOD_SPREAD) Var.VALUE(\Frequency_regVal)
	Var.IF (\debug_info!=0)
	(
		PRINT "Wrote control + frequency values to SSMOD control."
		PRINT ""
		PRINT "SSMOD will be enabled in the function Program_PLL()."
		PRINT ""
	)
	RETURN
)
// --  DO NOT USE THIS CODE, CURRENTLY UNSUPPORTED. 
// -- //Program the De-Skew PLL for the MLB.
// -- Program_Deskew_PLL(){
// --     //TODO: implement this eventually under Program_PLL()
// -- }
// -- *
// --  * \brief   Program a PLL Controller associated with a PLL.
// --  *
// --  * \param   Base_Address        The base address of the PLL Controller. This
// --  *                              will be different than the base addresses of
// --  *                              the PLL MMR instances used for programming the
// --  *                              PLLs.
// --  *
// --  * \param   address_offset      Address offset for M3 RAT compatibility.
// --  *
// --  * \return  none

Program_PLLCTRL:
(
	PRIVATE &__VF0 &__VF1
	ENTRY &__VF0 &__VF1
	
	&__VF0=&__VF0 // evaluation of passed expressions 
	&__VF1=&__VF1
	
	Var.NEWLOCAL unsigned int \Base_Address=&__VF0
	Var.NEWLOCAL unsigned int \address_offset=&__VF1
	Var.NEWLOCAL int \debug_info
	Var.Assign \debug_info=&__DEBUG
	Var.NEWLOCAL unsigned int \i
	Var.Assign \i=0x0
	Var.NEWLOCAL unsigned int \obsclk_div1
	Var.Assign \obsclk_div1=0x0
	Var.NEWLOCAL unsigned int \bp_divider
	Var.Assign \bp_divider=0x0
	Var.NEWLOCAL unsigned int \output_div1
	Var.Assign \output_div1=0x0
	Var.NEWLOCAL unsigned int \output_div2
	Var.Assign \output_div2=0x0
	Var.NEWLOCAL unsigned int \Control_regVal
	Var.Assign \Control_regVal=0x0
	Var.IF ((\Base_Address)==&__CSL_PLLCTRL0_BASE)
	(
		Var.Assign \obsclk_div1=&__MAIN_CTRL_OD1
		Var.Assign \bp_divider=&__MAIN_CTRL_BPDIV
		Var.Assign \output_div1=&__MAIN_CTRL_DIV1
	)
	ELSE
	(
		Var.IF ((\Base_Address)==&__CSL_WKUP_PLLCTRL0_BASE)
		(
			Var.Assign \obsclk_div1=&__MCU_CTRL_OD1
			Var.Assign \bp_divider=&__MCU_CTRL_BPDIV
			Var.Assign \output_div1=&__MCU_CTRL_DIV1
		)
		ELSE
		(
			PRINT "No PLL controller selected"
			PRINT ""
		)
	)
	// -- Check against all boundaries.
	Var.IF (((\obsclk_div1)<0x0)||((\obsclk_div1)>0xFF))
	(
		PRINT "ERROR: INVALID OBSCLK DIVIDER VALUE"
		PRINT ""
	)
	Var.IF (((\bp_divider)<0x0)||((\bp_divider)>0xFF))
	(
		PRINT "ERROR: INVALID BYPASS DIVIDER"
		PRINT ""
	)
	Var.IF (((\output_div1)<0x0)||((\output_div1)>0xFF))
	(
		PRINT "ERROR: INVALID PLL CONTROLLER OUTPUT DIVIDER 1 VALUE"
		PRINT ""
	)
	Var.IF (((\output_div2)<0x0)||((\output_div2)>0xFF))
	(
		PRINT "ERROR: INVALID PLL CONTROLLER OUTPUT DIVIDER 2 VALUE"
		PRINT ""
	)
	// -- Clear BIT 0 in PLL Controller control reigster.
	GOSUB Write_MMR_Field ((Var.VALUE(\Base_Address)+Var.VALUE(\address_offset))+&__PLL_CTRL_PLLCTL_OFFSET) 0x0 0x1 0x0
	Var.IF (\debug_info!=0)
	(
		PRINT "Cleared bit 0 in the PLL controller control register."
		PRINT ""
	)
	// -- Clear BIT 5 in PLL Controller control register.
	GOSUB Write_MMR_Field ((Var.VALUE(\Base_Address)+Var.VALUE(\address_offset))+&__PLL_CTRL_PLLCTL_OFFSET) 0x0 0x1 0x5
	Var.IF (\debug_info!=0)
	(
		PRINT "Cleared bit 5 in the PLL Controller control register."
		PRINT ""
		PRINT "PLL controller is now in bypass mode."
		PRINT ""
	)
	// -- Unlock the reset isolation register.
	// -- Write_MMR((Base_Address + address_offset + 0xE8), 0x5A69); //Write the key into the Reset Control register to unlock the Reset Isolation Register.
	// -- Write_MMR((Base_Address + address_offset + 0xF0), 0xFFFF); //Ensure all output clocks are warm reset-isolated. Only PORz resets should clear the clock settings.
	Var.IF (\debug_info!=0)
	(
		PRINT "Set reset isolation to prevent a warm reset from killing the PLL controller."
		PRINT ""
	)
	GOSUB Read_MMR ((Var.VALUE(\Base_Address)+Var.VALUE(\address_offset))+0x00)
	ENTRY &__V45
	Var.Assign \Control_regVal=&__V45
	GOSUB Write_MMR_Field ((Var.VALUE(\Base_Address)+Var.VALUE(\address_offset))+&__PLL_CTRL_BPDIV_OFFSET) Var.VALUE(\bp_divider) 0x8 0x0
	Var.IF (\debug_info!=0)
	(
		PRINT "Set PLLDIV1 (output_div1)."
		PRINT ""
	)
	// -- Set obsdivider- enable the clock (bit 15) and divide by 25 (b11000)
	GOSUB Write_MMR ((Var.VALUE(\Base_Address)+Var.VALUE(\address_offset))+&__PLL_CTRL_OSCDIV1_OFFSET) (Var.VALUE(\obsclk_div1)|(0x1<<0xF))
	GOSUB Write_MMR_Field ((Var.VALUE(\Base_Address)+Var.VALUE(\address_offset))+&__PLL_CTRL_PLLCMD_OFFSET) 0x0 0x1 0x0
	Var.IF (\debug_info!=0)
	(
		PRINT "Clear GOSET."
		PRINT ""
	)
	// -- Poll GOSTAT bit, the status bit in the PLL Controller Command Register
	GOSUB Read_MMR ((Var.VALUE(\Base_Address)+Var.VALUE(\address_offset))+&__PLL_CTRL_PLLSTAT_OFFSET)
	ENTRY &__V49
	V.WHILE ((&__V49&0x1)!=0)
	(
		GOSUB Read_MMR ((Var.VALUE(\Base_Address)+Var.VALUE(\address_offset))+&__PLL_CTRL_PLLSTAT_OFFSET)
		ENTRY &__V49
	)
	Var.IF (\debug_info!=0)
	(
		PRINT "GOSTAT is clear."
		PRINT ""
	)
	// -- Set PLLDIV1 (Divider 1, that feeds MAIN_SYSCLKOUT)
	GOSUB Write_MMR_Field ((Var.VALUE(\Base_Address)+Var.VALUE(\address_offset))+&__PLL_CTRL_PLLDIV1_OFFSET) Var.VALUE(\output_div1) 0x8 0x0
	Var.IF (\debug_info!=0)
	(
		PRINT "Set PLLDIV1 (output_div1)."
		PRINT ""
	)
	// -- Clear ALN1 on ALNCTRL (Align Controller Register)
	GOSUB Write_MMR_Field ((Var.VALUE(\Base_Address)+Var.VALUE(\address_offset))+&__PLL_CTRL_ALNCTL_OFFSET) 0x0 0x1 0x0
	Var.IF (\debug_info!=0)
	(
		PRINT "Set ALN1."
		PRINT ""
	)
	// -- Setup up OBSCLKs INSIDE the PLL Controller.
	// -- Set OCSEL to 0x12 (0b10010, point C, sysrefclk_po, right before it hits DIV1 (set to 1))
	GOSUB Write_MMR ((Var.VALUE(\Base_Address)+Var.VALUE(\address_offset))+0x104) 0x12
	Var.IF (\debug_info!=0)
	(
		PRINT "Set OCSEL to 0x12, point C on the observation clock input tree inside the PLL Controller."
		PRINT ""
	)
	// -- Set CLK control register for OBSCLK -- bit 0 (for AUXCLK) is cleared, bit 1 (for OBSCLK) is set
	GOSUB Write_MMR ((Var.VALUE(\Base_Address)+Var.VALUE(\address_offset))+0x148) 0x2
	Var.IF (\debug_info!=0)
	(
		PRINT "Set the clock control register to enable the OBSCLK output (bit 1)."
		PRINT ""
	)
	// -- Set GOSET to 1
	GOSUB Write_MMR_Field ((Var.VALUE(\Base_Address)+Var.VALUE(\address_offset))+&__PLL_CTRL_PLLCMD_OFFSET) 0x1 0x1 0x0
	Var.IF (\debug_info!=0)
	(
		PRINT "Set GOSET to 1."
		PRINT ""
	)
	// -- Poll on GOSTAT to be 0
	GOSUB Read_MMR ((Var.VALUE(\Base_Address)+Var.VALUE(\address_offset))+&__PLL_CTRL_PLLSTAT_OFFSET)
	ENTRY &__V55
	V.WHILE ((&__V55&0x1)!=0)
	(
		GOSUB Read_MMR ((Var.VALUE(\Base_Address)+Var.VALUE(\address_offset))+&__PLL_CTRL_PLLSTAT_OFFSET)
		ENTRY &__V55
	)
	Var.IF (\debug_info!=0)
	(
		PRINT "GOSTAT is clear."
		PRINT ""
	)
	// -- Write to PLL control enable bit (bit 0) in PLLCTRL control register. "1" to select refclk mode
	GOSUB Write_MMR_Field ((Var.VALUE(\Base_Address)+Var.VALUE(\address_offset))+&__PLL_CTRL_PLLCTL_OFFSET) 0x1 0x1 0x0
	Var.IF (\debug_info!=0)
	(
		PRINT "Enable PLL Controller (write to bit 0 in control register)."
		PRINT ""
	)
	// -- Clear GOSET
	GOSUB Write_MMR_Field ((Var.VALUE(\Base_Address)+Var.VALUE(\address_offset))+&__PLL_CTRL_PLLCMD_OFFSET) 0x0 0x1 0x0
	Var.IF (\debug_info!=0)
	(
		PRINT "Set GOSET to 0."
		PRINT ""
	)
	// -- Set PLLRST (bit 3) in PLLCTRL MMR to zero, turning off PLLCTRL reset
	GOSUB Write_MMR_Field ((Var.VALUE(\Base_Address)+Var.VALUE(\address_offset))+&__PLL_CTRL_PLLCTL_OFFSET) 0x0 0x1 0x3
	Var.IF (\debug_info!=0)
	(
		PRINT "PLLCTRL reset is cleared. PLLCTRL is free."
		PRINT ""
	)
	// -- PLL Controller is now free.
	RETURN
)
// -- *
// --  * \brief   Sets up the PLLs. This will call Program_PLL().
// --  *
// --  * \param   Base_Address        Base address for the PLL MMRs.
// --  *
// --  * \param   address_offset      Address offset for the M3 RAT.
// --  *
// --  * \param   PLL_index           Index of the PLL to program.
// --  *
// --  * \param   Clocking_Scheme     The clocking scheme to program the chip for.
// --  *
// --  * \return  none

Setup:
(
	PRIVATE &__VF0 &__VF1 &__VF2 &__VF3
	ENTRY &__VF0 &__VF1 &__VF2 &__VF3
	
	&__VF0=&__VF0 // evaluation of passed expressions 
	&__VF1=&__VF1
	&__VF2=&__VF2
	&__VF3=&__VF3
	
	Var.NEWLOCAL unsigned int \Base_Address=&__VF0
	Var.NEWLOCAL unsigned int \address_offset=&__VF1
	Var.NEWLOCAL unsigned int \PLL_index=&__VF2
	Var.NEWLOCAL unsigned int \Clocking_Scheme=&__VF3
	// -- Call the Program_PLL() function with the arguments passed in here.
	// -- Will cover PLLs + HSDIVs + PLLCTRLs + SSMOD
	GOSUB Program_PLL Var.VALUE(\Base_Address) Var.VALUE(\address_offset) Var.VALUE(\PLL_index) Var.VALUE(\Clocking_Scheme)
	RETURN
)
// -- *
// --  * \brief   Read off all the configuration MMRs for a PLL.
// --  *
// --  * \param   Base_Address        Base address for the PLL MMRs.
// --  *
// --  * \param   address_offset      Address offset for the M3 RAT.
// --  *
// --  * \param   PLL_index           Index of the PLL to program.
// --  *
// --  * \return  none

Get_PLL_Configuration:
(
	PRIVATE &__VF0 &__VF1 &__VF2
	ENTRY &__VF0 &__VF1 &__VF2
	
	&__VF0=&__VF0 // evaluation of passed expressions 
	&__VF1=&__VF1
	&__VF2=&__VF2
	
	Var.NEWLOCAL unsigned int \Base_Address=&__VF0
	Var.NEWLOCAL unsigned int \address_offset=&__VF1
	Var.NEWLOCAL unsigned int \PLL_index=&__VF2
	Var.NEWLOCAL int \debug_info
	Var.Assign \debug_info=&__DEBUG
	Var.NEWLOCAL unsigned int \fout
	Var.Assign \fout=0x0
	Var.NEWLOCAL unsigned int \fref
	Var.Assign \fref=0x0
	Var.NEWLOCAL unsigned int \frefdiv
	Var.Assign \frefdiv=0x0
	Var.NEWLOCAL unsigned int \fbdiv
	Var.Assign \fbdiv=0x0
	Var.NEWLOCAL signed int \frac
	Var.Assign \frac=0x0
	Var.NEWLOCAL unsigned int \refdiv
	Var.Assign \refdiv=0x0
	Var.NEWLOCAL unsigned int \postdiv1
	Var.Assign \postdiv1=0x0
	Var.NEWLOCAL unsigned int \postdiv2
	Var.Assign \postdiv2=0x0
	Var.NEWLOCAL signed int \div_val_0
	Var.Assign \div_val_0=0x0
	Var.NEWLOCAL signed int \div_val_1
	Var.Assign \div_val_1=0x0
	Var.NEWLOCAL signed int \div_val_2
	Var.Assign \div_val_2=0x0
	Var.NEWLOCAL signed int \div_val_3
	Var.Assign \div_val_3=0x0
	Var.NEWLOCAL signed int \div_val_4
	Var.Assign \div_val_4=0x0
	Var.NEWLOCAL signed int \div_val_5
	Var.Assign \div_val_5=0x0
	Var.NEWLOCAL signed int \div_val_6
	Var.Assign \div_val_6=0x0
	Var.NEWLOCAL signed int \div_val_7
	Var.Assign \div_val_7=0x0
	Var.NEWLOCAL signed int \div_val_8
	Var.Assign \div_val_8=0x0
	Var.NEWLOCAL unsigned int \ssmod_spreadval
	Var.Assign \ssmod_spreadval=0x0
	Var.NEWLOCAL unsigned int \ssmod_input_div
	Var.Assign \ssmod_input_div=0x0
	Var.NEWLOCAL unsigned int \ssmod_spreadtype
	Var.Assign \ssmod_spreadtype=0x0
	Var.NEWLOCAL unsigned int \PLL_config_info
	Var.NEWLOCAL unsigned int \HSDIV_Presence
	Var.Assign \HSDIV_Presence=0x0
	Var.NEWLOCAL unsigned int \Num_HSDIV
	Var.Assign \Num_HSDIV=0x0
	Var.NEWLOCAL unsigned int \hsdiv_value
	Var.Assign \hsdiv_value=0x0
	Var.NEWLOCAL unsigned int \SSM_Type
	Var.Assign \SSM_Type=0x0
	Var.NEWLOCAL unsigned int \SSM_Wavetable_Presence
	Var.Assign \SSM_Wavetable_Presence=0x0
	Var.NEWLOCAL unsigned int \PLL_Type
	Var.Assign \PLL_Type=0x0
	Var.NEWLOCAL unsigned int \Is_PLL_Locked
	Var.NEWLOCAL unsigned int \i
	Var.Assign \i=0x0
	Var.NEWLOCAL unsigned int \temp
	Var.Assign \temp=0x0
	AREA.Select
	PRINT "Base address: " %HEX Var.VALUE(\Base_Address) ""
	PRINT ""
	AREA.Select
	PRINT "PLL index: " %HEX Var.VALUE(\PLL_index) ""
	PRINT ""
	AREA.Select
	PRINT "PLL index register base: " %HEX Var.VALUE((\PLL_index*0x1000)) ""
	PRINT ""
	AREA.Select
	PRINT "Register: " %HEX Var.VALUE(&__CONTROL) ""
	PRINT ""
	GOSUB Read_MMR (((Var.VALUE(\Base_Address)+Var.VALUE(\address_offset))+(Var.VALUE(\PLL_index)*0x1000))+&__PLL_CONFIG)
	ENTRY &__V60
	Var.Assign \PLL_config_info=&__V60
	Var.Assign \HSDIV_Presence=((\PLL_config_info&0xFFFF0000)>>0x10)
	Var.Assign \SSM_Type=((\PLL_config_info&0x00001800)>>0xB)
	Var.Assign \SSM_Wavetable_Presence=(\PLL_config_info&(0x00000100>>0x8))
	Var.Assign \PLL_Type=(\PLL_config_info&0x00000003)
	GOSUB Read_MMR_Field (((Var.VALUE(\Base_Address)+Var.VALUE(\address_offset))+(Var.VALUE(\PLL_index)*0x1000))+&__OUTPUT_DIV_CONTROL) 0x6 0x0
	ENTRY &__V61
	Var.Assign \frefdiv=&__V61
	GOSUB Read_MMR (((Var.VALUE(\Base_Address)+Var.VALUE(\address_offset))+(Var.VALUE(\PLL_index)*0x1000))+&__FREQ_CONTROL_0)
	ENTRY &__V62
	Var.Assign \fbdiv=&__V62
	GOSUB Read_MMR (((Var.VALUE(\Base_Address)+Var.VALUE(\address_offset))+(Var.VALUE(\PLL_index)*0x1000))+&__FREQ_CONTROL_1)
	ENTRY &__V63
	Var.Assign \frac=&__V63
	GOSUB Read_MMR_Field (((Var.VALUE(\Base_Address)+Var.VALUE(\address_offset))+(Var.VALUE(\PLL_index)*0x1000))+&__OUTPUT_DIV_CONTROL) 0x3 0x10
	ENTRY &__V64
	Var.Assign \postdiv1=&__V64
	GOSUB Read_MMR_Field ((Var.VALUE(\Base_Address)+Var.VALUE(\address_offset))+((Var.VALUE(\PLL_index)*0x1000)+&__OUTPUT_DIV_CONTROL)) 0x3 0x18
	ENTRY &__V65
	Var.Assign \postdiv2=&__V65
	AREA.Select
	PRINT "Reference Divider is:     " %DECIMAL Var.VALUE(\frefdiv) ""
	PRINT ""
	AREA.Select
	PRINT "Feedback Divider is:      " %DECIMAL Var.VALUE(\fbdiv) ""
	PRINT ""
	AREA.Select
	PRINT "Fractional Multiplier is: " %DECIMAL Var.VALUE(\frac) ""
	PRINT ""
	AREA.Select
	PRINT "Output Divider #1 is:     " %DECIMAL Var.VALUE(\postdiv1) ""
	PRINT ""
	AREA.Select
	PRINT "Output Divider #2 is:     " %DECIMAL Var.VALUE(\postdiv2) ""
	PRINT ""
	Var.Assign \temp=\HSDIV_Presence
	WHILE (Var.VALUE(\temp)!=0x0)
	(
		Var.Assign \temp=(\temp>>0x1)
		Var.Assign \Num_HSDIV=\Num_HSDIV+1
	)
	// -- Print out number of HSDIVs
	AREA.Select
	PRINT "Number of hsidvs: " %DECIMAL Var.VALUE(\Num_HSDIV) ""
	PRINT ""
	Var.IF (\Num_HSDIV!=0)
	(
		Var.Assign \i=0x0
		WHILE (Var.VALUE(\i)<Var.VALUE(\Num_HSDIV))
		(
			GOSUB Read_MMR (((Var.VALUE(\Base_Address)+Var.VALUE(\address_offset))+(Var.VALUE(\PLL_index)*0x1000))+(0x80+(0x4*(Var.VALUE(\i)))))
			ENTRY &__V67
			Var.Assign \temp=&__V67
			Var.Assign \temp=(\temp&0x7F)
			AREA.Select
			PRINT "HSDIV #" %DECIMAL Var.VALUE(\i) "'s divider value is: " %DECIMAL Var.VALUE((\temp+0x1)) ""
			PRINT ""
			Var.Assign \i=\i+1
		)
	)
	PRINT "Parsed PLL configuration information."
	PRINT ""
	RETURN
)
// -- ***************************************************************************
// --  Global helper functions 
// -- ***************************************************************************
// -- *
// --  * \brief   Unlock the partition for a specific PLL.
// --  *
// --  * \param   Base_Address        The base address of the PLL MMR instance.
// --  *
// --  * \param   PLL_index           The index of the PLL (one PLL per partition).
// --  *
// --  * \return  none

Unlock_PLL_MMR:
(
	PRIVATE &__VF0 &__VF1 &__VF2
	ENTRY &__VF0 &__VF1 &__VF2
	
	&__VF0=&__VF0 // evaluation of passed expressions 
	&__VF1=&__VF1
	&__VF2=&__VF2
	
	Var.NEWLOCAL unsigned int \Base_Address=&__VF0
	Var.NEWLOCAL unsigned int \address_offset=&__VF1
	Var.NEWLOCAL unsigned int \PLL_index=&__VF2
	Var.NEWLOCAL unsigned int \first_mmr
	Var.NEWLOCAL unsigned int \second_mmr
	// -- Calculate the first lock register address based on the PLL index.
	Var.Assign \first_mmr=(((0x10+(\PLL_index*0x1000))+\Base_Address)+\address_offset)
	Var.Assign \second_mmr=(((0x14+(\PLL_index*0x1000))+\Base_Address)+\address_offset)
	GOSUB MMR_Unlock_One Var.VALUE(\first_mmr) Var.VALUE(\second_mmr)
	ENTRY &__V68
	RETURN
)
// -- *
// --  * \brief   Lock the partition for a specific PLL.
// --  *
// --  * \param   Base_Address        The base address of the PLL MMR instance.
// --  *
// --  * \param   PLL_index           The index of the PLL (one PLL per partition).
// --  *
// --  * \return  none

Lock_PLL_MMR:
(
	PRIVATE &__VF0 &__VF1 &__VF2
	ENTRY &__VF0 &__VF1 &__VF2
	
	&__VF0=&__VF0 // evaluation of passed expressions 
	&__VF1=&__VF1
	&__VF2=&__VF2
	
	Var.NEWLOCAL unsigned int \Base_Address=&__VF0
	Var.NEWLOCAL unsigned int \address_offset=&__VF1
	Var.NEWLOCAL unsigned int \PLL_index=&__VF2
	Var.NEWLOCAL unsigned int \first_mmr
	Var.NEWLOCAL unsigned int \second_mmr
	// -- Calculate the first lock register address based on the PLL index.
	Var.Assign \first_mmr=(((0x10+(\PLL_index*0x1000))+\Base_Address)+\address_offset)
	Var.Assign \second_mmr=(((0x14+(\PLL_index*0x1000))+\Base_Address)+\address_offset)
	GOSUB MMR_Lock_One Var.VALUE(\first_mmr) Var.VALUE(\second_mmr)
	ENTRY &__V69
	RETURN
)
// --  * Note: the following 2 functions are re-used from the J7 AVV MMR library.
// --  * Those files can be found in ${K3_AVV_REPO}/framework/mmr/src/j7es_mmr.c
// --  * and ${K3_AVV_REPO}/framework/mmr/include/j7es_mmr.h.
// -- *
// --  * \brief   Write the unlocking keys to the locking registers.
// --  *
// --  * \param   kick0               The first lock register.
// --  *
// --  * \param   kick1               The second lock register.
// --  *
// --  * \return  status              This should return 0 on a successful unlock.

MMR_Unlock_One:
(
	PRIVATE &__VF0 &__VF1
	ENTRY &__VF0 &__VF1
	
	&__VF0=&__VF0 // evaluation of passed expressions 
	&__VF1=&__VF1
	
	Var.NEWLOCAL unsigned int * \kick0=&__VF0
	Var.NEWLOCAL unsigned int * \kick1=&__VF1
	Var.NEWLOCAL unsigned int \status
	Var.Assign \status=0x1
	// --  if either of the kick lock registers are locked
	IF (((~(Data.Long(D:Var.VALUE(\kick0))&0x1))|(~(Data.Long(D:Var.VALUE(\kick1))&0x1)))!=0)
	(
		// --  unlock the partition by writing the unlock values to the kick lock registers
		Data.Set D:(Var.VALUE(\kick0)) %Long Var.VALUE(&__KICK0_UNLOCK)
		Data.Set D:(Var.VALUE(\kick1)) %Long Var.VALUE(&__KICK1_UNLOCK)
	)
	// --  check to see if either of the kick registers are unlocked.
	IF ((Data.Long(D:Var.VALUE(\kick0))&0x1)==0)
	(
		Var.Assign \status=0x0
	)
	// --  return the status to the calling program
	&__FUNCTION_RETURN_VALUE=Var.VALUE(\status)
	RETURN &__FUNCTION_RETURN_VALUE
	RETURN
)
// -- *
// --  * \brief   Write some lock keys to the locking registers.
// --  *
// --  * \param   kick0               The first lock register.
// --  *
// --  * \param   kick1               The second lock register.
// --  *
// --  * \return  status              This should return 0 on a successful lock.

MMR_Lock_One:
(
	PRIVATE &__VF0 &__VF1
	ENTRY &__VF0 &__VF1
	
	&__VF0=&__VF0 // evaluation of passed expressions 
	&__VF1=&__VF1
	
	Var.NEWLOCAL unsigned int * \kick0=&__VF0
	Var.NEWLOCAL unsigned int * \kick1=&__VF1
	Var.NEWLOCAL unsigned int \status
	Var.Assign \status=0x1
	// --  check to see if either of the kick registers are unlocked.
	IF ((Data.Long(D:Var.VALUE(\kick0))&0x1)!=0)
	(
		// --  write the kick lock value to the kick lock registers to lock the partition
		Data.Set D:(Var.VALUE(\kick0)) %Long Var.VALUE(&__KICK_LOCK)
		Data.Set D:(Var.VALUE(\kick1)) %Long Var.VALUE(&__KICK_LOCK)
	)
	// --  check to see if either of the kick registers are still unlocked.
	IF ((Data.Long(D:Var.VALUE(\kick0))&0x1)!=0)
	(
		Var.Assign \status=0x0
	)
	// --  return success or failure
	&__FUNCTION_RETURN_VALUE=Var.VALUE(\status)
	RETURN &__FUNCTION_RETURN_VALUE
	RETURN
)
// --  END OF FILE 
// --  ************************************************************************* 
// --  Global Helper Functions 
// --  ************************************************************************* 
// --  Read from an MMR. 

Read_MMR:
(
	PRIVATE &__VF0
	ENTRY &__VF0
	
	&__VF0=&__VF0 // evaluation of passed expression 
	
	Var.NEWLOCAL unsigned int \mmr_address=&__VF0
	Var.NEWLOCAL unsigned int * \p_mmr
	Var.Assign \p_mmr=((unsigned int *)\mmr_address)
	&__FUNCTION_RETURN_VALUE=Var.Value(*\p_mmr)
	RETURN &__FUNCTION_RETURN_VALUE
	RETURN
)
// --  Write to an MMR. 

Write_MMR:
(
	PRIVATE &__VF0 &__VF1
	ENTRY &__VF0 &__VF1
	
	&__VF0=&__VF0 // evaluation of passed expressions 
	&__VF1=&__VF1
	
	Var.NEWLOCAL unsigned int \mmr_address=&__VF0
	Var.NEWLOCAL unsigned int \mmr_value=&__VF1
	Var.NEWLOCAL unsigned int * \p_mmr
	Var.Assign \p_mmr=((unsigned int *)\mmr_address)
	Data.Set D:(Var.VALUE(\p_mmr)) %Long Var.VALUE(\mmr_value)
	RETURN
)
// --  Write to a specific field in an MMR. 

Write_MMR_Field:
(
	PRIVATE &__VF0 &__VF1 &__VF2 &__VF3
	ENTRY &__VF0 &__VF1 &__VF2 &__VF3
	
	&__VF0=&__VF0 // evaluation of passed expressions 
	&__VF1=&__VF1
	&__VF2=&__VF2
	&__VF3=&__VF3
	
	Var.NEWLOCAL unsigned int \mmr_address=&__VF0
	Var.NEWLOCAL unsigned int \field_value=&__VF1
	Var.NEWLOCAL unsigned int \width=&__VF2
	Var.NEWLOCAL unsigned int \leftshift=&__VF3
	Var.NEWLOCAL unsigned int * \p_mmr
	Var.NEWLOCAL unsigned int \mask
	Var.Assign \p_mmr=((unsigned int *)\mmr_address)
	Var.Assign \mask=(((0x1<<(\width))-0x1)<<\leftshift)
	Var.Assign \mask=~\mask
	Var.Assign (*\p_mmr&=\mask)
	Var.Assign (*\p_mmr|=(\field_value<<\leftshift))
	RETURN
)
// --  Read from a specific field in an MMR. 

Read_MMR_Field:
(
	PRIVATE &__VF0 &__VF1 &__VF2
	ENTRY &__VF0 &__VF1 &__VF2
	
	&__VF0=&__VF0 // evaluation of passed expressions 
	&__VF1=&__VF1
	&__VF2=&__VF2
	
	Var.NEWLOCAL unsigned int \mmr_address=&__VF0
	Var.NEWLOCAL unsigned int \width=&__VF1
	Var.NEWLOCAL unsigned int \leftshift=&__VF2
	Var.NEWLOCAL unsigned int * \p_mmr
	Var.NEWLOCAL unsigned int \mask
	Var.NEWLOCAL unsigned int \retval
	Var.Assign \p_mmr=((unsigned int *)\mmr_address)
	Var.Assign \mask=(((0x1<<(\width))-0x1)<<\leftshift)
	Var.Assign \retval=((\Data_Long(\p_mmr)&\mask)>>\leftshift)
	&__FUNCTION_RETURN_VALUE=Var.VALUE(\retval)
	RETURN &__FUNCTION_RETURN_VALUE
	RETURN
)

__GeL_MeNu_CrEaTe:
(
	MENU.ReProgram
	(
		ADD
		MENU
		(
			POPUP "GEL"
			(
				POPUP "PLL Configuration/Version"
				(
					MENUITEM "Check_Revision_History" 
					(
						DO "&path_J7AEP_PLL_MMR_PARAMS_PLL_cmm" Check_Revision_History
					)
				)
				POPUP "PLL Configuration/Standard Configuration"
				(
					MENUITEM "Set_All_PLL" 
					(
						DO "&path_J7AEP_PLL_MMR_PARAMS_PLL_cmm" Set_All_PLL
					)
				)
				POPUP "PLL Configuration/DDR PLL Configuration"
				(
					MENUITEM "Set_DDR0_PLL_EXTBYPASS" 
					(
						DO "&path_J7AEP_PLL_MMR_PARAMS_PLL_cmm" Set_DDR0_PLL_EXTBYPASS
					)
					MENUITEM "Set_DDR1_PLL_EXTBYPASS" 
					(
						DO "&path_J7AEP_PLL_MMR_PARAMS_PLL_cmm" Set_DDR1_PLL_EXTBYPASS
					)
					MENUITEM "Set_DDR0_PLL_533MHz" 
					(
						DO "&path_J7AEP_PLL_MMR_PARAMS_PLL_cmm" Set_DDR0_PLL_533MHz
					)
					MENUITEM "Set_DDR1_PLL_533MHz" 
					(
						DO "&path_J7AEP_PLL_MMR_PARAMS_PLL_cmm" Set_DDR1_PLL_533MHz
					)
					MENUITEM "Set_DDR0_PLL_1066MHz" 
					(
						DO "&path_J7AEP_PLL_MMR_PARAMS_PLL_cmm" Set_DDR0_PLL_1066MHz
					)
					MENUITEM "Set_DDR1_PLL_1066MHz" 
					(
						DO "&path_J7AEP_PLL_MMR_PARAMS_PLL_cmm" Set_DDR1_PLL_1066MHz
					)
				)
				POPUP "PLL Configuration/DSS PLL Configurations/eDP Mode 1"
				(
					MENUITEM "PLL16_74MHz" 
					(
						DO "&path_J7AEP_PLL_MMR_PARAMS_PLL_cmm" PLL16_74MHz
					)
					MENUITEM "PLL16_148MHz" 
					(
						DO "&path_J7AEP_PLL_MMR_PARAMS_PLL_cmm" PLL16_148MHz
					)
					MENUITEM "PLL16_234MHz" 
					(
						DO "&path_J7AEP_PLL_MMR_PARAMS_PLL_cmm" PLL16_234MHz
					)
					MENUITEM "PLL16_241MHz" 
					(
						DO "&path_J7AEP_PLL_MMR_PARAMS_PLL_cmm" PLL16_241MHz
					)
					MENUITEM "PLL16_522MHz" 
					(
						DO "&path_J7AEP_PLL_MMR_PARAMS_PLL_cmm" PLL16_522MHz
					)
					MENUITEM "PLL16_533MHz" 
					(
						DO "&path_J7AEP_PLL_MMR_PARAMS_PLL_cmm" PLL16_533MHz
					)
				)
				POPUP "PLL Configuration/DSS PLL Configurations/eDP Mode 2"
				(
					MENUITEM "PLL17_74MHz" 
					(
						DO "&path_J7AEP_PLL_MMR_PARAMS_PLL_cmm" PLL17_74MHz
					)
					MENUITEM "PLL17_148MHz" 
					(
						DO "&path_J7AEP_PLL_MMR_PARAMS_PLL_cmm" PLL17_148MHz
					)
					MENUITEM "PLL17_234MHz" 
					(
						DO "&path_J7AEP_PLL_MMR_PARAMS_PLL_cmm" PLL17_234MHz
					)
					MENUITEM "PLL17_241MHz" 
					(
						DO "&path_J7AEP_PLL_MMR_PARAMS_PLL_cmm" PLL17_241MHz
					)
					MENUITEM "PLL17_522MHz" 
					(
						DO "&path_J7AEP_PLL_MMR_PARAMS_PLL_cmm" PLL17_522MHz
					)
					MENUITEM "PLL17_533MHz" 
					(
						DO "&path_J7AEP_PLL_MMR_PARAMS_PLL_cmm" PLL17_533MHz
					)
				)
				POPUP "PLL Configuration/DSS PLL Configurations/DSS DPI0"
				(
					MENUITEM "PLL19_74MHz" 
					(
						DO "&path_J7AEP_PLL_MMR_PARAMS_PLL_cmm" PLL19_74MHz
					)
					MENUITEM "PLL19_148MHz" 
					(
						DO "&path_J7AEP_PLL_MMR_PARAMS_PLL_cmm" PLL19_148MHz
					)
				)
				POPUP "PLL Configuration/Video and Vision PLL Configurations"
				(
					MENUITEM "PLL5_2400MHz" 
					(
						DO "&path_J7AEP_PLL_MMR_PARAMS_PLL_cmm" PLL5_2400MHz
					)
					MENUITEM "PLL25_480MHz_720MHz" 
					(
						DO "&path_J7AEP_PLL_MMR_PARAMS_PLL_cmm" PLL25_480MHz_720MHz
					)
					MENUITEM "PLL25_520MHz_650MHz" 
					(
						DO "&path_J7AEP_PLL_MMR_PARAMS_PLL_cmm" PLL25_520MHz_650MHz
					)
				)
			)
		)
	)
	RETURN
)
// -- *
// --  * \brief   Display revision history and contact information.
// --  *
// --  * \param   none
// --  *
// --  * \return  none

Check_Revision_History:
(
	// --  Note: Production versions should remove identifying information from
	// --      * this function. 
	PRINT "Version 0.1."
	PRINT ""
	RETURN
	
)
// -- *
// --  * \brief  Set all PLLs on 
// --  *
// --  * \param   none
// --  *
// --  * \return  none

Set_All_PLL:
(
	Var.NEWLOCAL int \debug_info
	Var.Assign \debug_info=&__DEBUG
	Var.Assign \address_offset=0x80000000
	Var.IF (\debug_info!=0)
	(
		PRINT "Debugging enabled"
		PRINT ""
		PRINT "GEL_Trace " 0x1
		ENTRY &__V70
	)
	ELSE
	(
		PRINT "Debugging disabled."
		PRINT ""
		PRINT "GEL_Trace " 0x0
		ENTRY &__V71
	)
	// -- Turn on LPSC_WKUPMCU2MAIN.
	DO "&path_J7AEP_PSC_cmm" Turn_On_LPSC_WKUPMCU2MAIN
	ENTRY &__V72
	PRINT "Programming all PLLs."
	PRINT ""
	PRINT "Programming Main PLL 0 (Main PLL)"
	PRINT ""
	GOSUB Setup &__CSL_PLL0_CFG_BASE Var.VALUE(\address_offset) &__MAIN_PLL_INDEX &__OFC1
	PRINT "Main PLL 0 (Main PLL) Set."
	PRINT ""
	PRINT "Programming Main PLL 1 (Peripheral 0 PLL)"
	PRINT ""
	GOSUB Setup &__CSL_PLL0_CFG_BASE Var.VALUE(\address_offset) &__PER0_PLL_INDEX &__OFC1
	PRINT "Main PLL 1 (Peripheral 0 PLL) Set."
	PRINT ""
	PRINT "Programming Main PLL 2 (Peripheral 1 PLL)"
	PRINT ""
	GOSUB Setup &__CSL_PLL0_CFG_BASE Var.VALUE(\address_offset) &__PER1_PLL_INDEX &__OFC1
	PRINT "Main PLL 2 (Peripheral 1 PLL) Set."
	PRINT ""
	PRINT "Programming Main PLL 3 (CPSW5X PLL)"
	PRINT ""
	GOSUB Setup &__CSL_PLL0_CFG_BASE Var.VALUE(\address_offset) &__CPSW5X_PLL_INDEX &__OFC1
	PRINT "Main PLL 3 (CPSW5X PLL) Set."
	PRINT ""
	PRINT "Programming Main PLL 4 (Audio 0 PLL)"
	PRINT ""
	GOSUB Setup &__CSL_PLL0_CFG_BASE Var.VALUE(\address_offset) &__AUDIO0_PLL_INDEX &__OFC1
	PRINT "Main PLL 4 (Audio 0 PLL) Set."
	PRINT ""
	PRINT "Programming Main PLL 5 (Video PLL)"
	PRINT ""
	GOSUB Setup &__CSL_PLL0_CFG_BASE Var.VALUE(\address_offset) &__VIDEO_PLL_INDEX &__OFC1
	PRINT "Main PLL 5 (Video PLL) Set."
	PRINT ""
	PRINT "Programming Main PLL 7 (MSMC PLL)"
	PRINT ""
	GOSUB Setup &__CSL_PLL0_CFG_BASE Var.VALUE(\address_offset) &__MSMC_PLL_INDEX &__OFC1
	PRINT "Main PLL 7 (MSMC PLL) Set."
	PRINT ""
	PRINT "Programming Main PLL 8 (ARM0 PLL)"
	PRINT ""
	GOSUB Setup &__CSL_PLL0_CFG_BASE Var.VALUE(\address_offset) &__ARM0_PLL_INDEX &__OFC1
	PRINT "Main PLL 8 (ARM0 PLL) Set."
	PRINT ""
	PRINT "Programming Main PLL 12 (DDR0 PLL)"
	PRINT ""
	GOSUB Setup &__CSL_PLL0_CFG_BASE Var.VALUE(\address_offset) &__DDR0_PLL_INDEX &__OFC1
	PRINT "Main PLL 12 (DDR0 PLL) Set."
	PRINT ""
	PRINT "Programming Main PLL 14 (Main Domain Pulsar) PLL)"
	PRINT ""
	GOSUB Setup &__CSL_PLL0_CFG_BASE Var.VALUE(\address_offset) &__MAIN_R5F_PLL_INDEX &__OFC1
	PRINT "Main PLL 14 (Main Domain Pulsar PLL) Set."
	PRINT ""
	PRINT "Programming Main PLL 16 (DSS0 PLL)"
	PRINT ""
	GOSUB Setup &__CSL_PLL0_CFG_BASE Var.VALUE(\address_offset) &__DSS0_PLL_INDEX &__OFC1
	PRINT "Main PLL 16 (DSS0 PLL) Set."
	PRINT ""
	PRINT "Programming Main PLL 17 (DSS1 PLL)"
	PRINT ""
	GOSUB Setup &__CSL_PLL0_CFG_BASE Var.VALUE(\address_offset) &__DSS1_PLL_INDEX &__OFC1
	PRINT "Main PLL 17 (DSS1 PLL) Set."
	PRINT ""
	PRINT "Programming Main PLL 19 (DSS3 PLL)"
	PRINT ""
	GOSUB Setup &__CSL_PLL0_CFG_BASE Var.VALUE(\address_offset) &__DSS3_PLL_INDEX &__OFC1
	PRINT "Main PLL 19 (DSS3 PLL) Set."
	PRINT ""
	PRINT "Programming Main PLL 25 (Vision PLL)"
	PRINT ""
	GOSUB Setup &__CSL_PLL0_CFG_BASE Var.VALUE(\address_offset) &__VISION_PLL_INDEX &__DMPAC_520
	PRINT "Main PLL 25 (Vision PLL) Set."
	PRINT ""
	PRINT "Programming Main PLL 26 (DDR1 PLL)"
	PRINT ""
	GOSUB Setup &__CSL_PLL0_CFG_BASE Var.VALUE(\address_offset) &__DDR1_PLL_INDEX &__OFC1
	PRINT "Main PLL 26 (DDR1 PLL) Set."
	PRINT ""
	Var.Assign \address_offset=0x20000000
	PRINT "Programming MCU PLL 0 (MCU PLL)"
	PRINT ""
	GOSUB Setup &__CSL_MCU_PLL0_CFG_BASE Var.VALUE(\address_offset) &__MCU_R5F_PLL_INDEX &__OFC1
	PRINT "MCU PLL 0 (MCU PLL) Set."
	PRINT ""
	PRINT "Programming MCU PLL 1 (MCU Peripheral PLL)"
	PRINT ""
	GOSUB Setup &__CSL_MCU_PLL0_CFG_BASE Var.VALUE(\address_offset) &__MCU_PER1_PLL_INDEX &__OFC1
	PRINT "MCU PLL 1 (MCU PLL) Set."
	PRINT ""
	PRINT "Programming MCU PLL 2 (MCU CPSW PLL)"
	PRINT ""
	GOSUB Setup &__CSL_MCU_PLL0_CFG_BASE Var.VALUE(\address_offset) &__MCU_PER2_PLL_INDEX &__OFC1
	PRINT "MCU PLL 2 (MCU PLL) Set."
	PRINT ""
	PRINT "All PLLs programmed."
	PRINT ""
	&__FUNCTION_RETURN_VALUE=Var.VALUE(0x0)
	RETURN &__FUNCTION_RETURN_VALUE
	RETURN
	
)

Set_DDR0_PLL_EXTBYPASS:
(
	Var.NEWLOCAL unsigned int \address_offset
	Var.Assign \address_offset=0x80000000
	Var.NEWLOCAL unsigned int \Base_Address
	Var.Assign \Base_Address=&__CSL_PLL0_CFG_BASE
	Var.NEWLOCAL unsigned int \PLL_index
	Var.Assign \PLL_index=&__DDR0_PLL_INDEX
	Var.NEWLOCAL unsigned int \debug_info
	Var.Assign \debug_info=&__DEBUG
	PRINT "Setting DDR0 PLL to 20MHz/19.2MHz on silicon (bypass)"
	PRINT ""
	GOSUB Write_MMR_Field (((Var.VALUE(\Base_Address)+Var.VALUE(\address_offset))+(Var.VALUE(\PLL_index)*0x1000))+&__CONTROL) 0x1 0x1 0x1F
	Var.IF (\debug_info!=0)
	(
		PRINT "Set DDR0 PLL to external bypass via Control MMR."
		PRINT ""
	)
	PRINT "Set DDR0 PLL to external bypass (20MHz/19.2MHz on SVB/EVM)."
	PRINT ""
	RETURN
	
)

Set_DDR1_PLL_EXTBYPASS:
(
	Var.NEWLOCAL unsigned int \address_offset
	Var.Assign \address_offset=0x80000000
	Var.NEWLOCAL unsigned int \Base_Address
	Var.Assign \Base_Address=&__CSL_PLL0_CFG_BASE
	Var.NEWLOCAL unsigned int \PLL_index
	Var.Assign \PLL_index=&__DDR1_PLL_INDEX
	Var.NEWLOCAL unsigned int \debug_info
	Var.Assign \debug_info=&__DEBUG
	PRINT "Setting DDR1 PLL to 20MHz/19.2MHz on silicon (bypass)"
	PRINT ""
	GOSUB Write_MMR_Field (((Var.VALUE(\Base_Address)+Var.VALUE(\address_offset))+(Var.VALUE(\PLL_index)*0x1000))+&__CONTROL) 0x1 0x1 0x1F
	Var.IF (\debug_info!=0)
	(
		PRINT "Set DDR1 PLL to external bypass via Control MMR."
		PRINT ""
	)
	PRINT "Set DDR1 PLL to external bypass (20MHz/19.2MHz on SVB/EVM)."
	PRINT ""
	RETURN
	
)

Set_DDR0_PLL_533MHz:
(
	Var.NEWLOCAL unsigned int \address_offset
	Var.Assign \address_offset=0x80000000
	PRINT "Setting DDR0 PLL to produce a clock at 533MHz."
	PRINT ""
	PRINT "Programming Main PLL 12 (DDR0 PLL)"
	PRINT ""
	GOSUB Program_PLL &__CSL_PLL0_CFG_BASE Var.VALUE(\address_offset) &__DDR0_PLL_INDEX &__OFC1
	GOSUB Program_HSDIV &__CSL_PLL0_CFG_BASE Var.VALUE(\address_offset) &__DDR0_PLL_INDEX 0x0 0x7
	PRINT "Main PLL 12 (DDR0 PLL) Set."
	PRINT ""
	RETURN
	
)

Set_DDR1_PLL_533MHz:
(
	Var.NEWLOCAL unsigned int \address_offset
	Var.Assign \address_offset=0x80000000
	PRINT "Setting DDR1 PLL to produce a clock at 533MHz."
	PRINT ""
	PRINT "Programming Main PLL 26 (DDR1 PLL)"
	PRINT ""
	GOSUB Program_PLL &__CSL_PLL0_CFG_BASE Var.VALUE(\address_offset) &__DDR1_PLL_INDEX &__OFC1
	GOSUB Program_HSDIV &__CSL_PLL0_CFG_BASE Var.VALUE(\address_offset) &__DDR1_PLL_INDEX 0x0 0x7
	PRINT "Main PLL 26 (DDR1 PLL) Set."
	PRINT ""
	RETURN
	
)

Set_DDR0_PLL_1066MHz:
(
	Var.NEWLOCAL unsigned int \address_offset
	Var.Assign \address_offset=0x80000000
	PRINT "Setting DDR0 PLL to produce a clock at 1066MHz."
	PRINT ""
	PRINT "Programming Main PLL 12 (DDR0 PLL)"
	PRINT ""
	GOSUB Program_PLL &__CSL_PLL0_CFG_BASE Var.VALUE(\address_offset) &__DDR0_PLL_INDEX &__OFC1
	PRINT "Main PLL 12 (DDR0 PLL) Set."
	PRINT ""
	RETURN
	
)

Set_DDR1_PLL_1066MHz:
(
	Var.NEWLOCAL unsigned int \address_offset
	Var.Assign \address_offset=0x80000000
	PRINT "Setting DDR1 PLL to produce a clock at 1066MHz."
	PRINT ""
	PRINT "Programming Main PLL 26 (DDR1 PLL)"
	PRINT ""
	GOSUB Program_PLL &__CSL_PLL0_CFG_BASE Var.VALUE(\address_offset) &__DDR1_PLL_INDEX &__OFC1
	PRINT "Main PLL 26 (DDR1 PLL) Set."
	PRINT ""
	RETURN
	
)

PLL16_74MHz:
(
	Var.NEWLOCAL unsigned int \address_offset
	Var.Assign \address_offset=0x80000000
	PRINT "Setting DSS PLL 0 (MAIN_PLL16) to 74.25MHz."
	PRINT ""
	GOSUB Program_PLL &__CSL_PLL0_CFG_BASE Var.VALUE(\address_offset) &__DSS0_PLL_INDEX &__DSS_2970
	GOSUB Program_HSDIV &__CSL_PLL0_CFG_BASE Var.VALUE(\address_offset) &__DSS0_PLL_INDEX 0x0 0x27
	GOSUB Program_HSDIV &__CSL_PLL0_CFG_BASE Var.VALUE(\address_offset) &__DSS0_PLL_INDEX 0x1 0x27
	PRINT "DSS 0 PLL set to 74.25MHz"
	PRINT ""
	RETURN
	
)

PLL16_148MHz:
(
	Var.NEWLOCAL unsigned int \address_offset
	Var.Assign \address_offset=0x80000000
	PRINT "Setting DSS PLL 0 (MAIN_PLL16) to 148.5MHz."
	PRINT ""
	GOSUB Program_PLL &__CSL_PLL0_CFG_BASE Var.VALUE(\address_offset) &__DSS0_PLL_INDEX &__DSS_2970
	GOSUB Program_HSDIV &__CSL_PLL0_CFG_BASE Var.VALUE(\address_offset) &__DSS0_PLL_INDEX 0x0 0x13
	GOSUB Program_HSDIV &__CSL_PLL0_CFG_BASE Var.VALUE(\address_offset) &__DSS0_PLL_INDEX 0x1 0x13
	PRINT "DSS 0 PLL set to 148.5MHz"
	PRINT ""
	RETURN
	
)

PLL16_234MHz:
(
	Var.NEWLOCAL unsigned int \address_offset
	Var.Assign \address_offset=0x80000000
	PRINT "Setting DSS PLL 0 (MAIN_PLL16) to 234.59MHz."
	PRINT ""
	GOSUB Program_PLL &__CSL_PLL0_CFG_BASE Var.VALUE(\address_offset) &__DSS0_PLL_INDEX &__DSS_2345
	GOSUB Program_HSDIV &__CSL_PLL0_CFG_BASE Var.VALUE(\address_offset) &__DSS0_PLL_INDEX 0x0 0x9
	GOSUB Program_HSDIV &__CSL_PLL0_CFG_BASE Var.VALUE(\address_offset) &__DSS0_PLL_INDEX 0x1 0x9
	PRINT "DSS 0 PLL set to 234.59MHz"
	PRINT ""
	RETURN
	
)

PLL16_241MHz:
(
	Var.NEWLOCAL unsigned int \address_offset
	Var.Assign \address_offset=0x80000000
	PRINT "Setting DSS PLL 0 (MAIN_PLL16) to 241.5MHz."
	PRINT ""
	GOSUB Program_PLL &__CSL_PLL0_CFG_BASE Var.VALUE(\address_offset) &__DSS0_PLL_INDEX &__DSS_2898
	GOSUB Program_HSDIV &__CSL_PLL0_CFG_BASE Var.VALUE(\address_offset) &__DSS0_PLL_INDEX 0x0 0xB
	GOSUB Program_HSDIV &__CSL_PLL0_CFG_BASE Var.VALUE(\address_offset) &__DSS0_PLL_INDEX 0x1 0xB
	PRINT "DSS 0 PLL set to 241.5MHz"
	PRINT ""
	RETURN
	
)

PLL16_522MHz:
(
	Var.NEWLOCAL unsigned int \address_offset
	Var.Assign \address_offset=0x80000000
	PRINT "Setting DSS PLL 0 (MAIN_PLL16) to 522.614MHz."
	PRINT ""
	GOSUB Program_PLL &__CSL_PLL0_CFG_BASE Var.VALUE(\address_offset) &__DSS0_PLL_INDEX &__DSS_2613
	GOSUB Program_HSDIV &__CSL_PLL0_CFG_BASE Var.VALUE(\address_offset) &__DSS0_PLL_INDEX 0x0 0x4
	GOSUB Program_HSDIV &__CSL_PLL0_CFG_BASE Var.VALUE(\address_offset) &__DSS0_PLL_INDEX 0x1 0x4
	PRINT "DSS 0 PLL set to 522.614MHz"
	PRINT ""
	RETURN
	
)

PLL16_533MHz:
(
	Var.NEWLOCAL unsigned int \address_offset
	Var.Assign \address_offset=0x80000000
	PRINT "Setting DSS PLL 0 (MAIN_PLL16) to 533.25MHz."
	PRINT ""
	GOSUB Program_PLL &__CSL_PLL0_CFG_BASE Var.VALUE(\address_offset) &__DSS0_PLL_INDEX &__DSS_2133
	GOSUB Program_HSDIV &__CSL_PLL0_CFG_BASE Var.VALUE(\address_offset) &__DSS0_PLL_INDEX 0x0 0x3
	GOSUB Program_HSDIV &__CSL_PLL0_CFG_BASE Var.VALUE(\address_offset) &__DSS0_PLL_INDEX 0x1 0x3
	PRINT "DSS 0 PLL set to 533.25MHz"
	PRINT ""
	RETURN
	
)

PLL17_74MHz:
(
	Var.NEWLOCAL unsigned int \address_offset
	Var.Assign \address_offset=0x80000000
	PRINT "Setting DSS PLL 1 (MAIN_PLL17) to 74.25MHz."
	PRINT ""
	GOSUB Program_PLL &__CSL_PLL0_CFG_BASE Var.VALUE(\address_offset) &__DSS1_PLL_INDEX &__DSS_2970
	GOSUB Program_HSDIV &__CSL_PLL0_CFG_BASE Var.VALUE(\address_offset) &__DSS1_PLL_INDEX 0x0 0x27
	GOSUB Program_HSDIV &__CSL_PLL0_CFG_BASE Var.VALUE(\address_offset) &__DSS1_PLL_INDEX 0x1 0x27
	PRINT "DSS 1 PLL set to 74.25MHz"
	PRINT ""
	RETURN
	
)

PLL17_148MHz:
(
	Var.NEWLOCAL unsigned int \address_offset
	Var.Assign \address_offset=0x80000000
	PRINT "Setting DSS PLL 1 (MAIN_PLL17) to 148.5MHz."
	PRINT ""
	GOSUB Program_PLL &__CSL_PLL0_CFG_BASE Var.VALUE(\address_offset) &__DSS1_PLL_INDEX &__DSS_2970
	GOSUB Program_HSDIV &__CSL_PLL0_CFG_BASE Var.VALUE(\address_offset) &__DSS1_PLL_INDEX 0x0 0x13
	GOSUB Program_HSDIV &__CSL_PLL0_CFG_BASE Var.VALUE(\address_offset) &__DSS1_PLL_INDEX 0x1 0x13
	PRINT "DSS 1 PLL set to 148.5MHz"
	PRINT ""
	RETURN
	
)

PLL17_234MHz:
(
	Var.NEWLOCAL unsigned int \address_offset
	Var.Assign \address_offset=0x80000000
	PRINT "Setting DSS PLL 1 (MAIN_PLL17) to 234.59MHz."
	PRINT ""
	GOSUB Program_PLL &__CSL_PLL0_CFG_BASE Var.VALUE(\address_offset) &__DSS1_PLL_INDEX &__DSS_2345
	GOSUB Program_HSDIV &__CSL_PLL0_CFG_BASE Var.VALUE(\address_offset) &__DSS1_PLL_INDEX 0x0 0x9
	GOSUB Program_HSDIV &__CSL_PLL0_CFG_BASE Var.VALUE(\address_offset) &__DSS1_PLL_INDEX 0x1 0x9
	PRINT "DSS 1 PLL set to 234.59MHz"
	PRINT ""
	RETURN
	
)

PLL17_241MHz:
(
	Var.NEWLOCAL unsigned int \address_offset
	Var.Assign \address_offset=0x80000000
	PRINT "Setting DSS PLL 1 (MAIN_PLL17) to 241.5MHz."
	PRINT ""
	GOSUB Program_PLL &__CSL_PLL0_CFG_BASE Var.VALUE(\address_offset) &__DSS1_PLL_INDEX &__DSS_2898
	GOSUB Program_HSDIV &__CSL_PLL0_CFG_BASE Var.VALUE(\address_offset) &__DSS1_PLL_INDEX 0x0 0xB
	GOSUB Program_HSDIV &__CSL_PLL0_CFG_BASE Var.VALUE(\address_offset) &__DSS1_PLL_INDEX 0x1 0xB
	PRINT "DSS 1 PLL set to 241.5MHz"
	PRINT ""
	RETURN
	
)

PLL17_522MHz:
(
	Var.NEWLOCAL unsigned int \address_offset
	Var.Assign \address_offset=0x80000000
	PRINT "Setting DSS PLL 1 (MAIN_PLL17) to 522.614MHz."
	PRINT ""
	GOSUB Program_PLL &__CSL_PLL0_CFG_BASE Var.VALUE(\address_offset) &__DSS1_PLL_INDEX &__DSS_2613
	GOSUB Program_HSDIV &__CSL_PLL0_CFG_BASE Var.VALUE(\address_offset) &__DSS1_PLL_INDEX 0x0 0x4
	GOSUB Program_HSDIV &__CSL_PLL0_CFG_BASE Var.VALUE(\address_offset) &__DSS1_PLL_INDEX 0x1 0x4
	PRINT "DSS 1 PLL set to 522.614MHz"
	PRINT ""
	RETURN
	
)

PLL17_533MHz:
(
	Var.NEWLOCAL unsigned int \address_offset
	Var.Assign \address_offset=0x80000000
	PRINT "Setting DSS PLL 1 (MAIN_PLL17) to 533.25MHz."
	PRINT ""
	GOSUB Program_PLL &__CSL_PLL0_CFG_BASE Var.VALUE(\address_offset) &__DSS1_PLL_INDEX &__DSS_2133
	GOSUB Program_HSDIV &__CSL_PLL0_CFG_BASE Var.VALUE(\address_offset) &__DSS1_PLL_INDEX 0x0 0x3
	GOSUB Program_HSDIV &__CSL_PLL0_CFG_BASE Var.VALUE(\address_offset) &__DSS1_PLL_INDEX 0x1 0x3
	PRINT "DSS 1 PLL set to 533.25MHz"
	PRINT ""
	RETURN
	
)

PLL19_74MHz:
(
	Var.NEWLOCAL unsigned int \address_offset
	Var.Assign \address_offset=0x80000000
	PRINT "Setting DSS PLL 3 (MAIN_PLL19) to 74.25MHz."
	PRINT ""
	GOSUB Program_PLL &__CSL_PLL0_CFG_BASE Var.VALUE(\address_offset) &__DSS3_PLL_INDEX &__DSS_2970
	GOSUB Program_HSDIV &__CSL_PLL0_CFG_BASE Var.VALUE(\address_offset) &__DSS3_PLL_INDEX 0x0 0x27
	GOSUB Program_HSDIV &__CSL_PLL0_CFG_BASE Var.VALUE(\address_offset) &__DSS3_PLL_INDEX 0x1 0x27
	PRINT "DSS 3 PLL set to 74.25MHz"
	PRINT ""
	RETURN
	
)

PLL19_148MHz:
(
	Var.NEWLOCAL unsigned int \address_offset
	Var.Assign \address_offset=0x80000000
	PRINT "Setting DSS PLL 3 (MAIN_PLL19) to 148.5MHz."
	PRINT ""
	GOSUB Program_PLL &__CSL_PLL0_CFG_BASE Var.VALUE(\address_offset) &__DSS3_PLL_INDEX &__DSS_2970
	GOSUB Program_HSDIV &__CSL_PLL0_CFG_BASE Var.VALUE(\address_offset) &__DSS3_PLL_INDEX 0x0 0x13
	GOSUB Program_HSDIV &__CSL_PLL0_CFG_BASE Var.VALUE(\address_offset) &__DSS3_PLL_INDEX 0x1 0x13
	PRINT "DSS 3 PLL set to 148.5MHz"
	PRINT ""
	RETURN
	
)

PLL5_2400MHz:
(
	Var.NEWLOCAL unsigned int \address_offset
	Var.Assign \address_offset=0x80000000
	PRINT "Setting Video PLL (Main_PLL5) to a VCO of 2400MHz."
	PRINT ""
	GOSUB Program_PLL &__CSL_PLL0_CFG_BASE Var.VALUE(\address_offset) &__VIDEO_PLL_INDEX &__VIDEO_2400
	PRINT "Programming HSDIV 0 to 400MHz"
	PRINT ""
	GOSUB Program_HSDIV &__CSL_PLL0_CFG_BASE Var.VALUE(\address_offset) &__VIDEO_PLL_INDEX 0x0 0x5
	PRINT "Programming HSDIV 1 to 600MHz."
	PRINT ""
	GOSUB Program_HSDIV &__CSL_PLL0_CFG_BASE Var.VALUE(\address_offset) &__VIDEO_PLL_INDEX 0x1 0x3
	PRINT "Video PLL set to 2400MHz, HSDIV 0 set to 400MHz, HSDIV 1 set to 600MHz."
	PRINT ""
	RETURN
	
)

PLL25_480MHz_720MHz:
(
	Var.NEWLOCAL unsigned int \address_offset
	Var.Assign \address_offset=0x80000000
	PRINT "Programming Main PLL 25 (Vision PLL) for 480/720MHz."
	PRINT ""
	GOSUB Setup &__CSL_PLL0_CFG_BASE Var.VALUE(\address_offset) &__VISION_PLL_INDEX &__OFC1
	PRINT "Main PLL 25 (Vision PLL) Set."
	PRINT ""
	RETURN
	
)

PLL25_520MHz_650MHz:
(
	Var.NEWLOCAL unsigned int \address_offset
	Var.Assign \address_offset=0x80000000
	PRINT "Programming Main PLL 25 (Vision PLL) for 520/650MHz."
	PRINT ""
	GOSUB Setup &__CSL_PLL0_CFG_BASE Var.VALUE(\address_offset) &__VISION_PLL_INDEX &__DMPAC_520
	PRINT "Main PLL 25 (Vision PLL) Set."
	PRINT ""
	RETURN
	
)
