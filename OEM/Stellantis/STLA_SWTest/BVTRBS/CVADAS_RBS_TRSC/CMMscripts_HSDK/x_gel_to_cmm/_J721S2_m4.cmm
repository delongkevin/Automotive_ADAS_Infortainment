;;;;;;;;;;;;;;;;;;;;;;;;;;;;;;;;;;;;;;;;;;;;;;;;;;;;;;;;;;;;;;;;;;;;;;;;;;;;;;
; Basic CM4 connect for J721S2/TDA4VL
; 13 Oct 21 - Richard Woodruff - Adapt J7ES for J721S2.
; 11 Oct 22 - Richard Woodruff - Add PREPARE option.
;;;;;;;;;;;;;;;;;;;;;;;;;;;;;;;;;;;;;;;;;;;;;;;;;;;;;;;;;;;;;;;;;;;;;;;;;;;;;;
; INPUT PARMS: CM4-0, CM4-1   {default=CM4-0}
;            : PREPARE - used to reset AP in early JTAG only launch

 LOCAL &emulation
 &emulation="no"

 RESet
 SYStem.RESet
 area.create A000 100 1000
 area

; CM4 (2x1)  : J721S2-CM4-0 J721S2-CM4-1
; A72 (1x2)  : J721S2 (core.assign 1 2)
; CR5 (3x2)  : J721S2-CR5-MCU J721S2-CR5-MAIN0 J721S2-CR5-MAIN1 (core.assign 1 2)
; C7x (2x1)  : J721S2-C71X (core.assign 1 2)           

 IF COMBIPROBE()||UTRACE()
    SYStem.CONFIG.CONNECTOR MIPI34 ; because of converter LA-3782

 PRIVATE &parameters
 ENTRY %LINE &parameters
 &parameters=STRing.UPpeR("&parameters")
 PRIVATE &param_prepare
 &param_prepare=(STRing.SCAN("&parameters","PREPARE",0)!=-1)

 LOCAL &param_core 
 &param_core=STRing.SCANAndExtract("&parameters","CM4-","")
 IF "&param_core"=="1"
 (
   System.CPU J721S2-CM4-1
   SYStem.CONFIG CORE 2. 1.
 )
 ELSE
 (
   System.CPU J721S2-CM4-0
   SYStem.CONFIG CORE 1. 1.
 )
 SYStem.CONFIG.CTI1.Base E:0xE0042000

 SYStem.Option RESBREAK OFF
 SYStem.Option EnReset OFF
 IF "&emulation"=="yes"
 (
  SYStem.CONFIG DEBUGTIMESCALE 32.
  SYStem.Option MemStatusCheck ON
  SYStem.POLLING OFF
  setup.urate 2500.ms            ; slow window updates, this can be bigger
  SYStem.polling slow           ; sparse pinging
  SYStem.JTAGCLOCK rtck 100Khz
 )
 ELSE
  system.JTAGCLOCK CTCK 25MHz

 IF !SIMULATOR()
 (
   trace.method onchip
   trace.TraceCONNECT.tbr3
 )
 trace.CLOCK.333mhz
 trace.off
 SYStem.option DUALPORT on
 break.select program onchip
 break.select read onchip
 break.select write onchip

 IF (&param_prepare)
 (
  ;Reset at AP to clear state
   SYStem.Mode PREPARE
   data.Set EDBG:0x400003f0 %Long 0x00190000    ; Ensure Power-AP unlocked
   data.Set EDBG:0x400003f0 %Long 0yxxxxxxxxxxxxxxxxxxxxxxxxxxxxxxx1    ; Soft reset system
 )

 SYStem.Mode Attach
 Break

 register

; enable ITM BMC reports
 Data.set axi:0x00A90000 %LE %Long 0x1       ; Enable GTC for debug timestamps, 0x3=freeze in debug halt
 itm.TimeStampCLOCK 250.mhz
 itm.TimeStamps.on
 itm.TImeMode.AsyncTimeStamps                ; needed for onchip, offchip can use external

ENDDO

