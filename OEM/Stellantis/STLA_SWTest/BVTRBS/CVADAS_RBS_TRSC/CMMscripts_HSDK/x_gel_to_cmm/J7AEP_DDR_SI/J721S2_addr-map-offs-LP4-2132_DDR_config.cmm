LOCAL &function &args
ENTRY &function %LINE &args
// --  Copyright (c) 2019, Texas Instruments Incorporated
// --  *
// --  * Redistribution and use in source and binary forms, with or without
// --  * modification, are permitted provided that the following conditions
// --  * are met:
// --  *
// --  * *  Redistributions of source code must retain the above copyright
// --  *    notice, this list of conditions and the following disclaimer.
// --  *
// --  * *  Redistributions in binary form must reproduce the above copyright
// --  *    notice, this list of conditions and the following disclaimer in the
// --  *    documentation and/or other materials provided with the distribution.
// --  *
// --  * *  Neither the name of Texas Instruments Incorporated nor the names of
// --  *    its contributors may be used to endorse or promote products derived
// --  *    from this software without specific prior written permission.
// --  *
// --  * THIS SOFTWARE IS PROVIDED BY THE COPYRIGHT HOLDERS AND CONTRIBUTORS "AS IS"
// --  * AND ANY EXPRESS OR IMPLIED WARRANTIES, INCLUDING, BUT NOT LIMITED TO,
// --  * THE IMPLIED WARRANTIES OF MERCHANTABILITY AND FITNESS FOR A PARTICULAR
// --  * PURPOSE ARE DISCLAIMED. IN NO EVENT SHALL THE COPYRIGHT OWNER OR
// --  * CONTRIBUTORS BE LIABLE FOR ANY DIRECT, INDIRECT, INCIDENTAL, SPECIAL,
// --  * EXEMPLARY, OR CONSEQUENTIAL DAMAGES (INCLUDING, BUT NOT LIMITED TO,
// --  * PROCUREMENT OF SUBSTITUTE GOODS OR SERVICES; LOSS OF USE, DATA, OR PROFITS;
// --  * OR BUSINESS INTERRUPTION) HOWEVER CAUSED AND ON ANY THEORY OF LIABILITY,
// --  * WHETHER IN CONTRACT, STRICT LIABILITY, OR TORT (INCLUDING NEGLIGENCE OR
// --  * OTHERWISE) ARISING IN ANY WAY OUT OF THE USE OF THIS SOFTWARE,
// --  * EVEN IF ADVISED OF THE POSSIBILITY OF SUCH DAMAGE. 
LOCAL &__DDRSS_CTL_0__SFR_OFFS
&__DDRSS_CTL_0__SFR_OFFS=0x0
LOCAL &__DDRSS_CTL_1__SFR_OFFS
&__DDRSS_CTL_1__SFR_OFFS=0x4
LOCAL &__DDRSS_CTL_2__SFR_OFFS
&__DDRSS_CTL_2__SFR_OFFS=0x8
LOCAL &__DDRSS_CTL_3__SFR_OFFS
&__DDRSS_CTL_3__SFR_OFFS=0xc
LOCAL &__DDRSS_CTL_4__SFR_OFFS
&__DDRSS_CTL_4__SFR_OFFS=0x10
LOCAL &__DDRSS_CTL_5__SFR_OFFS
&__DDRSS_CTL_5__SFR_OFFS=0x14
LOCAL &__DDRSS_CTL_6__SFR_OFFS
&__DDRSS_CTL_6__SFR_OFFS=0x18
LOCAL &__DDRSS_CTL_7__SFR_OFFS
&__DDRSS_CTL_7__SFR_OFFS=0x1c
LOCAL &__DDRSS_CTL_8__SFR_OFFS
&__DDRSS_CTL_8__SFR_OFFS=0x20
LOCAL &__DDRSS_CTL_9__SFR_OFFS
&__DDRSS_CTL_9__SFR_OFFS=0x24
LOCAL &__DDRSS_CTL_10__SFR_OFFS
&__DDRSS_CTL_10__SFR_OFFS=0x28
LOCAL &__DDRSS_CTL_11__SFR_OFFS
&__DDRSS_CTL_11__SFR_OFFS=0x2c
LOCAL &__DDRSS_CTL_12__SFR_OFFS
&__DDRSS_CTL_12__SFR_OFFS=0x30
LOCAL &__DDRSS_CTL_13__SFR_OFFS
&__DDRSS_CTL_13__SFR_OFFS=0x34
LOCAL &__DDRSS_CTL_14__SFR_OFFS
&__DDRSS_CTL_14__SFR_OFFS=0x38
LOCAL &__DDRSS_CTL_15__SFR_OFFS
&__DDRSS_CTL_15__SFR_OFFS=0x3c
LOCAL &__DDRSS_CTL_16__SFR_OFFS
&__DDRSS_CTL_16__SFR_OFFS=0x40
LOCAL &__DDRSS_CTL_17__SFR_OFFS
&__DDRSS_CTL_17__SFR_OFFS=0x44
LOCAL &__DDRSS_CTL_18__SFR_OFFS
&__DDRSS_CTL_18__SFR_OFFS=0x48
LOCAL &__DDRSS_CTL_19__SFR_OFFS
&__DDRSS_CTL_19__SFR_OFFS=0x4c
LOCAL &__DDRSS_CTL_20__SFR_OFFS
&__DDRSS_CTL_20__SFR_OFFS=0x50
LOCAL &__DDRSS_CTL_21__SFR_OFFS
&__DDRSS_CTL_21__SFR_OFFS=0x54
LOCAL &__DDRSS_CTL_22__SFR_OFFS
&__DDRSS_CTL_22__SFR_OFFS=0x58
LOCAL &__DDRSS_CTL_23__SFR_OFFS
&__DDRSS_CTL_23__SFR_OFFS=0x5c
LOCAL &__DDRSS_CTL_24__SFR_OFFS
&__DDRSS_CTL_24__SFR_OFFS=0x60
LOCAL &__DDRSS_CTL_25__SFR_OFFS
&__DDRSS_CTL_25__SFR_OFFS=0x64
LOCAL &__DDRSS_CTL_26__SFR_OFFS
&__DDRSS_CTL_26__SFR_OFFS=0x68
LOCAL &__DDRSS_CTL_27__SFR_OFFS
&__DDRSS_CTL_27__SFR_OFFS=0x6c
LOCAL &__DDRSS_CTL_28__SFR_OFFS
&__DDRSS_CTL_28__SFR_OFFS=0x70
LOCAL &__DDRSS_CTL_29__SFR_OFFS
&__DDRSS_CTL_29__SFR_OFFS=0x74
LOCAL &__DDRSS_CTL_30__SFR_OFFS
&__DDRSS_CTL_30__SFR_OFFS=0x78
LOCAL &__DDRSS_CTL_31__SFR_OFFS
&__DDRSS_CTL_31__SFR_OFFS=0x7c
LOCAL &__DDRSS_CTL_32__SFR_OFFS
&__DDRSS_CTL_32__SFR_OFFS=0x80
LOCAL &__DDRSS_CTL_33__SFR_OFFS
&__DDRSS_CTL_33__SFR_OFFS=0x84
LOCAL &__DDRSS_CTL_34__SFR_OFFS
&__DDRSS_CTL_34__SFR_OFFS=0x88
LOCAL &__DDRSS_CTL_35__SFR_OFFS
&__DDRSS_CTL_35__SFR_OFFS=0x8c
LOCAL &__DDRSS_CTL_36__SFR_OFFS
&__DDRSS_CTL_36__SFR_OFFS=0x90
LOCAL &__DDRSS_CTL_37__SFR_OFFS
&__DDRSS_CTL_37__SFR_OFFS=0x94
LOCAL &__DDRSS_CTL_38__SFR_OFFS
&__DDRSS_CTL_38__SFR_OFFS=0x98
LOCAL &__DDRSS_CTL_39__SFR_OFFS
&__DDRSS_CTL_39__SFR_OFFS=0x9c
LOCAL &__DDRSS_CTL_40__SFR_OFFS
&__DDRSS_CTL_40__SFR_OFFS=0xa0
LOCAL &__DDRSS_CTL_41__SFR_OFFS
&__DDRSS_CTL_41__SFR_OFFS=0xa4
LOCAL &__DDRSS_CTL_42__SFR_OFFS
&__DDRSS_CTL_42__SFR_OFFS=0xa8
LOCAL &__DDRSS_CTL_43__SFR_OFFS
&__DDRSS_CTL_43__SFR_OFFS=0xac
LOCAL &__DDRSS_CTL_44__SFR_OFFS
&__DDRSS_CTL_44__SFR_OFFS=0xb0
LOCAL &__DDRSS_CTL_45__SFR_OFFS
&__DDRSS_CTL_45__SFR_OFFS=0xb4
LOCAL &__DDRSS_CTL_46__SFR_OFFS
&__DDRSS_CTL_46__SFR_OFFS=0xb8
LOCAL &__DDRSS_CTL_47__SFR_OFFS
&__DDRSS_CTL_47__SFR_OFFS=0xbc
LOCAL &__DDRSS_CTL_48__SFR_OFFS
&__DDRSS_CTL_48__SFR_OFFS=0xc0
LOCAL &__DDRSS_CTL_49__SFR_OFFS
&__DDRSS_CTL_49__SFR_OFFS=0xc4
LOCAL &__DDRSS_CTL_50__SFR_OFFS
&__DDRSS_CTL_50__SFR_OFFS=0xc8
LOCAL &__DDRSS_CTL_51__SFR_OFFS
&__DDRSS_CTL_51__SFR_OFFS=0xcc
LOCAL &__DDRSS_CTL_52__SFR_OFFS
&__DDRSS_CTL_52__SFR_OFFS=0xd0
LOCAL &__DDRSS_CTL_53__SFR_OFFS
&__DDRSS_CTL_53__SFR_OFFS=0xd4
LOCAL &__DDRSS_CTL_54__SFR_OFFS
&__DDRSS_CTL_54__SFR_OFFS=0xd8
LOCAL &__DDRSS_CTL_55__SFR_OFFS
&__DDRSS_CTL_55__SFR_OFFS=0xdc
LOCAL &__DDRSS_CTL_56__SFR_OFFS
&__DDRSS_CTL_56__SFR_OFFS=0xe0
LOCAL &__DDRSS_CTL_57__SFR_OFFS
&__DDRSS_CTL_57__SFR_OFFS=0xe4
LOCAL &__DDRSS_CTL_58__SFR_OFFS
&__DDRSS_CTL_58__SFR_OFFS=0xe8
LOCAL &__DDRSS_CTL_59__SFR_OFFS
&__DDRSS_CTL_59__SFR_OFFS=0xec
LOCAL &__DDRSS_CTL_60__SFR_OFFS
&__DDRSS_CTL_60__SFR_OFFS=0xf0
LOCAL &__DDRSS_CTL_61__SFR_OFFS
&__DDRSS_CTL_61__SFR_OFFS=0xf4
LOCAL &__DDRSS_CTL_62__SFR_OFFS
&__DDRSS_CTL_62__SFR_OFFS=0xf8
LOCAL &__DDRSS_CTL_63__SFR_OFFS
&__DDRSS_CTL_63__SFR_OFFS=0xfc
LOCAL &__DDRSS_CTL_64__SFR_OFFS
&__DDRSS_CTL_64__SFR_OFFS=0x100
LOCAL &__DDRSS_CTL_65__SFR_OFFS
&__DDRSS_CTL_65__SFR_OFFS=0x104
LOCAL &__DDRSS_CTL_66__SFR_OFFS
&__DDRSS_CTL_66__SFR_OFFS=0x108
LOCAL &__DDRSS_CTL_67__SFR_OFFS
&__DDRSS_CTL_67__SFR_OFFS=0x10c
LOCAL &__DDRSS_CTL_68__SFR_OFFS
&__DDRSS_CTL_68__SFR_OFFS=0x110
LOCAL &__DDRSS_CTL_69__SFR_OFFS
&__DDRSS_CTL_69__SFR_OFFS=0x114
LOCAL &__DDRSS_CTL_70__SFR_OFFS
&__DDRSS_CTL_70__SFR_OFFS=0x118
LOCAL &__DDRSS_CTL_71__SFR_OFFS
&__DDRSS_CTL_71__SFR_OFFS=0x11c
LOCAL &__DDRSS_CTL_72__SFR_OFFS
&__DDRSS_CTL_72__SFR_OFFS=0x120
LOCAL &__DDRSS_CTL_73__SFR_OFFS
&__DDRSS_CTL_73__SFR_OFFS=0x124
LOCAL &__DDRSS_CTL_74__SFR_OFFS
&__DDRSS_CTL_74__SFR_OFFS=0x128
LOCAL &__DDRSS_CTL_75__SFR_OFFS
&__DDRSS_CTL_75__SFR_OFFS=0x12c
LOCAL &__DDRSS_CTL_76__SFR_OFFS
&__DDRSS_CTL_76__SFR_OFFS=0x130
LOCAL &__DDRSS_CTL_77__SFR_OFFS
&__DDRSS_CTL_77__SFR_OFFS=0x134
LOCAL &__DDRSS_CTL_78__SFR_OFFS
&__DDRSS_CTL_78__SFR_OFFS=0x138
LOCAL &__DDRSS_CTL_79__SFR_OFFS
&__DDRSS_CTL_79__SFR_OFFS=0x13c
LOCAL &__DDRSS_CTL_80__SFR_OFFS
&__DDRSS_CTL_80__SFR_OFFS=0x140
LOCAL &__DDRSS_CTL_81__SFR_OFFS
&__DDRSS_CTL_81__SFR_OFFS=0x144
LOCAL &__DDRSS_CTL_82__SFR_OFFS
&__DDRSS_CTL_82__SFR_OFFS=0x148
LOCAL &__DDRSS_CTL_83__SFR_OFFS
&__DDRSS_CTL_83__SFR_OFFS=0x14c
LOCAL &__DDRSS_CTL_84__SFR_OFFS
&__DDRSS_CTL_84__SFR_OFFS=0x150
LOCAL &__DDRSS_CTL_85__SFR_OFFS
&__DDRSS_CTL_85__SFR_OFFS=0x154
LOCAL &__DDRSS_CTL_86__SFR_OFFS
&__DDRSS_CTL_86__SFR_OFFS=0x158
LOCAL &__DDRSS_CTL_87__SFR_OFFS
&__DDRSS_CTL_87__SFR_OFFS=0x15c
LOCAL &__DDRSS_CTL_88__SFR_OFFS
&__DDRSS_CTL_88__SFR_OFFS=0x160
LOCAL &__DDRSS_CTL_89__SFR_OFFS
&__DDRSS_CTL_89__SFR_OFFS=0x164
LOCAL &__DDRSS_CTL_90__SFR_OFFS
&__DDRSS_CTL_90__SFR_OFFS=0x168
LOCAL &__DDRSS_CTL_91__SFR_OFFS
&__DDRSS_CTL_91__SFR_OFFS=0x16c
LOCAL &__DDRSS_CTL_92__SFR_OFFS
&__DDRSS_CTL_92__SFR_OFFS=0x170
LOCAL &__DDRSS_CTL_93__SFR_OFFS
&__DDRSS_CTL_93__SFR_OFFS=0x174
LOCAL &__DDRSS_CTL_94__SFR_OFFS
&__DDRSS_CTL_94__SFR_OFFS=0x178
LOCAL &__DDRSS_CTL_95__SFR_OFFS
&__DDRSS_CTL_95__SFR_OFFS=0x17c
LOCAL &__DDRSS_CTL_96__SFR_OFFS
&__DDRSS_CTL_96__SFR_OFFS=0x180
LOCAL &__DDRSS_CTL_97__SFR_OFFS
&__DDRSS_CTL_97__SFR_OFFS=0x184
LOCAL &__DDRSS_CTL_98__SFR_OFFS
&__DDRSS_CTL_98__SFR_OFFS=0x188
LOCAL &__DDRSS_CTL_99__SFR_OFFS
&__DDRSS_CTL_99__SFR_OFFS=0x18c
LOCAL &__DDRSS_CTL_100__SFR_OFFS
&__DDRSS_CTL_100__SFR_OFFS=0x190
LOCAL &__DDRSS_CTL_101__SFR_OFFS
&__DDRSS_CTL_101__SFR_OFFS=0x194
LOCAL &__DDRSS_CTL_102__SFR_OFFS
&__DDRSS_CTL_102__SFR_OFFS=0x198
LOCAL &__DDRSS_CTL_103__SFR_OFFS
&__DDRSS_CTL_103__SFR_OFFS=0x19c
LOCAL &__DDRSS_CTL_104__SFR_OFFS
&__DDRSS_CTL_104__SFR_OFFS=0x1a0
LOCAL &__DDRSS_CTL_105__SFR_OFFS
&__DDRSS_CTL_105__SFR_OFFS=0x1a4
LOCAL &__DDRSS_CTL_106__SFR_OFFS
&__DDRSS_CTL_106__SFR_OFFS=0x1a8
LOCAL &__DDRSS_CTL_107__SFR_OFFS
&__DDRSS_CTL_107__SFR_OFFS=0x1ac
LOCAL &__DDRSS_CTL_108__SFR_OFFS
&__DDRSS_CTL_108__SFR_OFFS=0x1b0
LOCAL &__DDRSS_CTL_109__SFR_OFFS
&__DDRSS_CTL_109__SFR_OFFS=0x1b4
LOCAL &__DDRSS_CTL_110__SFR_OFFS
&__DDRSS_CTL_110__SFR_OFFS=0x1b8
LOCAL &__DDRSS_CTL_111__SFR_OFFS
&__DDRSS_CTL_111__SFR_OFFS=0x1bc
LOCAL &__DDRSS_CTL_112__SFR_OFFS
&__DDRSS_CTL_112__SFR_OFFS=0x1c0
LOCAL &__DDRSS_CTL_113__SFR_OFFS
&__DDRSS_CTL_113__SFR_OFFS=0x1c4
LOCAL &__DDRSS_CTL_114__SFR_OFFS
&__DDRSS_CTL_114__SFR_OFFS=0x1c8
LOCAL &__DDRSS_CTL_115__SFR_OFFS
&__DDRSS_CTL_115__SFR_OFFS=0x1cc
LOCAL &__DDRSS_CTL_116__SFR_OFFS
&__DDRSS_CTL_116__SFR_OFFS=0x1d0
LOCAL &__DDRSS_CTL_117__SFR_OFFS
&__DDRSS_CTL_117__SFR_OFFS=0x1d4
LOCAL &__DDRSS_CTL_118__SFR_OFFS
&__DDRSS_CTL_118__SFR_OFFS=0x1d8
LOCAL &__DDRSS_CTL_119__SFR_OFFS
&__DDRSS_CTL_119__SFR_OFFS=0x1dc
LOCAL &__DDRSS_CTL_120__SFR_OFFS
&__DDRSS_CTL_120__SFR_OFFS=0x1e0
LOCAL &__DDRSS_CTL_121__SFR_OFFS
&__DDRSS_CTL_121__SFR_OFFS=0x1e4
LOCAL &__DDRSS_CTL_122__SFR_OFFS
&__DDRSS_CTL_122__SFR_OFFS=0x1e8
LOCAL &__DDRSS_CTL_123__SFR_OFFS
&__DDRSS_CTL_123__SFR_OFFS=0x1ec
LOCAL &__DDRSS_CTL_124__SFR_OFFS
&__DDRSS_CTL_124__SFR_OFFS=0x1f0
LOCAL &__DDRSS_CTL_125__SFR_OFFS
&__DDRSS_CTL_125__SFR_OFFS=0x1f4
LOCAL &__DDRSS_CTL_126__SFR_OFFS
&__DDRSS_CTL_126__SFR_OFFS=0x1f8
LOCAL &__DDRSS_CTL_127__SFR_OFFS
&__DDRSS_CTL_127__SFR_OFFS=0x1fc
LOCAL &__DDRSS_CTL_128__SFR_OFFS
&__DDRSS_CTL_128__SFR_OFFS=0x200
LOCAL &__DDRSS_CTL_129__SFR_OFFS
&__DDRSS_CTL_129__SFR_OFFS=0x204
LOCAL &__DDRSS_CTL_130__SFR_OFFS
&__DDRSS_CTL_130__SFR_OFFS=0x208
LOCAL &__DDRSS_CTL_131__SFR_OFFS
&__DDRSS_CTL_131__SFR_OFFS=0x20c
LOCAL &__DDRSS_CTL_132__SFR_OFFS
&__DDRSS_CTL_132__SFR_OFFS=0x210
LOCAL &__DDRSS_CTL_133__SFR_OFFS
&__DDRSS_CTL_133__SFR_OFFS=0x214
LOCAL &__DDRSS_CTL_134__SFR_OFFS
&__DDRSS_CTL_134__SFR_OFFS=0x218
LOCAL &__DDRSS_CTL_135__SFR_OFFS
&__DDRSS_CTL_135__SFR_OFFS=0x21c
LOCAL &__DDRSS_CTL_136__SFR_OFFS
&__DDRSS_CTL_136__SFR_OFFS=0x220
LOCAL &__DDRSS_CTL_137__SFR_OFFS
&__DDRSS_CTL_137__SFR_OFFS=0x224
LOCAL &__DDRSS_CTL_138__SFR_OFFS
&__DDRSS_CTL_138__SFR_OFFS=0x228
LOCAL &__DDRSS_CTL_139__SFR_OFFS
&__DDRSS_CTL_139__SFR_OFFS=0x22c
LOCAL &__DDRSS_CTL_140__SFR_OFFS
&__DDRSS_CTL_140__SFR_OFFS=0x230
LOCAL &__DDRSS_CTL_141__SFR_OFFS
&__DDRSS_CTL_141__SFR_OFFS=0x234
LOCAL &__DDRSS_CTL_142__SFR_OFFS
&__DDRSS_CTL_142__SFR_OFFS=0x238
LOCAL &__DDRSS_CTL_143__SFR_OFFS
&__DDRSS_CTL_143__SFR_OFFS=0x23c
LOCAL &__DDRSS_CTL_144__SFR_OFFS
&__DDRSS_CTL_144__SFR_OFFS=0x240
LOCAL &__DDRSS_CTL_145__SFR_OFFS
&__DDRSS_CTL_145__SFR_OFFS=0x244
LOCAL &__DDRSS_CTL_146__SFR_OFFS
&__DDRSS_CTL_146__SFR_OFFS=0x248
LOCAL &__DDRSS_CTL_147__SFR_OFFS
&__DDRSS_CTL_147__SFR_OFFS=0x24c
LOCAL &__DDRSS_CTL_148__SFR_OFFS
&__DDRSS_CTL_148__SFR_OFFS=0x250
LOCAL &__DDRSS_CTL_149__SFR_OFFS
&__DDRSS_CTL_149__SFR_OFFS=0x254
LOCAL &__DDRSS_CTL_150__SFR_OFFS
&__DDRSS_CTL_150__SFR_OFFS=0x258
LOCAL &__DDRSS_CTL_151__SFR_OFFS
&__DDRSS_CTL_151__SFR_OFFS=0x25c
LOCAL &__DDRSS_CTL_152__SFR_OFFS
&__DDRSS_CTL_152__SFR_OFFS=0x260
LOCAL &__DDRSS_CTL_153__SFR_OFFS
&__DDRSS_CTL_153__SFR_OFFS=0x264
LOCAL &__DDRSS_CTL_154__SFR_OFFS
&__DDRSS_CTL_154__SFR_OFFS=0x268
LOCAL &__DDRSS_CTL_155__SFR_OFFS
&__DDRSS_CTL_155__SFR_OFFS=0x26c
LOCAL &__DDRSS_CTL_156__SFR_OFFS
&__DDRSS_CTL_156__SFR_OFFS=0x270
LOCAL &__DDRSS_CTL_157__SFR_OFFS
&__DDRSS_CTL_157__SFR_OFFS=0x274
LOCAL &__DDRSS_CTL_158__SFR_OFFS
&__DDRSS_CTL_158__SFR_OFFS=0x278
LOCAL &__DDRSS_CTL_159__SFR_OFFS
&__DDRSS_CTL_159__SFR_OFFS=0x27c
LOCAL &__DDRSS_CTL_160__SFR_OFFS
&__DDRSS_CTL_160__SFR_OFFS=0x280
LOCAL &__DDRSS_CTL_161__SFR_OFFS
&__DDRSS_CTL_161__SFR_OFFS=0x284
LOCAL &__DDRSS_CTL_162__SFR_OFFS
&__DDRSS_CTL_162__SFR_OFFS=0x288
LOCAL &__DDRSS_CTL_163__SFR_OFFS
&__DDRSS_CTL_163__SFR_OFFS=0x28c
LOCAL &__DDRSS_CTL_164__SFR_OFFS
&__DDRSS_CTL_164__SFR_OFFS=0x290
LOCAL &__DDRSS_CTL_165__SFR_OFFS
&__DDRSS_CTL_165__SFR_OFFS=0x294
LOCAL &__DDRSS_CTL_166__SFR_OFFS
&__DDRSS_CTL_166__SFR_OFFS=0x298
LOCAL &__DDRSS_CTL_167__SFR_OFFS
&__DDRSS_CTL_167__SFR_OFFS=0x29c
LOCAL &__DDRSS_CTL_168__SFR_OFFS
&__DDRSS_CTL_168__SFR_OFFS=0x2a0
LOCAL &__DDRSS_CTL_169__SFR_OFFS
&__DDRSS_CTL_169__SFR_OFFS=0x2a4
LOCAL &__DDRSS_CTL_170__SFR_OFFS
&__DDRSS_CTL_170__SFR_OFFS=0x2a8
LOCAL &__DDRSS_CTL_171__SFR_OFFS
&__DDRSS_CTL_171__SFR_OFFS=0x2ac
LOCAL &__DDRSS_CTL_172__SFR_OFFS
&__DDRSS_CTL_172__SFR_OFFS=0x2b0
LOCAL &__DDRSS_CTL_173__SFR_OFFS
&__DDRSS_CTL_173__SFR_OFFS=0x2b4
LOCAL &__DDRSS_CTL_174__SFR_OFFS
&__DDRSS_CTL_174__SFR_OFFS=0x2b8
LOCAL &__DDRSS_CTL_175__SFR_OFFS
&__DDRSS_CTL_175__SFR_OFFS=0x2bc
LOCAL &__DDRSS_CTL_176__SFR_OFFS
&__DDRSS_CTL_176__SFR_OFFS=0x2c0
LOCAL &__DDRSS_CTL_177__SFR_OFFS
&__DDRSS_CTL_177__SFR_OFFS=0x2c4
LOCAL &__DDRSS_CTL_178__SFR_OFFS
&__DDRSS_CTL_178__SFR_OFFS=0x2c8
LOCAL &__DDRSS_CTL_179__SFR_OFFS
&__DDRSS_CTL_179__SFR_OFFS=0x2cc
LOCAL &__DDRSS_CTL_180__SFR_OFFS
&__DDRSS_CTL_180__SFR_OFFS=0x2d0
LOCAL &__DDRSS_CTL_181__SFR_OFFS
&__DDRSS_CTL_181__SFR_OFFS=0x2d4
LOCAL &__DDRSS_CTL_182__SFR_OFFS
&__DDRSS_CTL_182__SFR_OFFS=0x2d8
LOCAL &__DDRSS_CTL_183__SFR_OFFS
&__DDRSS_CTL_183__SFR_OFFS=0x2dc
LOCAL &__DDRSS_CTL_184__SFR_OFFS
&__DDRSS_CTL_184__SFR_OFFS=0x2e0
LOCAL &__DDRSS_CTL_185__SFR_OFFS
&__DDRSS_CTL_185__SFR_OFFS=0x2e4
LOCAL &__DDRSS_CTL_186__SFR_OFFS
&__DDRSS_CTL_186__SFR_OFFS=0x2e8
LOCAL &__DDRSS_CTL_187__SFR_OFFS
&__DDRSS_CTL_187__SFR_OFFS=0x2ec
LOCAL &__DDRSS_CTL_188__SFR_OFFS
&__DDRSS_CTL_188__SFR_OFFS=0x2f0
LOCAL &__DDRSS_CTL_189__SFR_OFFS
&__DDRSS_CTL_189__SFR_OFFS=0x2f4
LOCAL &__DDRSS_CTL_190__SFR_OFFS
&__DDRSS_CTL_190__SFR_OFFS=0x2f8
LOCAL &__DDRSS_CTL_191__SFR_OFFS
&__DDRSS_CTL_191__SFR_OFFS=0x2fc
LOCAL &__DDRSS_CTL_192__SFR_OFFS
&__DDRSS_CTL_192__SFR_OFFS=0x300
LOCAL &__DDRSS_CTL_193__SFR_OFFS
&__DDRSS_CTL_193__SFR_OFFS=0x304
LOCAL &__DDRSS_CTL_194__SFR_OFFS
&__DDRSS_CTL_194__SFR_OFFS=0x308
LOCAL &__DDRSS_CTL_195__SFR_OFFS
&__DDRSS_CTL_195__SFR_OFFS=0x30c
LOCAL &__DDRSS_CTL_196__SFR_OFFS
&__DDRSS_CTL_196__SFR_OFFS=0x310
LOCAL &__DDRSS_CTL_197__SFR_OFFS
&__DDRSS_CTL_197__SFR_OFFS=0x314
LOCAL &__DDRSS_CTL_198__SFR_OFFS
&__DDRSS_CTL_198__SFR_OFFS=0x318
LOCAL &__DDRSS_CTL_199__SFR_OFFS
&__DDRSS_CTL_199__SFR_OFFS=0x31c
LOCAL &__DDRSS_CTL_200__SFR_OFFS
&__DDRSS_CTL_200__SFR_OFFS=0x320
LOCAL &__DDRSS_CTL_201__SFR_OFFS
&__DDRSS_CTL_201__SFR_OFFS=0x324
LOCAL &__DDRSS_CTL_202__SFR_OFFS
&__DDRSS_CTL_202__SFR_OFFS=0x328
LOCAL &__DDRSS_CTL_203__SFR_OFFS
&__DDRSS_CTL_203__SFR_OFFS=0x32c
LOCAL &__DDRSS_CTL_204__SFR_OFFS
&__DDRSS_CTL_204__SFR_OFFS=0x330
LOCAL &__DDRSS_CTL_205__SFR_OFFS
&__DDRSS_CTL_205__SFR_OFFS=0x334
LOCAL &__DDRSS_CTL_206__SFR_OFFS
&__DDRSS_CTL_206__SFR_OFFS=0x338
LOCAL &__DDRSS_CTL_207__SFR_OFFS
&__DDRSS_CTL_207__SFR_OFFS=0x33c
LOCAL &__DDRSS_CTL_208__SFR_OFFS
&__DDRSS_CTL_208__SFR_OFFS=0x340
LOCAL &__DDRSS_CTL_209__SFR_OFFS
&__DDRSS_CTL_209__SFR_OFFS=0x344
LOCAL &__DDRSS_CTL_210__SFR_OFFS
&__DDRSS_CTL_210__SFR_OFFS=0x348
LOCAL &__DDRSS_CTL_211__SFR_OFFS
&__DDRSS_CTL_211__SFR_OFFS=0x34c
LOCAL &__DDRSS_CTL_212__SFR_OFFS
&__DDRSS_CTL_212__SFR_OFFS=0x350
LOCAL &__DDRSS_CTL_213__SFR_OFFS
&__DDRSS_CTL_213__SFR_OFFS=0x354
LOCAL &__DDRSS_CTL_214__SFR_OFFS
&__DDRSS_CTL_214__SFR_OFFS=0x358
LOCAL &__DDRSS_CTL_215__SFR_OFFS
&__DDRSS_CTL_215__SFR_OFFS=0x35c
LOCAL &__DDRSS_CTL_216__SFR_OFFS
&__DDRSS_CTL_216__SFR_OFFS=0x360
LOCAL &__DDRSS_CTL_217__SFR_OFFS
&__DDRSS_CTL_217__SFR_OFFS=0x364
LOCAL &__DDRSS_CTL_218__SFR_OFFS
&__DDRSS_CTL_218__SFR_OFFS=0x368
LOCAL &__DDRSS_CTL_219__SFR_OFFS
&__DDRSS_CTL_219__SFR_OFFS=0x36c
LOCAL &__DDRSS_CTL_220__SFR_OFFS
&__DDRSS_CTL_220__SFR_OFFS=0x370
LOCAL &__DDRSS_CTL_221__SFR_OFFS
&__DDRSS_CTL_221__SFR_OFFS=0x374
LOCAL &__DDRSS_CTL_222__SFR_OFFS
&__DDRSS_CTL_222__SFR_OFFS=0x378
LOCAL &__DDRSS_CTL_223__SFR_OFFS
&__DDRSS_CTL_223__SFR_OFFS=0x37c
LOCAL &__DDRSS_CTL_224__SFR_OFFS
&__DDRSS_CTL_224__SFR_OFFS=0x380
LOCAL &__DDRSS_CTL_225__SFR_OFFS
&__DDRSS_CTL_225__SFR_OFFS=0x384
LOCAL &__DDRSS_CTL_226__SFR_OFFS
&__DDRSS_CTL_226__SFR_OFFS=0x388
LOCAL &__DDRSS_CTL_227__SFR_OFFS
&__DDRSS_CTL_227__SFR_OFFS=0x38c
LOCAL &__DDRSS_CTL_228__SFR_OFFS
&__DDRSS_CTL_228__SFR_OFFS=0x390
LOCAL &__DDRSS_CTL_229__SFR_OFFS
&__DDRSS_CTL_229__SFR_OFFS=0x394
LOCAL &__DDRSS_CTL_230__SFR_OFFS
&__DDRSS_CTL_230__SFR_OFFS=0x398
LOCAL &__DDRSS_CTL_231__SFR_OFFS
&__DDRSS_CTL_231__SFR_OFFS=0x39c
LOCAL &__DDRSS_CTL_232__SFR_OFFS
&__DDRSS_CTL_232__SFR_OFFS=0x3a0
LOCAL &__DDRSS_CTL_233__SFR_OFFS
&__DDRSS_CTL_233__SFR_OFFS=0x3a4
LOCAL &__DDRSS_CTL_234__SFR_OFFS
&__DDRSS_CTL_234__SFR_OFFS=0x3a8
LOCAL &__DDRSS_CTL_235__SFR_OFFS
&__DDRSS_CTL_235__SFR_OFFS=0x3ac
LOCAL &__DDRSS_CTL_236__SFR_OFFS
&__DDRSS_CTL_236__SFR_OFFS=0x3b0
LOCAL &__DDRSS_CTL_237__SFR_OFFS
&__DDRSS_CTL_237__SFR_OFFS=0x3b4
LOCAL &__DDRSS_CTL_238__SFR_OFFS
&__DDRSS_CTL_238__SFR_OFFS=0x3b8
LOCAL &__DDRSS_CTL_239__SFR_OFFS
&__DDRSS_CTL_239__SFR_OFFS=0x3bc
LOCAL &__DDRSS_CTL_240__SFR_OFFS
&__DDRSS_CTL_240__SFR_OFFS=0x3c0
LOCAL &__DDRSS_CTL_241__SFR_OFFS
&__DDRSS_CTL_241__SFR_OFFS=0x3c4
LOCAL &__DDRSS_CTL_242__SFR_OFFS
&__DDRSS_CTL_242__SFR_OFFS=0x3c8
LOCAL &__DDRSS_CTL_243__SFR_OFFS
&__DDRSS_CTL_243__SFR_OFFS=0x3cc
LOCAL &__DDRSS_CTL_244__SFR_OFFS
&__DDRSS_CTL_244__SFR_OFFS=0x3d0
LOCAL &__DDRSS_CTL_245__SFR_OFFS
&__DDRSS_CTL_245__SFR_OFFS=0x3d4
LOCAL &__DDRSS_CTL_246__SFR_OFFS
&__DDRSS_CTL_246__SFR_OFFS=0x3d8
LOCAL &__DDRSS_CTL_247__SFR_OFFS
&__DDRSS_CTL_247__SFR_OFFS=0x3dc
LOCAL &__DDRSS_CTL_248__SFR_OFFS
&__DDRSS_CTL_248__SFR_OFFS=0x3e0
LOCAL &__DDRSS_CTL_249__SFR_OFFS
&__DDRSS_CTL_249__SFR_OFFS=0x3e4
LOCAL &__DDRSS_CTL_250__SFR_OFFS
&__DDRSS_CTL_250__SFR_OFFS=0x3e8
LOCAL &__DDRSS_CTL_251__SFR_OFFS
&__DDRSS_CTL_251__SFR_OFFS=0x3ec
LOCAL &__DDRSS_CTL_252__SFR_OFFS
&__DDRSS_CTL_252__SFR_OFFS=0x3f0
LOCAL &__DDRSS_CTL_253__SFR_OFFS
&__DDRSS_CTL_253__SFR_OFFS=0x3f4
LOCAL &__DDRSS_CTL_254__SFR_OFFS
&__DDRSS_CTL_254__SFR_OFFS=0x3f8
LOCAL &__DDRSS_CTL_255__SFR_OFFS
&__DDRSS_CTL_255__SFR_OFFS=0x3fc
LOCAL &__DDRSS_CTL_256__SFR_OFFS
&__DDRSS_CTL_256__SFR_OFFS=0x400
LOCAL &__DDRSS_CTL_257__SFR_OFFS
&__DDRSS_CTL_257__SFR_OFFS=0x404
LOCAL &__DDRSS_CTL_258__SFR_OFFS
&__DDRSS_CTL_258__SFR_OFFS=0x408
LOCAL &__DDRSS_CTL_259__SFR_OFFS
&__DDRSS_CTL_259__SFR_OFFS=0x40c
LOCAL &__DDRSS_CTL_260__SFR_OFFS
&__DDRSS_CTL_260__SFR_OFFS=0x410
LOCAL &__DDRSS_CTL_261__SFR_OFFS
&__DDRSS_CTL_261__SFR_OFFS=0x414
LOCAL &__DDRSS_CTL_262__SFR_OFFS
&__DDRSS_CTL_262__SFR_OFFS=0x418
LOCAL &__DDRSS_CTL_263__SFR_OFFS
&__DDRSS_CTL_263__SFR_OFFS=0x41c
LOCAL &__DDRSS_CTL_264__SFR_OFFS
&__DDRSS_CTL_264__SFR_OFFS=0x420
LOCAL &__DDRSS_CTL_265__SFR_OFFS
&__DDRSS_CTL_265__SFR_OFFS=0x424
LOCAL &__DDRSS_CTL_266__SFR_OFFS
&__DDRSS_CTL_266__SFR_OFFS=0x428
LOCAL &__DDRSS_CTL_267__SFR_OFFS
&__DDRSS_CTL_267__SFR_OFFS=0x42c
LOCAL &__DDRSS_CTL_268__SFR_OFFS
&__DDRSS_CTL_268__SFR_OFFS=0x430
LOCAL &__DDRSS_CTL_269__SFR_OFFS
&__DDRSS_CTL_269__SFR_OFFS=0x434
LOCAL &__DDRSS_CTL_270__SFR_OFFS
&__DDRSS_CTL_270__SFR_OFFS=0x438
LOCAL &__DDRSS_CTL_271__SFR_OFFS
&__DDRSS_CTL_271__SFR_OFFS=0x43c
LOCAL &__DDRSS_CTL_272__SFR_OFFS
&__DDRSS_CTL_272__SFR_OFFS=0x440
LOCAL &__DDRSS_CTL_273__SFR_OFFS
&__DDRSS_CTL_273__SFR_OFFS=0x444
LOCAL &__DDRSS_CTL_274__SFR_OFFS
&__DDRSS_CTL_274__SFR_OFFS=0x448
LOCAL &__DDRSS_CTL_275__SFR_OFFS
&__DDRSS_CTL_275__SFR_OFFS=0x44c
LOCAL &__DDRSS_CTL_276__SFR_OFFS
&__DDRSS_CTL_276__SFR_OFFS=0x450
LOCAL &__DDRSS_CTL_277__SFR_OFFS
&__DDRSS_CTL_277__SFR_OFFS=0x454
LOCAL &__DDRSS_CTL_278__SFR_OFFS
&__DDRSS_CTL_278__SFR_OFFS=0x458
LOCAL &__DDRSS_CTL_279__SFR_OFFS
&__DDRSS_CTL_279__SFR_OFFS=0x45c
LOCAL &__DDRSS_CTL_280__SFR_OFFS
&__DDRSS_CTL_280__SFR_OFFS=0x460
LOCAL &__DDRSS_CTL_281__SFR_OFFS
&__DDRSS_CTL_281__SFR_OFFS=0x464
LOCAL &__DDRSS_CTL_282__SFR_OFFS
&__DDRSS_CTL_282__SFR_OFFS=0x468
LOCAL &__DDRSS_CTL_283__SFR_OFFS
&__DDRSS_CTL_283__SFR_OFFS=0x46c
LOCAL &__DDRSS_CTL_284__SFR_OFFS
&__DDRSS_CTL_284__SFR_OFFS=0x470
LOCAL &__DDRSS_CTL_285__SFR_OFFS
&__DDRSS_CTL_285__SFR_OFFS=0x474
LOCAL &__DDRSS_CTL_286__SFR_OFFS
&__DDRSS_CTL_286__SFR_OFFS=0x478
LOCAL &__DDRSS_CTL_287__SFR_OFFS
&__DDRSS_CTL_287__SFR_OFFS=0x47c
LOCAL &__DDRSS_CTL_288__SFR_OFFS
&__DDRSS_CTL_288__SFR_OFFS=0x480
LOCAL &__DDRSS_CTL_289__SFR_OFFS
&__DDRSS_CTL_289__SFR_OFFS=0x484
LOCAL &__DDRSS_CTL_290__SFR_OFFS
&__DDRSS_CTL_290__SFR_OFFS=0x488
LOCAL &__DDRSS_CTL_291__SFR_OFFS
&__DDRSS_CTL_291__SFR_OFFS=0x48c
LOCAL &__DDRSS_CTL_292__SFR_OFFS
&__DDRSS_CTL_292__SFR_OFFS=0x490
LOCAL &__DDRSS_CTL_293__SFR_OFFS
&__DDRSS_CTL_293__SFR_OFFS=0x494
LOCAL &__DDRSS_CTL_294__SFR_OFFS
&__DDRSS_CTL_294__SFR_OFFS=0x498
LOCAL &__DDRSS_CTL_295__SFR_OFFS
&__DDRSS_CTL_295__SFR_OFFS=0x49c
LOCAL &__DDRSS_CTL_296__SFR_OFFS
&__DDRSS_CTL_296__SFR_OFFS=0x4a0
LOCAL &__DDRSS_CTL_297__SFR_OFFS
&__DDRSS_CTL_297__SFR_OFFS=0x4a4
LOCAL &__DDRSS_CTL_298__SFR_OFFS
&__DDRSS_CTL_298__SFR_OFFS=0x4a8
LOCAL &__DDRSS_CTL_299__SFR_OFFS
&__DDRSS_CTL_299__SFR_OFFS=0x4ac
LOCAL &__DDRSS_CTL_300__SFR_OFFS
&__DDRSS_CTL_300__SFR_OFFS=0x4b0
LOCAL &__DDRSS_CTL_301__SFR_OFFS
&__DDRSS_CTL_301__SFR_OFFS=0x4b4
LOCAL &__DDRSS_CTL_302__SFR_OFFS
&__DDRSS_CTL_302__SFR_OFFS=0x4b8
LOCAL &__DDRSS_CTL_303__SFR_OFFS
&__DDRSS_CTL_303__SFR_OFFS=0x4bc
LOCAL &__DDRSS_CTL_304__SFR_OFFS
&__DDRSS_CTL_304__SFR_OFFS=0x4c0
LOCAL &__DDRSS_CTL_305__SFR_OFFS
&__DDRSS_CTL_305__SFR_OFFS=0x4c4
LOCAL &__DDRSS_CTL_306__SFR_OFFS
&__DDRSS_CTL_306__SFR_OFFS=0x4c8
LOCAL &__DDRSS_CTL_307__SFR_OFFS
&__DDRSS_CTL_307__SFR_OFFS=0x4cc
LOCAL &__DDRSS_CTL_308__SFR_OFFS
&__DDRSS_CTL_308__SFR_OFFS=0x4d0
LOCAL &__DDRSS_CTL_309__SFR_OFFS
&__DDRSS_CTL_309__SFR_OFFS=0x4d4
LOCAL &__DDRSS_CTL_310__SFR_OFFS
&__DDRSS_CTL_310__SFR_OFFS=0x4d8
LOCAL &__DDRSS_CTL_311__SFR_OFFS
&__DDRSS_CTL_311__SFR_OFFS=0x4dc
LOCAL &__DDRSS_CTL_312__SFR_OFFS
&__DDRSS_CTL_312__SFR_OFFS=0x4e0
LOCAL &__DDRSS_CTL_313__SFR_OFFS
&__DDRSS_CTL_313__SFR_OFFS=0x4e4
LOCAL &__DDRSS_CTL_314__SFR_OFFS
&__DDRSS_CTL_314__SFR_OFFS=0x4e8
LOCAL &__DDRSS_CTL_315__SFR_OFFS
&__DDRSS_CTL_315__SFR_OFFS=0x4ec
LOCAL &__DDRSS_CTL_316__SFR_OFFS
&__DDRSS_CTL_316__SFR_OFFS=0x4f0
LOCAL &__DDRSS_CTL_317__SFR_OFFS
&__DDRSS_CTL_317__SFR_OFFS=0x4f4
LOCAL &__DDRSS_CTL_318__SFR_OFFS
&__DDRSS_CTL_318__SFR_OFFS=0x4f8
LOCAL &__DDRSS_CTL_319__SFR_OFFS
&__DDRSS_CTL_319__SFR_OFFS=0x4fc
LOCAL &__DDRSS_CTL_320__SFR_OFFS
&__DDRSS_CTL_320__SFR_OFFS=0x500
LOCAL &__DDRSS_CTL_321__SFR_OFFS
&__DDRSS_CTL_321__SFR_OFFS=0x504
LOCAL &__DDRSS_CTL_322__SFR_OFFS
&__DDRSS_CTL_322__SFR_OFFS=0x508
LOCAL &__DDRSS_CTL_323__SFR_OFFS
&__DDRSS_CTL_323__SFR_OFFS=0x50c
LOCAL &__DDRSS_CTL_324__SFR_OFFS
&__DDRSS_CTL_324__SFR_OFFS=0x510
LOCAL &__DDRSS_CTL_325__SFR_OFFS
&__DDRSS_CTL_325__SFR_OFFS=0x514
LOCAL &__DDRSS_CTL_326__SFR_OFFS
&__DDRSS_CTL_326__SFR_OFFS=0x518
LOCAL &__DDRSS_CTL_327__SFR_OFFS
&__DDRSS_CTL_327__SFR_OFFS=0x51c
LOCAL &__DDRSS_CTL_328__SFR_OFFS
&__DDRSS_CTL_328__SFR_OFFS=0x520
LOCAL &__DDRSS_CTL_329__SFR_OFFS
&__DDRSS_CTL_329__SFR_OFFS=0x524
LOCAL &__DDRSS_CTL_330__SFR_OFFS
&__DDRSS_CTL_330__SFR_OFFS=0x528
LOCAL &__DDRSS_CTL_331__SFR_OFFS
&__DDRSS_CTL_331__SFR_OFFS=0x52c
LOCAL &__DDRSS_CTL_332__SFR_OFFS
&__DDRSS_CTL_332__SFR_OFFS=0x530
LOCAL &__DDRSS_CTL_333__SFR_OFFS
&__DDRSS_CTL_333__SFR_OFFS=0x534
LOCAL &__DDRSS_CTL_334__SFR_OFFS
&__DDRSS_CTL_334__SFR_OFFS=0x538
LOCAL &__DDRSS_CTL_335__SFR_OFFS
&__DDRSS_CTL_335__SFR_OFFS=0x53c
LOCAL &__DDRSS_CTL_336__SFR_OFFS
&__DDRSS_CTL_336__SFR_OFFS=0x540
LOCAL &__DDRSS_CTL_337__SFR_OFFS
&__DDRSS_CTL_337__SFR_OFFS=0x544
LOCAL &__DDRSS_CTL_338__SFR_OFFS
&__DDRSS_CTL_338__SFR_OFFS=0x548
LOCAL &__DDRSS_CTL_339__SFR_OFFS
&__DDRSS_CTL_339__SFR_OFFS=0x54c
LOCAL &__DDRSS_CTL_340__SFR_OFFS
&__DDRSS_CTL_340__SFR_OFFS=0x550
LOCAL &__DDRSS_CTL_341__SFR_OFFS
&__DDRSS_CTL_341__SFR_OFFS=0x554
LOCAL &__DDRSS_CTL_342__SFR_OFFS
&__DDRSS_CTL_342__SFR_OFFS=0x558
LOCAL &__DDRSS_CTL_343__SFR_OFFS
&__DDRSS_CTL_343__SFR_OFFS=0x55c
LOCAL &__DDRSS_CTL_344__SFR_OFFS
&__DDRSS_CTL_344__SFR_OFFS=0x560
LOCAL &__DDRSS_CTL_345__SFR_OFFS
&__DDRSS_CTL_345__SFR_OFFS=0x564
LOCAL &__DDRSS_CTL_346__SFR_OFFS
&__DDRSS_CTL_346__SFR_OFFS=0x568
LOCAL &__DDRSS_CTL_347__SFR_OFFS
&__DDRSS_CTL_347__SFR_OFFS=0x56c
LOCAL &__DDRSS_CTL_348__SFR_OFFS
&__DDRSS_CTL_348__SFR_OFFS=0x570
LOCAL &__DDRSS_CTL_349__SFR_OFFS
&__DDRSS_CTL_349__SFR_OFFS=0x574
LOCAL &__DDRSS_CTL_350__SFR_OFFS
&__DDRSS_CTL_350__SFR_OFFS=0x578
LOCAL &__DDRSS_CTL_351__SFR_OFFS
&__DDRSS_CTL_351__SFR_OFFS=0x57c
LOCAL &__DDRSS_CTL_352__SFR_OFFS
&__DDRSS_CTL_352__SFR_OFFS=0x580
LOCAL &__DDRSS_CTL_353__SFR_OFFS
&__DDRSS_CTL_353__SFR_OFFS=0x584
LOCAL &__DDRSS_CTL_354__SFR_OFFS
&__DDRSS_CTL_354__SFR_OFFS=0x588
LOCAL &__DDRSS_CTL_355__SFR_OFFS
&__DDRSS_CTL_355__SFR_OFFS=0x58c
LOCAL &__DDRSS_CTL_356__SFR_OFFS
&__DDRSS_CTL_356__SFR_OFFS=0x590
LOCAL &__DDRSS_CTL_357__SFR_OFFS
&__DDRSS_CTL_357__SFR_OFFS=0x594
LOCAL &__DDRSS_CTL_358__SFR_OFFS
&__DDRSS_CTL_358__SFR_OFFS=0x598
LOCAL &__DDRSS_CTL_359__SFR_OFFS
&__DDRSS_CTL_359__SFR_OFFS=0x59c
LOCAL &__DDRSS_CTL_360__SFR_OFFS
&__DDRSS_CTL_360__SFR_OFFS=0x5a0
LOCAL &__DDRSS_CTL_361__SFR_OFFS
&__DDRSS_CTL_361__SFR_OFFS=0x5a4
LOCAL &__DDRSS_CTL_362__SFR_OFFS
&__DDRSS_CTL_362__SFR_OFFS=0x5a8
LOCAL &__DDRSS_CTL_363__SFR_OFFS
&__DDRSS_CTL_363__SFR_OFFS=0x5ac
LOCAL &__DDRSS_CTL_364__SFR_OFFS
&__DDRSS_CTL_364__SFR_OFFS=0x5b0
LOCAL &__DDRSS_CTL_365__SFR_OFFS
&__DDRSS_CTL_365__SFR_OFFS=0x5b4
LOCAL &__DDRSS_CTL_366__SFR_OFFS
&__DDRSS_CTL_366__SFR_OFFS=0x5b8
LOCAL &__DDRSS_CTL_367__SFR_OFFS
&__DDRSS_CTL_367__SFR_OFFS=0x5bc
LOCAL &__DDRSS_CTL_368__SFR_OFFS
&__DDRSS_CTL_368__SFR_OFFS=0x5c0
LOCAL &__DDRSS_CTL_369__SFR_OFFS
&__DDRSS_CTL_369__SFR_OFFS=0x5c4
LOCAL &__DDRSS_CTL_370__SFR_OFFS
&__DDRSS_CTL_370__SFR_OFFS=0x5c8
LOCAL &__DDRSS_CTL_371__SFR_OFFS
&__DDRSS_CTL_371__SFR_OFFS=0x5cc
LOCAL &__DDRSS_CTL_372__SFR_OFFS
&__DDRSS_CTL_372__SFR_OFFS=0x5d0
LOCAL &__DDRSS_CTL_373__SFR_OFFS
&__DDRSS_CTL_373__SFR_OFFS=0x5d4
LOCAL &__DDRSS_CTL_374__SFR_OFFS
&__DDRSS_CTL_374__SFR_OFFS=0x5d8
LOCAL &__DDRSS_CTL_375__SFR_OFFS
&__DDRSS_CTL_375__SFR_OFFS=0x5dc
LOCAL &__DDRSS_CTL_376__SFR_OFFS
&__DDRSS_CTL_376__SFR_OFFS=0x5e0
LOCAL &__DDRSS_CTL_377__SFR_OFFS
&__DDRSS_CTL_377__SFR_OFFS=0x5e4
LOCAL &__DDRSS_CTL_378__SFR_OFFS
&__DDRSS_CTL_378__SFR_OFFS=0x5e8
LOCAL &__DDRSS_CTL_379__SFR_OFFS
&__DDRSS_CTL_379__SFR_OFFS=0x5ec
LOCAL &__DDRSS_CTL_380__SFR_OFFS
&__DDRSS_CTL_380__SFR_OFFS=0x5f0
LOCAL &__DDRSS_CTL_381__SFR_OFFS
&__DDRSS_CTL_381__SFR_OFFS=0x5f4
LOCAL &__DDRSS_CTL_382__SFR_OFFS
&__DDRSS_CTL_382__SFR_OFFS=0x5f8
LOCAL &__DDRSS_CTL_383__SFR_OFFS
&__DDRSS_CTL_383__SFR_OFFS=0x5fc
LOCAL &__DDRSS_CTL_384__SFR_OFFS
&__DDRSS_CTL_384__SFR_OFFS=0x600
LOCAL &__DDRSS_CTL_385__SFR_OFFS
&__DDRSS_CTL_385__SFR_OFFS=0x604
LOCAL &__DDRSS_CTL_386__SFR_OFFS
&__DDRSS_CTL_386__SFR_OFFS=0x608
LOCAL &__DDRSS_CTL_387__SFR_OFFS
&__DDRSS_CTL_387__SFR_OFFS=0x60c
LOCAL &__DDRSS_CTL_388__SFR_OFFS
&__DDRSS_CTL_388__SFR_OFFS=0x610
LOCAL &__DDRSS_CTL_389__SFR_OFFS
&__DDRSS_CTL_389__SFR_OFFS=0x614
LOCAL &__DDRSS_CTL_390__SFR_OFFS
&__DDRSS_CTL_390__SFR_OFFS=0x618
LOCAL &__DDRSS_CTL_391__SFR_OFFS
&__DDRSS_CTL_391__SFR_OFFS=0x61c
LOCAL &__DDRSS_CTL_392__SFR_OFFS
&__DDRSS_CTL_392__SFR_OFFS=0x620
LOCAL &__DDRSS_CTL_393__SFR_OFFS
&__DDRSS_CTL_393__SFR_OFFS=0x624
LOCAL &__DDRSS_CTL_394__SFR_OFFS
&__DDRSS_CTL_394__SFR_OFFS=0x628
LOCAL &__DDRSS_CTL_395__SFR_OFFS
&__DDRSS_CTL_395__SFR_OFFS=0x62c
LOCAL &__DDRSS_CTL_396__SFR_OFFS
&__DDRSS_CTL_396__SFR_OFFS=0x630
LOCAL &__DDRSS_CTL_397__SFR_OFFS
&__DDRSS_CTL_397__SFR_OFFS=0x634
LOCAL &__DDRSS_CTL_398__SFR_OFFS
&__DDRSS_CTL_398__SFR_OFFS=0x638
LOCAL &__DDRSS_CTL_399__SFR_OFFS
&__DDRSS_CTL_399__SFR_OFFS=0x63c
LOCAL &__DDRSS_CTL_400__SFR_OFFS
&__DDRSS_CTL_400__SFR_OFFS=0x640
LOCAL &__DDRSS_CTL_401__SFR_OFFS
&__DDRSS_CTL_401__SFR_OFFS=0x644
LOCAL &__DDRSS_CTL_402__SFR_OFFS
&__DDRSS_CTL_402__SFR_OFFS=0x648
LOCAL &__DDRSS_CTL_403__SFR_OFFS
&__DDRSS_CTL_403__SFR_OFFS=0x64c
LOCAL &__DDRSS_CTL_404__SFR_OFFS
&__DDRSS_CTL_404__SFR_OFFS=0x650
LOCAL &__DDRSS_CTL_405__SFR_OFFS
&__DDRSS_CTL_405__SFR_OFFS=0x654
LOCAL &__DDRSS_CTL_406__SFR_OFFS
&__DDRSS_CTL_406__SFR_OFFS=0x658
LOCAL &__DDRSS_CTL_407__SFR_OFFS
&__DDRSS_CTL_407__SFR_OFFS=0x65c
LOCAL &__DDRSS_CTL_408__SFR_OFFS
&__DDRSS_CTL_408__SFR_OFFS=0x660
LOCAL &__DDRSS_CTL_409__SFR_OFFS
&__DDRSS_CTL_409__SFR_OFFS=0x664
LOCAL &__DDRSS_CTL_410__SFR_OFFS
&__DDRSS_CTL_410__SFR_OFFS=0x668
LOCAL &__DDRSS_CTL_411__SFR_OFFS
&__DDRSS_CTL_411__SFR_OFFS=0x66c
LOCAL &__DDRSS_CTL_412__SFR_OFFS
&__DDRSS_CTL_412__SFR_OFFS=0x670
LOCAL &__DDRSS_CTL_413__SFR_OFFS
&__DDRSS_CTL_413__SFR_OFFS=0x674
LOCAL &__DDRSS_CTL_414__SFR_OFFS
&__DDRSS_CTL_414__SFR_OFFS=0x678
LOCAL &__DDRSS_CTL_415__SFR_OFFS
&__DDRSS_CTL_415__SFR_OFFS=0x67c
LOCAL &__DDRSS_CTL_416__SFR_OFFS
&__DDRSS_CTL_416__SFR_OFFS=0x680
LOCAL &__DDRSS_CTL_417__SFR_OFFS
&__DDRSS_CTL_417__SFR_OFFS=0x684
LOCAL &__DDRSS_CTL_418__SFR_OFFS
&__DDRSS_CTL_418__SFR_OFFS=0x688
LOCAL &__DDRSS_CTL_419__SFR_OFFS
&__DDRSS_CTL_419__SFR_OFFS=0x68c
LOCAL &__DDRSS_CTL_420__SFR_OFFS
&__DDRSS_CTL_420__SFR_OFFS=0x690
LOCAL &__DDRSS_CTL_421__SFR_OFFS
&__DDRSS_CTL_421__SFR_OFFS=0x694
LOCAL &__DDRSS_CTL_422__SFR_OFFS
&__DDRSS_CTL_422__SFR_OFFS=0x698
LOCAL &__DDRSS_CTL_423__SFR_OFFS
&__DDRSS_CTL_423__SFR_OFFS=0x69c
LOCAL &__DDRSS_CTL_424__SFR_OFFS
&__DDRSS_CTL_424__SFR_OFFS=0x6a0
LOCAL &__DDRSS_CTL_425__SFR_OFFS
&__DDRSS_CTL_425__SFR_OFFS=0x6a4
LOCAL &__DDRSS_CTL_426__SFR_OFFS
&__DDRSS_CTL_426__SFR_OFFS=0x6a8
LOCAL &__DDRSS_CTL_427__SFR_OFFS
&__DDRSS_CTL_427__SFR_OFFS=0x6ac
LOCAL &__DDRSS_CTL_428__SFR_OFFS
&__DDRSS_CTL_428__SFR_OFFS=0x6b0
LOCAL &__DDRSS_CTL_429__SFR_OFFS
&__DDRSS_CTL_429__SFR_OFFS=0x6b4
LOCAL &__DDRSS_CTL_430__SFR_OFFS
&__DDRSS_CTL_430__SFR_OFFS=0x6b8
LOCAL &__DDRSS_CTL_431__SFR_OFFS
&__DDRSS_CTL_431__SFR_OFFS=0x6bc
LOCAL &__DDRSS_CTL_432__SFR_OFFS
&__DDRSS_CTL_432__SFR_OFFS=0x6c0
LOCAL &__DDRSS_CTL_433__SFR_OFFS
&__DDRSS_CTL_433__SFR_OFFS=0x6c4
LOCAL &__DDRSS_CTL_434__SFR_OFFS
&__DDRSS_CTL_434__SFR_OFFS=0x6c8
LOCAL &__DDRSS_CTL_435__SFR_OFFS
&__DDRSS_CTL_435__SFR_OFFS=0x6cc
LOCAL &__DDRSS_CTL_436__SFR_OFFS
&__DDRSS_CTL_436__SFR_OFFS=0x6d0
LOCAL &__DDRSS_CTL_437__SFR_OFFS
&__DDRSS_CTL_437__SFR_OFFS=0x6d4
LOCAL &__DDRSS_CTL_438__SFR_OFFS
&__DDRSS_CTL_438__SFR_OFFS=0x6d8
LOCAL &__DDRSS_CTL_439__SFR_OFFS
&__DDRSS_CTL_439__SFR_OFFS=0x6dc
LOCAL &__DDRSS_CTL_440__SFR_OFFS
&__DDRSS_CTL_440__SFR_OFFS=0x6e0
LOCAL &__DDRSS_CTL_441__SFR_OFFS
&__DDRSS_CTL_441__SFR_OFFS=0x6e4
LOCAL &__DDRSS_CTL_442__SFR_OFFS
&__DDRSS_CTL_442__SFR_OFFS=0x6e8
LOCAL &__DDRSS_CTL_443__SFR_OFFS
&__DDRSS_CTL_443__SFR_OFFS=0x6ec
LOCAL &__DDRSS_CTL_444__SFR_OFFS
&__DDRSS_CTL_444__SFR_OFFS=0x6f0
LOCAL &__DDRSS_CTL_445__SFR_OFFS
&__DDRSS_CTL_445__SFR_OFFS=0x6f4
LOCAL &__DDRSS_CTL_446__SFR_OFFS
&__DDRSS_CTL_446__SFR_OFFS=0x6f8
LOCAL &__DDRSS_CTL_447__SFR_OFFS
&__DDRSS_CTL_447__SFR_OFFS=0x6fc
LOCAL &__DDRSS_CTL_448__SFR_OFFS
&__DDRSS_CTL_448__SFR_OFFS=0x700
LOCAL &__DDRSS_CTL_449__SFR_OFFS
&__DDRSS_CTL_449__SFR_OFFS=0x704
LOCAL &__DDRSS_CTL_450__SFR_OFFS
&__DDRSS_CTL_450__SFR_OFFS=0x708
LOCAL &__DDRSS_CTL_451__SFR_OFFS
&__DDRSS_CTL_451__SFR_OFFS=0x70c
LOCAL &__DDRSS_CTL_452__SFR_OFFS
&__DDRSS_CTL_452__SFR_OFFS=0x710
LOCAL &__DDRSS_CTL_453__SFR_OFFS
&__DDRSS_CTL_453__SFR_OFFS=0x714
LOCAL &__DDRSS_CTL_454__SFR_OFFS
&__DDRSS_CTL_454__SFR_OFFS=0x718
LOCAL &__DDRSS_CTL_455__SFR_OFFS
&__DDRSS_CTL_455__SFR_OFFS=0x71c
LOCAL &__DDRSS_CTL_456__SFR_OFFS
&__DDRSS_CTL_456__SFR_OFFS=0x720
LOCAL &__DDRSS_CTL_457__SFR_OFFS
&__DDRSS_CTL_457__SFR_OFFS=0x724
LOCAL &__DDRSS_CTL_458__SFR_OFFS
&__DDRSS_CTL_458__SFR_OFFS=0x728
// --  Macros for register block PI 
LOCAL &__DDRSS_PI_REGISTER_BLOCK__OFFS
&__DDRSS_PI_REGISTER_BLOCK__OFFS=0x2000
LOCAL &__DDRSS_PI_0__SFR_OFFS
&__DDRSS_PI_0__SFR_OFFS=0x0
LOCAL &__DDRSS_PI_1__SFR_OFFS
&__DDRSS_PI_1__SFR_OFFS=0x4
LOCAL &__DDRSS_PI_2__SFR_OFFS
&__DDRSS_PI_2__SFR_OFFS=0x8
LOCAL &__DDRSS_PI_3__SFR_OFFS
&__DDRSS_PI_3__SFR_OFFS=0xc
LOCAL &__DDRSS_PI_4__SFR_OFFS
&__DDRSS_PI_4__SFR_OFFS=0x10
LOCAL &__DDRSS_PI_5__SFR_OFFS
&__DDRSS_PI_5__SFR_OFFS=0x14
LOCAL &__DDRSS_PI_6__SFR_OFFS
&__DDRSS_PI_6__SFR_OFFS=0x18
LOCAL &__DDRSS_PI_7__SFR_OFFS
&__DDRSS_PI_7__SFR_OFFS=0x1c
LOCAL &__DDRSS_PI_8__SFR_OFFS
&__DDRSS_PI_8__SFR_OFFS=0x20
LOCAL &__DDRSS_PI_9__SFR_OFFS
&__DDRSS_PI_9__SFR_OFFS=0x24
LOCAL &__DDRSS_PI_10__SFR_OFFS
&__DDRSS_PI_10__SFR_OFFS=0x28
LOCAL &__DDRSS_PI_11__SFR_OFFS
&__DDRSS_PI_11__SFR_OFFS=0x2c
LOCAL &__DDRSS_PI_12__SFR_OFFS
&__DDRSS_PI_12__SFR_OFFS=0x30
LOCAL &__DDRSS_PI_13__SFR_OFFS
&__DDRSS_PI_13__SFR_OFFS=0x34
LOCAL &__DDRSS_PI_14__SFR_OFFS
&__DDRSS_PI_14__SFR_OFFS=0x38
LOCAL &__DDRSS_PI_15__SFR_OFFS
&__DDRSS_PI_15__SFR_OFFS=0x3c
LOCAL &__DDRSS_PI_16__SFR_OFFS
&__DDRSS_PI_16__SFR_OFFS=0x40
LOCAL &__DDRSS_PI_17__SFR_OFFS
&__DDRSS_PI_17__SFR_OFFS=0x44
LOCAL &__DDRSS_PI_18__SFR_OFFS
&__DDRSS_PI_18__SFR_OFFS=0x48
LOCAL &__DDRSS_PI_19__SFR_OFFS
&__DDRSS_PI_19__SFR_OFFS=0x4c
LOCAL &__DDRSS_PI_20__SFR_OFFS
&__DDRSS_PI_20__SFR_OFFS=0x50
LOCAL &__DDRSS_PI_21__SFR_OFFS
&__DDRSS_PI_21__SFR_OFFS=0x54
LOCAL &__DDRSS_PI_22__SFR_OFFS
&__DDRSS_PI_22__SFR_OFFS=0x58
LOCAL &__DDRSS_PI_23__SFR_OFFS
&__DDRSS_PI_23__SFR_OFFS=0x5c
LOCAL &__DDRSS_PI_24__SFR_OFFS
&__DDRSS_PI_24__SFR_OFFS=0x60
LOCAL &__DDRSS_PI_25__SFR_OFFS
&__DDRSS_PI_25__SFR_OFFS=0x64
LOCAL &__DDRSS_PI_26__SFR_OFFS
&__DDRSS_PI_26__SFR_OFFS=0x68
LOCAL &__DDRSS_PI_27__SFR_OFFS
&__DDRSS_PI_27__SFR_OFFS=0x6c
LOCAL &__DDRSS_PI_28__SFR_OFFS
&__DDRSS_PI_28__SFR_OFFS=0x70
LOCAL &__DDRSS_PI_29__SFR_OFFS
&__DDRSS_PI_29__SFR_OFFS=0x74
LOCAL &__DDRSS_PI_30__SFR_OFFS
&__DDRSS_PI_30__SFR_OFFS=0x78
LOCAL &__DDRSS_PI_31__SFR_OFFS
&__DDRSS_PI_31__SFR_OFFS=0x7c
LOCAL &__DDRSS_PI_32__SFR_OFFS
&__DDRSS_PI_32__SFR_OFFS=0x80
LOCAL &__DDRSS_PI_33__SFR_OFFS
&__DDRSS_PI_33__SFR_OFFS=0x84
LOCAL &__DDRSS_PI_34__SFR_OFFS
&__DDRSS_PI_34__SFR_OFFS=0x88
LOCAL &__DDRSS_PI_35__SFR_OFFS
&__DDRSS_PI_35__SFR_OFFS=0x8c
LOCAL &__DDRSS_PI_36__SFR_OFFS
&__DDRSS_PI_36__SFR_OFFS=0x90
LOCAL &__DDRSS_PI_37__SFR_OFFS
&__DDRSS_PI_37__SFR_OFFS=0x94
LOCAL &__DDRSS_PI_38__SFR_OFFS
&__DDRSS_PI_38__SFR_OFFS=0x98
LOCAL &__DDRSS_PI_39__SFR_OFFS
&__DDRSS_PI_39__SFR_OFFS=0x9c
LOCAL &__DDRSS_PI_40__SFR_OFFS
&__DDRSS_PI_40__SFR_OFFS=0xa0
LOCAL &__DDRSS_PI_41__SFR_OFFS
&__DDRSS_PI_41__SFR_OFFS=0xa4
LOCAL &__DDRSS_PI_42__SFR_OFFS
&__DDRSS_PI_42__SFR_OFFS=0xa8
LOCAL &__DDRSS_PI_43__SFR_OFFS
&__DDRSS_PI_43__SFR_OFFS=0xac
LOCAL &__DDRSS_PI_44__SFR_OFFS
&__DDRSS_PI_44__SFR_OFFS=0xb0
LOCAL &__DDRSS_PI_45__SFR_OFFS
&__DDRSS_PI_45__SFR_OFFS=0xb4
LOCAL &__DDRSS_PI_46__SFR_OFFS
&__DDRSS_PI_46__SFR_OFFS=0xb8
LOCAL &__DDRSS_PI_47__SFR_OFFS
&__DDRSS_PI_47__SFR_OFFS=0xbc
LOCAL &__DDRSS_PI_48__SFR_OFFS
&__DDRSS_PI_48__SFR_OFFS=0xc0
LOCAL &__DDRSS_PI_49__SFR_OFFS
&__DDRSS_PI_49__SFR_OFFS=0xc4
LOCAL &__DDRSS_PI_50__SFR_OFFS
&__DDRSS_PI_50__SFR_OFFS=0xc8
LOCAL &__DDRSS_PI_51__SFR_OFFS
&__DDRSS_PI_51__SFR_OFFS=0xcc
LOCAL &__DDRSS_PI_52__SFR_OFFS
&__DDRSS_PI_52__SFR_OFFS=0xd0
LOCAL &__DDRSS_PI_53__SFR_OFFS
&__DDRSS_PI_53__SFR_OFFS=0xd4
LOCAL &__DDRSS_PI_54__SFR_OFFS
&__DDRSS_PI_54__SFR_OFFS=0xd8
LOCAL &__DDRSS_PI_55__SFR_OFFS
&__DDRSS_PI_55__SFR_OFFS=0xdc
LOCAL &__DDRSS_PI_56__SFR_OFFS
&__DDRSS_PI_56__SFR_OFFS=0xe0
LOCAL &__DDRSS_PI_57__SFR_OFFS
&__DDRSS_PI_57__SFR_OFFS=0xe4
LOCAL &__DDRSS_PI_58__SFR_OFFS
&__DDRSS_PI_58__SFR_OFFS=0xe8
LOCAL &__DDRSS_PI_59__SFR_OFFS
&__DDRSS_PI_59__SFR_OFFS=0xec
LOCAL &__DDRSS_PI_60__SFR_OFFS
&__DDRSS_PI_60__SFR_OFFS=0xf0
LOCAL &__DDRSS_PI_61__SFR_OFFS
&__DDRSS_PI_61__SFR_OFFS=0xf4
LOCAL &__DDRSS_PI_62__SFR_OFFS
&__DDRSS_PI_62__SFR_OFFS=0xf8
LOCAL &__DDRSS_PI_63__SFR_OFFS
&__DDRSS_PI_63__SFR_OFFS=0xfc
LOCAL &__DDRSS_PI_64__SFR_OFFS
&__DDRSS_PI_64__SFR_OFFS=0x100
LOCAL &__DDRSS_PI_65__SFR_OFFS
&__DDRSS_PI_65__SFR_OFFS=0x104
LOCAL &__DDRSS_PI_66__SFR_OFFS
&__DDRSS_PI_66__SFR_OFFS=0x108
LOCAL &__DDRSS_PI_67__SFR_OFFS
&__DDRSS_PI_67__SFR_OFFS=0x10c
LOCAL &__DDRSS_PI_68__SFR_OFFS
&__DDRSS_PI_68__SFR_OFFS=0x110
LOCAL &__DDRSS_PI_69__SFR_OFFS
&__DDRSS_PI_69__SFR_OFFS=0x114
LOCAL &__DDRSS_PI_70__SFR_OFFS
&__DDRSS_PI_70__SFR_OFFS=0x118
LOCAL &__DDRSS_PI_71__SFR_OFFS
&__DDRSS_PI_71__SFR_OFFS=0x11c
LOCAL &__DDRSS_PI_72__SFR_OFFS
&__DDRSS_PI_72__SFR_OFFS=0x120
LOCAL &__DDRSS_PI_73__SFR_OFFS
&__DDRSS_PI_73__SFR_OFFS=0x124
LOCAL &__DDRSS_PI_74__SFR_OFFS
&__DDRSS_PI_74__SFR_OFFS=0x128
LOCAL &__DDRSS_PI_75__SFR_OFFS
&__DDRSS_PI_75__SFR_OFFS=0x12c
LOCAL &__DDRSS_PI_76__SFR_OFFS
&__DDRSS_PI_76__SFR_OFFS=0x130
LOCAL &__DDRSS_PI_77__SFR_OFFS
&__DDRSS_PI_77__SFR_OFFS=0x134
LOCAL &__DDRSS_PI_78__SFR_OFFS
&__DDRSS_PI_78__SFR_OFFS=0x138
LOCAL &__DDRSS_PI_79__SFR_OFFS
&__DDRSS_PI_79__SFR_OFFS=0x13c
LOCAL &__DDRSS_PI_80__SFR_OFFS
&__DDRSS_PI_80__SFR_OFFS=0x140
LOCAL &__DDRSS_PI_81__SFR_OFFS
&__DDRSS_PI_81__SFR_OFFS=0x144
LOCAL &__DDRSS_PI_82__SFR_OFFS
&__DDRSS_PI_82__SFR_OFFS=0x148
LOCAL &__DDRSS_PI_83__SFR_OFFS
&__DDRSS_PI_83__SFR_OFFS=0x14c
LOCAL &__DDRSS_PI_84__SFR_OFFS
&__DDRSS_PI_84__SFR_OFFS=0x150
LOCAL &__DDRSS_PI_85__SFR_OFFS
&__DDRSS_PI_85__SFR_OFFS=0x154
LOCAL &__DDRSS_PI_86__SFR_OFFS
&__DDRSS_PI_86__SFR_OFFS=0x158
LOCAL &__DDRSS_PI_87__SFR_OFFS
&__DDRSS_PI_87__SFR_OFFS=0x15c
LOCAL &__DDRSS_PI_88__SFR_OFFS
&__DDRSS_PI_88__SFR_OFFS=0x160
LOCAL &__DDRSS_PI_89__SFR_OFFS
&__DDRSS_PI_89__SFR_OFFS=0x164
LOCAL &__DDRSS_PI_90__SFR_OFFS
&__DDRSS_PI_90__SFR_OFFS=0x168
LOCAL &__DDRSS_PI_91__SFR_OFFS
&__DDRSS_PI_91__SFR_OFFS=0x16c
LOCAL &__DDRSS_PI_92__SFR_OFFS
&__DDRSS_PI_92__SFR_OFFS=0x170
LOCAL &__DDRSS_PI_93__SFR_OFFS
&__DDRSS_PI_93__SFR_OFFS=0x174
LOCAL &__DDRSS_PI_94__SFR_OFFS
&__DDRSS_PI_94__SFR_OFFS=0x178
LOCAL &__DDRSS_PI_95__SFR_OFFS
&__DDRSS_PI_95__SFR_OFFS=0x17c
LOCAL &__DDRSS_PI_96__SFR_OFFS
&__DDRSS_PI_96__SFR_OFFS=0x180
LOCAL &__DDRSS_PI_97__SFR_OFFS
&__DDRSS_PI_97__SFR_OFFS=0x184
LOCAL &__DDRSS_PI_98__SFR_OFFS
&__DDRSS_PI_98__SFR_OFFS=0x188
LOCAL &__DDRSS_PI_99__SFR_OFFS
&__DDRSS_PI_99__SFR_OFFS=0x18c
LOCAL &__DDRSS_PI_100__SFR_OFFS
&__DDRSS_PI_100__SFR_OFFS=0x190
LOCAL &__DDRSS_PI_101__SFR_OFFS
&__DDRSS_PI_101__SFR_OFFS=0x194
LOCAL &__DDRSS_PI_102__SFR_OFFS
&__DDRSS_PI_102__SFR_OFFS=0x198
LOCAL &__DDRSS_PI_103__SFR_OFFS
&__DDRSS_PI_103__SFR_OFFS=0x19c
LOCAL &__DDRSS_PI_104__SFR_OFFS
&__DDRSS_PI_104__SFR_OFFS=0x1a0
LOCAL &__DDRSS_PI_105__SFR_OFFS
&__DDRSS_PI_105__SFR_OFFS=0x1a4
LOCAL &__DDRSS_PI_106__SFR_OFFS
&__DDRSS_PI_106__SFR_OFFS=0x1a8
LOCAL &__DDRSS_PI_107__SFR_OFFS
&__DDRSS_PI_107__SFR_OFFS=0x1ac
LOCAL &__DDRSS_PI_108__SFR_OFFS
&__DDRSS_PI_108__SFR_OFFS=0x1b0
LOCAL &__DDRSS_PI_109__SFR_OFFS
&__DDRSS_PI_109__SFR_OFFS=0x1b4
LOCAL &__DDRSS_PI_110__SFR_OFFS
&__DDRSS_PI_110__SFR_OFFS=0x1b8
LOCAL &__DDRSS_PI_111__SFR_OFFS
&__DDRSS_PI_111__SFR_OFFS=0x1bc
LOCAL &__DDRSS_PI_112__SFR_OFFS
&__DDRSS_PI_112__SFR_OFFS=0x1c0
LOCAL &__DDRSS_PI_113__SFR_OFFS
&__DDRSS_PI_113__SFR_OFFS=0x1c4
LOCAL &__DDRSS_PI_114__SFR_OFFS
&__DDRSS_PI_114__SFR_OFFS=0x1c8
LOCAL &__DDRSS_PI_115__SFR_OFFS
&__DDRSS_PI_115__SFR_OFFS=0x1cc
LOCAL &__DDRSS_PI_116__SFR_OFFS
&__DDRSS_PI_116__SFR_OFFS=0x1d0
LOCAL &__DDRSS_PI_117__SFR_OFFS
&__DDRSS_PI_117__SFR_OFFS=0x1d4
LOCAL &__DDRSS_PI_118__SFR_OFFS
&__DDRSS_PI_118__SFR_OFFS=0x1d8
LOCAL &__DDRSS_PI_119__SFR_OFFS
&__DDRSS_PI_119__SFR_OFFS=0x1dc
LOCAL &__DDRSS_PI_120__SFR_OFFS
&__DDRSS_PI_120__SFR_OFFS=0x1e0
LOCAL &__DDRSS_PI_121__SFR_OFFS
&__DDRSS_PI_121__SFR_OFFS=0x1e4
LOCAL &__DDRSS_PI_122__SFR_OFFS
&__DDRSS_PI_122__SFR_OFFS=0x1e8
LOCAL &__DDRSS_PI_123__SFR_OFFS
&__DDRSS_PI_123__SFR_OFFS=0x1ec
LOCAL &__DDRSS_PI_124__SFR_OFFS
&__DDRSS_PI_124__SFR_OFFS=0x1f0
LOCAL &__DDRSS_PI_125__SFR_OFFS
&__DDRSS_PI_125__SFR_OFFS=0x1f4
LOCAL &__DDRSS_PI_126__SFR_OFFS
&__DDRSS_PI_126__SFR_OFFS=0x1f8
LOCAL &__DDRSS_PI_127__SFR_OFFS
&__DDRSS_PI_127__SFR_OFFS=0x1fc
LOCAL &__DDRSS_PI_128__SFR_OFFS
&__DDRSS_PI_128__SFR_OFFS=0x200
LOCAL &__DDRSS_PI_129__SFR_OFFS
&__DDRSS_PI_129__SFR_OFFS=0x204
LOCAL &__DDRSS_PI_130__SFR_OFFS
&__DDRSS_PI_130__SFR_OFFS=0x208
LOCAL &__DDRSS_PI_131__SFR_OFFS
&__DDRSS_PI_131__SFR_OFFS=0x20c
LOCAL &__DDRSS_PI_132__SFR_OFFS
&__DDRSS_PI_132__SFR_OFFS=0x210
LOCAL &__DDRSS_PI_133__SFR_OFFS
&__DDRSS_PI_133__SFR_OFFS=0x214
LOCAL &__DDRSS_PI_134__SFR_OFFS
&__DDRSS_PI_134__SFR_OFFS=0x218
LOCAL &__DDRSS_PI_135__SFR_OFFS
&__DDRSS_PI_135__SFR_OFFS=0x21c
LOCAL &__DDRSS_PI_136__SFR_OFFS
&__DDRSS_PI_136__SFR_OFFS=0x220
LOCAL &__DDRSS_PI_137__SFR_OFFS
&__DDRSS_PI_137__SFR_OFFS=0x224
LOCAL &__DDRSS_PI_138__SFR_OFFS
&__DDRSS_PI_138__SFR_OFFS=0x228
LOCAL &__DDRSS_PI_139__SFR_OFFS
&__DDRSS_PI_139__SFR_OFFS=0x22c
LOCAL &__DDRSS_PI_140__SFR_OFFS
&__DDRSS_PI_140__SFR_OFFS=0x230
LOCAL &__DDRSS_PI_141__SFR_OFFS
&__DDRSS_PI_141__SFR_OFFS=0x234
LOCAL &__DDRSS_PI_142__SFR_OFFS
&__DDRSS_PI_142__SFR_OFFS=0x238
LOCAL &__DDRSS_PI_143__SFR_OFFS
&__DDRSS_PI_143__SFR_OFFS=0x23c
LOCAL &__DDRSS_PI_144__SFR_OFFS
&__DDRSS_PI_144__SFR_OFFS=0x240
LOCAL &__DDRSS_PI_145__SFR_OFFS
&__DDRSS_PI_145__SFR_OFFS=0x244
LOCAL &__DDRSS_PI_146__SFR_OFFS
&__DDRSS_PI_146__SFR_OFFS=0x248
LOCAL &__DDRSS_PI_147__SFR_OFFS
&__DDRSS_PI_147__SFR_OFFS=0x24c
LOCAL &__DDRSS_PI_148__SFR_OFFS
&__DDRSS_PI_148__SFR_OFFS=0x250
LOCAL &__DDRSS_PI_149__SFR_OFFS
&__DDRSS_PI_149__SFR_OFFS=0x254
LOCAL &__DDRSS_PI_150__SFR_OFFS
&__DDRSS_PI_150__SFR_OFFS=0x258
LOCAL &__DDRSS_PI_151__SFR_OFFS
&__DDRSS_PI_151__SFR_OFFS=0x25c
LOCAL &__DDRSS_PI_152__SFR_OFFS
&__DDRSS_PI_152__SFR_OFFS=0x260
LOCAL &__DDRSS_PI_153__SFR_OFFS
&__DDRSS_PI_153__SFR_OFFS=0x264
LOCAL &__DDRSS_PI_154__SFR_OFFS
&__DDRSS_PI_154__SFR_OFFS=0x268
LOCAL &__DDRSS_PI_155__SFR_OFFS
&__DDRSS_PI_155__SFR_OFFS=0x26c
LOCAL &__DDRSS_PI_156__SFR_OFFS
&__DDRSS_PI_156__SFR_OFFS=0x270
LOCAL &__DDRSS_PI_157__SFR_OFFS
&__DDRSS_PI_157__SFR_OFFS=0x274
LOCAL &__DDRSS_PI_158__SFR_OFFS
&__DDRSS_PI_158__SFR_OFFS=0x278
LOCAL &__DDRSS_PI_159__SFR_OFFS
&__DDRSS_PI_159__SFR_OFFS=0x27c
LOCAL &__DDRSS_PI_160__SFR_OFFS
&__DDRSS_PI_160__SFR_OFFS=0x280
LOCAL &__DDRSS_PI_161__SFR_OFFS
&__DDRSS_PI_161__SFR_OFFS=0x284
LOCAL &__DDRSS_PI_162__SFR_OFFS
&__DDRSS_PI_162__SFR_OFFS=0x288
LOCAL &__DDRSS_PI_163__SFR_OFFS
&__DDRSS_PI_163__SFR_OFFS=0x28c
LOCAL &__DDRSS_PI_164__SFR_OFFS
&__DDRSS_PI_164__SFR_OFFS=0x290
LOCAL &__DDRSS_PI_165__SFR_OFFS
&__DDRSS_PI_165__SFR_OFFS=0x294
LOCAL &__DDRSS_PI_166__SFR_OFFS
&__DDRSS_PI_166__SFR_OFFS=0x298
LOCAL &__DDRSS_PI_167__SFR_OFFS
&__DDRSS_PI_167__SFR_OFFS=0x29c
LOCAL &__DDRSS_PI_168__SFR_OFFS
&__DDRSS_PI_168__SFR_OFFS=0x2a0
LOCAL &__DDRSS_PI_169__SFR_OFFS
&__DDRSS_PI_169__SFR_OFFS=0x2a4
LOCAL &__DDRSS_PI_170__SFR_OFFS
&__DDRSS_PI_170__SFR_OFFS=0x2a8
LOCAL &__DDRSS_PI_171__SFR_OFFS
&__DDRSS_PI_171__SFR_OFFS=0x2ac
LOCAL &__DDRSS_PI_172__SFR_OFFS
&__DDRSS_PI_172__SFR_OFFS=0x2b0
LOCAL &__DDRSS_PI_173__SFR_OFFS
&__DDRSS_PI_173__SFR_OFFS=0x2b4
LOCAL &__DDRSS_PI_174__SFR_OFFS
&__DDRSS_PI_174__SFR_OFFS=0x2b8
LOCAL &__DDRSS_PI_175__SFR_OFFS
&__DDRSS_PI_175__SFR_OFFS=0x2bc
LOCAL &__DDRSS_PI_176__SFR_OFFS
&__DDRSS_PI_176__SFR_OFFS=0x2c0
LOCAL &__DDRSS_PI_177__SFR_OFFS
&__DDRSS_PI_177__SFR_OFFS=0x2c4
LOCAL &__DDRSS_PI_178__SFR_OFFS
&__DDRSS_PI_178__SFR_OFFS=0x2c8
LOCAL &__DDRSS_PI_179__SFR_OFFS
&__DDRSS_PI_179__SFR_OFFS=0x2cc
LOCAL &__DDRSS_PI_180__SFR_OFFS
&__DDRSS_PI_180__SFR_OFFS=0x2d0
LOCAL &__DDRSS_PI_181__SFR_OFFS
&__DDRSS_PI_181__SFR_OFFS=0x2d4
LOCAL &__DDRSS_PI_182__SFR_OFFS
&__DDRSS_PI_182__SFR_OFFS=0x2d8
LOCAL &__DDRSS_PI_183__SFR_OFFS
&__DDRSS_PI_183__SFR_OFFS=0x2dc
LOCAL &__DDRSS_PI_184__SFR_OFFS
&__DDRSS_PI_184__SFR_OFFS=0x2e0
LOCAL &__DDRSS_PI_185__SFR_OFFS
&__DDRSS_PI_185__SFR_OFFS=0x2e4
LOCAL &__DDRSS_PI_186__SFR_OFFS
&__DDRSS_PI_186__SFR_OFFS=0x2e8
LOCAL &__DDRSS_PI_187__SFR_OFFS
&__DDRSS_PI_187__SFR_OFFS=0x2ec
LOCAL &__DDRSS_PI_188__SFR_OFFS
&__DDRSS_PI_188__SFR_OFFS=0x2f0
LOCAL &__DDRSS_PI_189__SFR_OFFS
&__DDRSS_PI_189__SFR_OFFS=0x2f4
LOCAL &__DDRSS_PI_190__SFR_OFFS
&__DDRSS_PI_190__SFR_OFFS=0x2f8
LOCAL &__DDRSS_PI_191__SFR_OFFS
&__DDRSS_PI_191__SFR_OFFS=0x2fc
LOCAL &__DDRSS_PI_192__SFR_OFFS
&__DDRSS_PI_192__SFR_OFFS=0x300
LOCAL &__DDRSS_PI_193__SFR_OFFS
&__DDRSS_PI_193__SFR_OFFS=0x304
LOCAL &__DDRSS_PI_194__SFR_OFFS
&__DDRSS_PI_194__SFR_OFFS=0x308
LOCAL &__DDRSS_PI_195__SFR_OFFS
&__DDRSS_PI_195__SFR_OFFS=0x30c
LOCAL &__DDRSS_PI_196__SFR_OFFS
&__DDRSS_PI_196__SFR_OFFS=0x310
LOCAL &__DDRSS_PI_197__SFR_OFFS
&__DDRSS_PI_197__SFR_OFFS=0x314
LOCAL &__DDRSS_PI_198__SFR_OFFS
&__DDRSS_PI_198__SFR_OFFS=0x318
LOCAL &__DDRSS_PI_199__SFR_OFFS
&__DDRSS_PI_199__SFR_OFFS=0x31c
LOCAL &__DDRSS_PI_200__SFR_OFFS
&__DDRSS_PI_200__SFR_OFFS=0x320
LOCAL &__DDRSS_PI_201__SFR_OFFS
&__DDRSS_PI_201__SFR_OFFS=0x324
LOCAL &__DDRSS_PI_202__SFR_OFFS
&__DDRSS_PI_202__SFR_OFFS=0x328
LOCAL &__DDRSS_PI_203__SFR_OFFS
&__DDRSS_PI_203__SFR_OFFS=0x32c
LOCAL &__DDRSS_PI_204__SFR_OFFS
&__DDRSS_PI_204__SFR_OFFS=0x330
LOCAL &__DDRSS_PI_205__SFR_OFFS
&__DDRSS_PI_205__SFR_OFFS=0x334
LOCAL &__DDRSS_PI_206__SFR_OFFS
&__DDRSS_PI_206__SFR_OFFS=0x338
LOCAL &__DDRSS_PI_207__SFR_OFFS
&__DDRSS_PI_207__SFR_OFFS=0x33c
LOCAL &__DDRSS_PI_208__SFR_OFFS
&__DDRSS_PI_208__SFR_OFFS=0x340
LOCAL &__DDRSS_PI_209__SFR_OFFS
&__DDRSS_PI_209__SFR_OFFS=0x344
LOCAL &__DDRSS_PI_210__SFR_OFFS
&__DDRSS_PI_210__SFR_OFFS=0x348
LOCAL &__DDRSS_PI_211__SFR_OFFS
&__DDRSS_PI_211__SFR_OFFS=0x34c
LOCAL &__DDRSS_PI_212__SFR_OFFS
&__DDRSS_PI_212__SFR_OFFS=0x350
LOCAL &__DDRSS_PI_213__SFR_OFFS
&__DDRSS_PI_213__SFR_OFFS=0x354
LOCAL &__DDRSS_PI_214__SFR_OFFS
&__DDRSS_PI_214__SFR_OFFS=0x358
LOCAL &__DDRSS_PI_215__SFR_OFFS
&__DDRSS_PI_215__SFR_OFFS=0x35c
LOCAL &__DDRSS_PI_216__SFR_OFFS
&__DDRSS_PI_216__SFR_OFFS=0x360
LOCAL &__DDRSS_PI_217__SFR_OFFS
&__DDRSS_PI_217__SFR_OFFS=0x364
LOCAL &__DDRSS_PI_218__SFR_OFFS
&__DDRSS_PI_218__SFR_OFFS=0x368
LOCAL &__DDRSS_PI_219__SFR_OFFS
&__DDRSS_PI_219__SFR_OFFS=0x36c
LOCAL &__DDRSS_PI_220__SFR_OFFS
&__DDRSS_PI_220__SFR_OFFS=0x370
LOCAL &__DDRSS_PI_221__SFR_OFFS
&__DDRSS_PI_221__SFR_OFFS=0x374
LOCAL &__DDRSS_PI_222__SFR_OFFS
&__DDRSS_PI_222__SFR_OFFS=0x378
LOCAL &__DDRSS_PI_223__SFR_OFFS
&__DDRSS_PI_223__SFR_OFFS=0x37c
LOCAL &__DDRSS_PI_224__SFR_OFFS
&__DDRSS_PI_224__SFR_OFFS=0x380
LOCAL &__DDRSS_PI_225__SFR_OFFS
&__DDRSS_PI_225__SFR_OFFS=0x384
LOCAL &__DDRSS_PI_226__SFR_OFFS
&__DDRSS_PI_226__SFR_OFFS=0x388
LOCAL &__DDRSS_PI_227__SFR_OFFS
&__DDRSS_PI_227__SFR_OFFS=0x38c
LOCAL &__DDRSS_PI_228__SFR_OFFS
&__DDRSS_PI_228__SFR_OFFS=0x390
LOCAL &__DDRSS_PI_229__SFR_OFFS
&__DDRSS_PI_229__SFR_OFFS=0x394
LOCAL &__DDRSS_PI_230__SFR_OFFS
&__DDRSS_PI_230__SFR_OFFS=0x398
LOCAL &__DDRSS_PI_231__SFR_OFFS
&__DDRSS_PI_231__SFR_OFFS=0x39c
LOCAL &__DDRSS_PI_232__SFR_OFFS
&__DDRSS_PI_232__SFR_OFFS=0x3a0
LOCAL &__DDRSS_PI_233__SFR_OFFS
&__DDRSS_PI_233__SFR_OFFS=0x3a4
LOCAL &__DDRSS_PI_234__SFR_OFFS
&__DDRSS_PI_234__SFR_OFFS=0x3a8
LOCAL &__DDRSS_PI_235__SFR_OFFS
&__DDRSS_PI_235__SFR_OFFS=0x3ac
LOCAL &__DDRSS_PI_236__SFR_OFFS
&__DDRSS_PI_236__SFR_OFFS=0x3b0
LOCAL &__DDRSS_PI_237__SFR_OFFS
&__DDRSS_PI_237__SFR_OFFS=0x3b4
LOCAL &__DDRSS_PI_238__SFR_OFFS
&__DDRSS_PI_238__SFR_OFFS=0x3b8
LOCAL &__DDRSS_PI_239__SFR_OFFS
&__DDRSS_PI_239__SFR_OFFS=0x3bc
LOCAL &__DDRSS_PI_240__SFR_OFFS
&__DDRSS_PI_240__SFR_OFFS=0x3c0
LOCAL &__DDRSS_PI_241__SFR_OFFS
&__DDRSS_PI_241__SFR_OFFS=0x3c4
LOCAL &__DDRSS_PI_242__SFR_OFFS
&__DDRSS_PI_242__SFR_OFFS=0x3c8
LOCAL &__DDRSS_PI_243__SFR_OFFS
&__DDRSS_PI_243__SFR_OFFS=0x3cc
LOCAL &__DDRSS_PI_244__SFR_OFFS
&__DDRSS_PI_244__SFR_OFFS=0x3d0
LOCAL &__DDRSS_PI_245__SFR_OFFS
&__DDRSS_PI_245__SFR_OFFS=0x3d4
LOCAL &__DDRSS_PI_246__SFR_OFFS
&__DDRSS_PI_246__SFR_OFFS=0x3d8
LOCAL &__DDRSS_PI_247__SFR_OFFS
&__DDRSS_PI_247__SFR_OFFS=0x3dc
LOCAL &__DDRSS_PI_248__SFR_OFFS
&__DDRSS_PI_248__SFR_OFFS=0x3e0
LOCAL &__DDRSS_PI_249__SFR_OFFS
&__DDRSS_PI_249__SFR_OFFS=0x3e4
LOCAL &__DDRSS_PI_250__SFR_OFFS
&__DDRSS_PI_250__SFR_OFFS=0x3e8
LOCAL &__DDRSS_PI_251__SFR_OFFS
&__DDRSS_PI_251__SFR_OFFS=0x3ec
LOCAL &__DDRSS_PI_252__SFR_OFFS
&__DDRSS_PI_252__SFR_OFFS=0x3f0
LOCAL &__DDRSS_PI_253__SFR_OFFS
&__DDRSS_PI_253__SFR_OFFS=0x3f4
LOCAL &__DDRSS_PI_254__SFR_OFFS
&__DDRSS_PI_254__SFR_OFFS=0x3f8
LOCAL &__DDRSS_PI_255__SFR_OFFS
&__DDRSS_PI_255__SFR_OFFS=0x3fc
LOCAL &__DDRSS_PI_256__SFR_OFFS
&__DDRSS_PI_256__SFR_OFFS=0x400
LOCAL &__DDRSS_PI_257__SFR_OFFS
&__DDRSS_PI_257__SFR_OFFS=0x404
LOCAL &__DDRSS_PI_258__SFR_OFFS
&__DDRSS_PI_258__SFR_OFFS=0x408
LOCAL &__DDRSS_PI_259__SFR_OFFS
&__DDRSS_PI_259__SFR_OFFS=0x40c
LOCAL &__DDRSS_PI_260__SFR_OFFS
&__DDRSS_PI_260__SFR_OFFS=0x410
LOCAL &__DDRSS_PI_261__SFR_OFFS
&__DDRSS_PI_261__SFR_OFFS=0x414
LOCAL &__DDRSS_PI_262__SFR_OFFS
&__DDRSS_PI_262__SFR_OFFS=0x418
LOCAL &__DDRSS_PI_263__SFR_OFFS
&__DDRSS_PI_263__SFR_OFFS=0x41c
LOCAL &__DDRSS_PI_264__SFR_OFFS
&__DDRSS_PI_264__SFR_OFFS=0x420
LOCAL &__DDRSS_PI_265__SFR_OFFS
&__DDRSS_PI_265__SFR_OFFS=0x424
LOCAL &__DDRSS_PI_266__SFR_OFFS
&__DDRSS_PI_266__SFR_OFFS=0x428
LOCAL &__DDRSS_PI_267__SFR_OFFS
&__DDRSS_PI_267__SFR_OFFS=0x42c
LOCAL &__DDRSS_PI_268__SFR_OFFS
&__DDRSS_PI_268__SFR_OFFS=0x430
LOCAL &__DDRSS_PI_269__SFR_OFFS
&__DDRSS_PI_269__SFR_OFFS=0x434
LOCAL &__DDRSS_PI_270__SFR_OFFS
&__DDRSS_PI_270__SFR_OFFS=0x438
LOCAL &__DDRSS_PI_271__SFR_OFFS
&__DDRSS_PI_271__SFR_OFFS=0x43c
LOCAL &__DDRSS_PI_272__SFR_OFFS
&__DDRSS_PI_272__SFR_OFFS=0x440
LOCAL &__DDRSS_PI_273__SFR_OFFS
&__DDRSS_PI_273__SFR_OFFS=0x444
LOCAL &__DDRSS_PI_274__SFR_OFFS
&__DDRSS_PI_274__SFR_OFFS=0x448
LOCAL &__DDRSS_PI_275__SFR_OFFS
&__DDRSS_PI_275__SFR_OFFS=0x44c
LOCAL &__DDRSS_PI_276__SFR_OFFS
&__DDRSS_PI_276__SFR_OFFS=0x450
LOCAL &__DDRSS_PI_277__SFR_OFFS
&__DDRSS_PI_277__SFR_OFFS=0x454
LOCAL &__DDRSS_PI_278__SFR_OFFS
&__DDRSS_PI_278__SFR_OFFS=0x458
LOCAL &__DDRSS_PI_279__SFR_OFFS
&__DDRSS_PI_279__SFR_OFFS=0x45c
LOCAL &__DDRSS_PI_280__SFR_OFFS
&__DDRSS_PI_280__SFR_OFFS=0x460
LOCAL &__DDRSS_PI_281__SFR_OFFS
&__DDRSS_PI_281__SFR_OFFS=0x464
LOCAL &__DDRSS_PI_282__SFR_OFFS
&__DDRSS_PI_282__SFR_OFFS=0x468
LOCAL &__DDRSS_PI_283__SFR_OFFS
&__DDRSS_PI_283__SFR_OFFS=0x46c
LOCAL &__DDRSS_PI_284__SFR_OFFS
&__DDRSS_PI_284__SFR_OFFS=0x470
LOCAL &__DDRSS_PI_285__SFR_OFFS
&__DDRSS_PI_285__SFR_OFFS=0x474
LOCAL &__DDRSS_PI_286__SFR_OFFS
&__DDRSS_PI_286__SFR_OFFS=0x478
LOCAL &__DDRSS_PI_287__SFR_OFFS
&__DDRSS_PI_287__SFR_OFFS=0x47c
LOCAL &__DDRSS_PI_288__SFR_OFFS
&__DDRSS_PI_288__SFR_OFFS=0x480
LOCAL &__DDRSS_PI_289__SFR_OFFS
&__DDRSS_PI_289__SFR_OFFS=0x484
LOCAL &__DDRSS_PI_290__SFR_OFFS
&__DDRSS_PI_290__SFR_OFFS=0x488
LOCAL &__DDRSS_PI_291__SFR_OFFS
&__DDRSS_PI_291__SFR_OFFS=0x48c
LOCAL &__DDRSS_PI_292__SFR_OFFS
&__DDRSS_PI_292__SFR_OFFS=0x490
LOCAL &__DDRSS_PI_293__SFR_OFFS
&__DDRSS_PI_293__SFR_OFFS=0x494
LOCAL &__DDRSS_PI_294__SFR_OFFS
&__DDRSS_PI_294__SFR_OFFS=0x498
LOCAL &__DDRSS_PI_295__SFR_OFFS
&__DDRSS_PI_295__SFR_OFFS=0x49c
LOCAL &__DDRSS_PI_296__SFR_OFFS
&__DDRSS_PI_296__SFR_OFFS=0x4a0
LOCAL &__DDRSS_PI_297__SFR_OFFS
&__DDRSS_PI_297__SFR_OFFS=0x4a4
LOCAL &__DDRSS_PI_298__SFR_OFFS
&__DDRSS_PI_298__SFR_OFFS=0x4a8
LOCAL &__DDRSS_PI_299__SFR_OFFS
&__DDRSS_PI_299__SFR_OFFS=0x4ac
// --  Macros for register block Data_Slice_0 
LOCAL &__DDRSS_Data_Slice_0_REGISTER_BLOCK__OFFS
&__DDRSS_Data_Slice_0_REGISTER_BLOCK__OFFS=0x4000
LOCAL &__DDRSS_PHY_0__SFR_OFFS
&__DDRSS_PHY_0__SFR_OFFS=0x0
LOCAL &__DDRSS_PHY_1__SFR_OFFS
&__DDRSS_PHY_1__SFR_OFFS=0x4
LOCAL &__DDRSS_PHY_2__SFR_OFFS
&__DDRSS_PHY_2__SFR_OFFS=0x8
LOCAL &__DDRSS_PHY_3__SFR_OFFS
&__DDRSS_PHY_3__SFR_OFFS=0xc
LOCAL &__DDRSS_PHY_4__SFR_OFFS
&__DDRSS_PHY_4__SFR_OFFS=0x10
LOCAL &__DDRSS_PHY_5__SFR_OFFS
&__DDRSS_PHY_5__SFR_OFFS=0x14
LOCAL &__DDRSS_PHY_6__SFR_OFFS
&__DDRSS_PHY_6__SFR_OFFS=0x18
LOCAL &__DDRSS_PHY_7__SFR_OFFS
&__DDRSS_PHY_7__SFR_OFFS=0x1c
LOCAL &__DDRSS_PHY_8__SFR_OFFS
&__DDRSS_PHY_8__SFR_OFFS=0x20
LOCAL &__DDRSS_PHY_9__SFR_OFFS
&__DDRSS_PHY_9__SFR_OFFS=0x24
LOCAL &__DDRSS_PHY_10__SFR_OFFS
&__DDRSS_PHY_10__SFR_OFFS=0x28
LOCAL &__DDRSS_PHY_11__SFR_OFFS
&__DDRSS_PHY_11__SFR_OFFS=0x2c
LOCAL &__DDRSS_PHY_12__SFR_OFFS
&__DDRSS_PHY_12__SFR_OFFS=0x30
LOCAL &__DDRSS_PHY_13__SFR_OFFS
&__DDRSS_PHY_13__SFR_OFFS=0x34
LOCAL &__DDRSS_PHY_14__SFR_OFFS
&__DDRSS_PHY_14__SFR_OFFS=0x38
LOCAL &__DDRSS_PHY_15__SFR_OFFS
&__DDRSS_PHY_15__SFR_OFFS=0x3c
LOCAL &__DDRSS_PHY_16__SFR_OFFS
&__DDRSS_PHY_16__SFR_OFFS=0x40
LOCAL &__DDRSS_PHY_17__SFR_OFFS
&__DDRSS_PHY_17__SFR_OFFS=0x44
LOCAL &__DDRSS_PHY_18__SFR_OFFS
&__DDRSS_PHY_18__SFR_OFFS=0x48
LOCAL &__DDRSS_PHY_19__SFR_OFFS
&__DDRSS_PHY_19__SFR_OFFS=0x4c
LOCAL &__DDRSS_PHY_20__SFR_OFFS
&__DDRSS_PHY_20__SFR_OFFS=0x50
LOCAL &__DDRSS_PHY_21__SFR_OFFS
&__DDRSS_PHY_21__SFR_OFFS=0x54
LOCAL &__DDRSS_PHY_22__SFR_OFFS
&__DDRSS_PHY_22__SFR_OFFS=0x58
LOCAL &__DDRSS_PHY_23__SFR_OFFS
&__DDRSS_PHY_23__SFR_OFFS=0x5c
LOCAL &__DDRSS_PHY_24__SFR_OFFS
&__DDRSS_PHY_24__SFR_OFFS=0x60
LOCAL &__DDRSS_PHY_25__SFR_OFFS
&__DDRSS_PHY_25__SFR_OFFS=0x64
LOCAL &__DDRSS_PHY_26__SFR_OFFS
&__DDRSS_PHY_26__SFR_OFFS=0x68
LOCAL &__DDRSS_PHY_27__SFR_OFFS
&__DDRSS_PHY_27__SFR_OFFS=0x6c
LOCAL &__DDRSS_PHY_28__SFR_OFFS
&__DDRSS_PHY_28__SFR_OFFS=0x70
LOCAL &__DDRSS_PHY_29__SFR_OFFS
&__DDRSS_PHY_29__SFR_OFFS=0x74
LOCAL &__DDRSS_PHY_30__SFR_OFFS
&__DDRSS_PHY_30__SFR_OFFS=0x78
LOCAL &__DDRSS_PHY_31__SFR_OFFS
&__DDRSS_PHY_31__SFR_OFFS=0x7c
LOCAL &__DDRSS_PHY_32__SFR_OFFS
&__DDRSS_PHY_32__SFR_OFFS=0x80
LOCAL &__DDRSS_PHY_33__SFR_OFFS
&__DDRSS_PHY_33__SFR_OFFS=0x84
LOCAL &__DDRSS_PHY_34__SFR_OFFS
&__DDRSS_PHY_34__SFR_OFFS=0x88
LOCAL &__DDRSS_PHY_35__SFR_OFFS
&__DDRSS_PHY_35__SFR_OFFS=0x8c
LOCAL &__DDRSS_PHY_36__SFR_OFFS
&__DDRSS_PHY_36__SFR_OFFS=0x90
LOCAL &__DDRSS_PHY_37__SFR_OFFS
&__DDRSS_PHY_37__SFR_OFFS=0x94
LOCAL &__DDRSS_PHY_38__SFR_OFFS
&__DDRSS_PHY_38__SFR_OFFS=0x98
LOCAL &__DDRSS_PHY_39__SFR_OFFS
&__DDRSS_PHY_39__SFR_OFFS=0x9c
LOCAL &__DDRSS_PHY_40__SFR_OFFS
&__DDRSS_PHY_40__SFR_OFFS=0xa0
LOCAL &__DDRSS_PHY_41__SFR_OFFS
&__DDRSS_PHY_41__SFR_OFFS=0xa4
LOCAL &__DDRSS_PHY_42__SFR_OFFS
&__DDRSS_PHY_42__SFR_OFFS=0xa8
LOCAL &__DDRSS_PHY_43__SFR_OFFS
&__DDRSS_PHY_43__SFR_OFFS=0xac
LOCAL &__DDRSS_PHY_44__SFR_OFFS
&__DDRSS_PHY_44__SFR_OFFS=0xb0
LOCAL &__DDRSS_PHY_45__SFR_OFFS
&__DDRSS_PHY_45__SFR_OFFS=0xb4
LOCAL &__DDRSS_PHY_46__SFR_OFFS
&__DDRSS_PHY_46__SFR_OFFS=0xb8
LOCAL &__DDRSS_PHY_47__SFR_OFFS
&__DDRSS_PHY_47__SFR_OFFS=0xbc
LOCAL &__DDRSS_PHY_48__SFR_OFFS
&__DDRSS_PHY_48__SFR_OFFS=0xc0
LOCAL &__DDRSS_PHY_49__SFR_OFFS
&__DDRSS_PHY_49__SFR_OFFS=0xc4
LOCAL &__DDRSS_PHY_50__SFR_OFFS
&__DDRSS_PHY_50__SFR_OFFS=0xc8
LOCAL &__DDRSS_PHY_51__SFR_OFFS
&__DDRSS_PHY_51__SFR_OFFS=0xcc
LOCAL &__DDRSS_PHY_52__SFR_OFFS
&__DDRSS_PHY_52__SFR_OFFS=0xd0
LOCAL &__DDRSS_PHY_53__SFR_OFFS
&__DDRSS_PHY_53__SFR_OFFS=0xd4
LOCAL &__DDRSS_PHY_54__SFR_OFFS
&__DDRSS_PHY_54__SFR_OFFS=0xd8
LOCAL &__DDRSS_PHY_55__SFR_OFFS
&__DDRSS_PHY_55__SFR_OFFS=0xdc
LOCAL &__DDRSS_PHY_56__SFR_OFFS
&__DDRSS_PHY_56__SFR_OFFS=0xe0
LOCAL &__DDRSS_PHY_57__SFR_OFFS
&__DDRSS_PHY_57__SFR_OFFS=0xe4
LOCAL &__DDRSS_PHY_58__SFR_OFFS
&__DDRSS_PHY_58__SFR_OFFS=0xe8
LOCAL &__DDRSS_PHY_59__SFR_OFFS
&__DDRSS_PHY_59__SFR_OFFS=0xec
LOCAL &__DDRSS_PHY_60__SFR_OFFS
&__DDRSS_PHY_60__SFR_OFFS=0xf0
LOCAL &__DDRSS_PHY_61__SFR_OFFS
&__DDRSS_PHY_61__SFR_OFFS=0xf4
LOCAL &__DDRSS_PHY_62__SFR_OFFS
&__DDRSS_PHY_62__SFR_OFFS=0xf8
LOCAL &__DDRSS_PHY_63__SFR_OFFS
&__DDRSS_PHY_63__SFR_OFFS=0xfc
LOCAL &__DDRSS_PHY_64__SFR_OFFS
&__DDRSS_PHY_64__SFR_OFFS=0x100
LOCAL &__DDRSS_PHY_65__SFR_OFFS
&__DDRSS_PHY_65__SFR_OFFS=0x104
LOCAL &__DDRSS_PHY_66__SFR_OFFS
&__DDRSS_PHY_66__SFR_OFFS=0x108
LOCAL &__DDRSS_PHY_67__SFR_OFFS
&__DDRSS_PHY_67__SFR_OFFS=0x10c
LOCAL &__DDRSS_PHY_68__SFR_OFFS
&__DDRSS_PHY_68__SFR_OFFS=0x110
LOCAL &__DDRSS_PHY_69__SFR_OFFS
&__DDRSS_PHY_69__SFR_OFFS=0x114
LOCAL &__DDRSS_PHY_70__SFR_OFFS
&__DDRSS_PHY_70__SFR_OFFS=0x118
LOCAL &__DDRSS_PHY_71__SFR_OFFS
&__DDRSS_PHY_71__SFR_OFFS=0x11c
LOCAL &__DDRSS_PHY_72__SFR_OFFS
&__DDRSS_PHY_72__SFR_OFFS=0x120
LOCAL &__DDRSS_PHY_73__SFR_OFFS
&__DDRSS_PHY_73__SFR_OFFS=0x124
LOCAL &__DDRSS_PHY_74__SFR_OFFS
&__DDRSS_PHY_74__SFR_OFFS=0x128
LOCAL &__DDRSS_PHY_75__SFR_OFFS
&__DDRSS_PHY_75__SFR_OFFS=0x12c
LOCAL &__DDRSS_PHY_76__SFR_OFFS
&__DDRSS_PHY_76__SFR_OFFS=0x130
LOCAL &__DDRSS_PHY_77__SFR_OFFS
&__DDRSS_PHY_77__SFR_OFFS=0x134
LOCAL &__DDRSS_PHY_78__SFR_OFFS
&__DDRSS_PHY_78__SFR_OFFS=0x138
LOCAL &__DDRSS_PHY_79__SFR_OFFS
&__DDRSS_PHY_79__SFR_OFFS=0x13c
LOCAL &__DDRSS_PHY_80__SFR_OFFS
&__DDRSS_PHY_80__SFR_OFFS=0x140
LOCAL &__DDRSS_PHY_81__SFR_OFFS
&__DDRSS_PHY_81__SFR_OFFS=0x144
LOCAL &__DDRSS_PHY_82__SFR_OFFS
&__DDRSS_PHY_82__SFR_OFFS=0x148
LOCAL &__DDRSS_PHY_83__SFR_OFFS
&__DDRSS_PHY_83__SFR_OFFS=0x14c
LOCAL &__DDRSS_PHY_84__SFR_OFFS
&__DDRSS_PHY_84__SFR_OFFS=0x150
LOCAL &__DDRSS_PHY_85__SFR_OFFS
&__DDRSS_PHY_85__SFR_OFFS=0x154
LOCAL &__DDRSS_PHY_86__SFR_OFFS
&__DDRSS_PHY_86__SFR_OFFS=0x158
LOCAL &__DDRSS_PHY_87__SFR_OFFS
&__DDRSS_PHY_87__SFR_OFFS=0x15c
LOCAL &__DDRSS_PHY_88__SFR_OFFS
&__DDRSS_PHY_88__SFR_OFFS=0x160
LOCAL &__DDRSS_PHY_89__SFR_OFFS
&__DDRSS_PHY_89__SFR_OFFS=0x164
LOCAL &__DDRSS_PHY_90__SFR_OFFS
&__DDRSS_PHY_90__SFR_OFFS=0x168
LOCAL &__DDRSS_PHY_91__SFR_OFFS
&__DDRSS_PHY_91__SFR_OFFS=0x16c
LOCAL &__DDRSS_PHY_92__SFR_OFFS
&__DDRSS_PHY_92__SFR_OFFS=0x170
LOCAL &__DDRSS_PHY_93__SFR_OFFS
&__DDRSS_PHY_93__SFR_OFFS=0x174
LOCAL &__DDRSS_PHY_94__SFR_OFFS
&__DDRSS_PHY_94__SFR_OFFS=0x178
LOCAL &__DDRSS_PHY_95__SFR_OFFS
&__DDRSS_PHY_95__SFR_OFFS=0x17c
LOCAL &__DDRSS_PHY_96__SFR_OFFS
&__DDRSS_PHY_96__SFR_OFFS=0x180
LOCAL &__DDRSS_PHY_97__SFR_OFFS
&__DDRSS_PHY_97__SFR_OFFS=0x184
LOCAL &__DDRSS_PHY_98__SFR_OFFS
&__DDRSS_PHY_98__SFR_OFFS=0x188
LOCAL &__DDRSS_PHY_99__SFR_OFFS
&__DDRSS_PHY_99__SFR_OFFS=0x18c
LOCAL &__DDRSS_PHY_100__SFR_OFFS
&__DDRSS_PHY_100__SFR_OFFS=0x190
LOCAL &__DDRSS_PHY_101__SFR_OFFS
&__DDRSS_PHY_101__SFR_OFFS=0x194
LOCAL &__DDRSS_PHY_102__SFR_OFFS
&__DDRSS_PHY_102__SFR_OFFS=0x198
LOCAL &__DDRSS_PHY_103__SFR_OFFS
&__DDRSS_PHY_103__SFR_OFFS=0x19c
LOCAL &__DDRSS_PHY_104__SFR_OFFS
&__DDRSS_PHY_104__SFR_OFFS=0x1a0
LOCAL &__DDRSS_PHY_105__SFR_OFFS
&__DDRSS_PHY_105__SFR_OFFS=0x1a4
LOCAL &__DDRSS_PHY_106__SFR_OFFS
&__DDRSS_PHY_106__SFR_OFFS=0x1a8
LOCAL &__DDRSS_PHY_107__SFR_OFFS
&__DDRSS_PHY_107__SFR_OFFS=0x1ac
LOCAL &__DDRSS_PHY_108__SFR_OFFS
&__DDRSS_PHY_108__SFR_OFFS=0x1b0
LOCAL &__DDRSS_PHY_109__SFR_OFFS
&__DDRSS_PHY_109__SFR_OFFS=0x1b4
LOCAL &__DDRSS_PHY_110__SFR_OFFS
&__DDRSS_PHY_110__SFR_OFFS=0x1b8
LOCAL &__DDRSS_PHY_111__SFR_OFFS
&__DDRSS_PHY_111__SFR_OFFS=0x1bc
LOCAL &__DDRSS_PHY_112__SFR_OFFS
&__DDRSS_PHY_112__SFR_OFFS=0x1c0
LOCAL &__DDRSS_PHY_113__SFR_OFFS
&__DDRSS_PHY_113__SFR_OFFS=0x1c4
LOCAL &__DDRSS_PHY_114__SFR_OFFS
&__DDRSS_PHY_114__SFR_OFFS=0x1c8
LOCAL &__DDRSS_PHY_115__SFR_OFFS
&__DDRSS_PHY_115__SFR_OFFS=0x1cc
LOCAL &__DDRSS_PHY_116__SFR_OFFS
&__DDRSS_PHY_116__SFR_OFFS=0x1d0
LOCAL &__DDRSS_PHY_117__SFR_OFFS
&__DDRSS_PHY_117__SFR_OFFS=0x1d4
LOCAL &__DDRSS_PHY_118__SFR_OFFS
&__DDRSS_PHY_118__SFR_OFFS=0x1d8
LOCAL &__DDRSS_PHY_119__SFR_OFFS
&__DDRSS_PHY_119__SFR_OFFS=0x1dc
LOCAL &__DDRSS_PHY_120__SFR_OFFS
&__DDRSS_PHY_120__SFR_OFFS=0x1e0
LOCAL &__DDRSS_PHY_121__SFR_OFFS
&__DDRSS_PHY_121__SFR_OFFS=0x1e4
LOCAL &__DDRSS_PHY_122__SFR_OFFS
&__DDRSS_PHY_122__SFR_OFFS=0x1e8
LOCAL &__DDRSS_PHY_123__SFR_OFFS
&__DDRSS_PHY_123__SFR_OFFS=0x1ec
LOCAL &__DDRSS_PHY_124__SFR_OFFS
&__DDRSS_PHY_124__SFR_OFFS=0x1f0
LOCAL &__DDRSS_PHY_125__SFR_OFFS
&__DDRSS_PHY_125__SFR_OFFS=0x1f4
LOCAL &__DDRSS_PHY_126__SFR_OFFS
&__DDRSS_PHY_126__SFR_OFFS=0x1f8
LOCAL &__DDRSS_PHY_127__SFR_OFFS
&__DDRSS_PHY_127__SFR_OFFS=0x1fc
LOCAL &__DDRSS_PHY_128__SFR_OFFS
&__DDRSS_PHY_128__SFR_OFFS=0x200
LOCAL &__DDRSS_PHY_129__SFR_OFFS
&__DDRSS_PHY_129__SFR_OFFS=0x204
LOCAL &__DDRSS_PHY_130__SFR_OFFS
&__DDRSS_PHY_130__SFR_OFFS=0x208
LOCAL &__DDRSS_PHY_131__SFR_OFFS
&__DDRSS_PHY_131__SFR_OFFS=0x20c
LOCAL &__DDRSS_PHY_132__SFR_OFFS
&__DDRSS_PHY_132__SFR_OFFS=0x210
LOCAL &__DDRSS_PHY_133__SFR_OFFS
&__DDRSS_PHY_133__SFR_OFFS=0x214
LOCAL &__DDRSS_PHY_134__SFR_OFFS
&__DDRSS_PHY_134__SFR_OFFS=0x218
LOCAL &__DDRSS_PHY_135__SFR_OFFS
&__DDRSS_PHY_135__SFR_OFFS=0x21c
LOCAL &__DDRSS_PHY_136__SFR_OFFS
&__DDRSS_PHY_136__SFR_OFFS=0x220
LOCAL &__DDRSS_PHY_137__SFR_OFFS
&__DDRSS_PHY_137__SFR_OFFS=0x224
LOCAL &__DDRSS_PHY_138__SFR_OFFS
&__DDRSS_PHY_138__SFR_OFFS=0x228
LOCAL &__DDRSS_PHY_139__SFR_OFFS
&__DDRSS_PHY_139__SFR_OFFS=0x22c
// --  Macros for register block Data_Slice_1 
LOCAL &__DDRSS_Data_Slice_1_REGISTER_BLOCK__OFFS
&__DDRSS_Data_Slice_1_REGISTER_BLOCK__OFFS=0x4400
LOCAL &__DDRSS_PHY_256__SFR_OFFS
&__DDRSS_PHY_256__SFR_OFFS=0x0
LOCAL &__DDRSS_PHY_257__SFR_OFFS
&__DDRSS_PHY_257__SFR_OFFS=0x4
LOCAL &__DDRSS_PHY_258__SFR_OFFS
&__DDRSS_PHY_258__SFR_OFFS=0x8
LOCAL &__DDRSS_PHY_259__SFR_OFFS
&__DDRSS_PHY_259__SFR_OFFS=0xc
LOCAL &__DDRSS_PHY_260__SFR_OFFS
&__DDRSS_PHY_260__SFR_OFFS=0x10
LOCAL &__DDRSS_PHY_261__SFR_OFFS
&__DDRSS_PHY_261__SFR_OFFS=0x14
LOCAL &__DDRSS_PHY_262__SFR_OFFS
&__DDRSS_PHY_262__SFR_OFFS=0x18
LOCAL &__DDRSS_PHY_263__SFR_OFFS
&__DDRSS_PHY_263__SFR_OFFS=0x1c
LOCAL &__DDRSS_PHY_264__SFR_OFFS
&__DDRSS_PHY_264__SFR_OFFS=0x20
LOCAL &__DDRSS_PHY_265__SFR_OFFS
&__DDRSS_PHY_265__SFR_OFFS=0x24
LOCAL &__DDRSS_PHY_266__SFR_OFFS
&__DDRSS_PHY_266__SFR_OFFS=0x28
LOCAL &__DDRSS_PHY_267__SFR_OFFS
&__DDRSS_PHY_267__SFR_OFFS=0x2c
LOCAL &__DDRSS_PHY_268__SFR_OFFS
&__DDRSS_PHY_268__SFR_OFFS=0x30
LOCAL &__DDRSS_PHY_269__SFR_OFFS
&__DDRSS_PHY_269__SFR_OFFS=0x34
LOCAL &__DDRSS_PHY_270__SFR_OFFS
&__DDRSS_PHY_270__SFR_OFFS=0x38
LOCAL &__DDRSS_PHY_271__SFR_OFFS
&__DDRSS_PHY_271__SFR_OFFS=0x3c
LOCAL &__DDRSS_PHY_272__SFR_OFFS
&__DDRSS_PHY_272__SFR_OFFS=0x40
LOCAL &__DDRSS_PHY_273__SFR_OFFS
&__DDRSS_PHY_273__SFR_OFFS=0x44
LOCAL &__DDRSS_PHY_274__SFR_OFFS
&__DDRSS_PHY_274__SFR_OFFS=0x48
LOCAL &__DDRSS_PHY_275__SFR_OFFS
&__DDRSS_PHY_275__SFR_OFFS=0x4c
LOCAL &__DDRSS_PHY_276__SFR_OFFS
&__DDRSS_PHY_276__SFR_OFFS=0x50
LOCAL &__DDRSS_PHY_277__SFR_OFFS
&__DDRSS_PHY_277__SFR_OFFS=0x54
LOCAL &__DDRSS_PHY_278__SFR_OFFS
&__DDRSS_PHY_278__SFR_OFFS=0x58
LOCAL &__DDRSS_PHY_279__SFR_OFFS
&__DDRSS_PHY_279__SFR_OFFS=0x5c
LOCAL &__DDRSS_PHY_280__SFR_OFFS
&__DDRSS_PHY_280__SFR_OFFS=0x60
LOCAL &__DDRSS_PHY_281__SFR_OFFS
&__DDRSS_PHY_281__SFR_OFFS=0x64
LOCAL &__DDRSS_PHY_282__SFR_OFFS
&__DDRSS_PHY_282__SFR_OFFS=0x68
LOCAL &__DDRSS_PHY_283__SFR_OFFS
&__DDRSS_PHY_283__SFR_OFFS=0x6c
LOCAL &__DDRSS_PHY_284__SFR_OFFS
&__DDRSS_PHY_284__SFR_OFFS=0x70
LOCAL &__DDRSS_PHY_285__SFR_OFFS
&__DDRSS_PHY_285__SFR_OFFS=0x74
LOCAL &__DDRSS_PHY_286__SFR_OFFS
&__DDRSS_PHY_286__SFR_OFFS=0x78
LOCAL &__DDRSS_PHY_287__SFR_OFFS
&__DDRSS_PHY_287__SFR_OFFS=0x7c
LOCAL &__DDRSS_PHY_288__SFR_OFFS
&__DDRSS_PHY_288__SFR_OFFS=0x80
LOCAL &__DDRSS_PHY_289__SFR_OFFS
&__DDRSS_PHY_289__SFR_OFFS=0x84
LOCAL &__DDRSS_PHY_290__SFR_OFFS
&__DDRSS_PHY_290__SFR_OFFS=0x88
LOCAL &__DDRSS_PHY_291__SFR_OFFS
&__DDRSS_PHY_291__SFR_OFFS=0x8c
LOCAL &__DDRSS_PHY_292__SFR_OFFS
&__DDRSS_PHY_292__SFR_OFFS=0x90
LOCAL &__DDRSS_PHY_293__SFR_OFFS
&__DDRSS_PHY_293__SFR_OFFS=0x94
LOCAL &__DDRSS_PHY_294__SFR_OFFS
&__DDRSS_PHY_294__SFR_OFFS=0x98
LOCAL &__DDRSS_PHY_295__SFR_OFFS
&__DDRSS_PHY_295__SFR_OFFS=0x9c
LOCAL &__DDRSS_PHY_296__SFR_OFFS
&__DDRSS_PHY_296__SFR_OFFS=0xa0
LOCAL &__DDRSS_PHY_297__SFR_OFFS
&__DDRSS_PHY_297__SFR_OFFS=0xa4
LOCAL &__DDRSS_PHY_298__SFR_OFFS
&__DDRSS_PHY_298__SFR_OFFS=0xa8
LOCAL &__DDRSS_PHY_299__SFR_OFFS
&__DDRSS_PHY_299__SFR_OFFS=0xac
LOCAL &__DDRSS_PHY_300__SFR_OFFS
&__DDRSS_PHY_300__SFR_OFFS=0xb0
LOCAL &__DDRSS_PHY_301__SFR_OFFS
&__DDRSS_PHY_301__SFR_OFFS=0xb4
LOCAL &__DDRSS_PHY_302__SFR_OFFS
&__DDRSS_PHY_302__SFR_OFFS=0xb8
LOCAL &__DDRSS_PHY_303__SFR_OFFS
&__DDRSS_PHY_303__SFR_OFFS=0xbc
LOCAL &__DDRSS_PHY_304__SFR_OFFS
&__DDRSS_PHY_304__SFR_OFFS=0xc0
LOCAL &__DDRSS_PHY_305__SFR_OFFS
&__DDRSS_PHY_305__SFR_OFFS=0xc4
LOCAL &__DDRSS_PHY_306__SFR_OFFS
&__DDRSS_PHY_306__SFR_OFFS=0xc8
LOCAL &__DDRSS_PHY_307__SFR_OFFS
&__DDRSS_PHY_307__SFR_OFFS=0xcc
LOCAL &__DDRSS_PHY_308__SFR_OFFS
&__DDRSS_PHY_308__SFR_OFFS=0xd0
LOCAL &__DDRSS_PHY_309__SFR_OFFS
&__DDRSS_PHY_309__SFR_OFFS=0xd4
LOCAL &__DDRSS_PHY_310__SFR_OFFS
&__DDRSS_PHY_310__SFR_OFFS=0xd8
LOCAL &__DDRSS_PHY_311__SFR_OFFS
&__DDRSS_PHY_311__SFR_OFFS=0xdc
LOCAL &__DDRSS_PHY_312__SFR_OFFS
&__DDRSS_PHY_312__SFR_OFFS=0xe0
LOCAL &__DDRSS_PHY_313__SFR_OFFS
&__DDRSS_PHY_313__SFR_OFFS=0xe4
LOCAL &__DDRSS_PHY_314__SFR_OFFS
&__DDRSS_PHY_314__SFR_OFFS=0xe8
LOCAL &__DDRSS_PHY_315__SFR_OFFS
&__DDRSS_PHY_315__SFR_OFFS=0xec
LOCAL &__DDRSS_PHY_316__SFR_OFFS
&__DDRSS_PHY_316__SFR_OFFS=0xf0
LOCAL &__DDRSS_PHY_317__SFR_OFFS
&__DDRSS_PHY_317__SFR_OFFS=0xf4
LOCAL &__DDRSS_PHY_318__SFR_OFFS
&__DDRSS_PHY_318__SFR_OFFS=0xf8
LOCAL &__DDRSS_PHY_319__SFR_OFFS
&__DDRSS_PHY_319__SFR_OFFS=0xfc
LOCAL &__DDRSS_PHY_320__SFR_OFFS
&__DDRSS_PHY_320__SFR_OFFS=0x100
LOCAL &__DDRSS_PHY_321__SFR_OFFS
&__DDRSS_PHY_321__SFR_OFFS=0x104
LOCAL &__DDRSS_PHY_322__SFR_OFFS
&__DDRSS_PHY_322__SFR_OFFS=0x108
LOCAL &__DDRSS_PHY_323__SFR_OFFS
&__DDRSS_PHY_323__SFR_OFFS=0x10c
LOCAL &__DDRSS_PHY_324__SFR_OFFS
&__DDRSS_PHY_324__SFR_OFFS=0x110
LOCAL &__DDRSS_PHY_325__SFR_OFFS
&__DDRSS_PHY_325__SFR_OFFS=0x114
LOCAL &__DDRSS_PHY_326__SFR_OFFS
&__DDRSS_PHY_326__SFR_OFFS=0x118
LOCAL &__DDRSS_PHY_327__SFR_OFFS
&__DDRSS_PHY_327__SFR_OFFS=0x11c
LOCAL &__DDRSS_PHY_328__SFR_OFFS
&__DDRSS_PHY_328__SFR_OFFS=0x120
LOCAL &__DDRSS_PHY_329__SFR_OFFS
&__DDRSS_PHY_329__SFR_OFFS=0x124
LOCAL &__DDRSS_PHY_330__SFR_OFFS
&__DDRSS_PHY_330__SFR_OFFS=0x128
LOCAL &__DDRSS_PHY_331__SFR_OFFS
&__DDRSS_PHY_331__SFR_OFFS=0x12c
LOCAL &__DDRSS_PHY_332__SFR_OFFS
&__DDRSS_PHY_332__SFR_OFFS=0x130
LOCAL &__DDRSS_PHY_333__SFR_OFFS
&__DDRSS_PHY_333__SFR_OFFS=0x134
LOCAL &__DDRSS_PHY_334__SFR_OFFS
&__DDRSS_PHY_334__SFR_OFFS=0x138
LOCAL &__DDRSS_PHY_335__SFR_OFFS
&__DDRSS_PHY_335__SFR_OFFS=0x13c
LOCAL &__DDRSS_PHY_336__SFR_OFFS
&__DDRSS_PHY_336__SFR_OFFS=0x140
LOCAL &__DDRSS_PHY_337__SFR_OFFS
&__DDRSS_PHY_337__SFR_OFFS=0x144
LOCAL &__DDRSS_PHY_338__SFR_OFFS
&__DDRSS_PHY_338__SFR_OFFS=0x148
LOCAL &__DDRSS_PHY_339__SFR_OFFS
&__DDRSS_PHY_339__SFR_OFFS=0x14c
LOCAL &__DDRSS_PHY_340__SFR_OFFS
&__DDRSS_PHY_340__SFR_OFFS=0x150
LOCAL &__DDRSS_PHY_341__SFR_OFFS
&__DDRSS_PHY_341__SFR_OFFS=0x154
LOCAL &__DDRSS_PHY_342__SFR_OFFS
&__DDRSS_PHY_342__SFR_OFFS=0x158
LOCAL &__DDRSS_PHY_343__SFR_OFFS
&__DDRSS_PHY_343__SFR_OFFS=0x15c
LOCAL &__DDRSS_PHY_344__SFR_OFFS
&__DDRSS_PHY_344__SFR_OFFS=0x160
LOCAL &__DDRSS_PHY_345__SFR_OFFS
&__DDRSS_PHY_345__SFR_OFFS=0x164
LOCAL &__DDRSS_PHY_346__SFR_OFFS
&__DDRSS_PHY_346__SFR_OFFS=0x168
LOCAL &__DDRSS_PHY_347__SFR_OFFS
&__DDRSS_PHY_347__SFR_OFFS=0x16c
LOCAL &__DDRSS_PHY_348__SFR_OFFS
&__DDRSS_PHY_348__SFR_OFFS=0x170
LOCAL &__DDRSS_PHY_349__SFR_OFFS
&__DDRSS_PHY_349__SFR_OFFS=0x174
LOCAL &__DDRSS_PHY_350__SFR_OFFS
&__DDRSS_PHY_350__SFR_OFFS=0x178
LOCAL &__DDRSS_PHY_351__SFR_OFFS
&__DDRSS_PHY_351__SFR_OFFS=0x17c
LOCAL &__DDRSS_PHY_352__SFR_OFFS
&__DDRSS_PHY_352__SFR_OFFS=0x180
LOCAL &__DDRSS_PHY_353__SFR_OFFS
&__DDRSS_PHY_353__SFR_OFFS=0x184
LOCAL &__DDRSS_PHY_354__SFR_OFFS
&__DDRSS_PHY_354__SFR_OFFS=0x188
LOCAL &__DDRSS_PHY_355__SFR_OFFS
&__DDRSS_PHY_355__SFR_OFFS=0x18c
LOCAL &__DDRSS_PHY_356__SFR_OFFS
&__DDRSS_PHY_356__SFR_OFFS=0x190
LOCAL &__DDRSS_PHY_357__SFR_OFFS
&__DDRSS_PHY_357__SFR_OFFS=0x194
LOCAL &__DDRSS_PHY_358__SFR_OFFS
&__DDRSS_PHY_358__SFR_OFFS=0x198
LOCAL &__DDRSS_PHY_359__SFR_OFFS
&__DDRSS_PHY_359__SFR_OFFS=0x19c
LOCAL &__DDRSS_PHY_360__SFR_OFFS
&__DDRSS_PHY_360__SFR_OFFS=0x1a0
LOCAL &__DDRSS_PHY_361__SFR_OFFS
&__DDRSS_PHY_361__SFR_OFFS=0x1a4
LOCAL &__DDRSS_PHY_362__SFR_OFFS
&__DDRSS_PHY_362__SFR_OFFS=0x1a8
LOCAL &__DDRSS_PHY_363__SFR_OFFS
&__DDRSS_PHY_363__SFR_OFFS=0x1ac
LOCAL &__DDRSS_PHY_364__SFR_OFFS
&__DDRSS_PHY_364__SFR_OFFS=0x1b0
LOCAL &__DDRSS_PHY_365__SFR_OFFS
&__DDRSS_PHY_365__SFR_OFFS=0x1b4
LOCAL &__DDRSS_PHY_366__SFR_OFFS
&__DDRSS_PHY_366__SFR_OFFS=0x1b8
LOCAL &__DDRSS_PHY_367__SFR_OFFS
&__DDRSS_PHY_367__SFR_OFFS=0x1bc
LOCAL &__DDRSS_PHY_368__SFR_OFFS
&__DDRSS_PHY_368__SFR_OFFS=0x1c0
LOCAL &__DDRSS_PHY_369__SFR_OFFS
&__DDRSS_PHY_369__SFR_OFFS=0x1c4
LOCAL &__DDRSS_PHY_370__SFR_OFFS
&__DDRSS_PHY_370__SFR_OFFS=0x1c8
LOCAL &__DDRSS_PHY_371__SFR_OFFS
&__DDRSS_PHY_371__SFR_OFFS=0x1cc
LOCAL &__DDRSS_PHY_372__SFR_OFFS
&__DDRSS_PHY_372__SFR_OFFS=0x1d0
LOCAL &__DDRSS_PHY_373__SFR_OFFS
&__DDRSS_PHY_373__SFR_OFFS=0x1d4
LOCAL &__DDRSS_PHY_374__SFR_OFFS
&__DDRSS_PHY_374__SFR_OFFS=0x1d8
LOCAL &__DDRSS_PHY_375__SFR_OFFS
&__DDRSS_PHY_375__SFR_OFFS=0x1dc
LOCAL &__DDRSS_PHY_376__SFR_OFFS
&__DDRSS_PHY_376__SFR_OFFS=0x1e0
LOCAL &__DDRSS_PHY_377__SFR_OFFS
&__DDRSS_PHY_377__SFR_OFFS=0x1e4
LOCAL &__DDRSS_PHY_378__SFR_OFFS
&__DDRSS_PHY_378__SFR_OFFS=0x1e8
LOCAL &__DDRSS_PHY_379__SFR_OFFS
&__DDRSS_PHY_379__SFR_OFFS=0x1ec
LOCAL &__DDRSS_PHY_380__SFR_OFFS
&__DDRSS_PHY_380__SFR_OFFS=0x1f0
LOCAL &__DDRSS_PHY_381__SFR_OFFS
&__DDRSS_PHY_381__SFR_OFFS=0x1f4
LOCAL &__DDRSS_PHY_382__SFR_OFFS
&__DDRSS_PHY_382__SFR_OFFS=0x1f8
LOCAL &__DDRSS_PHY_383__SFR_OFFS
&__DDRSS_PHY_383__SFR_OFFS=0x1fc
LOCAL &__DDRSS_PHY_384__SFR_OFFS
&__DDRSS_PHY_384__SFR_OFFS=0x200
LOCAL &__DDRSS_PHY_385__SFR_OFFS
&__DDRSS_PHY_385__SFR_OFFS=0x204
LOCAL &__DDRSS_PHY_386__SFR_OFFS
&__DDRSS_PHY_386__SFR_OFFS=0x208
LOCAL &__DDRSS_PHY_387__SFR_OFFS
&__DDRSS_PHY_387__SFR_OFFS=0x20c
LOCAL &__DDRSS_PHY_388__SFR_OFFS
&__DDRSS_PHY_388__SFR_OFFS=0x210
LOCAL &__DDRSS_PHY_389__SFR_OFFS
&__DDRSS_PHY_389__SFR_OFFS=0x214
LOCAL &__DDRSS_PHY_390__SFR_OFFS
&__DDRSS_PHY_390__SFR_OFFS=0x218
LOCAL &__DDRSS_PHY_391__SFR_OFFS
&__DDRSS_PHY_391__SFR_OFFS=0x21c
LOCAL &__DDRSS_PHY_392__SFR_OFFS
&__DDRSS_PHY_392__SFR_OFFS=0x220
LOCAL &__DDRSS_PHY_393__SFR_OFFS
&__DDRSS_PHY_393__SFR_OFFS=0x224
LOCAL &__DDRSS_PHY_394__SFR_OFFS
&__DDRSS_PHY_394__SFR_OFFS=0x228
LOCAL &__DDRSS_PHY_395__SFR_OFFS
&__DDRSS_PHY_395__SFR_OFFS=0x22c
// --  Macros for register block Data_Slice_2 
LOCAL &__DDRSS_Data_Slice_2_REGISTER_BLOCK__OFFS
&__DDRSS_Data_Slice_2_REGISTER_BLOCK__OFFS=0x4800
LOCAL &__DDRSS_PHY_512__SFR_OFFS
&__DDRSS_PHY_512__SFR_OFFS=0x0
LOCAL &__DDRSS_PHY_513__SFR_OFFS
&__DDRSS_PHY_513__SFR_OFFS=0x4
LOCAL &__DDRSS_PHY_514__SFR_OFFS
&__DDRSS_PHY_514__SFR_OFFS=0x8
LOCAL &__DDRSS_PHY_515__SFR_OFFS
&__DDRSS_PHY_515__SFR_OFFS=0xc
LOCAL &__DDRSS_PHY_516__SFR_OFFS
&__DDRSS_PHY_516__SFR_OFFS=0x10
LOCAL &__DDRSS_PHY_517__SFR_OFFS
&__DDRSS_PHY_517__SFR_OFFS=0x14
LOCAL &__DDRSS_PHY_518__SFR_OFFS
&__DDRSS_PHY_518__SFR_OFFS=0x18
LOCAL &__DDRSS_PHY_519__SFR_OFFS
&__DDRSS_PHY_519__SFR_OFFS=0x1c
LOCAL &__DDRSS_PHY_520__SFR_OFFS
&__DDRSS_PHY_520__SFR_OFFS=0x20
LOCAL &__DDRSS_PHY_521__SFR_OFFS
&__DDRSS_PHY_521__SFR_OFFS=0x24
LOCAL &__DDRSS_PHY_522__SFR_OFFS
&__DDRSS_PHY_522__SFR_OFFS=0x28
LOCAL &__DDRSS_PHY_523__SFR_OFFS
&__DDRSS_PHY_523__SFR_OFFS=0x2c
LOCAL &__DDRSS_PHY_524__SFR_OFFS
&__DDRSS_PHY_524__SFR_OFFS=0x30
LOCAL &__DDRSS_PHY_525__SFR_OFFS
&__DDRSS_PHY_525__SFR_OFFS=0x34
LOCAL &__DDRSS_PHY_526__SFR_OFFS
&__DDRSS_PHY_526__SFR_OFFS=0x38
LOCAL &__DDRSS_PHY_527__SFR_OFFS
&__DDRSS_PHY_527__SFR_OFFS=0x3c
LOCAL &__DDRSS_PHY_528__SFR_OFFS
&__DDRSS_PHY_528__SFR_OFFS=0x40
LOCAL &__DDRSS_PHY_529__SFR_OFFS
&__DDRSS_PHY_529__SFR_OFFS=0x44
LOCAL &__DDRSS_PHY_530__SFR_OFFS
&__DDRSS_PHY_530__SFR_OFFS=0x48
LOCAL &__DDRSS_PHY_531__SFR_OFFS
&__DDRSS_PHY_531__SFR_OFFS=0x4c
LOCAL &__DDRSS_PHY_532__SFR_OFFS
&__DDRSS_PHY_532__SFR_OFFS=0x50
LOCAL &__DDRSS_PHY_533__SFR_OFFS
&__DDRSS_PHY_533__SFR_OFFS=0x54
LOCAL &__DDRSS_PHY_534__SFR_OFFS
&__DDRSS_PHY_534__SFR_OFFS=0x58
LOCAL &__DDRSS_PHY_535__SFR_OFFS
&__DDRSS_PHY_535__SFR_OFFS=0x5c
LOCAL &__DDRSS_PHY_536__SFR_OFFS
&__DDRSS_PHY_536__SFR_OFFS=0x60
LOCAL &__DDRSS_PHY_537__SFR_OFFS
&__DDRSS_PHY_537__SFR_OFFS=0x64
LOCAL &__DDRSS_PHY_538__SFR_OFFS
&__DDRSS_PHY_538__SFR_OFFS=0x68
LOCAL &__DDRSS_PHY_539__SFR_OFFS
&__DDRSS_PHY_539__SFR_OFFS=0x6c
LOCAL &__DDRSS_PHY_540__SFR_OFFS
&__DDRSS_PHY_540__SFR_OFFS=0x70
LOCAL &__DDRSS_PHY_541__SFR_OFFS
&__DDRSS_PHY_541__SFR_OFFS=0x74
LOCAL &__DDRSS_PHY_542__SFR_OFFS
&__DDRSS_PHY_542__SFR_OFFS=0x78
LOCAL &__DDRSS_PHY_543__SFR_OFFS
&__DDRSS_PHY_543__SFR_OFFS=0x7c
LOCAL &__DDRSS_PHY_544__SFR_OFFS
&__DDRSS_PHY_544__SFR_OFFS=0x80
LOCAL &__DDRSS_PHY_545__SFR_OFFS
&__DDRSS_PHY_545__SFR_OFFS=0x84
LOCAL &__DDRSS_PHY_546__SFR_OFFS
&__DDRSS_PHY_546__SFR_OFFS=0x88
LOCAL &__DDRSS_PHY_547__SFR_OFFS
&__DDRSS_PHY_547__SFR_OFFS=0x8c
LOCAL &__DDRSS_PHY_548__SFR_OFFS
&__DDRSS_PHY_548__SFR_OFFS=0x90
LOCAL &__DDRSS_PHY_549__SFR_OFFS
&__DDRSS_PHY_549__SFR_OFFS=0x94
LOCAL &__DDRSS_PHY_550__SFR_OFFS
&__DDRSS_PHY_550__SFR_OFFS=0x98
LOCAL &__DDRSS_PHY_551__SFR_OFFS
&__DDRSS_PHY_551__SFR_OFFS=0x9c
LOCAL &__DDRSS_PHY_552__SFR_OFFS
&__DDRSS_PHY_552__SFR_OFFS=0xa0
LOCAL &__DDRSS_PHY_553__SFR_OFFS
&__DDRSS_PHY_553__SFR_OFFS=0xa4
LOCAL &__DDRSS_PHY_554__SFR_OFFS
&__DDRSS_PHY_554__SFR_OFFS=0xa8
LOCAL &__DDRSS_PHY_555__SFR_OFFS
&__DDRSS_PHY_555__SFR_OFFS=0xac
LOCAL &__DDRSS_PHY_556__SFR_OFFS
&__DDRSS_PHY_556__SFR_OFFS=0xb0
LOCAL &__DDRSS_PHY_557__SFR_OFFS
&__DDRSS_PHY_557__SFR_OFFS=0xb4
LOCAL &__DDRSS_PHY_558__SFR_OFFS
&__DDRSS_PHY_558__SFR_OFFS=0xb8
LOCAL &__DDRSS_PHY_559__SFR_OFFS
&__DDRSS_PHY_559__SFR_OFFS=0xbc
LOCAL &__DDRSS_PHY_560__SFR_OFFS
&__DDRSS_PHY_560__SFR_OFFS=0xc0
LOCAL &__DDRSS_PHY_561__SFR_OFFS
&__DDRSS_PHY_561__SFR_OFFS=0xc4
LOCAL &__DDRSS_PHY_562__SFR_OFFS
&__DDRSS_PHY_562__SFR_OFFS=0xc8
LOCAL &__DDRSS_PHY_563__SFR_OFFS
&__DDRSS_PHY_563__SFR_OFFS=0xcc
LOCAL &__DDRSS_PHY_564__SFR_OFFS
&__DDRSS_PHY_564__SFR_OFFS=0xd0
LOCAL &__DDRSS_PHY_565__SFR_OFFS
&__DDRSS_PHY_565__SFR_OFFS=0xd4
LOCAL &__DDRSS_PHY_566__SFR_OFFS
&__DDRSS_PHY_566__SFR_OFFS=0xd8
LOCAL &__DDRSS_PHY_567__SFR_OFFS
&__DDRSS_PHY_567__SFR_OFFS=0xdc
LOCAL &__DDRSS_PHY_568__SFR_OFFS
&__DDRSS_PHY_568__SFR_OFFS=0xe0
LOCAL &__DDRSS_PHY_569__SFR_OFFS
&__DDRSS_PHY_569__SFR_OFFS=0xe4
LOCAL &__DDRSS_PHY_570__SFR_OFFS
&__DDRSS_PHY_570__SFR_OFFS=0xe8
LOCAL &__DDRSS_PHY_571__SFR_OFFS
&__DDRSS_PHY_571__SFR_OFFS=0xec
LOCAL &__DDRSS_PHY_572__SFR_OFFS
&__DDRSS_PHY_572__SFR_OFFS=0xf0
LOCAL &__DDRSS_PHY_573__SFR_OFFS
&__DDRSS_PHY_573__SFR_OFFS=0xf4
LOCAL &__DDRSS_PHY_574__SFR_OFFS
&__DDRSS_PHY_574__SFR_OFFS=0xf8
LOCAL &__DDRSS_PHY_575__SFR_OFFS
&__DDRSS_PHY_575__SFR_OFFS=0xfc
LOCAL &__DDRSS_PHY_576__SFR_OFFS
&__DDRSS_PHY_576__SFR_OFFS=0x100
LOCAL &__DDRSS_PHY_577__SFR_OFFS
&__DDRSS_PHY_577__SFR_OFFS=0x104
LOCAL &__DDRSS_PHY_578__SFR_OFFS
&__DDRSS_PHY_578__SFR_OFFS=0x108
LOCAL &__DDRSS_PHY_579__SFR_OFFS
&__DDRSS_PHY_579__SFR_OFFS=0x10c
LOCAL &__DDRSS_PHY_580__SFR_OFFS
&__DDRSS_PHY_580__SFR_OFFS=0x110
LOCAL &__DDRSS_PHY_581__SFR_OFFS
&__DDRSS_PHY_581__SFR_OFFS=0x114
LOCAL &__DDRSS_PHY_582__SFR_OFFS
&__DDRSS_PHY_582__SFR_OFFS=0x118
LOCAL &__DDRSS_PHY_583__SFR_OFFS
&__DDRSS_PHY_583__SFR_OFFS=0x11c
LOCAL &__DDRSS_PHY_584__SFR_OFFS
&__DDRSS_PHY_584__SFR_OFFS=0x120
LOCAL &__DDRSS_PHY_585__SFR_OFFS
&__DDRSS_PHY_585__SFR_OFFS=0x124
LOCAL &__DDRSS_PHY_586__SFR_OFFS
&__DDRSS_PHY_586__SFR_OFFS=0x128
LOCAL &__DDRSS_PHY_587__SFR_OFFS
&__DDRSS_PHY_587__SFR_OFFS=0x12c
LOCAL &__DDRSS_PHY_588__SFR_OFFS
&__DDRSS_PHY_588__SFR_OFFS=0x130
LOCAL &__DDRSS_PHY_589__SFR_OFFS
&__DDRSS_PHY_589__SFR_OFFS=0x134
LOCAL &__DDRSS_PHY_590__SFR_OFFS
&__DDRSS_PHY_590__SFR_OFFS=0x138
LOCAL &__DDRSS_PHY_591__SFR_OFFS
&__DDRSS_PHY_591__SFR_OFFS=0x13c
LOCAL &__DDRSS_PHY_592__SFR_OFFS
&__DDRSS_PHY_592__SFR_OFFS=0x140
LOCAL &__DDRSS_PHY_593__SFR_OFFS
&__DDRSS_PHY_593__SFR_OFFS=0x144
LOCAL &__DDRSS_PHY_594__SFR_OFFS
&__DDRSS_PHY_594__SFR_OFFS=0x148
LOCAL &__DDRSS_PHY_595__SFR_OFFS
&__DDRSS_PHY_595__SFR_OFFS=0x14c
LOCAL &__DDRSS_PHY_596__SFR_OFFS
&__DDRSS_PHY_596__SFR_OFFS=0x150
LOCAL &__DDRSS_PHY_597__SFR_OFFS
&__DDRSS_PHY_597__SFR_OFFS=0x154
LOCAL &__DDRSS_PHY_598__SFR_OFFS
&__DDRSS_PHY_598__SFR_OFFS=0x158
LOCAL &__DDRSS_PHY_599__SFR_OFFS
&__DDRSS_PHY_599__SFR_OFFS=0x15c
LOCAL &__DDRSS_PHY_600__SFR_OFFS
&__DDRSS_PHY_600__SFR_OFFS=0x160
LOCAL &__DDRSS_PHY_601__SFR_OFFS
&__DDRSS_PHY_601__SFR_OFFS=0x164
LOCAL &__DDRSS_PHY_602__SFR_OFFS
&__DDRSS_PHY_602__SFR_OFFS=0x168
LOCAL &__DDRSS_PHY_603__SFR_OFFS
&__DDRSS_PHY_603__SFR_OFFS=0x16c
LOCAL &__DDRSS_PHY_604__SFR_OFFS
&__DDRSS_PHY_604__SFR_OFFS=0x170
LOCAL &__DDRSS_PHY_605__SFR_OFFS
&__DDRSS_PHY_605__SFR_OFFS=0x174
LOCAL &__DDRSS_PHY_606__SFR_OFFS
&__DDRSS_PHY_606__SFR_OFFS=0x178
LOCAL &__DDRSS_PHY_607__SFR_OFFS
&__DDRSS_PHY_607__SFR_OFFS=0x17c
LOCAL &__DDRSS_PHY_608__SFR_OFFS
&__DDRSS_PHY_608__SFR_OFFS=0x180
LOCAL &__DDRSS_PHY_609__SFR_OFFS
&__DDRSS_PHY_609__SFR_OFFS=0x184
LOCAL &__DDRSS_PHY_610__SFR_OFFS
&__DDRSS_PHY_610__SFR_OFFS=0x188
LOCAL &__DDRSS_PHY_611__SFR_OFFS
&__DDRSS_PHY_611__SFR_OFFS=0x18c
LOCAL &__DDRSS_PHY_612__SFR_OFFS
&__DDRSS_PHY_612__SFR_OFFS=0x190
LOCAL &__DDRSS_PHY_613__SFR_OFFS
&__DDRSS_PHY_613__SFR_OFFS=0x194
LOCAL &__DDRSS_PHY_614__SFR_OFFS
&__DDRSS_PHY_614__SFR_OFFS=0x198
LOCAL &__DDRSS_PHY_615__SFR_OFFS
&__DDRSS_PHY_615__SFR_OFFS=0x19c
LOCAL &__DDRSS_PHY_616__SFR_OFFS
&__DDRSS_PHY_616__SFR_OFFS=0x1a0
LOCAL &__DDRSS_PHY_617__SFR_OFFS
&__DDRSS_PHY_617__SFR_OFFS=0x1a4
LOCAL &__DDRSS_PHY_618__SFR_OFFS
&__DDRSS_PHY_618__SFR_OFFS=0x1a8
LOCAL &__DDRSS_PHY_619__SFR_OFFS
&__DDRSS_PHY_619__SFR_OFFS=0x1ac
LOCAL &__DDRSS_PHY_620__SFR_OFFS
&__DDRSS_PHY_620__SFR_OFFS=0x1b0
LOCAL &__DDRSS_PHY_621__SFR_OFFS
&__DDRSS_PHY_621__SFR_OFFS=0x1b4
LOCAL &__DDRSS_PHY_622__SFR_OFFS
&__DDRSS_PHY_622__SFR_OFFS=0x1b8
LOCAL &__DDRSS_PHY_623__SFR_OFFS
&__DDRSS_PHY_623__SFR_OFFS=0x1bc
LOCAL &__DDRSS_PHY_624__SFR_OFFS
&__DDRSS_PHY_624__SFR_OFFS=0x1c0
LOCAL &__DDRSS_PHY_625__SFR_OFFS
&__DDRSS_PHY_625__SFR_OFFS=0x1c4
LOCAL &__DDRSS_PHY_626__SFR_OFFS
&__DDRSS_PHY_626__SFR_OFFS=0x1c8
LOCAL &__DDRSS_PHY_627__SFR_OFFS
&__DDRSS_PHY_627__SFR_OFFS=0x1cc
LOCAL &__DDRSS_PHY_628__SFR_OFFS
&__DDRSS_PHY_628__SFR_OFFS=0x1d0
LOCAL &__DDRSS_PHY_629__SFR_OFFS
&__DDRSS_PHY_629__SFR_OFFS=0x1d4
LOCAL &__DDRSS_PHY_630__SFR_OFFS
&__DDRSS_PHY_630__SFR_OFFS=0x1d8
LOCAL &__DDRSS_PHY_631__SFR_OFFS
&__DDRSS_PHY_631__SFR_OFFS=0x1dc
LOCAL &__DDRSS_PHY_632__SFR_OFFS
&__DDRSS_PHY_632__SFR_OFFS=0x1e0
LOCAL &__DDRSS_PHY_633__SFR_OFFS
&__DDRSS_PHY_633__SFR_OFFS=0x1e4
LOCAL &__DDRSS_PHY_634__SFR_OFFS
&__DDRSS_PHY_634__SFR_OFFS=0x1e8
LOCAL &__DDRSS_PHY_635__SFR_OFFS
&__DDRSS_PHY_635__SFR_OFFS=0x1ec
LOCAL &__DDRSS_PHY_636__SFR_OFFS
&__DDRSS_PHY_636__SFR_OFFS=0x1f0
LOCAL &__DDRSS_PHY_637__SFR_OFFS
&__DDRSS_PHY_637__SFR_OFFS=0x1f4
LOCAL &__DDRSS_PHY_638__SFR_OFFS
&__DDRSS_PHY_638__SFR_OFFS=0x1f8
LOCAL &__DDRSS_PHY_639__SFR_OFFS
&__DDRSS_PHY_639__SFR_OFFS=0x1fc
LOCAL &__DDRSS_PHY_640__SFR_OFFS
&__DDRSS_PHY_640__SFR_OFFS=0x200
LOCAL &__DDRSS_PHY_641__SFR_OFFS
&__DDRSS_PHY_641__SFR_OFFS=0x204
LOCAL &__DDRSS_PHY_642__SFR_OFFS
&__DDRSS_PHY_642__SFR_OFFS=0x208
LOCAL &__DDRSS_PHY_643__SFR_OFFS
&__DDRSS_PHY_643__SFR_OFFS=0x20c
LOCAL &__DDRSS_PHY_644__SFR_OFFS
&__DDRSS_PHY_644__SFR_OFFS=0x210
LOCAL &__DDRSS_PHY_645__SFR_OFFS
&__DDRSS_PHY_645__SFR_OFFS=0x214
LOCAL &__DDRSS_PHY_646__SFR_OFFS
&__DDRSS_PHY_646__SFR_OFFS=0x218
LOCAL &__DDRSS_PHY_647__SFR_OFFS
&__DDRSS_PHY_647__SFR_OFFS=0x21c
LOCAL &__DDRSS_PHY_648__SFR_OFFS
&__DDRSS_PHY_648__SFR_OFFS=0x220
LOCAL &__DDRSS_PHY_649__SFR_OFFS
&__DDRSS_PHY_649__SFR_OFFS=0x224
LOCAL &__DDRSS_PHY_650__SFR_OFFS
&__DDRSS_PHY_650__SFR_OFFS=0x228
LOCAL &__DDRSS_PHY_651__SFR_OFFS
&__DDRSS_PHY_651__SFR_OFFS=0x22c
// --  Macros for register block Data_Slice_3 
LOCAL &__DDRSS_Data_Slice_3_REGISTER_BLOCK__OFFS
&__DDRSS_Data_Slice_3_REGISTER_BLOCK__OFFS=0x4c00
LOCAL &__DDRSS_PHY_768__SFR_OFFS
&__DDRSS_PHY_768__SFR_OFFS=0x0
LOCAL &__DDRSS_PHY_769__SFR_OFFS
&__DDRSS_PHY_769__SFR_OFFS=0x4
LOCAL &__DDRSS_PHY_770__SFR_OFFS
&__DDRSS_PHY_770__SFR_OFFS=0x8
LOCAL &__DDRSS_PHY_771__SFR_OFFS
&__DDRSS_PHY_771__SFR_OFFS=0xc
LOCAL &__DDRSS_PHY_772__SFR_OFFS
&__DDRSS_PHY_772__SFR_OFFS=0x10
LOCAL &__DDRSS_PHY_773__SFR_OFFS
&__DDRSS_PHY_773__SFR_OFFS=0x14
LOCAL &__DDRSS_PHY_774__SFR_OFFS
&__DDRSS_PHY_774__SFR_OFFS=0x18
LOCAL &__DDRSS_PHY_775__SFR_OFFS
&__DDRSS_PHY_775__SFR_OFFS=0x1c
LOCAL &__DDRSS_PHY_776__SFR_OFFS
&__DDRSS_PHY_776__SFR_OFFS=0x20
LOCAL &__DDRSS_PHY_777__SFR_OFFS
&__DDRSS_PHY_777__SFR_OFFS=0x24
LOCAL &__DDRSS_PHY_778__SFR_OFFS
&__DDRSS_PHY_778__SFR_OFFS=0x28
LOCAL &__DDRSS_PHY_779__SFR_OFFS
&__DDRSS_PHY_779__SFR_OFFS=0x2c
LOCAL &__DDRSS_PHY_780__SFR_OFFS
&__DDRSS_PHY_780__SFR_OFFS=0x30
LOCAL &__DDRSS_PHY_781__SFR_OFFS
&__DDRSS_PHY_781__SFR_OFFS=0x34
LOCAL &__DDRSS_PHY_782__SFR_OFFS
&__DDRSS_PHY_782__SFR_OFFS=0x38
LOCAL &__DDRSS_PHY_783__SFR_OFFS
&__DDRSS_PHY_783__SFR_OFFS=0x3c
LOCAL &__DDRSS_PHY_784__SFR_OFFS
&__DDRSS_PHY_784__SFR_OFFS=0x40
LOCAL &__DDRSS_PHY_785__SFR_OFFS
&__DDRSS_PHY_785__SFR_OFFS=0x44
LOCAL &__DDRSS_PHY_786__SFR_OFFS
&__DDRSS_PHY_786__SFR_OFFS=0x48
LOCAL &__DDRSS_PHY_787__SFR_OFFS
&__DDRSS_PHY_787__SFR_OFFS=0x4c
LOCAL &__DDRSS_PHY_788__SFR_OFFS
&__DDRSS_PHY_788__SFR_OFFS=0x50
LOCAL &__DDRSS_PHY_789__SFR_OFFS
&__DDRSS_PHY_789__SFR_OFFS=0x54
LOCAL &__DDRSS_PHY_790__SFR_OFFS
&__DDRSS_PHY_790__SFR_OFFS=0x58
LOCAL &__DDRSS_PHY_791__SFR_OFFS
&__DDRSS_PHY_791__SFR_OFFS=0x5c
LOCAL &__DDRSS_PHY_792__SFR_OFFS
&__DDRSS_PHY_792__SFR_OFFS=0x60
LOCAL &__DDRSS_PHY_793__SFR_OFFS
&__DDRSS_PHY_793__SFR_OFFS=0x64
LOCAL &__DDRSS_PHY_794__SFR_OFFS
&__DDRSS_PHY_794__SFR_OFFS=0x68
LOCAL &__DDRSS_PHY_795__SFR_OFFS
&__DDRSS_PHY_795__SFR_OFFS=0x6c
LOCAL &__DDRSS_PHY_796__SFR_OFFS
&__DDRSS_PHY_796__SFR_OFFS=0x70
LOCAL &__DDRSS_PHY_797__SFR_OFFS
&__DDRSS_PHY_797__SFR_OFFS=0x74
LOCAL &__DDRSS_PHY_798__SFR_OFFS
&__DDRSS_PHY_798__SFR_OFFS=0x78
LOCAL &__DDRSS_PHY_799__SFR_OFFS
&__DDRSS_PHY_799__SFR_OFFS=0x7c
LOCAL &__DDRSS_PHY_800__SFR_OFFS
&__DDRSS_PHY_800__SFR_OFFS=0x80
LOCAL &__DDRSS_PHY_801__SFR_OFFS
&__DDRSS_PHY_801__SFR_OFFS=0x84
LOCAL &__DDRSS_PHY_802__SFR_OFFS
&__DDRSS_PHY_802__SFR_OFFS=0x88
LOCAL &__DDRSS_PHY_803__SFR_OFFS
&__DDRSS_PHY_803__SFR_OFFS=0x8c
LOCAL &__DDRSS_PHY_804__SFR_OFFS
&__DDRSS_PHY_804__SFR_OFFS=0x90
LOCAL &__DDRSS_PHY_805__SFR_OFFS
&__DDRSS_PHY_805__SFR_OFFS=0x94
LOCAL &__DDRSS_PHY_806__SFR_OFFS
&__DDRSS_PHY_806__SFR_OFFS=0x98
LOCAL &__DDRSS_PHY_807__SFR_OFFS
&__DDRSS_PHY_807__SFR_OFFS=0x9c
LOCAL &__DDRSS_PHY_808__SFR_OFFS
&__DDRSS_PHY_808__SFR_OFFS=0xa0
LOCAL &__DDRSS_PHY_809__SFR_OFFS
&__DDRSS_PHY_809__SFR_OFFS=0xa4
LOCAL &__DDRSS_PHY_810__SFR_OFFS
&__DDRSS_PHY_810__SFR_OFFS=0xa8
LOCAL &__DDRSS_PHY_811__SFR_OFFS
&__DDRSS_PHY_811__SFR_OFFS=0xac
LOCAL &__DDRSS_PHY_812__SFR_OFFS
&__DDRSS_PHY_812__SFR_OFFS=0xb0
LOCAL &__DDRSS_PHY_813__SFR_OFFS
&__DDRSS_PHY_813__SFR_OFFS=0xb4
LOCAL &__DDRSS_PHY_814__SFR_OFFS
&__DDRSS_PHY_814__SFR_OFFS=0xb8
LOCAL &__DDRSS_PHY_815__SFR_OFFS
&__DDRSS_PHY_815__SFR_OFFS=0xbc
LOCAL &__DDRSS_PHY_816__SFR_OFFS
&__DDRSS_PHY_816__SFR_OFFS=0xc0
LOCAL &__DDRSS_PHY_817__SFR_OFFS
&__DDRSS_PHY_817__SFR_OFFS=0xc4
LOCAL &__DDRSS_PHY_818__SFR_OFFS
&__DDRSS_PHY_818__SFR_OFFS=0xc8
LOCAL &__DDRSS_PHY_819__SFR_OFFS
&__DDRSS_PHY_819__SFR_OFFS=0xcc
LOCAL &__DDRSS_PHY_820__SFR_OFFS
&__DDRSS_PHY_820__SFR_OFFS=0xd0
LOCAL &__DDRSS_PHY_821__SFR_OFFS
&__DDRSS_PHY_821__SFR_OFFS=0xd4
LOCAL &__DDRSS_PHY_822__SFR_OFFS
&__DDRSS_PHY_822__SFR_OFFS=0xd8
LOCAL &__DDRSS_PHY_823__SFR_OFFS
&__DDRSS_PHY_823__SFR_OFFS=0xdc
LOCAL &__DDRSS_PHY_824__SFR_OFFS
&__DDRSS_PHY_824__SFR_OFFS=0xe0
LOCAL &__DDRSS_PHY_825__SFR_OFFS
&__DDRSS_PHY_825__SFR_OFFS=0xe4
LOCAL &__DDRSS_PHY_826__SFR_OFFS
&__DDRSS_PHY_826__SFR_OFFS=0xe8
LOCAL &__DDRSS_PHY_827__SFR_OFFS
&__DDRSS_PHY_827__SFR_OFFS=0xec
LOCAL &__DDRSS_PHY_828__SFR_OFFS
&__DDRSS_PHY_828__SFR_OFFS=0xf0
LOCAL &__DDRSS_PHY_829__SFR_OFFS
&__DDRSS_PHY_829__SFR_OFFS=0xf4
LOCAL &__DDRSS_PHY_830__SFR_OFFS
&__DDRSS_PHY_830__SFR_OFFS=0xf8
LOCAL &__DDRSS_PHY_831__SFR_OFFS
&__DDRSS_PHY_831__SFR_OFFS=0xfc
LOCAL &__DDRSS_PHY_832__SFR_OFFS
&__DDRSS_PHY_832__SFR_OFFS=0x100
LOCAL &__DDRSS_PHY_833__SFR_OFFS
&__DDRSS_PHY_833__SFR_OFFS=0x104
LOCAL &__DDRSS_PHY_834__SFR_OFFS
&__DDRSS_PHY_834__SFR_OFFS=0x108
LOCAL &__DDRSS_PHY_835__SFR_OFFS
&__DDRSS_PHY_835__SFR_OFFS=0x10c
LOCAL &__DDRSS_PHY_836__SFR_OFFS
&__DDRSS_PHY_836__SFR_OFFS=0x110
LOCAL &__DDRSS_PHY_837__SFR_OFFS
&__DDRSS_PHY_837__SFR_OFFS=0x114
LOCAL &__DDRSS_PHY_838__SFR_OFFS
&__DDRSS_PHY_838__SFR_OFFS=0x118
LOCAL &__DDRSS_PHY_839__SFR_OFFS
&__DDRSS_PHY_839__SFR_OFFS=0x11c
LOCAL &__DDRSS_PHY_840__SFR_OFFS
&__DDRSS_PHY_840__SFR_OFFS=0x120
LOCAL &__DDRSS_PHY_841__SFR_OFFS
&__DDRSS_PHY_841__SFR_OFFS=0x124
LOCAL &__DDRSS_PHY_842__SFR_OFFS
&__DDRSS_PHY_842__SFR_OFFS=0x128
LOCAL &__DDRSS_PHY_843__SFR_OFFS
&__DDRSS_PHY_843__SFR_OFFS=0x12c
LOCAL &__DDRSS_PHY_844__SFR_OFFS
&__DDRSS_PHY_844__SFR_OFFS=0x130
LOCAL &__DDRSS_PHY_845__SFR_OFFS
&__DDRSS_PHY_845__SFR_OFFS=0x134
LOCAL &__DDRSS_PHY_846__SFR_OFFS
&__DDRSS_PHY_846__SFR_OFFS=0x138
LOCAL &__DDRSS_PHY_847__SFR_OFFS
&__DDRSS_PHY_847__SFR_OFFS=0x13c
LOCAL &__DDRSS_PHY_848__SFR_OFFS
&__DDRSS_PHY_848__SFR_OFFS=0x140
LOCAL &__DDRSS_PHY_849__SFR_OFFS
&__DDRSS_PHY_849__SFR_OFFS=0x144
LOCAL &__DDRSS_PHY_850__SFR_OFFS
&__DDRSS_PHY_850__SFR_OFFS=0x148
LOCAL &__DDRSS_PHY_851__SFR_OFFS
&__DDRSS_PHY_851__SFR_OFFS=0x14c
LOCAL &__DDRSS_PHY_852__SFR_OFFS
&__DDRSS_PHY_852__SFR_OFFS=0x150
LOCAL &__DDRSS_PHY_853__SFR_OFFS
&__DDRSS_PHY_853__SFR_OFFS=0x154
LOCAL &__DDRSS_PHY_854__SFR_OFFS
&__DDRSS_PHY_854__SFR_OFFS=0x158
LOCAL &__DDRSS_PHY_855__SFR_OFFS
&__DDRSS_PHY_855__SFR_OFFS=0x15c
LOCAL &__DDRSS_PHY_856__SFR_OFFS
&__DDRSS_PHY_856__SFR_OFFS=0x160
LOCAL &__DDRSS_PHY_857__SFR_OFFS
&__DDRSS_PHY_857__SFR_OFFS=0x164
LOCAL &__DDRSS_PHY_858__SFR_OFFS
&__DDRSS_PHY_858__SFR_OFFS=0x168
LOCAL &__DDRSS_PHY_859__SFR_OFFS
&__DDRSS_PHY_859__SFR_OFFS=0x16c
LOCAL &__DDRSS_PHY_860__SFR_OFFS
&__DDRSS_PHY_860__SFR_OFFS=0x170
LOCAL &__DDRSS_PHY_861__SFR_OFFS
&__DDRSS_PHY_861__SFR_OFFS=0x174
LOCAL &__DDRSS_PHY_862__SFR_OFFS
&__DDRSS_PHY_862__SFR_OFFS=0x178
LOCAL &__DDRSS_PHY_863__SFR_OFFS
&__DDRSS_PHY_863__SFR_OFFS=0x17c
LOCAL &__DDRSS_PHY_864__SFR_OFFS
&__DDRSS_PHY_864__SFR_OFFS=0x180
LOCAL &__DDRSS_PHY_865__SFR_OFFS
&__DDRSS_PHY_865__SFR_OFFS=0x184
LOCAL &__DDRSS_PHY_866__SFR_OFFS
&__DDRSS_PHY_866__SFR_OFFS=0x188
LOCAL &__DDRSS_PHY_867__SFR_OFFS
&__DDRSS_PHY_867__SFR_OFFS=0x18c
LOCAL &__DDRSS_PHY_868__SFR_OFFS
&__DDRSS_PHY_868__SFR_OFFS=0x190
LOCAL &__DDRSS_PHY_869__SFR_OFFS
&__DDRSS_PHY_869__SFR_OFFS=0x194
LOCAL &__DDRSS_PHY_870__SFR_OFFS
&__DDRSS_PHY_870__SFR_OFFS=0x198
LOCAL &__DDRSS_PHY_871__SFR_OFFS
&__DDRSS_PHY_871__SFR_OFFS=0x19c
LOCAL &__DDRSS_PHY_872__SFR_OFFS
&__DDRSS_PHY_872__SFR_OFFS=0x1a0
LOCAL &__DDRSS_PHY_873__SFR_OFFS
&__DDRSS_PHY_873__SFR_OFFS=0x1a4
LOCAL &__DDRSS_PHY_874__SFR_OFFS
&__DDRSS_PHY_874__SFR_OFFS=0x1a8
LOCAL &__DDRSS_PHY_875__SFR_OFFS
&__DDRSS_PHY_875__SFR_OFFS=0x1ac
LOCAL &__DDRSS_PHY_876__SFR_OFFS
&__DDRSS_PHY_876__SFR_OFFS=0x1b0
LOCAL &__DDRSS_PHY_877__SFR_OFFS
&__DDRSS_PHY_877__SFR_OFFS=0x1b4
LOCAL &__DDRSS_PHY_878__SFR_OFFS
&__DDRSS_PHY_878__SFR_OFFS=0x1b8
LOCAL &__DDRSS_PHY_879__SFR_OFFS
&__DDRSS_PHY_879__SFR_OFFS=0x1bc
LOCAL &__DDRSS_PHY_880__SFR_OFFS
&__DDRSS_PHY_880__SFR_OFFS=0x1c0
LOCAL &__DDRSS_PHY_881__SFR_OFFS
&__DDRSS_PHY_881__SFR_OFFS=0x1c4
LOCAL &__DDRSS_PHY_882__SFR_OFFS
&__DDRSS_PHY_882__SFR_OFFS=0x1c8
LOCAL &__DDRSS_PHY_883__SFR_OFFS
&__DDRSS_PHY_883__SFR_OFFS=0x1cc
LOCAL &__DDRSS_PHY_884__SFR_OFFS
&__DDRSS_PHY_884__SFR_OFFS=0x1d0
LOCAL &__DDRSS_PHY_885__SFR_OFFS
&__DDRSS_PHY_885__SFR_OFFS=0x1d4
LOCAL &__DDRSS_PHY_886__SFR_OFFS
&__DDRSS_PHY_886__SFR_OFFS=0x1d8
LOCAL &__DDRSS_PHY_887__SFR_OFFS
&__DDRSS_PHY_887__SFR_OFFS=0x1dc
LOCAL &__DDRSS_PHY_888__SFR_OFFS
&__DDRSS_PHY_888__SFR_OFFS=0x1e0
LOCAL &__DDRSS_PHY_889__SFR_OFFS
&__DDRSS_PHY_889__SFR_OFFS=0x1e4
LOCAL &__DDRSS_PHY_890__SFR_OFFS
&__DDRSS_PHY_890__SFR_OFFS=0x1e8
LOCAL &__DDRSS_PHY_891__SFR_OFFS
&__DDRSS_PHY_891__SFR_OFFS=0x1ec
LOCAL &__DDRSS_PHY_892__SFR_OFFS
&__DDRSS_PHY_892__SFR_OFFS=0x1f0
LOCAL &__DDRSS_PHY_893__SFR_OFFS
&__DDRSS_PHY_893__SFR_OFFS=0x1f4
LOCAL &__DDRSS_PHY_894__SFR_OFFS
&__DDRSS_PHY_894__SFR_OFFS=0x1f8
LOCAL &__DDRSS_PHY_895__SFR_OFFS
&__DDRSS_PHY_895__SFR_OFFS=0x1fc
LOCAL &__DDRSS_PHY_896__SFR_OFFS
&__DDRSS_PHY_896__SFR_OFFS=0x200
LOCAL &__DDRSS_PHY_897__SFR_OFFS
&__DDRSS_PHY_897__SFR_OFFS=0x204
LOCAL &__DDRSS_PHY_898__SFR_OFFS
&__DDRSS_PHY_898__SFR_OFFS=0x208
LOCAL &__DDRSS_PHY_899__SFR_OFFS
&__DDRSS_PHY_899__SFR_OFFS=0x20c
LOCAL &__DDRSS_PHY_900__SFR_OFFS
&__DDRSS_PHY_900__SFR_OFFS=0x210
LOCAL &__DDRSS_PHY_901__SFR_OFFS
&__DDRSS_PHY_901__SFR_OFFS=0x214
LOCAL &__DDRSS_PHY_902__SFR_OFFS
&__DDRSS_PHY_902__SFR_OFFS=0x218
LOCAL &__DDRSS_PHY_903__SFR_OFFS
&__DDRSS_PHY_903__SFR_OFFS=0x21c
LOCAL &__DDRSS_PHY_904__SFR_OFFS
&__DDRSS_PHY_904__SFR_OFFS=0x220
LOCAL &__DDRSS_PHY_905__SFR_OFFS
&__DDRSS_PHY_905__SFR_OFFS=0x224
LOCAL &__DDRSS_PHY_906__SFR_OFFS
&__DDRSS_PHY_906__SFR_OFFS=0x228
LOCAL &__DDRSS_PHY_907__SFR_OFFS
&__DDRSS_PHY_907__SFR_OFFS=0x22c
// --  Macros for register block Address_Slice_0 
LOCAL &__DDRSS_Address_Slice_0_REGISTER_BLOCK__OFFS
&__DDRSS_Address_Slice_0_REGISTER_BLOCK__OFFS=0x5000
LOCAL &__DDRSS_PHY_1024__SFR_OFFS
&__DDRSS_PHY_1024__SFR_OFFS=0x0
LOCAL &__DDRSS_PHY_1025__SFR_OFFS
&__DDRSS_PHY_1025__SFR_OFFS=0x4
LOCAL &__DDRSS_PHY_1026__SFR_OFFS
&__DDRSS_PHY_1026__SFR_OFFS=0x8
LOCAL &__DDRSS_PHY_1027__SFR_OFFS
&__DDRSS_PHY_1027__SFR_OFFS=0xc
LOCAL &__DDRSS_PHY_1028__SFR_OFFS
&__DDRSS_PHY_1028__SFR_OFFS=0x10
LOCAL &__DDRSS_PHY_1029__SFR_OFFS
&__DDRSS_PHY_1029__SFR_OFFS=0x14
LOCAL &__DDRSS_PHY_1030__SFR_OFFS
&__DDRSS_PHY_1030__SFR_OFFS=0x18
LOCAL &__DDRSS_PHY_1031__SFR_OFFS
&__DDRSS_PHY_1031__SFR_OFFS=0x1c
LOCAL &__DDRSS_PHY_1032__SFR_OFFS
&__DDRSS_PHY_1032__SFR_OFFS=0x20
LOCAL &__DDRSS_PHY_1033__SFR_OFFS
&__DDRSS_PHY_1033__SFR_OFFS=0x24
LOCAL &__DDRSS_PHY_1034__SFR_OFFS
&__DDRSS_PHY_1034__SFR_OFFS=0x28
LOCAL &__DDRSS_PHY_1035__SFR_OFFS
&__DDRSS_PHY_1035__SFR_OFFS=0x2c
LOCAL &__DDRSS_PHY_1036__SFR_OFFS
&__DDRSS_PHY_1036__SFR_OFFS=0x30
LOCAL &__DDRSS_PHY_1037__SFR_OFFS
&__DDRSS_PHY_1037__SFR_OFFS=0x34
LOCAL &__DDRSS_PHY_1038__SFR_OFFS
&__DDRSS_PHY_1038__SFR_OFFS=0x38
LOCAL &__DDRSS_PHY_1039__SFR_OFFS
&__DDRSS_PHY_1039__SFR_OFFS=0x3c
LOCAL &__DDRSS_PHY_1040__SFR_OFFS
&__DDRSS_PHY_1040__SFR_OFFS=0x40
LOCAL &__DDRSS_PHY_1041__SFR_OFFS
&__DDRSS_PHY_1041__SFR_OFFS=0x44
LOCAL &__DDRSS_PHY_1042__SFR_OFFS
&__DDRSS_PHY_1042__SFR_OFFS=0x48
LOCAL &__DDRSS_PHY_1043__SFR_OFFS
&__DDRSS_PHY_1043__SFR_OFFS=0x4c
LOCAL &__DDRSS_PHY_1044__SFR_OFFS
&__DDRSS_PHY_1044__SFR_OFFS=0x50
LOCAL &__DDRSS_PHY_1045__SFR_OFFS
&__DDRSS_PHY_1045__SFR_OFFS=0x54
LOCAL &__DDRSS_PHY_1046__SFR_OFFS
&__DDRSS_PHY_1046__SFR_OFFS=0x58
LOCAL &__DDRSS_PHY_1047__SFR_OFFS
&__DDRSS_PHY_1047__SFR_OFFS=0x5c
LOCAL &__DDRSS_PHY_1048__SFR_OFFS
&__DDRSS_PHY_1048__SFR_OFFS=0x60
LOCAL &__DDRSS_PHY_1049__SFR_OFFS
&__DDRSS_PHY_1049__SFR_OFFS=0x64
LOCAL &__DDRSS_PHY_1050__SFR_OFFS
&__DDRSS_PHY_1050__SFR_OFFS=0x68
LOCAL &__DDRSS_PHY_1051__SFR_OFFS
&__DDRSS_PHY_1051__SFR_OFFS=0x6c
LOCAL &__DDRSS_PHY_1052__SFR_OFFS
&__DDRSS_PHY_1052__SFR_OFFS=0x70
LOCAL &__DDRSS_PHY_1053__SFR_OFFS
&__DDRSS_PHY_1053__SFR_OFFS=0x74
LOCAL &__DDRSS_PHY_1054__SFR_OFFS
&__DDRSS_PHY_1054__SFR_OFFS=0x78
LOCAL &__DDRSS_PHY_1055__SFR_OFFS
&__DDRSS_PHY_1055__SFR_OFFS=0x7c
LOCAL &__DDRSS_PHY_1056__SFR_OFFS
&__DDRSS_PHY_1056__SFR_OFFS=0x80
LOCAL &__DDRSS_PHY_1057__SFR_OFFS
&__DDRSS_PHY_1057__SFR_OFFS=0x84
LOCAL &__DDRSS_PHY_1058__SFR_OFFS
&__DDRSS_PHY_1058__SFR_OFFS=0x88
LOCAL &__DDRSS_PHY_1059__SFR_OFFS
&__DDRSS_PHY_1059__SFR_OFFS=0x8c
LOCAL &__DDRSS_PHY_1060__SFR_OFFS
&__DDRSS_PHY_1060__SFR_OFFS=0x90
LOCAL &__DDRSS_PHY_1061__SFR_OFFS
&__DDRSS_PHY_1061__SFR_OFFS=0x94
LOCAL &__DDRSS_PHY_1062__SFR_OFFS
&__DDRSS_PHY_1062__SFR_OFFS=0x98
LOCAL &__DDRSS_PHY_1063__SFR_OFFS
&__DDRSS_PHY_1063__SFR_OFFS=0x9c
LOCAL &__DDRSS_PHY_1064__SFR_OFFS
&__DDRSS_PHY_1064__SFR_OFFS=0xa0
LOCAL &__DDRSS_PHY_1065__SFR_OFFS
&__DDRSS_PHY_1065__SFR_OFFS=0xa4
LOCAL &__DDRSS_PHY_1066__SFR_OFFS
&__DDRSS_PHY_1066__SFR_OFFS=0xa8
LOCAL &__DDRSS_PHY_1067__SFR_OFFS
&__DDRSS_PHY_1067__SFR_OFFS=0xac
LOCAL &__DDRSS_PHY_1068__SFR_OFFS
&__DDRSS_PHY_1068__SFR_OFFS=0xb0
LOCAL &__DDRSS_PHY_1069__SFR_OFFS
&__DDRSS_PHY_1069__SFR_OFFS=0xb4
LOCAL &__DDRSS_PHY_1070__SFR_OFFS
&__DDRSS_PHY_1070__SFR_OFFS=0xb8
LOCAL &__DDRSS_PHY_1071__SFR_OFFS
&__DDRSS_PHY_1071__SFR_OFFS=0xbc
LOCAL &__DDRSS_PHY_1072__SFR_OFFS
&__DDRSS_PHY_1072__SFR_OFFS=0xc0
LOCAL &__DDRSS_PHY_1073__SFR_OFFS
&__DDRSS_PHY_1073__SFR_OFFS=0xc4
LOCAL &__DDRSS_PHY_1074__SFR_OFFS
&__DDRSS_PHY_1074__SFR_OFFS=0xc8
LOCAL &__DDRSS_PHY_1075__SFR_OFFS
&__DDRSS_PHY_1075__SFR_OFFS=0xcc
// --  Macros for register block PHY_Core 
LOCAL &__DDRSS_PHY_Core_REGISTER_BLOCK__OFFS
&__DDRSS_PHY_Core_REGISTER_BLOCK__OFFS=0x5400
LOCAL &__DDRSS_PHY_1280__SFR_OFFS
&__DDRSS_PHY_1280__SFR_OFFS=0x0
LOCAL &__DDRSS_PHY_1281__SFR_OFFS
&__DDRSS_PHY_1281__SFR_OFFS=0x4
LOCAL &__DDRSS_PHY_1282__SFR_OFFS
&__DDRSS_PHY_1282__SFR_OFFS=0x8
LOCAL &__DDRSS_PHY_1283__SFR_OFFS
&__DDRSS_PHY_1283__SFR_OFFS=0xc
LOCAL &__DDRSS_PHY_1284__SFR_OFFS
&__DDRSS_PHY_1284__SFR_OFFS=0x10
LOCAL &__DDRSS_PHY_1285__SFR_OFFS
&__DDRSS_PHY_1285__SFR_OFFS=0x14
LOCAL &__DDRSS_PHY_1286__SFR_OFFS
&__DDRSS_PHY_1286__SFR_OFFS=0x18
LOCAL &__DDRSS_PHY_1287__SFR_OFFS
&__DDRSS_PHY_1287__SFR_OFFS=0x1c
LOCAL &__DDRSS_PHY_1288__SFR_OFFS
&__DDRSS_PHY_1288__SFR_OFFS=0x20
LOCAL &__DDRSS_PHY_1289__SFR_OFFS
&__DDRSS_PHY_1289__SFR_OFFS=0x24
LOCAL &__DDRSS_PHY_1290__SFR_OFFS
&__DDRSS_PHY_1290__SFR_OFFS=0x28
LOCAL &__DDRSS_PHY_1291__SFR_OFFS
&__DDRSS_PHY_1291__SFR_OFFS=0x2c
LOCAL &__DDRSS_PHY_1292__SFR_OFFS
&__DDRSS_PHY_1292__SFR_OFFS=0x30
LOCAL &__DDRSS_PHY_1293__SFR_OFFS
&__DDRSS_PHY_1293__SFR_OFFS=0x34
LOCAL &__DDRSS_PHY_1294__SFR_OFFS
&__DDRSS_PHY_1294__SFR_OFFS=0x38
LOCAL &__DDRSS_PHY_1295__SFR_OFFS
&__DDRSS_PHY_1295__SFR_OFFS=0x3c
LOCAL &__DDRSS_PHY_1296__SFR_OFFS
&__DDRSS_PHY_1296__SFR_OFFS=0x40
LOCAL &__DDRSS_PHY_1297__SFR_OFFS
&__DDRSS_PHY_1297__SFR_OFFS=0x44
LOCAL &__DDRSS_PHY_1298__SFR_OFFS
&__DDRSS_PHY_1298__SFR_OFFS=0x48
LOCAL &__DDRSS_PHY_1299__SFR_OFFS
&__DDRSS_PHY_1299__SFR_OFFS=0x4c
LOCAL &__DDRSS_PHY_1300__SFR_OFFS
&__DDRSS_PHY_1300__SFR_OFFS=0x50
LOCAL &__DDRSS_PHY_1301__SFR_OFFS
&__DDRSS_PHY_1301__SFR_OFFS=0x54
LOCAL &__DDRSS_PHY_1302__SFR_OFFS
&__DDRSS_PHY_1302__SFR_OFFS=0x58
LOCAL &__DDRSS_PHY_1303__SFR_OFFS
&__DDRSS_PHY_1303__SFR_OFFS=0x5c
LOCAL &__DDRSS_PHY_1304__SFR_OFFS
&__DDRSS_PHY_1304__SFR_OFFS=0x60
LOCAL &__DDRSS_PHY_1305__SFR_OFFS
&__DDRSS_PHY_1305__SFR_OFFS=0x64
LOCAL &__DDRSS_PHY_1306__SFR_OFFS
&__DDRSS_PHY_1306__SFR_OFFS=0x68
LOCAL &__DDRSS_PHY_1307__SFR_OFFS
&__DDRSS_PHY_1307__SFR_OFFS=0x6c
LOCAL &__DDRSS_PHY_1308__SFR_OFFS
&__DDRSS_PHY_1308__SFR_OFFS=0x70
LOCAL &__DDRSS_PHY_1309__SFR_OFFS
&__DDRSS_PHY_1309__SFR_OFFS=0x74
LOCAL &__DDRSS_PHY_1310__SFR_OFFS
&__DDRSS_PHY_1310__SFR_OFFS=0x78
LOCAL &__DDRSS_PHY_1311__SFR_OFFS
&__DDRSS_PHY_1311__SFR_OFFS=0x7c
LOCAL &__DDRSS_PHY_1312__SFR_OFFS
&__DDRSS_PHY_1312__SFR_OFFS=0x80
LOCAL &__DDRSS_PHY_1313__SFR_OFFS
&__DDRSS_PHY_1313__SFR_OFFS=0x84
LOCAL &__DDRSS_PHY_1314__SFR_OFFS
&__DDRSS_PHY_1314__SFR_OFFS=0x88
LOCAL &__DDRSS_PHY_1315__SFR_OFFS
&__DDRSS_PHY_1315__SFR_OFFS=0x8c
LOCAL &__DDRSS_PHY_1316__SFR_OFFS
&__DDRSS_PHY_1316__SFR_OFFS=0x90
LOCAL &__DDRSS_PHY_1317__SFR_OFFS
&__DDRSS_PHY_1317__SFR_OFFS=0x94
LOCAL &__DDRSS_PHY_1318__SFR_OFFS
&__DDRSS_PHY_1318__SFR_OFFS=0x98
LOCAL &__DDRSS_PHY_1319__SFR_OFFS
&__DDRSS_PHY_1319__SFR_OFFS=0x9c
LOCAL &__DDRSS_PHY_1320__SFR_OFFS
&__DDRSS_PHY_1320__SFR_OFFS=0xa0
LOCAL &__DDRSS_PHY_1321__SFR_OFFS
&__DDRSS_PHY_1321__SFR_OFFS=0xa4
LOCAL &__DDRSS_PHY_1322__SFR_OFFS
&__DDRSS_PHY_1322__SFR_OFFS=0xa8
LOCAL &__DDRSS_PHY_1323__SFR_OFFS
&__DDRSS_PHY_1323__SFR_OFFS=0xac
LOCAL &__DDRSS_PHY_1324__SFR_OFFS
&__DDRSS_PHY_1324__SFR_OFFS=0xb0
LOCAL &__DDRSS_PHY_1325__SFR_OFFS
&__DDRSS_PHY_1325__SFR_OFFS=0xb4
LOCAL &__DDRSS_PHY_1326__SFR_OFFS
&__DDRSS_PHY_1326__SFR_OFFS=0xb8
LOCAL &__DDRSS_PHY_1327__SFR_OFFS
&__DDRSS_PHY_1327__SFR_OFFS=0xbc
LOCAL &__DDRSS_PHY_1328__SFR_OFFS
&__DDRSS_PHY_1328__SFR_OFFS=0xc0
LOCAL &__DDRSS_PHY_1329__SFR_OFFS
&__DDRSS_PHY_1329__SFR_OFFS=0xc4
LOCAL &__DDRSS_PHY_1330__SFR_OFFS
&__DDRSS_PHY_1330__SFR_OFFS=0xc8
LOCAL &__DDRSS_PHY_1331__SFR_OFFS
&__DDRSS_PHY_1331__SFR_OFFS=0xcc
LOCAL &__DDRSS_PHY_1332__SFR_OFFS
&__DDRSS_PHY_1332__SFR_OFFS=0xd0
LOCAL &__DDRSS_PHY_1333__SFR_OFFS
&__DDRSS_PHY_1333__SFR_OFFS=0xd4
LOCAL &__DDRSS_PHY_1334__SFR_OFFS
&__DDRSS_PHY_1334__SFR_OFFS=0xd8
LOCAL &__DDRSS_PHY_1335__SFR_OFFS
&__DDRSS_PHY_1335__SFR_OFFS=0xdc
LOCAL &__DDRSS_PHY_1336__SFR_OFFS
&__DDRSS_PHY_1336__SFR_OFFS=0xe0
LOCAL &__DDRSS_PHY_1337__SFR_OFFS
&__DDRSS_PHY_1337__SFR_OFFS=0xe4
LOCAL &__DDRSS_PHY_1338__SFR_OFFS
&__DDRSS_PHY_1338__SFR_OFFS=0xe8
LOCAL &__DDRSS_PHY_1339__SFR_OFFS
&__DDRSS_PHY_1339__SFR_OFFS=0xec
LOCAL &__DDRSS_PHY_1340__SFR_OFFS
&__DDRSS_PHY_1340__SFR_OFFS=0xf0
LOCAL &__DDRSS_PHY_1341__SFR_OFFS
&__DDRSS_PHY_1341__SFR_OFFS=0xf4
LOCAL &__DDRSS_PHY_1342__SFR_OFFS
&__DDRSS_PHY_1342__SFR_OFFS=0xf8
LOCAL &__DDRSS_PHY_1343__SFR_OFFS
&__DDRSS_PHY_1343__SFR_OFFS=0xfc
LOCAL &__DDRSS_PHY_1344__SFR_OFFS
&__DDRSS_PHY_1344__SFR_OFFS=0x100
LOCAL &__DDRSS_PHY_1345__SFR_OFFS
&__DDRSS_PHY_1345__SFR_OFFS=0x104
LOCAL &__DDRSS_PHY_1346__SFR_OFFS
&__DDRSS_PHY_1346__SFR_OFFS=0x108
LOCAL &__DDRSS_PHY_1347__SFR_OFFS
&__DDRSS_PHY_1347__SFR_OFFS=0x10c
LOCAL &__DDRSS_PHY_1348__SFR_OFFS
&__DDRSS_PHY_1348__SFR_OFFS=0x110
LOCAL &__DDRSS_PHY_1349__SFR_OFFS
&__DDRSS_PHY_1349__SFR_OFFS=0x114
LOCAL &__DDRSS_PHY_1350__SFR_OFFS
&__DDRSS_PHY_1350__SFR_OFFS=0x118
LOCAL &__DDRSS_PHY_1351__SFR_OFFS
&__DDRSS_PHY_1351__SFR_OFFS=0x11c
LOCAL &__DDRSS_PHY_1352__SFR_OFFS
&__DDRSS_PHY_1352__SFR_OFFS=0x120
LOCAL &__DDRSS_PHY_1353__SFR_OFFS
&__DDRSS_PHY_1353__SFR_OFFS=0x124
LOCAL &__DDRSS_PHY_1354__SFR_OFFS
&__DDRSS_PHY_1354__SFR_OFFS=0x128
LOCAL &__DDRSS_PHY_1355__SFR_OFFS
&__DDRSS_PHY_1355__SFR_OFFS=0x12c
LOCAL &__DDRSS_PHY_1356__SFR_OFFS
&__DDRSS_PHY_1356__SFR_OFFS=0x130
LOCAL &__DDRSS_PHY_1357__SFR_OFFS
&__DDRSS_PHY_1357__SFR_OFFS=0x134
LOCAL &__DDRSS_PHY_1358__SFR_OFFS
&__DDRSS_PHY_1358__SFR_OFFS=0x138
LOCAL &__DDRSS_PHY_1359__SFR_OFFS
&__DDRSS_PHY_1359__SFR_OFFS=0x13c
LOCAL &__DDRSS_PHY_1360__SFR_OFFS
&__DDRSS_PHY_1360__SFR_OFFS=0x140
LOCAL &__DDRSS_PHY_1361__SFR_OFFS
&__DDRSS_PHY_1361__SFR_OFFS=0x144
LOCAL &__DDRSS_PHY_1362__SFR_OFFS
&__DDRSS_PHY_1362__SFR_OFFS=0x148
LOCAL &__DDRSS_PHY_1363__SFR_OFFS
&__DDRSS_PHY_1363__SFR_OFFS=0x14c
LOCAL &__DDRSS_PHY_1364__SFR_OFFS
&__DDRSS_PHY_1364__SFR_OFFS=0x150
LOCAL &__DDRSS_PHY_1365__SFR_OFFS
&__DDRSS_PHY_1365__SFR_OFFS=0x154
LOCAL &__DDRSS_PHY_1366__SFR_OFFS
&__DDRSS_PHY_1366__SFR_OFFS=0x158
LOCAL &__DDRSS_PHY_1367__SFR_OFFS
&__DDRSS_PHY_1367__SFR_OFFS=0x15c
LOCAL &__DDRSS_PHY_1368__SFR_OFFS
&__DDRSS_PHY_1368__SFR_OFFS=0x160
LOCAL &__DDRSS_PHY_1369__SFR_OFFS
&__DDRSS_PHY_1369__SFR_OFFS=0x164
LOCAL &__DDRSS_PHY_1370__SFR_OFFS
&__DDRSS_PHY_1370__SFR_OFFS=0x168
LOCAL &__DDRSS_PHY_1371__SFR_OFFS
&__DDRSS_PHY_1371__SFR_OFFS=0x16c
LOCAL &__DDRSS_PHY_1372__SFR_OFFS
&__DDRSS_PHY_1372__SFR_OFFS=0x170
LOCAL &__DDRSS_PHY_1373__SFR_OFFS
&__DDRSS_PHY_1373__SFR_OFFS=0x174
LOCAL &__DDRSS_PHY_1374__SFR_OFFS
&__DDRSS_PHY_1374__SFR_OFFS=0x178
LOCAL &__DDRSS_PHY_1375__SFR_OFFS
&__DDRSS_PHY_1375__SFR_OFFS=0x17c
LOCAL &__DDRSS_PHY_1376__SFR_OFFS
&__DDRSS_PHY_1376__SFR_OFFS=0x180
LOCAL &__DDRSS_PHY_1377__SFR_OFFS
&__DDRSS_PHY_1377__SFR_OFFS=0x184
LOCAL &__DDRSS_PHY_1378__SFR_OFFS
&__DDRSS_PHY_1378__SFR_OFFS=0x188
LOCAL &__DDRSS_PHY_1379__SFR_OFFS
&__DDRSS_PHY_1379__SFR_OFFS=0x18c
LOCAL &__DDRSS_PHY_1380__SFR_OFFS
&__DDRSS_PHY_1380__SFR_OFFS=0x190
LOCAL &__DDRSS_PHY_1381__SFR_OFFS
&__DDRSS_PHY_1381__SFR_OFFS=0x194
LOCAL &__DDRSS_PHY_1382__SFR_OFFS
&__DDRSS_PHY_1382__SFR_OFFS=0x198
LOCAL &__DDRSS_PHY_1383__SFR_OFFS
&__DDRSS_PHY_1383__SFR_OFFS=0x19c
LOCAL &__DDRSS_PHY_1384__SFR_OFFS
&__DDRSS_PHY_1384__SFR_OFFS=0x1a0
LOCAL &__DDRSS_PHY_1385__SFR_OFFS
&__DDRSS_PHY_1385__SFR_OFFS=0x1a4
LOCAL &__DDRSS_PHY_1386__SFR_OFFS
&__DDRSS_PHY_1386__SFR_OFFS=0x1a8
LOCAL &__DDRSS_PHY_1387__SFR_OFFS
&__DDRSS_PHY_1387__SFR_OFFS=0x1ac
LOCAL &__DDRSS_PHY_1388__SFR_OFFS
&__DDRSS_PHY_1388__SFR_OFFS=0x1b0
LOCAL &__DDRSS_PHY_1389__SFR_OFFS
&__DDRSS_PHY_1389__SFR_OFFS=0x1b4
LOCAL &__DDRSS_PHY_1390__SFR_OFFS
&__DDRSS_PHY_1390__SFR_OFFS=0x1b8
LOCAL &__DDRSS_PHY_1391__SFR_OFFS
&__DDRSS_PHY_1391__SFR_OFFS=0x1bc
LOCAL &__DDRSS_PHY_1392__SFR_OFFS
&__DDRSS_PHY_1392__SFR_OFFS=0x1c0
LOCAL &__DDRSS_PHY_1393__SFR_OFFS
&__DDRSS_PHY_1393__SFR_OFFS=0x1c4
LOCAL &__DDRSS_PHY_1394__SFR_OFFS
&__DDRSS_PHY_1394__SFR_OFFS=0x1c8
LOCAL &__DDRSS_PHY_1395__SFR_OFFS
&__DDRSS_PHY_1395__SFR_OFFS=0x1cc
LOCAL &__DDRSS_PHY_1396__SFR_OFFS
&__DDRSS_PHY_1396__SFR_OFFS=0x1d0
LOCAL &__DDRSS_PHY_1397__SFR_OFFS
&__DDRSS_PHY_1397__SFR_OFFS=0x1d4
LOCAL &__DDRSS_PHY_1398__SFR_OFFS
&__DDRSS_PHY_1398__SFR_OFFS=0x1d8
LOCAL &__DDRSS_PHY_1399__SFR_OFFS
&__DDRSS_PHY_1399__SFR_OFFS=0x1dc
LOCAL &__DDRSS_PHY_1400__SFR_OFFS
&__DDRSS_PHY_1400__SFR_OFFS=0x1e0
LOCAL &__DDRSS_PHY_1401__SFR_OFFS
&__DDRSS_PHY_1401__SFR_OFFS=0x1e4
LOCAL &__DDRSS_PHY_1402__SFR_OFFS
&__DDRSS_PHY_1402__SFR_OFFS=0x1e8
LOCAL &__DDRSS_PHY_1403__SFR_OFFS
&__DDRSS_PHY_1403__SFR_OFFS=0x1ec
LOCAL &__DDRSS_PHY_1404__SFR_OFFS
&__DDRSS_PHY_1404__SFR_OFFS=0x1f0
LOCAL &__DDRSS_PHY_1405__SFR_OFFS
&__DDRSS_PHY_1405__SFR_OFFS=0x1f4
LOCAL &__DDRSS_PHY_1406__SFR_OFFS
&__DDRSS_PHY_1406__SFR_OFFS=0x1f8
LOCAL &__DDRSS_PHY_1407__SFR_OFFS
&__DDRSS_PHY_1407__SFR_OFFS=0x1fc
LOCAL &__DDRSS_PHY_1408__SFR_OFFS
&__DDRSS_PHY_1408__SFR_OFFS=0x200
LOCAL &__DDRSS_PHY_1409__SFR_OFFS
&__DDRSS_PHY_1409__SFR_OFFS=0x204
LOCAL &__DDRSS_PHY_1410__SFR_OFFS
&__DDRSS_PHY_1410__SFR_OFFS=0x208
LOCAL &__DDRSS_PHY_1411__SFR_OFFS
&__DDRSS_PHY_1411__SFR_OFFS=0x20c
LOCAL &__DDRSS_PHY_1412__SFR_OFFS
&__DDRSS_PHY_1412__SFR_OFFS=0x210
LOCAL &__DDRSS_PHY_1413__SFR_OFFS
&__DDRSS_PHY_1413__SFR_OFFS=0x214
LOCAL &__DDRSS_PHY_1414__SFR_OFFS
&__DDRSS_PHY_1414__SFR_OFFS=0x218
LOCAL &__DDRSS_PHY_1415__SFR_OFFS
&__DDRSS_PHY_1415__SFR_OFFS=0x21c
LOCAL &__DDRSS_PHY_1416__SFR_OFFS
&__DDRSS_PHY_1416__SFR_OFFS=0x220
LOCAL &__DDRSS_PHY_1417__SFR_OFFS
&__DDRSS_PHY_1417__SFR_OFFS=0x224
LOCAL &__DDRSS_PHY_1418__SFR_OFFS
&__DDRSS_PHY_1418__SFR_OFFS=0x228
LOCAL &__DDRSS_PHY_1419__SFR_OFFS
&__DDRSS_PHY_1419__SFR_OFFS=0x22c
LOCAL &__DDRSS_PHY_1420__SFR_OFFS
&__DDRSS_PHY_1420__SFR_OFFS=0x230
LOCAL &__DDRSS_PHY_1421__SFR_OFFS
&__DDRSS_PHY_1421__SFR_OFFS=0x234
LOCAL &__DDRSS_PHY_1422__SFR_OFFS
&__DDRSS_PHY_1422__SFR_OFFS=0x238
// --  Copyright (c) 2019, Texas Instruments Incorporated
// --  *
// --  * Redistribution and use in source and binary forms, with or without
// --  * modification, are permitted provided that the following conditions
// --  * are met:
// --  *
// --  * *  Redistributions of source code must retain the above copyright
// --  *    notice, this list of conditions and the following disclaimer.
// --  *
// --  * *  Redistributions in binary form must reproduce the above copyright
// --  *    notice, this list of conditions and the following disclaimer in the
// --  *    documentation and/or other materials provided with the distribution.
// --  *
// --  * *  Neither the name of Texas Instruments Incorporated nor the names of
// --  *    its contributors may be used to endorse or promote products derived
// --  *    from this software without specific prior written permission.
// --  *
// --  * THIS SOFTWARE IS PROVIDED BY THE COPYRIGHT HOLDERS AND CONTRIBUTORS "AS IS"
// --  * AND ANY EXPRESS OR IMPLIED WARRANTIES, INCLUDING, BUT NOT LIMITED TO,
// --  * THE IMPLIED WARRANTIES OF MERCHANTABILITY AND FITNESS FOR A PARTICULAR
// --  * PURPOSE ARE DISCLAIMED. IN NO EVENT SHALL THE COPYRIGHT OWNER OR
// --  * CONTRIBUTORS BE LIABLE FOR ANY DIRECT, INDIRECT, INCIDENTAL, SPECIAL,
// --  * EXEMPLARY, OR CONSEQUENTIAL DAMAGES (INCLUDING, BUT NOT LIMITED TO,
// --  * PROCUREMENT OF SUBSTITUTE GOODS OR SERVICES; LOSS OF USE, DATA, OR PROFITS;
// --  * OR BUSINESS INTERRUPTION) HOWEVER CAUSED AND ON ANY THEORY OF LIABILITY,
// --  * WHETHER IN CONTRACT, STRICT LIABILITY, OR TORT (INCLUDING NEGLIGENCE OR
// --  * OTHERWISE) ARISING IN ANY WAY OUT OF THE USE OF THIS SOFTWARE,
// --  * EVEN IF ADVISED OF THE POSSIBILITY OF SUCH DAMAGE. 
// --  * This file was generated by the Jacinto7_DDRSS_RegConfigTool, Revision: 0.7.0
// --  * This file was generated on 10/14/2021
LOCAL &__DDRSS_PLL_FHS_CNT
&__DDRSS_PLL_FHS_CNT=10.
LOCAL &__DDRSS_PLL_FREQUENCY_0
&__DDRSS_PLL_FREQUENCY_0=27500000.
LOCAL &__DDRSS_PLL_FREQUENCY_1
&__DDRSS_PLL_FREQUENCY_1=533000000.
LOCAL &__DDRSS_PLL_FREQUENCY_2
&__DDRSS_PLL_FREQUENCY_2=533000000.
LOCAL &__MULTI_DDR_CFG_INTRLV_GRAN
&__MULTI_DDR_CFG_INTRLV_GRAN=0.
LOCAL &__MULTI_DDR_CFG_INTRLV_SIZE
&__MULTI_DDR_CFG_INTRLV_SIZE=11.
LOCAL &__MULTI_DDR_CFG_ECC_ENABLE
&__MULTI_DDR_CFG_ECC_ENABLE=0.
LOCAL &__MULTI_DDR_CFG_HYBRID_SELECT
&__MULTI_DDR_CFG_HYBRID_SELECT=0.
LOCAL &__MULTI_DDR_CFG_EMIFS_ACTIVE
&__MULTI_DDR_CFG_EMIFS_ACTIVE=3.
LOCAL &__DDRSS0_CTL_00_DATA
&__DDRSS0_CTL_00_DATA=0x00000B00
LOCAL &__DDRSS0_CTL_01_DATA
&__DDRSS0_CTL_01_DATA=0x00000000
LOCAL &__DDRSS0_CTL_02_DATA
&__DDRSS0_CTL_02_DATA=0x00000000
LOCAL &__DDRSS0_CTL_03_DATA
&__DDRSS0_CTL_03_DATA=0x00000000
LOCAL &__DDRSS0_CTL_04_DATA
&__DDRSS0_CTL_04_DATA=0x00000000
LOCAL &__DDRSS0_CTL_05_DATA
&__DDRSS0_CTL_05_DATA=0x00000000
LOCAL &__DDRSS0_CTL_06_DATA
&__DDRSS0_CTL_06_DATA=0x00000000
LOCAL &__DDRSS0_CTL_07_DATA
&__DDRSS0_CTL_07_DATA=0x00002AF8
LOCAL &__DDRSS0_CTL_08_DATA
&__DDRSS0_CTL_08_DATA=0x0001ADAF
LOCAL &__DDRSS0_CTL_09_DATA
&__DDRSS0_CTL_09_DATA=0x00000005
LOCAL &__DDRSS0_CTL_10_DATA
&__DDRSS0_CTL_10_DATA=0x0000006E
LOCAL &__DDRSS0_CTL_11_DATA
&__DDRSS0_CTL_11_DATA=0x000340E4
LOCAL &__DDRSS0_CTL_12_DATA
&__DDRSS0_CTL_12_DATA=0x002088E5
LOCAL &__DDRSS0_CTL_13_DATA
&__DDRSS0_CTL_13_DATA=0x00000005
LOCAL &__DDRSS0_CTL_14_DATA
&__DDRSS0_CTL_14_DATA=0x00000855
LOCAL &__DDRSS0_CTL_15_DATA
&__DDRSS0_CTL_15_DATA=0x000340E4
LOCAL &__DDRSS0_CTL_16_DATA
&__DDRSS0_CTL_16_DATA=0x002088E5
LOCAL &__DDRSS0_CTL_17_DATA
&__DDRSS0_CTL_17_DATA=0x00000005
LOCAL &__DDRSS0_CTL_18_DATA
&__DDRSS0_CTL_18_DATA=0x00000855
LOCAL &__DDRSS0_CTL_19_DATA
&__DDRSS0_CTL_19_DATA=0x01010000
LOCAL &__DDRSS0_CTL_20_DATA
&__DDRSS0_CTL_20_DATA=0x02011001
LOCAL &__DDRSS0_CTL_21_DATA
&__DDRSS0_CTL_21_DATA=0x02010000
LOCAL &__DDRSS0_CTL_22_DATA
&__DDRSS0_CTL_22_DATA=0x00020100
LOCAL &__DDRSS0_CTL_23_DATA
&__DDRSS0_CTL_23_DATA=0x0000000B
LOCAL &__DDRSS0_CTL_24_DATA
&__DDRSS0_CTL_24_DATA=0x0000001C
LOCAL &__DDRSS0_CTL_25_DATA
&__DDRSS0_CTL_25_DATA=0x00000000
LOCAL &__DDRSS0_CTL_26_DATA
&__DDRSS0_CTL_26_DATA=0x00000000
LOCAL &__DDRSS0_CTL_27_DATA
&__DDRSS0_CTL_27_DATA=0x03020200
LOCAL &__DDRSS0_CTL_28_DATA
&__DDRSS0_CTL_28_DATA=0x00002B2B
LOCAL &__DDRSS0_CTL_29_DATA
&__DDRSS0_CTL_29_DATA=0x00100000
LOCAL &__DDRSS0_CTL_30_DATA
&__DDRSS0_CTL_30_DATA=0x00000000
LOCAL &__DDRSS0_CTL_31_DATA
&__DDRSS0_CTL_31_DATA=0x00000000
LOCAL &__DDRSS0_CTL_32_DATA
&__DDRSS0_CTL_32_DATA=0x00000000
LOCAL &__DDRSS0_CTL_33_DATA
&__DDRSS0_CTL_33_DATA=0x00000000
LOCAL &__DDRSS0_CTL_34_DATA
&__DDRSS0_CTL_34_DATA=0x040C0000
LOCAL &__DDRSS0_CTL_35_DATA
&__DDRSS0_CTL_35_DATA=0x0A280A28
LOCAL &__DDRSS0_CTL_36_DATA
&__DDRSS0_CTL_36_DATA=0x00050804
LOCAL &__DDRSS0_CTL_37_DATA
&__DDRSS0_CTL_37_DATA=0x09040008
LOCAL &__DDRSS0_CTL_38_DATA
&__DDRSS0_CTL_38_DATA=0x0B000204
LOCAL &__DDRSS0_CTL_39_DATA
&__DDRSS0_CTL_39_DATA=0x0C300046
LOCAL &__DDRSS0_CTL_40_DATA
&__DDRSS0_CTL_40_DATA=0x0B002116
LOCAL &__DDRSS0_CTL_41_DATA
&__DDRSS0_CTL_41_DATA=0x0C300046
LOCAL &__DDRSS0_CTL_42_DATA
&__DDRSS0_CTL_42_DATA=0x20002116
LOCAL &__DDRSS0_CTL_43_DATA
&__DDRSS0_CTL_43_DATA=0x000A0A09
LOCAL &__DDRSS0_CTL_44_DATA
&__DDRSS0_CTL_44_DATA=0x0400078A
LOCAL &__DDRSS0_CTL_45_DATA
&__DDRSS0_CTL_45_DATA=0x0F0B0904
LOCAL &__DDRSS0_CTL_46_DATA
&__DDRSS0_CTL_46_DATA=0x0800922C
LOCAL &__DDRSS0_CTL_47_DATA
&__DDRSS0_CTL_47_DATA=0x0F0B0908
LOCAL &__DDRSS0_CTL_48_DATA
&__DDRSS0_CTL_48_DATA=0x0800922C
LOCAL &__DDRSS0_CTL_49_DATA
&__DDRSS0_CTL_49_DATA=0x02030408
LOCAL &__DDRSS0_CTL_50_DATA
&__DDRSS0_CTL_50_DATA=0x16040500
LOCAL &__DDRSS0_CTL_51_DATA
&__DDRSS0_CTL_51_DATA=0x08151615
LOCAL &__DDRSS0_CTL_52_DATA
&__DDRSS0_CTL_52_DATA=0x14000E0A
LOCAL &__DDRSS0_CTL_53_DATA
&__DDRSS0_CTL_53_DATA=0x02010A0A
LOCAL &__DDRSS0_CTL_54_DATA
&__DDRSS0_CTL_54_DATA=0x01010002
LOCAL &__DDRSS0_CTL_55_DATA
&__DDRSS0_CTL_55_DATA=0x042B2B08
LOCAL &__DDRSS0_CTL_56_DATA
&__DDRSS0_CTL_56_DATA=0x04191904
LOCAL &__DDRSS0_CTL_57_DATA
&__DDRSS0_CTL_57_DATA=0x00001919
LOCAL &__DDRSS0_CTL_58_DATA
&__DDRSS0_CTL_58_DATA=0x00010100
LOCAL &__DDRSS0_CTL_59_DATA
&__DDRSS0_CTL_59_DATA=0x03010000
LOCAL &__DDRSS0_CTL_60_DATA
&__DDRSS0_CTL_60_DATA=0x00001508
LOCAL &__DDRSS0_CTL_61_DATA
&__DDRSS0_CTL_61_DATA=0x000000CE
LOCAL &__DDRSS0_CTL_62_DATA
&__DDRSS0_CTL_62_DATA=0x00000196
LOCAL &__DDRSS0_CTL_63_DATA
&__DDRSS0_CTL_63_DATA=0x00001035
LOCAL &__DDRSS0_CTL_64_DATA
&__DDRSS0_CTL_64_DATA=0x00000196
LOCAL &__DDRSS0_CTL_65_DATA
&__DDRSS0_CTL_65_DATA=0x00001035
LOCAL &__DDRSS0_CTL_66_DATA
&__DDRSS0_CTL_66_DATA=0x00000005
LOCAL &__DDRSS0_CTL_67_DATA
&__DDRSS0_CTL_67_DATA=0x00050000
LOCAL &__DDRSS0_CTL_68_DATA
&__DDRSS0_CTL_68_DATA=0x00650012
LOCAL &__DDRSS0_CTL_69_DATA
&__DDRSS0_CTL_69_DATA=0x00650200
LOCAL &__DDRSS0_CTL_70_DATA
&__DDRSS0_CTL_70_DATA=0x00400200
LOCAL &__DDRSS0_CTL_71_DATA
&__DDRSS0_CTL_71_DATA=0x00120103
LOCAL &__DDRSS0_CTL_72_DATA
&__DDRSS0_CTL_72_DATA=0x00080005
LOCAL &__DDRSS0_CTL_73_DATA
&__DDRSS0_CTL_73_DATA=0x19080008
LOCAL &__DDRSS0_CTL_74_DATA
&__DDRSS0_CTL_74_DATA=0x05050119
LOCAL &__DDRSS0_CTL_75_DATA
&__DDRSS0_CTL_75_DATA=0x0201030A
LOCAL &__DDRSS0_CTL_76_DATA
&__DDRSS0_CTL_76_DATA=0x030F0806
LOCAL &__DDRSS0_CTL_77_DATA
&__DDRSS0_CTL_77_DATA=0x08060201
LOCAL &__DDRSS0_CTL_78_DATA
&__DDRSS0_CTL_78_DATA=0x0001030F
LOCAL &__DDRSS0_CTL_79_DATA
&__DDRSS0_CTL_79_DATA=0x00160016
LOCAL &__DDRSS0_CTL_80_DATA
&__DDRSS0_CTL_80_DATA=0x019E019E
LOCAL &__DDRSS0_CTL_81_DATA
&__DDRSS0_CTL_81_DATA=0x019E019E
LOCAL &__DDRSS0_CTL_82_DATA
&__DDRSS0_CTL_82_DATA=0x03050505
LOCAL &__DDRSS0_CTL_83_DATA
&__DDRSS0_CTL_83_DATA=0x03010303
LOCAL &__DDRSS0_CTL_84_DATA
&__DDRSS0_CTL_84_DATA=0x10060806
LOCAL &__DDRSS0_CTL_85_DATA
&__DDRSS0_CTL_85_DATA=0x03020803
LOCAL &__DDRSS0_CTL_86_DATA
&__DDRSS0_CTL_86_DATA=0x10060806
LOCAL &__DDRSS0_CTL_87_DATA
&__DDRSS0_CTL_87_DATA=0x03020803
LOCAL &__DDRSS0_CTL_88_DATA
&__DDRSS0_CTL_88_DATA=0x03010000
LOCAL &__DDRSS0_CTL_89_DATA
&__DDRSS0_CTL_89_DATA=0x00010000
LOCAL &__DDRSS0_CTL_90_DATA
&__DDRSS0_CTL_90_DATA=0x00000000
LOCAL &__DDRSS0_CTL_91_DATA
&__DDRSS0_CTL_91_DATA=0x00000000
LOCAL &__DDRSS0_CTL_92_DATA
&__DDRSS0_CTL_92_DATA=0x01000000
LOCAL &__DDRSS0_CTL_93_DATA
&__DDRSS0_CTL_93_DATA=0x80104002
LOCAL &__DDRSS0_CTL_94_DATA
&__DDRSS0_CTL_94_DATA=0x00000000
LOCAL &__DDRSS0_CTL_95_DATA
&__DDRSS0_CTL_95_DATA=0x00040005
LOCAL &__DDRSS0_CTL_96_DATA
&__DDRSS0_CTL_96_DATA=0x00000000
LOCAL &__DDRSS0_CTL_97_DATA
&__DDRSS0_CTL_97_DATA=0x00050000
LOCAL &__DDRSS0_CTL_98_DATA
&__DDRSS0_CTL_98_DATA=0x00000004
LOCAL &__DDRSS0_CTL_99_DATA
&__DDRSS0_CTL_99_DATA=0x00000000
LOCAL &__DDRSS0_CTL_100_DATA
&__DDRSS0_CTL_100_DATA=0x00040005
LOCAL &__DDRSS0_CTL_101_DATA
&__DDRSS0_CTL_101_DATA=0x00000000
LOCAL &__DDRSS0_CTL_102_DATA
&__DDRSS0_CTL_102_DATA=0x00003380
LOCAL &__DDRSS0_CTL_103_DATA
&__DDRSS0_CTL_103_DATA=0x00003380
LOCAL &__DDRSS0_CTL_104_DATA
&__DDRSS0_CTL_104_DATA=0x00003380
LOCAL &__DDRSS0_CTL_105_DATA
&__DDRSS0_CTL_105_DATA=0x00003380
LOCAL &__DDRSS0_CTL_106_DATA
&__DDRSS0_CTL_106_DATA=0x00003380
LOCAL &__DDRSS0_CTL_107_DATA
&__DDRSS0_CTL_107_DATA=0x00000000
LOCAL &__DDRSS0_CTL_108_DATA
&__DDRSS0_CTL_108_DATA=0x000005A2
LOCAL &__DDRSS0_CTL_109_DATA
&__DDRSS0_CTL_109_DATA=0x00040D40
LOCAL &__DDRSS0_CTL_110_DATA
&__DDRSS0_CTL_110_DATA=0x00040D40
LOCAL &__DDRSS0_CTL_111_DATA
&__DDRSS0_CTL_111_DATA=0x00040D40
LOCAL &__DDRSS0_CTL_112_DATA
&__DDRSS0_CTL_112_DATA=0x00040D40
LOCAL &__DDRSS0_CTL_113_DATA
&__DDRSS0_CTL_113_DATA=0x00040D40
LOCAL &__DDRSS0_CTL_114_DATA
&__DDRSS0_CTL_114_DATA=0x00000000
LOCAL &__DDRSS0_CTL_115_DATA
&__DDRSS0_CTL_115_DATA=0x00007173
LOCAL &__DDRSS0_CTL_116_DATA
&__DDRSS0_CTL_116_DATA=0x00040D40
LOCAL &__DDRSS0_CTL_117_DATA
&__DDRSS0_CTL_117_DATA=0x00040D40
LOCAL &__DDRSS0_CTL_118_DATA
&__DDRSS0_CTL_118_DATA=0x00040D40
LOCAL &__DDRSS0_CTL_119_DATA
&__DDRSS0_CTL_119_DATA=0x00040D40
LOCAL &__DDRSS0_CTL_120_DATA
&__DDRSS0_CTL_120_DATA=0x00040D40
LOCAL &__DDRSS0_CTL_121_DATA
&__DDRSS0_CTL_121_DATA=0x00000000
LOCAL &__DDRSS0_CTL_122_DATA
&__DDRSS0_CTL_122_DATA=0x00007173
LOCAL &__DDRSS0_CTL_123_DATA
&__DDRSS0_CTL_123_DATA=0x00000000
LOCAL &__DDRSS0_CTL_124_DATA
&__DDRSS0_CTL_124_DATA=0x00000000
LOCAL &__DDRSS0_CTL_125_DATA
&__DDRSS0_CTL_125_DATA=0x00000000
LOCAL &__DDRSS0_CTL_126_DATA
&__DDRSS0_CTL_126_DATA=0x00000000
LOCAL &__DDRSS0_CTL_127_DATA
&__DDRSS0_CTL_127_DATA=0x00000000
LOCAL &__DDRSS0_CTL_128_DATA
&__DDRSS0_CTL_128_DATA=0x00000000
LOCAL &__DDRSS0_CTL_129_DATA
&__DDRSS0_CTL_129_DATA=0x00000000
LOCAL &__DDRSS0_CTL_130_DATA
&__DDRSS0_CTL_130_DATA=0x00000000
LOCAL &__DDRSS0_CTL_131_DATA
&__DDRSS0_CTL_131_DATA=0x06030500
LOCAL &__DDRSS0_CTL_132_DATA
&__DDRSS0_CTL_132_DATA=0x00030603
LOCAL &__DDRSS0_CTL_133_DATA
&__DDRSS0_CTL_133_DATA=0x0A090000
LOCAL &__DDRSS0_CTL_134_DATA
&__DDRSS0_CTL_134_DATA=0x0A090701
LOCAL &__DDRSS0_CTL_135_DATA
&__DDRSS0_CTL_135_DATA=0x0900000E
LOCAL &__DDRSS0_CTL_136_DATA
&__DDRSS0_CTL_136_DATA=0x0907010A
LOCAL &__DDRSS0_CTL_137_DATA
&__DDRSS0_CTL_137_DATA=0x00000E0A
LOCAL &__DDRSS0_CTL_138_DATA
&__DDRSS0_CTL_138_DATA=0x07010A09
LOCAL &__DDRSS0_CTL_139_DATA
&__DDRSS0_CTL_139_DATA=0x000E0A09
LOCAL &__DDRSS0_CTL_140_DATA
&__DDRSS0_CTL_140_DATA=0x07000401
LOCAL &__DDRSS0_CTL_141_DATA
&__DDRSS0_CTL_141_DATA=0x00000000
LOCAL &__DDRSS0_CTL_142_DATA
&__DDRSS0_CTL_142_DATA=0x00000000
LOCAL &__DDRSS0_CTL_143_DATA
&__DDRSS0_CTL_143_DATA=0x00000000
LOCAL &__DDRSS0_CTL_144_DATA
&__DDRSS0_CTL_144_DATA=0x00000000
LOCAL &__DDRSS0_CTL_145_DATA
&__DDRSS0_CTL_145_DATA=0x00000000
LOCAL &__DDRSS0_CTL_146_DATA
&__DDRSS0_CTL_146_DATA=0x00000000
LOCAL &__DDRSS0_CTL_147_DATA
&__DDRSS0_CTL_147_DATA=0x00000000
LOCAL &__DDRSS0_CTL_148_DATA
&__DDRSS0_CTL_148_DATA=0x08080000
LOCAL &__DDRSS0_CTL_149_DATA
&__DDRSS0_CTL_149_DATA=0x01000000
LOCAL &__DDRSS0_CTL_150_DATA
&__DDRSS0_CTL_150_DATA=0x800000C0
LOCAL &__DDRSS0_CTL_151_DATA
&__DDRSS0_CTL_151_DATA=0x800000C0
LOCAL &__DDRSS0_CTL_152_DATA
&__DDRSS0_CTL_152_DATA=0x800000C0
LOCAL &__DDRSS0_CTL_153_DATA
&__DDRSS0_CTL_153_DATA=0x00000000
LOCAL &__DDRSS0_CTL_154_DATA
&__DDRSS0_CTL_154_DATA=0x00001500
LOCAL &__DDRSS0_CTL_155_DATA
&__DDRSS0_CTL_155_DATA=0x00000000
LOCAL &__DDRSS0_CTL_156_DATA
&__DDRSS0_CTL_156_DATA=0x00000001
LOCAL &__DDRSS0_CTL_157_DATA
&__DDRSS0_CTL_157_DATA=0x00000002
LOCAL &__DDRSS0_CTL_158_DATA
&__DDRSS0_CTL_158_DATA=0x0000100E
LOCAL &__DDRSS0_CTL_159_DATA
&__DDRSS0_CTL_159_DATA=0x00000000
LOCAL &__DDRSS0_CTL_160_DATA
&__DDRSS0_CTL_160_DATA=0x00000000
LOCAL &__DDRSS0_CTL_161_DATA
&__DDRSS0_CTL_161_DATA=0x00000000
LOCAL &__DDRSS0_CTL_162_DATA
&__DDRSS0_CTL_162_DATA=0x00000000
LOCAL &__DDRSS0_CTL_163_DATA
&__DDRSS0_CTL_163_DATA=0x00000000
LOCAL &__DDRSS0_CTL_164_DATA
&__DDRSS0_CTL_164_DATA=0x000B0000
LOCAL &__DDRSS0_CTL_165_DATA
&__DDRSS0_CTL_165_DATA=0x000E0006
LOCAL &__DDRSS0_CTL_166_DATA
&__DDRSS0_CTL_166_DATA=0x000E0404
LOCAL &__DDRSS0_CTL_167_DATA
&__DDRSS0_CTL_167_DATA=0x006B00D6
LOCAL &__DDRSS0_CTL_168_DATA
&__DDRSS0_CTL_168_DATA=0x0808010B
LOCAL &__DDRSS0_CTL_169_DATA
&__DDRSS0_CTL_169_DATA=0x00D6010B
LOCAL &__DDRSS0_CTL_170_DATA
&__DDRSS0_CTL_170_DATA=0x010B006B
LOCAL &__DDRSS0_CTL_171_DATA
&__DDRSS0_CTL_171_DATA=0x010B0808
LOCAL &__DDRSS0_CTL_172_DATA
&__DDRSS0_CTL_172_DATA=0x00000000
LOCAL &__DDRSS0_CTL_173_DATA
&__DDRSS0_CTL_173_DATA=0x00000000
LOCAL &__DDRSS0_CTL_174_DATA
&__DDRSS0_CTL_174_DATA=0x00000000
LOCAL &__DDRSS0_CTL_175_DATA
&__DDRSS0_CTL_175_DATA=0x1BB40084
LOCAL &__DDRSS0_CTL_176_DATA
&__DDRSS0_CTL_176_DATA=0x33001BB4
LOCAL &__DDRSS0_CTL_177_DATA
&__DDRSS0_CTL_177_DATA=0x00003333
LOCAL &__DDRSS0_CTL_178_DATA
&__DDRSS0_CTL_178_DATA=0x56000000
LOCAL &__DDRSS0_CTL_179_DATA
&__DDRSS0_CTL_179_DATA=0x27270056
LOCAL &__DDRSS0_CTL_180_DATA
&__DDRSS0_CTL_180_DATA=0x0F0F0000
LOCAL &__DDRSS0_CTL_181_DATA
&__DDRSS0_CTL_181_DATA=0x16000000
LOCAL &__DDRSS0_CTL_182_DATA
&__DDRSS0_CTL_182_DATA=0x00841616
LOCAL &__DDRSS0_CTL_183_DATA
&__DDRSS0_CTL_183_DATA=0x1BB41BB4
LOCAL &__DDRSS0_CTL_184_DATA
&__DDRSS0_CTL_184_DATA=0x33333300
LOCAL &__DDRSS0_CTL_185_DATA
&__DDRSS0_CTL_185_DATA=0x00000000
LOCAL &__DDRSS0_CTL_186_DATA
&__DDRSS0_CTL_186_DATA=0x00565600
LOCAL &__DDRSS0_CTL_187_DATA
&__DDRSS0_CTL_187_DATA=0x00002727
LOCAL &__DDRSS0_CTL_188_DATA
&__DDRSS0_CTL_188_DATA=0x00000F0F
LOCAL &__DDRSS0_CTL_189_DATA
&__DDRSS0_CTL_189_DATA=0x16161600
LOCAL &__DDRSS0_CTL_190_DATA
&__DDRSS0_CTL_190_DATA=0x00000020
LOCAL &__DDRSS0_CTL_191_DATA
&__DDRSS0_CTL_191_DATA=0x00000000
LOCAL &__DDRSS0_CTL_192_DATA
&__DDRSS0_CTL_192_DATA=0x00000001
LOCAL &__DDRSS0_CTL_193_DATA
&__DDRSS0_CTL_193_DATA=0x00000000
LOCAL &__DDRSS0_CTL_194_DATA
&__DDRSS0_CTL_194_DATA=0x01000000
LOCAL &__DDRSS0_CTL_195_DATA
&__DDRSS0_CTL_195_DATA=0x00000001
LOCAL &__DDRSS0_CTL_196_DATA
&__DDRSS0_CTL_196_DATA=0x00000000
LOCAL &__DDRSS0_CTL_197_DATA
&__DDRSS0_CTL_197_DATA=0x00000000
LOCAL &__DDRSS0_CTL_198_DATA
&__DDRSS0_CTL_198_DATA=0x00000000
LOCAL &__DDRSS0_CTL_199_DATA
&__DDRSS0_CTL_199_DATA=0x00000000
LOCAL &__DDRSS0_CTL_200_DATA
&__DDRSS0_CTL_200_DATA=0x00000000
LOCAL &__DDRSS0_CTL_201_DATA
&__DDRSS0_CTL_201_DATA=0x00000000
LOCAL &__DDRSS0_CTL_202_DATA
&__DDRSS0_CTL_202_DATA=0x00000000
LOCAL &__DDRSS0_CTL_203_DATA
&__DDRSS0_CTL_203_DATA=0x00000000
LOCAL &__DDRSS0_CTL_204_DATA
&__DDRSS0_CTL_204_DATA=0x00000000
LOCAL &__DDRSS0_CTL_205_DATA
&__DDRSS0_CTL_205_DATA=0x00000000
LOCAL &__DDRSS0_CTL_206_DATA
&__DDRSS0_CTL_206_DATA=0x02000000
LOCAL &__DDRSS0_CTL_207_DATA
&__DDRSS0_CTL_207_DATA=0x01080101
LOCAL &__DDRSS0_CTL_208_DATA
&__DDRSS0_CTL_208_DATA=0x00000000
LOCAL &__DDRSS0_CTL_209_DATA
&__DDRSS0_CTL_209_DATA=0x00000000
LOCAL &__DDRSS0_CTL_210_DATA
&__DDRSS0_CTL_210_DATA=0x00000000
LOCAL &__DDRSS0_CTL_211_DATA
&__DDRSS0_CTL_211_DATA=0x00000000
LOCAL &__DDRSS0_CTL_212_DATA
&__DDRSS0_CTL_212_DATA=0x00000000
LOCAL &__DDRSS0_CTL_213_DATA
&__DDRSS0_CTL_213_DATA=0x00000000
LOCAL &__DDRSS0_CTL_214_DATA
&__DDRSS0_CTL_214_DATA=0x00000000
LOCAL &__DDRSS0_CTL_215_DATA
&__DDRSS0_CTL_215_DATA=0x00000000
LOCAL &__DDRSS0_CTL_216_DATA
&__DDRSS0_CTL_216_DATA=0x00000000
LOCAL &__DDRSS0_CTL_217_DATA
&__DDRSS0_CTL_217_DATA=0x00000000
LOCAL &__DDRSS0_CTL_218_DATA
&__DDRSS0_CTL_218_DATA=0x00000000
LOCAL &__DDRSS0_CTL_219_DATA
&__DDRSS0_CTL_219_DATA=0x00000000
LOCAL &__DDRSS0_CTL_220_DATA
&__DDRSS0_CTL_220_DATA=0x00000000
LOCAL &__DDRSS0_CTL_221_DATA
&__DDRSS0_CTL_221_DATA=0x00000000
LOCAL &__DDRSS0_CTL_222_DATA
&__DDRSS0_CTL_222_DATA=0x00001000
LOCAL &__DDRSS0_CTL_223_DATA
&__DDRSS0_CTL_223_DATA=0x006403E8
LOCAL &__DDRSS0_CTL_224_DATA
&__DDRSS0_CTL_224_DATA=0x00000000
LOCAL &__DDRSS0_CTL_225_DATA
&__DDRSS0_CTL_225_DATA=0x00000000
LOCAL &__DDRSS0_CTL_226_DATA
&__DDRSS0_CTL_226_DATA=0x00000000
LOCAL &__DDRSS0_CTL_227_DATA
&__DDRSS0_CTL_227_DATA=0x15110000
LOCAL &__DDRSS0_CTL_228_DATA
&__DDRSS0_CTL_228_DATA=0x00040C18
LOCAL &__DDRSS0_CTL_229_DATA
&__DDRSS0_CTL_229_DATA=0x00000000
LOCAL &__DDRSS0_CTL_230_DATA
&__DDRSS0_CTL_230_DATA=0x00000000
LOCAL &__DDRSS0_CTL_231_DATA
&__DDRSS0_CTL_231_DATA=0x00000000
LOCAL &__DDRSS0_CTL_232_DATA
&__DDRSS0_CTL_232_DATA=0x00000000
LOCAL &__DDRSS0_CTL_233_DATA
&__DDRSS0_CTL_233_DATA=0x00000000
LOCAL &__DDRSS0_CTL_234_DATA
&__DDRSS0_CTL_234_DATA=0x00000000
LOCAL &__DDRSS0_CTL_235_DATA
&__DDRSS0_CTL_235_DATA=0x00000000
LOCAL &__DDRSS0_CTL_236_DATA
&__DDRSS0_CTL_236_DATA=0x00000000
LOCAL &__DDRSS0_CTL_237_DATA
&__DDRSS0_CTL_237_DATA=0x00000000
LOCAL &__DDRSS0_CTL_238_DATA
&__DDRSS0_CTL_238_DATA=0x00000000
LOCAL &__DDRSS0_CTL_239_DATA
&__DDRSS0_CTL_239_DATA=0x00000000
LOCAL &__DDRSS0_CTL_240_DATA
&__DDRSS0_CTL_240_DATA=0x00000000
LOCAL &__DDRSS0_CTL_241_DATA
&__DDRSS0_CTL_241_DATA=0x00000000
LOCAL &__DDRSS0_CTL_242_DATA
&__DDRSS0_CTL_242_DATA=0x00030000
LOCAL &__DDRSS0_CTL_243_DATA
&__DDRSS0_CTL_243_DATA=0x00000000
LOCAL &__DDRSS0_CTL_244_DATA
&__DDRSS0_CTL_244_DATA=0x00000000
LOCAL &__DDRSS0_CTL_245_DATA
&__DDRSS0_CTL_245_DATA=0x00000000
LOCAL &__DDRSS0_CTL_246_DATA
&__DDRSS0_CTL_246_DATA=0x00000000
LOCAL &__DDRSS0_CTL_247_DATA
&__DDRSS0_CTL_247_DATA=0x00000000
LOCAL &__DDRSS0_CTL_248_DATA
&__DDRSS0_CTL_248_DATA=0x00000000
LOCAL &__DDRSS0_CTL_249_DATA
&__DDRSS0_CTL_249_DATA=0x00000000
LOCAL &__DDRSS0_CTL_250_DATA
&__DDRSS0_CTL_250_DATA=0x00000000
LOCAL &__DDRSS0_CTL_251_DATA
&__DDRSS0_CTL_251_DATA=0x00000000
LOCAL &__DDRSS0_CTL_252_DATA
&__DDRSS0_CTL_252_DATA=0x00000000
LOCAL &__DDRSS0_CTL_253_DATA
&__DDRSS0_CTL_253_DATA=0x00000000
LOCAL &__DDRSS0_CTL_254_DATA
&__DDRSS0_CTL_254_DATA=0x00000000
LOCAL &__DDRSS0_CTL_255_DATA
&__DDRSS0_CTL_255_DATA=0x00000000
LOCAL &__DDRSS0_CTL_256_DATA
&__DDRSS0_CTL_256_DATA=0x00000000
LOCAL &__DDRSS0_CTL_257_DATA
&__DDRSS0_CTL_257_DATA=0x01000200
LOCAL &__DDRSS0_CTL_258_DATA
&__DDRSS0_CTL_258_DATA=0x00370040
LOCAL &__DDRSS0_CTL_259_DATA
&__DDRSS0_CTL_259_DATA=0x00020008
LOCAL &__DDRSS0_CTL_260_DATA
&__DDRSS0_CTL_260_DATA=0x00400100
LOCAL &__DDRSS0_CTL_261_DATA
&__DDRSS0_CTL_261_DATA=0x0020042B
LOCAL &__DDRSS0_CTL_262_DATA
&__DDRSS0_CTL_262_DATA=0x01000200
LOCAL &__DDRSS0_CTL_263_DATA
&__DDRSS0_CTL_263_DATA=0x042B0040
LOCAL &__DDRSS0_CTL_264_DATA
&__DDRSS0_CTL_264_DATA=0x00000020
LOCAL &__DDRSS0_CTL_265_DATA
&__DDRSS0_CTL_265_DATA=0x00360003
LOCAL &__DDRSS0_CTL_266_DATA
&__DDRSS0_CTL_266_DATA=0x01000036
LOCAL &__DDRSS0_CTL_267_DATA
&__DDRSS0_CTL_267_DATA=0x00000000
LOCAL &__DDRSS0_CTL_268_DATA
&__DDRSS0_CTL_268_DATA=0x00000000
LOCAL &__DDRSS0_CTL_269_DATA
&__DDRSS0_CTL_269_DATA=0x00000202
LOCAL &__DDRSS0_CTL_270_DATA
&__DDRSS0_CTL_270_DATA=0x00001FFF
LOCAL &__DDRSS0_CTL_271_DATA
&__DDRSS0_CTL_271_DATA=0x3FFF2000
LOCAL &__DDRSS0_CTL_272_DATA
&__DDRSS0_CTL_272_DATA=0x03FF0000
LOCAL &__DDRSS0_CTL_273_DATA
&__DDRSS0_CTL_273_DATA=0x000103FF
LOCAL &__DDRSS0_CTL_274_DATA
&__DDRSS0_CTL_274_DATA=0x0FFF0B00
LOCAL &__DDRSS0_CTL_275_DATA
&__DDRSS0_CTL_275_DATA=0x01010001
LOCAL &__DDRSS0_CTL_276_DATA
&__DDRSS0_CTL_276_DATA=0x01010101
LOCAL &__DDRSS0_CTL_277_DATA
&__DDRSS0_CTL_277_DATA=0x01180101
LOCAL &__DDRSS0_CTL_278_DATA
&__DDRSS0_CTL_278_DATA=0x00030000
LOCAL &__DDRSS0_CTL_279_DATA
&__DDRSS0_CTL_279_DATA=0x00000000
LOCAL &__DDRSS0_CTL_280_DATA
&__DDRSS0_CTL_280_DATA=0x00000000
LOCAL &__DDRSS0_CTL_281_DATA
&__DDRSS0_CTL_281_DATA=0x00000000
LOCAL &__DDRSS0_CTL_282_DATA
&__DDRSS0_CTL_282_DATA=0x00000000
LOCAL &__DDRSS0_CTL_283_DATA
&__DDRSS0_CTL_283_DATA=0x00000000
LOCAL &__DDRSS0_CTL_284_DATA
&__DDRSS0_CTL_284_DATA=0x00000000
LOCAL &__DDRSS0_CTL_285_DATA
&__DDRSS0_CTL_285_DATA=0x00000000
LOCAL &__DDRSS0_CTL_286_DATA
&__DDRSS0_CTL_286_DATA=0x00040101
LOCAL &__DDRSS0_CTL_287_DATA
&__DDRSS0_CTL_287_DATA=0x04010100
LOCAL &__DDRSS0_CTL_288_DATA
&__DDRSS0_CTL_288_DATA=0x00000000
LOCAL &__DDRSS0_CTL_289_DATA
&__DDRSS0_CTL_289_DATA=0x00000000
LOCAL &__DDRSS0_CTL_290_DATA
&__DDRSS0_CTL_290_DATA=0x03030300
LOCAL &__DDRSS0_CTL_291_DATA
&__DDRSS0_CTL_291_DATA=0x00000001
LOCAL &__DDRSS0_CTL_292_DATA
&__DDRSS0_CTL_292_DATA=0x00000000
LOCAL &__DDRSS0_CTL_293_DATA
&__DDRSS0_CTL_293_DATA=0x00000000
LOCAL &__DDRSS0_CTL_294_DATA
&__DDRSS0_CTL_294_DATA=0x00000000
LOCAL &__DDRSS0_CTL_295_DATA
&__DDRSS0_CTL_295_DATA=0x00000000
LOCAL &__DDRSS0_CTL_296_DATA
&__DDRSS0_CTL_296_DATA=0x00000000
LOCAL &__DDRSS0_CTL_297_DATA
&__DDRSS0_CTL_297_DATA=0x00000000
LOCAL &__DDRSS0_CTL_298_DATA
&__DDRSS0_CTL_298_DATA=0x00000000
LOCAL &__DDRSS0_CTL_299_DATA
&__DDRSS0_CTL_299_DATA=0x00000000
LOCAL &__DDRSS0_CTL_300_DATA
&__DDRSS0_CTL_300_DATA=0x00000000
LOCAL &__DDRSS0_CTL_301_DATA
&__DDRSS0_CTL_301_DATA=0x00000000
LOCAL &__DDRSS0_CTL_302_DATA
&__DDRSS0_CTL_302_DATA=0x00000000
LOCAL &__DDRSS0_CTL_303_DATA
&__DDRSS0_CTL_303_DATA=0x00000000
LOCAL &__DDRSS0_CTL_304_DATA
&__DDRSS0_CTL_304_DATA=0x00000000
LOCAL &__DDRSS0_CTL_305_DATA
&__DDRSS0_CTL_305_DATA=0x00000000
LOCAL &__DDRSS0_CTL_306_DATA
&__DDRSS0_CTL_306_DATA=0x00000000
LOCAL &__DDRSS0_CTL_307_DATA
&__DDRSS0_CTL_307_DATA=0x00000000
LOCAL &__DDRSS0_CTL_308_DATA
&__DDRSS0_CTL_308_DATA=0x00000000
LOCAL &__DDRSS0_CTL_309_DATA
&__DDRSS0_CTL_309_DATA=0x00000000
LOCAL &__DDRSS0_CTL_310_DATA
&__DDRSS0_CTL_310_DATA=0x00000000
LOCAL &__DDRSS0_CTL_311_DATA
&__DDRSS0_CTL_311_DATA=0x00000000
LOCAL &__DDRSS0_CTL_312_DATA
&__DDRSS0_CTL_312_DATA=0x00000000
LOCAL &__DDRSS0_CTL_313_DATA
&__DDRSS0_CTL_313_DATA=0x01000000
LOCAL &__DDRSS0_CTL_314_DATA
&__DDRSS0_CTL_314_DATA=0x00020201
LOCAL &__DDRSS0_CTL_315_DATA
&__DDRSS0_CTL_315_DATA=0x01000101
LOCAL &__DDRSS0_CTL_316_DATA
&__DDRSS0_CTL_316_DATA=0x01010001
LOCAL &__DDRSS0_CTL_317_DATA
&__DDRSS0_CTL_317_DATA=0x00010101
LOCAL &__DDRSS0_CTL_318_DATA
&__DDRSS0_CTL_318_DATA=0x05060603
LOCAL &__DDRSS0_CTL_319_DATA
&__DDRSS0_CTL_319_DATA=0x08081111
LOCAL &__DDRSS0_CTL_320_DATA
&__DDRSS0_CTL_320_DATA=0x00090308
LOCAL &__DDRSS0_CTL_321_DATA
&__DDRSS0_CTL_321_DATA=0x070A030F
LOCAL &__DDRSS0_CTL_322_DATA
&__DDRSS0_CTL_322_DATA=0x070A0306
LOCAL &__DDRSS0_CTL_323_DATA
&__DDRSS0_CTL_323_DATA=0x0A090006
LOCAL &__DDRSS0_CTL_324_DATA
&__DDRSS0_CTL_324_DATA=0x0100000A
LOCAL &__DDRSS0_CTL_325_DATA
&__DDRSS0_CTL_325_DATA=0x04020401
LOCAL &__DDRSS0_CTL_326_DATA
&__DDRSS0_CTL_326_DATA=0x00000002
LOCAL &__DDRSS0_CTL_327_DATA
&__DDRSS0_CTL_327_DATA=0x00000000
LOCAL &__DDRSS0_CTL_328_DATA
&__DDRSS0_CTL_328_DATA=0x00010000
LOCAL &__DDRSS0_CTL_329_DATA
&__DDRSS0_CTL_329_DATA=0x00280D00
LOCAL &__DDRSS0_CTL_330_DATA
&__DDRSS0_CTL_330_DATA=0x00000001
LOCAL &__DDRSS0_CTL_331_DATA
&__DDRSS0_CTL_331_DATA=0x00030001
LOCAL &__DDRSS0_CTL_332_DATA
&__DDRSS0_CTL_332_DATA=0x00000000
LOCAL &__DDRSS0_CTL_333_DATA
&__DDRSS0_CTL_333_DATA=0x00000000
LOCAL &__DDRSS0_CTL_334_DATA
&__DDRSS0_CTL_334_DATA=0x00000000
LOCAL &__DDRSS0_CTL_335_DATA
&__DDRSS0_CTL_335_DATA=0x00000000
LOCAL &__DDRSS0_CTL_336_DATA
&__DDRSS0_CTL_336_DATA=0x00000000
LOCAL &__DDRSS0_CTL_337_DATA
&__DDRSS0_CTL_337_DATA=0x00000000
LOCAL &__DDRSS0_CTL_338_DATA
&__DDRSS0_CTL_338_DATA=0x00000000
LOCAL &__DDRSS0_CTL_339_DATA
&__DDRSS0_CTL_339_DATA=0x00000000
LOCAL &__DDRSS0_CTL_340_DATA
&__DDRSS0_CTL_340_DATA=0x01000000
LOCAL &__DDRSS0_CTL_341_DATA
&__DDRSS0_CTL_341_DATA=0x00000001
LOCAL &__DDRSS0_CTL_342_DATA
&__DDRSS0_CTL_342_DATA=0x00010100
LOCAL &__DDRSS0_CTL_343_DATA
&__DDRSS0_CTL_343_DATA=0x03030000
LOCAL &__DDRSS0_CTL_344_DATA
&__DDRSS0_CTL_344_DATA=0x00000000
LOCAL &__DDRSS0_CTL_345_DATA
&__DDRSS0_CTL_345_DATA=0x00000000
LOCAL &__DDRSS0_CTL_346_DATA
&__DDRSS0_CTL_346_DATA=0x00000000
LOCAL &__DDRSS0_CTL_347_DATA
&__DDRSS0_CTL_347_DATA=0x00000000
LOCAL &__DDRSS0_CTL_348_DATA
&__DDRSS0_CTL_348_DATA=0x00000000
LOCAL &__DDRSS0_CTL_349_DATA
&__DDRSS0_CTL_349_DATA=0x00000000
LOCAL &__DDRSS0_CTL_350_DATA
&__DDRSS0_CTL_350_DATA=0x00000000
LOCAL &__DDRSS0_CTL_351_DATA
&__DDRSS0_CTL_351_DATA=0x00000000
LOCAL &__DDRSS0_CTL_352_DATA
&__DDRSS0_CTL_352_DATA=0x00000000
LOCAL &__DDRSS0_CTL_353_DATA
&__DDRSS0_CTL_353_DATA=0x00000000
LOCAL &__DDRSS0_CTL_354_DATA
&__DDRSS0_CTL_354_DATA=0x00000000
LOCAL &__DDRSS0_CTL_355_DATA
&__DDRSS0_CTL_355_DATA=0x00000000
LOCAL &__DDRSS0_CTL_356_DATA
&__DDRSS0_CTL_356_DATA=0x00000000
LOCAL &__DDRSS0_CTL_357_DATA
&__DDRSS0_CTL_357_DATA=0x00000000
LOCAL &__DDRSS0_CTL_358_DATA
&__DDRSS0_CTL_358_DATA=0x00000000
LOCAL &__DDRSS0_CTL_359_DATA
&__DDRSS0_CTL_359_DATA=0x00000000
LOCAL &__DDRSS0_CTL_360_DATA
&__DDRSS0_CTL_360_DATA=0x000556AA
LOCAL &__DDRSS0_CTL_361_DATA
&__DDRSS0_CTL_361_DATA=0x000AAAAA
LOCAL &__DDRSS0_CTL_362_DATA
&__DDRSS0_CTL_362_DATA=0x000AA955
LOCAL &__DDRSS0_CTL_363_DATA
&__DDRSS0_CTL_363_DATA=0x00055555
LOCAL &__DDRSS0_CTL_364_DATA
&__DDRSS0_CTL_364_DATA=0x000B3133
LOCAL &__DDRSS0_CTL_365_DATA
&__DDRSS0_CTL_365_DATA=0x0004CD33
LOCAL &__DDRSS0_CTL_366_DATA
&__DDRSS0_CTL_366_DATA=0x0004CECC
LOCAL &__DDRSS0_CTL_367_DATA
&__DDRSS0_CTL_367_DATA=0x000B32CC
LOCAL &__DDRSS0_CTL_368_DATA
&__DDRSS0_CTL_368_DATA=0x00010300
LOCAL &__DDRSS0_CTL_369_DATA
&__DDRSS0_CTL_369_DATA=0x03000100
LOCAL &__DDRSS0_CTL_370_DATA
&__DDRSS0_CTL_370_DATA=0x00000000
LOCAL &__DDRSS0_CTL_371_DATA
&__DDRSS0_CTL_371_DATA=0x00000000
LOCAL &__DDRSS0_CTL_372_DATA
&__DDRSS0_CTL_372_DATA=0x00000000
LOCAL &__DDRSS0_CTL_373_DATA
&__DDRSS0_CTL_373_DATA=0x00000000
LOCAL &__DDRSS0_CTL_374_DATA
&__DDRSS0_CTL_374_DATA=0x00000000
LOCAL &__DDRSS0_CTL_375_DATA
&__DDRSS0_CTL_375_DATA=0x00000000
LOCAL &__DDRSS0_CTL_376_DATA
&__DDRSS0_CTL_376_DATA=0x00000000
LOCAL &__DDRSS0_CTL_377_DATA
&__DDRSS0_CTL_377_DATA=0x00010000
LOCAL &__DDRSS0_CTL_378_DATA
&__DDRSS0_CTL_378_DATA=0x00000404
LOCAL &__DDRSS0_CTL_379_DATA
&__DDRSS0_CTL_379_DATA=0x00000000
LOCAL &__DDRSS0_CTL_380_DATA
&__DDRSS0_CTL_380_DATA=0x00000000
LOCAL &__DDRSS0_CTL_381_DATA
&__DDRSS0_CTL_381_DATA=0x00000000
LOCAL &__DDRSS0_CTL_382_DATA
&__DDRSS0_CTL_382_DATA=0x00000000
LOCAL &__DDRSS0_CTL_383_DATA
&__DDRSS0_CTL_383_DATA=0x00000000
LOCAL &__DDRSS0_CTL_384_DATA
&__DDRSS0_CTL_384_DATA=0x00000000
LOCAL &__DDRSS0_CTL_385_DATA
&__DDRSS0_CTL_385_DATA=0x00000000
LOCAL &__DDRSS0_CTL_386_DATA
&__DDRSS0_CTL_386_DATA=0x00000000
LOCAL &__DDRSS0_CTL_387_DATA
&__DDRSS0_CTL_387_DATA=0x2A2A1B00
LOCAL &__DDRSS0_CTL_388_DATA
&__DDRSS0_CTL_388_DATA=0x000A0000
LOCAL &__DDRSS0_CTL_389_DATA
&__DDRSS0_CTL_389_DATA=0x0000019C
LOCAL &__DDRSS0_CTL_390_DATA
&__DDRSS0_CTL_390_DATA=0x00000200
LOCAL &__DDRSS0_CTL_391_DATA
&__DDRSS0_CTL_391_DATA=0x00000200
LOCAL &__DDRSS0_CTL_392_DATA
&__DDRSS0_CTL_392_DATA=0x00000200
LOCAL &__DDRSS0_CTL_393_DATA
&__DDRSS0_CTL_393_DATA=0x00000200
LOCAL &__DDRSS0_CTL_394_DATA
&__DDRSS0_CTL_394_DATA=0x000004D4
LOCAL &__DDRSS0_CTL_395_DATA
&__DDRSS0_CTL_395_DATA=0x00001018
LOCAL &__DDRSS0_CTL_396_DATA
&__DDRSS0_CTL_396_DATA=0x00000204
LOCAL &__DDRSS0_CTL_397_DATA
&__DDRSS0_CTL_397_DATA=0x0000206A
LOCAL &__DDRSS0_CTL_398_DATA
&__DDRSS0_CTL_398_DATA=0x00000200
LOCAL &__DDRSS0_CTL_399_DATA
&__DDRSS0_CTL_399_DATA=0x00000200
LOCAL &__DDRSS0_CTL_400_DATA
&__DDRSS0_CTL_400_DATA=0x00000200
LOCAL &__DDRSS0_CTL_401_DATA
&__DDRSS0_CTL_401_DATA=0x00000200
LOCAL &__DDRSS0_CTL_402_DATA
&__DDRSS0_CTL_402_DATA=0x0000613E
LOCAL &__DDRSS0_CTL_403_DATA
&__DDRSS0_CTL_403_DATA=0x00014424
LOCAL &__DDRSS0_CTL_404_DATA
&__DDRSS0_CTL_404_DATA=0x0000060C
LOCAL &__DDRSS0_CTL_405_DATA
&__DDRSS0_CTL_405_DATA=0x0000206A
LOCAL &__DDRSS0_CTL_406_DATA
&__DDRSS0_CTL_406_DATA=0x00000200
LOCAL &__DDRSS0_CTL_407_DATA
&__DDRSS0_CTL_407_DATA=0x00000200
LOCAL &__DDRSS0_CTL_408_DATA
&__DDRSS0_CTL_408_DATA=0x00000200
LOCAL &__DDRSS0_CTL_409_DATA
&__DDRSS0_CTL_409_DATA=0x00000200
LOCAL &__DDRSS0_CTL_410_DATA
&__DDRSS0_CTL_410_DATA=0x0000613E
LOCAL &__DDRSS0_CTL_411_DATA
&__DDRSS0_CTL_411_DATA=0x00014424
LOCAL &__DDRSS0_CTL_412_DATA
&__DDRSS0_CTL_412_DATA=0x0202060C
LOCAL &__DDRSS0_CTL_413_DATA
&__DDRSS0_CTL_413_DATA=0x03030202
LOCAL &__DDRSS0_CTL_414_DATA
&__DDRSS0_CTL_414_DATA=0x00000022
LOCAL &__DDRSS0_CTL_415_DATA
&__DDRSS0_CTL_415_DATA=0x00000000
LOCAL &__DDRSS0_CTL_416_DATA
&__DDRSS0_CTL_416_DATA=0x00000000
LOCAL &__DDRSS0_CTL_417_DATA
&__DDRSS0_CTL_417_DATA=0x00001403
LOCAL &__DDRSS0_CTL_418_DATA
&__DDRSS0_CTL_418_DATA=0x000007D0
LOCAL &__DDRSS0_CTL_419_DATA
&__DDRSS0_CTL_419_DATA=0x00000000
LOCAL &__DDRSS0_CTL_420_DATA
&__DDRSS0_CTL_420_DATA=0x00000000
LOCAL &__DDRSS0_CTL_421_DATA
&__DDRSS0_CTL_421_DATA=0x00030000
LOCAL &__DDRSS0_CTL_422_DATA
&__DDRSS0_CTL_422_DATA=0x0007001F
LOCAL &__DDRSS0_CTL_423_DATA
&__DDRSS0_CTL_423_DATA=0x00110029
LOCAL &__DDRSS0_CTL_424_DATA
&__DDRSS0_CTL_424_DATA=0x00110029
LOCAL &__DDRSS0_CTL_425_DATA
&__DDRSS0_CTL_425_DATA=0x00000000
LOCAL &__DDRSS0_CTL_426_DATA
&__DDRSS0_CTL_426_DATA=0x00000000
LOCAL &__DDRSS0_CTL_427_DATA
&__DDRSS0_CTL_427_DATA=0x02000000
LOCAL &__DDRSS0_CTL_428_DATA
&__DDRSS0_CTL_428_DATA=0x01000404
LOCAL &__DDRSS0_CTL_429_DATA
&__DDRSS0_CTL_429_DATA=0x030E030E
LOCAL &__DDRSS0_CTL_430_DATA
&__DDRSS0_CTL_430_DATA=0x00000105
LOCAL &__DDRSS0_CTL_431_DATA
&__DDRSS0_CTL_431_DATA=0x00010101
LOCAL &__DDRSS0_CTL_432_DATA
&__DDRSS0_CTL_432_DATA=0x00010101
LOCAL &__DDRSS0_CTL_433_DATA
&__DDRSS0_CTL_433_DATA=0x00010001
LOCAL &__DDRSS0_CTL_434_DATA
&__DDRSS0_CTL_434_DATA=0x00000101
LOCAL &__DDRSS0_CTL_435_DATA
&__DDRSS0_CTL_435_DATA=0x02000201
LOCAL &__DDRSS0_CTL_436_DATA
&__DDRSS0_CTL_436_DATA=0x02010000
LOCAL &__DDRSS0_CTL_437_DATA
&__DDRSS0_CTL_437_DATA=0x00000200
LOCAL &__DDRSS0_CTL_438_DATA
&__DDRSS0_CTL_438_DATA=0x14060000
LOCAL &__DDRSS0_CTL_439_DATA
&__DDRSS0_CTL_439_DATA=0x00000114
LOCAL &__DDRSS0_CTL_440_DATA
&__DDRSS0_CTL_440_DATA=0xFFFFFFFF
LOCAL &__DDRSS0_CTL_441_DATA
&__DDRSS0_CTL_441_DATA=0xFFFFFFFF
LOCAL &__DDRSS0_CTL_442_DATA
&__DDRSS0_CTL_442_DATA=0x00000000
LOCAL &__DDRSS0_CTL_443_DATA
&__DDRSS0_CTL_443_DATA=0x00000000
LOCAL &__DDRSS0_CTL_444_DATA
&__DDRSS0_CTL_444_DATA=0x00000000
LOCAL &__DDRSS0_CTL_445_DATA
&__DDRSS0_CTL_445_DATA=0x00000000
LOCAL &__DDRSS0_CTL_446_DATA
&__DDRSS0_CTL_446_DATA=0x00000000
LOCAL &__DDRSS0_CTL_447_DATA
&__DDRSS0_CTL_447_DATA=0x00000000
LOCAL &__DDRSS0_CTL_448_DATA
&__DDRSS0_CTL_448_DATA=0x00000000
LOCAL &__DDRSS0_CTL_449_DATA
&__DDRSS0_CTL_449_DATA=0x00000000
LOCAL &__DDRSS0_CTL_450_DATA
&__DDRSS0_CTL_450_DATA=0x00000000
LOCAL &__DDRSS0_CTL_451_DATA
&__DDRSS0_CTL_451_DATA=0x00000000
LOCAL &__DDRSS0_CTL_452_DATA
&__DDRSS0_CTL_452_DATA=0x00000000
LOCAL &__DDRSS0_CTL_453_DATA
&__DDRSS0_CTL_453_DATA=0x00000000
LOCAL &__DDRSS0_CTL_454_DATA
&__DDRSS0_CTL_454_DATA=0x00000000
LOCAL &__DDRSS0_CTL_455_DATA
&__DDRSS0_CTL_455_DATA=0x00000000
LOCAL &__DDRSS0_CTL_456_DATA
&__DDRSS0_CTL_456_DATA=0x00000000
LOCAL &__DDRSS0_CTL_457_DATA
&__DDRSS0_CTL_457_DATA=0x00000000
LOCAL &__DDRSS0_CTL_458_DATA
&__DDRSS0_CTL_458_DATA=0x00000000
LOCAL &__DDRSS0_PI_00_DATA
&__DDRSS0_PI_00_DATA=0x00000B00
LOCAL &__DDRSS0_PI_01_DATA
&__DDRSS0_PI_01_DATA=0x00000000
LOCAL &__DDRSS0_PI_02_DATA
&__DDRSS0_PI_02_DATA=0x00000000
LOCAL &__DDRSS0_PI_03_DATA
&__DDRSS0_PI_03_DATA=0x00000000
LOCAL &__DDRSS0_PI_04_DATA
&__DDRSS0_PI_04_DATA=0x00000000
LOCAL &__DDRSS0_PI_05_DATA
&__DDRSS0_PI_05_DATA=0x00000101
LOCAL &__DDRSS0_PI_06_DATA
&__DDRSS0_PI_06_DATA=0x00640000
LOCAL &__DDRSS0_PI_07_DATA
&__DDRSS0_PI_07_DATA=0x00000001
LOCAL &__DDRSS0_PI_08_DATA
&__DDRSS0_PI_08_DATA=0x00000000
LOCAL &__DDRSS0_PI_09_DATA
&__DDRSS0_PI_09_DATA=0x00000000
LOCAL &__DDRSS0_PI_10_DATA
&__DDRSS0_PI_10_DATA=0x00000000
LOCAL &__DDRSS0_PI_11_DATA
&__DDRSS0_PI_11_DATA=0x00000000
LOCAL &__DDRSS0_PI_12_DATA
&__DDRSS0_PI_12_DATA=0x00000007
LOCAL &__DDRSS0_PI_13_DATA
&__DDRSS0_PI_13_DATA=0x00010002
LOCAL &__DDRSS0_PI_14_DATA
&__DDRSS0_PI_14_DATA=0x0800000F
LOCAL &__DDRSS0_PI_15_DATA
&__DDRSS0_PI_15_DATA=0x00000103
LOCAL &__DDRSS0_PI_16_DATA
&__DDRSS0_PI_16_DATA=0x00000005
LOCAL &__DDRSS0_PI_17_DATA
&__DDRSS0_PI_17_DATA=0x00000000
LOCAL &__DDRSS0_PI_18_DATA
&__DDRSS0_PI_18_DATA=0x00000000
LOCAL &__DDRSS0_PI_19_DATA
&__DDRSS0_PI_19_DATA=0x00000000
LOCAL &__DDRSS0_PI_20_DATA
&__DDRSS0_PI_20_DATA=0x00000000
LOCAL &__DDRSS0_PI_21_DATA
&__DDRSS0_PI_21_DATA=0x00000000
LOCAL &__DDRSS0_PI_22_DATA
&__DDRSS0_PI_22_DATA=0x00000000
LOCAL &__DDRSS0_PI_23_DATA
&__DDRSS0_PI_23_DATA=0x00000000
LOCAL &__DDRSS0_PI_24_DATA
&__DDRSS0_PI_24_DATA=0x00000000
LOCAL &__DDRSS0_PI_25_DATA
&__DDRSS0_PI_25_DATA=0x00000000
LOCAL &__DDRSS0_PI_26_DATA
&__DDRSS0_PI_26_DATA=0x00010100
LOCAL &__DDRSS0_PI_27_DATA
&__DDRSS0_PI_27_DATA=0x00280A00
LOCAL &__DDRSS0_PI_28_DATA
&__DDRSS0_PI_28_DATA=0x00000000
LOCAL &__DDRSS0_PI_29_DATA
&__DDRSS0_PI_29_DATA=0x0F000000
LOCAL &__DDRSS0_PI_30_DATA
&__DDRSS0_PI_30_DATA=0x00003200
LOCAL &__DDRSS0_PI_31_DATA
&__DDRSS0_PI_31_DATA=0x00000000
LOCAL &__DDRSS0_PI_32_DATA
&__DDRSS0_PI_32_DATA=0x00000000
LOCAL &__DDRSS0_PI_33_DATA
&__DDRSS0_PI_33_DATA=0x01010102
LOCAL &__DDRSS0_PI_34_DATA
&__DDRSS0_PI_34_DATA=0x00000000
LOCAL &__DDRSS0_PI_35_DATA
&__DDRSS0_PI_35_DATA=0x000000AA
LOCAL &__DDRSS0_PI_36_DATA
&__DDRSS0_PI_36_DATA=0x00000055
LOCAL &__DDRSS0_PI_37_DATA
&__DDRSS0_PI_37_DATA=0x000000B5
LOCAL &__DDRSS0_PI_38_DATA
&__DDRSS0_PI_38_DATA=0x0000004A
LOCAL &__DDRSS0_PI_39_DATA
&__DDRSS0_PI_39_DATA=0x00000056
LOCAL &__DDRSS0_PI_40_DATA
&__DDRSS0_PI_40_DATA=0x000000A9
LOCAL &__DDRSS0_PI_41_DATA
&__DDRSS0_PI_41_DATA=0x000000A9
LOCAL &__DDRSS0_PI_42_DATA
&__DDRSS0_PI_42_DATA=0x000000B5
LOCAL &__DDRSS0_PI_43_DATA
&__DDRSS0_PI_43_DATA=0x00000000
LOCAL &__DDRSS0_PI_44_DATA
&__DDRSS0_PI_44_DATA=0x00000000
LOCAL &__DDRSS0_PI_45_DATA
&__DDRSS0_PI_45_DATA=0x000F0F00
LOCAL &__DDRSS0_PI_46_DATA
&__DDRSS0_PI_46_DATA=0x00000016
LOCAL &__DDRSS0_PI_47_DATA
&__DDRSS0_PI_47_DATA=0x000007D0
LOCAL &__DDRSS0_PI_48_DATA
&__DDRSS0_PI_48_DATA=0x00000300
LOCAL &__DDRSS0_PI_49_DATA
&__DDRSS0_PI_49_DATA=0x00000000
LOCAL &__DDRSS0_PI_50_DATA
&__DDRSS0_PI_50_DATA=0x00000000
LOCAL &__DDRSS0_PI_51_DATA
&__DDRSS0_PI_51_DATA=0x01000000
LOCAL &__DDRSS0_PI_52_DATA
&__DDRSS0_PI_52_DATA=0x00010101
LOCAL &__DDRSS0_PI_53_DATA
&__DDRSS0_PI_53_DATA=0x00000000
LOCAL &__DDRSS0_PI_54_DATA
&__DDRSS0_PI_54_DATA=0x00030000
LOCAL &__DDRSS0_PI_55_DATA
&__DDRSS0_PI_55_DATA=0x0F000000
LOCAL &__DDRSS0_PI_56_DATA
&__DDRSS0_PI_56_DATA=0x00000017
LOCAL &__DDRSS0_PI_57_DATA
&__DDRSS0_PI_57_DATA=0x00000000
LOCAL &__DDRSS0_PI_58_DATA
&__DDRSS0_PI_58_DATA=0x00000000
LOCAL &__DDRSS0_PI_59_DATA
&__DDRSS0_PI_59_DATA=0x00000000
LOCAL &__DDRSS0_PI_60_DATA
&__DDRSS0_PI_60_DATA=0x0A0A140A
LOCAL &__DDRSS0_PI_61_DATA
&__DDRSS0_PI_61_DATA=0x10020101
LOCAL &__DDRSS0_PI_62_DATA
&__DDRSS0_PI_62_DATA=0x00020805
LOCAL &__DDRSS0_PI_63_DATA
&__DDRSS0_PI_63_DATA=0x01000404
LOCAL &__DDRSS0_PI_64_DATA
&__DDRSS0_PI_64_DATA=0x00000000
LOCAL &__DDRSS0_PI_65_DATA
&__DDRSS0_PI_65_DATA=0x00000000
LOCAL &__DDRSS0_PI_66_DATA
&__DDRSS0_PI_66_DATA=0x00000100
LOCAL &__DDRSS0_PI_67_DATA
&__DDRSS0_PI_67_DATA=0x0001010F
LOCAL &__DDRSS0_PI_68_DATA
&__DDRSS0_PI_68_DATA=0x00340000
LOCAL &__DDRSS0_PI_69_DATA
&__DDRSS0_PI_69_DATA=0x00000000
LOCAL &__DDRSS0_PI_70_DATA
&__DDRSS0_PI_70_DATA=0x00000000
LOCAL &__DDRSS0_PI_71_DATA
&__DDRSS0_PI_71_DATA=0x0000FFFF
LOCAL &__DDRSS0_PI_72_DATA
&__DDRSS0_PI_72_DATA=0x00000000
LOCAL &__DDRSS0_PI_73_DATA
&__DDRSS0_PI_73_DATA=0x00080000
LOCAL &__DDRSS0_PI_74_DATA
&__DDRSS0_PI_74_DATA=0x02000200
LOCAL &__DDRSS0_PI_75_DATA
&__DDRSS0_PI_75_DATA=0x01000100
LOCAL &__DDRSS0_PI_76_DATA
&__DDRSS0_PI_76_DATA=0x01000000
LOCAL &__DDRSS0_PI_77_DATA
&__DDRSS0_PI_77_DATA=0x02000200
LOCAL &__DDRSS0_PI_78_DATA
&__DDRSS0_PI_78_DATA=0x00000200
LOCAL &__DDRSS0_PI_79_DATA
&__DDRSS0_PI_79_DATA=0x00000000
LOCAL &__DDRSS0_PI_80_DATA
&__DDRSS0_PI_80_DATA=0x00000000
LOCAL &__DDRSS0_PI_81_DATA
&__DDRSS0_PI_81_DATA=0x00000000
LOCAL &__DDRSS0_PI_82_DATA
&__DDRSS0_PI_82_DATA=0x00000000
LOCAL &__DDRSS0_PI_83_DATA
&__DDRSS0_PI_83_DATA=0x00000000
LOCAL &__DDRSS0_PI_84_DATA
&__DDRSS0_PI_84_DATA=0x00000000
LOCAL &__DDRSS0_PI_85_DATA
&__DDRSS0_PI_85_DATA=0x00000000
LOCAL &__DDRSS0_PI_86_DATA
&__DDRSS0_PI_86_DATA=0x00000000
LOCAL &__DDRSS0_PI_87_DATA
&__DDRSS0_PI_87_DATA=0x00000000
LOCAL &__DDRSS0_PI_88_DATA
&__DDRSS0_PI_88_DATA=0x00000000
LOCAL &__DDRSS0_PI_89_DATA
&__DDRSS0_PI_89_DATA=0x00000000
LOCAL &__DDRSS0_PI_90_DATA
&__DDRSS0_PI_90_DATA=0x00000000
LOCAL &__DDRSS0_PI_91_DATA
&__DDRSS0_PI_91_DATA=0x00000400
LOCAL &__DDRSS0_PI_92_DATA
&__DDRSS0_PI_92_DATA=0x02010000
LOCAL &__DDRSS0_PI_93_DATA
&__DDRSS0_PI_93_DATA=0x00080003
LOCAL &__DDRSS0_PI_94_DATA
&__DDRSS0_PI_94_DATA=0x00080000
LOCAL &__DDRSS0_PI_95_DATA
&__DDRSS0_PI_95_DATA=0x00000001
LOCAL &__DDRSS0_PI_96_DATA
&__DDRSS0_PI_96_DATA=0x00000000
LOCAL &__DDRSS0_PI_97_DATA
&__DDRSS0_PI_97_DATA=0x0000AA00
LOCAL &__DDRSS0_PI_98_DATA
&__DDRSS0_PI_98_DATA=0x00000000
LOCAL &__DDRSS0_PI_99_DATA
&__DDRSS0_PI_99_DATA=0x00000000
LOCAL &__DDRSS0_PI_100_DATA
&__DDRSS0_PI_100_DATA=0x00010000
LOCAL &__DDRSS0_PI_101_DATA
&__DDRSS0_PI_101_DATA=0x00000000
LOCAL &__DDRSS0_PI_102_DATA
&__DDRSS0_PI_102_DATA=0x00000000
LOCAL &__DDRSS0_PI_103_DATA
&__DDRSS0_PI_103_DATA=0x00000000
LOCAL &__DDRSS0_PI_104_DATA
&__DDRSS0_PI_104_DATA=0x00000000
LOCAL &__DDRSS0_PI_105_DATA
&__DDRSS0_PI_105_DATA=0x00000000
LOCAL &__DDRSS0_PI_106_DATA
&__DDRSS0_PI_106_DATA=0x00000000
LOCAL &__DDRSS0_PI_107_DATA
&__DDRSS0_PI_107_DATA=0x00000000
LOCAL &__DDRSS0_PI_108_DATA
&__DDRSS0_PI_108_DATA=0x00000000
LOCAL &__DDRSS0_PI_109_DATA
&__DDRSS0_PI_109_DATA=0x00000000
LOCAL &__DDRSS0_PI_110_DATA
&__DDRSS0_PI_110_DATA=0x00000000
LOCAL &__DDRSS0_PI_111_DATA
&__DDRSS0_PI_111_DATA=0x00000000
LOCAL &__DDRSS0_PI_112_DATA
&__DDRSS0_PI_112_DATA=0x00000000
LOCAL &__DDRSS0_PI_113_DATA
&__DDRSS0_PI_113_DATA=0x00000000
LOCAL &__DDRSS0_PI_114_DATA
&__DDRSS0_PI_114_DATA=0x00000000
LOCAL &__DDRSS0_PI_115_DATA
&__DDRSS0_PI_115_DATA=0x00000000
LOCAL &__DDRSS0_PI_116_DATA
&__DDRSS0_PI_116_DATA=0x00000000
LOCAL &__DDRSS0_PI_117_DATA
&__DDRSS0_PI_117_DATA=0x00000000
LOCAL &__DDRSS0_PI_118_DATA
&__DDRSS0_PI_118_DATA=0x00000000
LOCAL &__DDRSS0_PI_119_DATA
&__DDRSS0_PI_119_DATA=0x00000000
LOCAL &__DDRSS0_PI_120_DATA
&__DDRSS0_PI_120_DATA=0x00000000
LOCAL &__DDRSS0_PI_121_DATA
&__DDRSS0_PI_121_DATA=0x00000000
LOCAL &__DDRSS0_PI_122_DATA
&__DDRSS0_PI_122_DATA=0x00000000
LOCAL &__DDRSS0_PI_123_DATA
&__DDRSS0_PI_123_DATA=0x00000000
LOCAL &__DDRSS0_PI_124_DATA
&__DDRSS0_PI_124_DATA=0x00000000
LOCAL &__DDRSS0_PI_125_DATA
&__DDRSS0_PI_125_DATA=0x00000008
LOCAL &__DDRSS0_PI_126_DATA
&__DDRSS0_PI_126_DATA=0x00000000
LOCAL &__DDRSS0_PI_127_DATA
&__DDRSS0_PI_127_DATA=0x00000000
LOCAL &__DDRSS0_PI_128_DATA
&__DDRSS0_PI_128_DATA=0x00000000
LOCAL &__DDRSS0_PI_129_DATA
&__DDRSS0_PI_129_DATA=0x00000000
LOCAL &__DDRSS0_PI_130_DATA
&__DDRSS0_PI_130_DATA=0x00000000
LOCAL &__DDRSS0_PI_131_DATA
&__DDRSS0_PI_131_DATA=0x00000000
LOCAL &__DDRSS0_PI_132_DATA
&__DDRSS0_PI_132_DATA=0x00000000
LOCAL &__DDRSS0_PI_133_DATA
&__DDRSS0_PI_133_DATA=0x00000000
LOCAL &__DDRSS0_PI_134_DATA
&__DDRSS0_PI_134_DATA=0x00000002
LOCAL &__DDRSS0_PI_135_DATA
&__DDRSS0_PI_135_DATA=0x00000000
LOCAL &__DDRSS0_PI_136_DATA
&__DDRSS0_PI_136_DATA=0x00000000
LOCAL &__DDRSS0_PI_137_DATA
&__DDRSS0_PI_137_DATA=0x0000000A
LOCAL &__DDRSS0_PI_138_DATA
&__DDRSS0_PI_138_DATA=0x00000019
LOCAL &__DDRSS0_PI_139_DATA
&__DDRSS0_PI_139_DATA=0x00000100
LOCAL &__DDRSS0_PI_140_DATA
&__DDRSS0_PI_140_DATA=0x00000000
LOCAL &__DDRSS0_PI_141_DATA
&__DDRSS0_PI_141_DATA=0x00000000
LOCAL &__DDRSS0_PI_142_DATA
&__DDRSS0_PI_142_DATA=0x00000000
LOCAL &__DDRSS0_PI_143_DATA
&__DDRSS0_PI_143_DATA=0x00000000
LOCAL &__DDRSS0_PI_144_DATA
&__DDRSS0_PI_144_DATA=0x01000000
LOCAL &__DDRSS0_PI_145_DATA
&__DDRSS0_PI_145_DATA=0x00010003
LOCAL &__DDRSS0_PI_146_DATA
&__DDRSS0_PI_146_DATA=0x02000101
LOCAL &__DDRSS0_PI_147_DATA
&__DDRSS0_PI_147_DATA=0x01030001
LOCAL &__DDRSS0_PI_148_DATA
&__DDRSS0_PI_148_DATA=0x00010400
LOCAL &__DDRSS0_PI_149_DATA
&__DDRSS0_PI_149_DATA=0x06000105
LOCAL &__DDRSS0_PI_150_DATA
&__DDRSS0_PI_150_DATA=0x01070001
LOCAL &__DDRSS0_PI_151_DATA
&__DDRSS0_PI_151_DATA=0x00000000
LOCAL &__DDRSS0_PI_152_DATA
&__DDRSS0_PI_152_DATA=0x00000000
LOCAL &__DDRSS0_PI_153_DATA
&__DDRSS0_PI_153_DATA=0x00000000
LOCAL &__DDRSS0_PI_154_DATA
&__DDRSS0_PI_154_DATA=0x00010001
LOCAL &__DDRSS0_PI_155_DATA
&__DDRSS0_PI_155_DATA=0x00000000
LOCAL &__DDRSS0_PI_156_DATA
&__DDRSS0_PI_156_DATA=0x00000000
LOCAL &__DDRSS0_PI_157_DATA
&__DDRSS0_PI_157_DATA=0x00000000
LOCAL &__DDRSS0_PI_158_DATA
&__DDRSS0_PI_158_DATA=0x00000000
LOCAL &__DDRSS0_PI_159_DATA
&__DDRSS0_PI_159_DATA=0x00000401
LOCAL &__DDRSS0_PI_160_DATA
&__DDRSS0_PI_160_DATA=0x00000000
LOCAL &__DDRSS0_PI_161_DATA
&__DDRSS0_PI_161_DATA=0x00010000
LOCAL &__DDRSS0_PI_162_DATA
&__DDRSS0_PI_162_DATA=0x00000000
LOCAL &__DDRSS0_PI_163_DATA
&__DDRSS0_PI_163_DATA=0x16160200
LOCAL &__DDRSS0_PI_164_DATA
&__DDRSS0_PI_164_DATA=0x00000034
LOCAL &__DDRSS0_PI_165_DATA
&__DDRSS0_PI_165_DATA=0x0000004B
LOCAL &__DDRSS0_PI_166_DATA
&__DDRSS0_PI_166_DATA=0x0002004B
LOCAL &__DDRSS0_PI_167_DATA
&__DDRSS0_PI_167_DATA=0x02000200
LOCAL &__DDRSS0_PI_168_DATA
&__DDRSS0_PI_168_DATA=0x280A0C04
LOCAL &__DDRSS0_PI_169_DATA
&__DDRSS0_PI_169_DATA=0x0015280A
LOCAL &__DDRSS0_PI_170_DATA
&__DDRSS0_PI_170_DATA=0x000000CE
LOCAL &__DDRSS0_PI_171_DATA
&__DDRSS0_PI_171_DATA=0x00000196
LOCAL &__DDRSS0_PI_172_DATA
&__DDRSS0_PI_172_DATA=0x00001035
LOCAL &__DDRSS0_PI_173_DATA
&__DDRSS0_PI_173_DATA=0x00000196
LOCAL &__DDRSS0_PI_174_DATA
&__DDRSS0_PI_174_DATA=0x04001035
LOCAL &__DDRSS0_PI_175_DATA
&__DDRSS0_PI_175_DATA=0x01010404
LOCAL &__DDRSS0_PI_176_DATA
&__DDRSS0_PI_176_DATA=0x00001501
LOCAL &__DDRSS0_PI_177_DATA
&__DDRSS0_PI_177_DATA=0x00150015
LOCAL &__DDRSS0_PI_178_DATA
&__DDRSS0_PI_178_DATA=0x01000100
LOCAL &__DDRSS0_PI_179_DATA
&__DDRSS0_PI_179_DATA=0x00000100
LOCAL &__DDRSS0_PI_180_DATA
&__DDRSS0_PI_180_DATA=0x00000000
LOCAL &__DDRSS0_PI_181_DATA
&__DDRSS0_PI_181_DATA=0x01010101
LOCAL &__DDRSS0_PI_182_DATA
&__DDRSS0_PI_182_DATA=0x00000101
LOCAL &__DDRSS0_PI_183_DATA
&__DDRSS0_PI_183_DATA=0x00000000
LOCAL &__DDRSS0_PI_184_DATA
&__DDRSS0_PI_184_DATA=0x00000000
LOCAL &__DDRSS0_PI_185_DATA
&__DDRSS0_PI_185_DATA=0x0C040000
LOCAL &__DDRSS0_PI_186_DATA
&__DDRSS0_PI_186_DATA=0x0606020C
LOCAL &__DDRSS0_PI_187_DATA
&__DDRSS0_PI_187_DATA=0x00040402
LOCAL &__DDRSS0_PI_188_DATA
&__DDRSS0_PI_188_DATA=0x000D0035
LOCAL &__DDRSS0_PI_189_DATA
&__DDRSS0_PI_189_DATA=0x0017003F
LOCAL &__DDRSS0_PI_190_DATA
&__DDRSS0_PI_190_DATA=0x0017003F
LOCAL &__DDRSS0_PI_191_DATA
&__DDRSS0_PI_191_DATA=0x01010101
LOCAL &__DDRSS0_PI_192_DATA
&__DDRSS0_PI_192_DATA=0x0002000E
LOCAL &__DDRSS0_PI_193_DATA
&__DDRSS0_PI_193_DATA=0x0002010B
LOCAL &__DDRSS0_PI_194_DATA
&__DDRSS0_PI_194_DATA=0x0100010B
LOCAL &__DDRSS0_PI_195_DATA
&__DDRSS0_PI_195_DATA=0x000F000F
LOCAL &__DDRSS0_PI_196_DATA
&__DDRSS0_PI_196_DATA=0x010C0100
LOCAL &__DDRSS0_PI_197_DATA
&__DDRSS0_PI_197_DATA=0x0100010C
LOCAL &__DDRSS0_PI_198_DATA
&__DDRSS0_PI_198_DATA=0x010C010C
LOCAL &__DDRSS0_PI_199_DATA
&__DDRSS0_PI_199_DATA=0x32103200
LOCAL &__DDRSS0_PI_200_DATA
&__DDRSS0_PI_200_DATA=0x01013210
LOCAL &__DDRSS0_PI_201_DATA
&__DDRSS0_PI_201_DATA=0x0A070601
LOCAL &__DDRSS0_PI_202_DATA
&__DDRSS0_PI_202_DATA=0x100B080D
LOCAL &__DDRSS0_PI_203_DATA
&__DDRSS0_PI_203_DATA=0x100B080F
LOCAL &__DDRSS0_PI_204_DATA
&__DDRSS0_PI_204_DATA=0x0000C00F
LOCAL &__DDRSS0_PI_205_DATA
&__DDRSS0_PI_205_DATA=0x00C01000
LOCAL &__DDRSS0_PI_206_DATA
&__DDRSS0_PI_206_DATA=0x00C01000
LOCAL &__DDRSS0_PI_207_DATA
&__DDRSS0_PI_207_DATA=0x00021000
LOCAL &__DDRSS0_PI_208_DATA
&__DDRSS0_PI_208_DATA=0x0019000E
LOCAL &__DDRSS0_PI_209_DATA
&__DDRSS0_PI_209_DATA=0x0019010B
LOCAL &__DDRSS0_PI_210_DATA
&__DDRSS0_PI_210_DATA=0x0011010B
LOCAL &__DDRSS0_PI_211_DATA
&__DDRSS0_PI_211_DATA=0x32000056
LOCAL &__DDRSS0_PI_212_DATA
&__DDRSS0_PI_212_DATA=0x00000301
LOCAL &__DDRSS0_PI_213_DATA
&__DDRSS0_PI_213_DATA=0x005A0023
LOCAL &__DDRSS0_PI_214_DATA
&__DDRSS0_PI_214_DATA=0x03013212
LOCAL &__DDRSS0_PI_215_DATA
&__DDRSS0_PI_215_DATA=0x00002300
LOCAL &__DDRSS0_PI_216_DATA
&__DDRSS0_PI_216_DATA=0x3212005A
LOCAL &__DDRSS0_PI_217_DATA
&__DDRSS0_PI_217_DATA=0x09000301
LOCAL &__DDRSS0_PI_218_DATA
&__DDRSS0_PI_218_DATA=0x04010504
LOCAL &__DDRSS0_PI_219_DATA
&__DDRSS0_PI_219_DATA=0x040006C9
LOCAL &__DDRSS0_PI_220_DATA
&__DDRSS0_PI_220_DATA=0x0A032001
LOCAL &__DDRSS0_PI_221_DATA
&__DDRSS0_PI_221_DATA=0x1619090A
LOCAL &__DDRSS0_PI_222_DATA
&__DDRSS0_PI_222_DATA=0x0000150D
LOCAL &__DDRSS0_PI_223_DATA
&__DDRSS0_PI_223_DATA=0x3000838E
LOCAL &__DDRSS0_PI_224_DATA
&__DDRSS0_PI_224_DATA=0x0F102004
LOCAL &__DDRSS0_PI_225_DATA
&__DDRSS0_PI_225_DATA=0x1619090B
LOCAL &__DDRSS0_PI_226_DATA
&__DDRSS0_PI_226_DATA=0x0000150D
LOCAL &__DDRSS0_PI_227_DATA
&__DDRSS0_PI_227_DATA=0x3000838E
LOCAL &__DDRSS0_PI_228_DATA
&__DDRSS0_PI_228_DATA=0x0F102004
LOCAL &__DDRSS0_PI_229_DATA
&__DDRSS0_PI_229_DATA=0x00019C0B
LOCAL &__DDRSS0_PI_230_DATA
&__DDRSS0_PI_230_DATA=0x00001018
LOCAL &__DDRSS0_PI_231_DATA
&__DDRSS0_PI_231_DATA=0x0000206A
LOCAL &__DDRSS0_PI_232_DATA
&__DDRSS0_PI_232_DATA=0x00014424
LOCAL &__DDRSS0_PI_233_DATA
&__DDRSS0_PI_233_DATA=0x0000206A
LOCAL &__DDRSS0_PI_234_DATA
&__DDRSS0_PI_234_DATA=0x00014424
LOCAL &__DDRSS0_PI_235_DATA
&__DDRSS0_PI_235_DATA=0x019E0016
LOCAL &__DDRSS0_PI_236_DATA
&__DDRSS0_PI_236_DATA=0x0303019E
LOCAL &__DDRSS0_PI_237_DATA
&__DDRSS0_PI_237_DATA=0x002AF803
LOCAL &__DDRSS0_PI_238_DATA
&__DDRSS0_PI_238_DATA=0x0001ADAF
LOCAL &__DDRSS0_PI_239_DATA
&__DDRSS0_PI_239_DATA=0x00000005
LOCAL &__DDRSS0_PI_240_DATA
&__DDRSS0_PI_240_DATA=0x0000006E
LOCAL &__DDRSS0_PI_241_DATA
&__DDRSS0_PI_241_DATA=0x00000016
LOCAL &__DDRSS0_PI_242_DATA
&__DDRSS0_PI_242_DATA=0x000340E4
LOCAL &__DDRSS0_PI_243_DATA
&__DDRSS0_PI_243_DATA=0x0001ADAF
LOCAL &__DDRSS0_PI_244_DATA
&__DDRSS0_PI_244_DATA=0x00000005
LOCAL &__DDRSS0_PI_245_DATA
&__DDRSS0_PI_245_DATA=0x00000855
LOCAL &__DDRSS0_PI_246_DATA
&__DDRSS0_PI_246_DATA=0x0000019E
LOCAL &__DDRSS0_PI_247_DATA
&__DDRSS0_PI_247_DATA=0x000340E4
LOCAL &__DDRSS0_PI_248_DATA
&__DDRSS0_PI_248_DATA=0x0001ADAF
LOCAL &__DDRSS0_PI_249_DATA
&__DDRSS0_PI_249_DATA=0x00000005
LOCAL &__DDRSS0_PI_250_DATA
&__DDRSS0_PI_250_DATA=0x00000855
LOCAL &__DDRSS0_PI_251_DATA
&__DDRSS0_PI_251_DATA=0x0100019E
LOCAL &__DDRSS0_PI_252_DATA
&__DDRSS0_PI_252_DATA=0x00370040
LOCAL &__DDRSS0_PI_253_DATA
&__DDRSS0_PI_253_DATA=0x00010008
LOCAL &__DDRSS0_PI_254_DATA
&__DDRSS0_PI_254_DATA=0x042B0040
LOCAL &__DDRSS0_PI_255_DATA
&__DDRSS0_PI_255_DATA=0x00010020
LOCAL &__DDRSS0_PI_256_DATA
&__DDRSS0_PI_256_DATA=0x042B0040
LOCAL &__DDRSS0_PI_257_DATA
&__DDRSS0_PI_257_DATA=0x00000320
LOCAL &__DDRSS0_PI_258_DATA
&__DDRSS0_PI_258_DATA=0x00360036
LOCAL &__DDRSS0_PI_259_DATA
&__DDRSS0_PI_259_DATA=0x08040404
LOCAL &__DDRSS0_PI_260_DATA
&__DDRSS0_PI_260_DATA=0x00000055
LOCAL &__DDRSS0_PI_261_DATA
&__DDRSS0_PI_261_DATA=0x55083C5A
LOCAL &__DDRSS0_PI_262_DATA
&__DDRSS0_PI_262_DATA=0x5A000000
LOCAL &__DDRSS0_PI_263_DATA
&__DDRSS0_PI_263_DATA=0x0055083C
LOCAL &__DDRSS0_PI_264_DATA
&__DDRSS0_PI_264_DATA=0x3C5A0000
LOCAL &__DDRSS0_PI_265_DATA
&__DDRSS0_PI_265_DATA=0x00005508
LOCAL &__DDRSS0_PI_266_DATA
&__DDRSS0_PI_266_DATA=0x0C3C5A00
LOCAL &__DDRSS0_PI_267_DATA
&__DDRSS0_PI_267_DATA=0x080F0E0D
LOCAL &__DDRSS0_PI_268_DATA
&__DDRSS0_PI_268_DATA=0x000B0A09
LOCAL &__DDRSS0_PI_269_DATA
&__DDRSS0_PI_269_DATA=0x00030201
LOCAL &__DDRSS0_PI_270_DATA
&__DDRSS0_PI_270_DATA=0x01000000
LOCAL &__DDRSS0_PI_271_DATA
&__DDRSS0_PI_271_DATA=0x04020201
LOCAL &__DDRSS0_PI_272_DATA
&__DDRSS0_PI_272_DATA=0x00080804
LOCAL &__DDRSS0_PI_273_DATA
&__DDRSS0_PI_273_DATA=0x00000000
LOCAL &__DDRSS0_PI_274_DATA
&__DDRSS0_PI_274_DATA=0x00000000
LOCAL &__DDRSS0_PI_275_DATA
&__DDRSS0_PI_275_DATA=0x00330084
LOCAL &__DDRSS0_PI_276_DATA
&__DDRSS0_PI_276_DATA=0x00160000
LOCAL &__DDRSS0_PI_277_DATA
&__DDRSS0_PI_277_DATA=0x56331BB4
LOCAL &__DDRSS0_PI_278_DATA
&__DDRSS0_PI_278_DATA=0x00160F27
LOCAL &__DDRSS0_PI_279_DATA
&__DDRSS0_PI_279_DATA=0x56331BB4
LOCAL &__DDRSS0_PI_280_DATA
&__DDRSS0_PI_280_DATA=0x00160F27
LOCAL &__DDRSS0_PI_281_DATA
&__DDRSS0_PI_281_DATA=0x00330084
LOCAL &__DDRSS0_PI_282_DATA
&__DDRSS0_PI_282_DATA=0x00160000
LOCAL &__DDRSS0_PI_283_DATA
&__DDRSS0_PI_283_DATA=0x56331BB4
LOCAL &__DDRSS0_PI_284_DATA
&__DDRSS0_PI_284_DATA=0x00160F27
LOCAL &__DDRSS0_PI_285_DATA
&__DDRSS0_PI_285_DATA=0x56331BB4
LOCAL &__DDRSS0_PI_286_DATA
&__DDRSS0_PI_286_DATA=0x00160F27
LOCAL &__DDRSS0_PI_287_DATA
&__DDRSS0_PI_287_DATA=0x00330084
LOCAL &__DDRSS0_PI_288_DATA
&__DDRSS0_PI_288_DATA=0x00160000
LOCAL &__DDRSS0_PI_289_DATA
&__DDRSS0_PI_289_DATA=0x56331BB4
LOCAL &__DDRSS0_PI_290_DATA
&__DDRSS0_PI_290_DATA=0x00160F27
LOCAL &__DDRSS0_PI_291_DATA
&__DDRSS0_PI_291_DATA=0x56331BB4
LOCAL &__DDRSS0_PI_292_DATA
&__DDRSS0_PI_292_DATA=0x00160F27
LOCAL &__DDRSS0_PI_293_DATA
&__DDRSS0_PI_293_DATA=0x00330084
LOCAL &__DDRSS0_PI_294_DATA
&__DDRSS0_PI_294_DATA=0x00160000
LOCAL &__DDRSS0_PI_295_DATA
&__DDRSS0_PI_295_DATA=0x56331BB4
LOCAL &__DDRSS0_PI_296_DATA
&__DDRSS0_PI_296_DATA=0x00160F27
LOCAL &__DDRSS0_PI_297_DATA
&__DDRSS0_PI_297_DATA=0x56331BB4
LOCAL &__DDRSS0_PI_298_DATA
&__DDRSS0_PI_298_DATA=0x00160F27
LOCAL &__DDRSS0_PI_299_DATA
&__DDRSS0_PI_299_DATA=0x00000000
LOCAL &__DDRSS0_PHY_00_DATA
&__DDRSS0_PHY_00_DATA=0x000004F0
LOCAL &__DDRSS0_PHY_01_DATA
&__DDRSS0_PHY_01_DATA=0x00000000
LOCAL &__DDRSS0_PHY_02_DATA
&__DDRSS0_PHY_02_DATA=0x00030200
LOCAL &__DDRSS0_PHY_03_DATA
&__DDRSS0_PHY_03_DATA=0x00000000
LOCAL &__DDRSS0_PHY_04_DATA
&__DDRSS0_PHY_04_DATA=0x00000000
LOCAL &__DDRSS0_PHY_05_DATA
&__DDRSS0_PHY_05_DATA=0x01030000
LOCAL &__DDRSS0_PHY_06_DATA
&__DDRSS0_PHY_06_DATA=0x00010000
LOCAL &__DDRSS0_PHY_07_DATA
&__DDRSS0_PHY_07_DATA=0x01030004
LOCAL &__DDRSS0_PHY_08_DATA
&__DDRSS0_PHY_08_DATA=0x01000000
LOCAL &__DDRSS0_PHY_09_DATA
&__DDRSS0_PHY_09_DATA=0x00000000
LOCAL &__DDRSS0_PHY_10_DATA
&__DDRSS0_PHY_10_DATA=0x00000000
LOCAL &__DDRSS0_PHY_11_DATA
&__DDRSS0_PHY_11_DATA=0x01000001
LOCAL &__DDRSS0_PHY_12_DATA
&__DDRSS0_PHY_12_DATA=0x00000100
LOCAL &__DDRSS0_PHY_13_DATA
&__DDRSS0_PHY_13_DATA=0x000800C0
LOCAL &__DDRSS0_PHY_14_DATA
&__DDRSS0_PHY_14_DATA=0x060100CC
LOCAL &__DDRSS0_PHY_15_DATA
&__DDRSS0_PHY_15_DATA=0x00030066
LOCAL &__DDRSS0_PHY_16_DATA
&__DDRSS0_PHY_16_DATA=0x00000000
LOCAL &__DDRSS0_PHY_17_DATA
&__DDRSS0_PHY_17_DATA=0x00000301
LOCAL &__DDRSS0_PHY_18_DATA
&__DDRSS0_PHY_18_DATA=0x0000AAAA
LOCAL &__DDRSS0_PHY_19_DATA
&__DDRSS0_PHY_19_DATA=0x00005555
LOCAL &__DDRSS0_PHY_20_DATA
&__DDRSS0_PHY_20_DATA=0x0000B5B5
LOCAL &__DDRSS0_PHY_21_DATA
&__DDRSS0_PHY_21_DATA=0x00004A4A
LOCAL &__DDRSS0_PHY_22_DATA
&__DDRSS0_PHY_22_DATA=0x00005656
LOCAL &__DDRSS0_PHY_23_DATA
&__DDRSS0_PHY_23_DATA=0x0000A9A9
LOCAL &__DDRSS0_PHY_24_DATA
&__DDRSS0_PHY_24_DATA=0x0000A9A9
LOCAL &__DDRSS0_PHY_25_DATA
&__DDRSS0_PHY_25_DATA=0x0000B5B5
LOCAL &__DDRSS0_PHY_26_DATA
&__DDRSS0_PHY_26_DATA=0x00000000
LOCAL &__DDRSS0_PHY_27_DATA
&__DDRSS0_PHY_27_DATA=0x00000000
LOCAL &__DDRSS0_PHY_28_DATA
&__DDRSS0_PHY_28_DATA=0x2A000000
LOCAL &__DDRSS0_PHY_29_DATA
&__DDRSS0_PHY_29_DATA=0x00000808
LOCAL &__DDRSS0_PHY_30_DATA
&__DDRSS0_PHY_30_DATA=0x0F000000
LOCAL &__DDRSS0_PHY_31_DATA
&__DDRSS0_PHY_31_DATA=0x00000F0F
LOCAL &__DDRSS0_PHY_32_DATA
&__DDRSS0_PHY_32_DATA=0x10200000
LOCAL &__DDRSS0_PHY_33_DATA
&__DDRSS0_PHY_33_DATA=0x0C002006
LOCAL &__DDRSS0_PHY_34_DATA
&__DDRSS0_PHY_34_DATA=0x00000000
LOCAL &__DDRSS0_PHY_35_DATA
&__DDRSS0_PHY_35_DATA=0x00000000
LOCAL &__DDRSS0_PHY_36_DATA
&__DDRSS0_PHY_36_DATA=0x55555555
LOCAL &__DDRSS0_PHY_37_DATA
&__DDRSS0_PHY_37_DATA=0xAAAAAAAA
LOCAL &__DDRSS0_PHY_38_DATA
&__DDRSS0_PHY_38_DATA=0x55555555
LOCAL &__DDRSS0_PHY_39_DATA
&__DDRSS0_PHY_39_DATA=0xAAAAAAAA
LOCAL &__DDRSS0_PHY_40_DATA
&__DDRSS0_PHY_40_DATA=0x00005555
LOCAL &__DDRSS0_PHY_41_DATA
&__DDRSS0_PHY_41_DATA=0x01000100
LOCAL &__DDRSS0_PHY_42_DATA
&__DDRSS0_PHY_42_DATA=0x00800180
LOCAL &__DDRSS0_PHY_43_DATA
&__DDRSS0_PHY_43_DATA=0x00000001
LOCAL &__DDRSS0_PHY_44_DATA
&__DDRSS0_PHY_44_DATA=0x00000000
LOCAL &__DDRSS0_PHY_45_DATA
&__DDRSS0_PHY_45_DATA=0x00000000
LOCAL &__DDRSS0_PHY_46_DATA
&__DDRSS0_PHY_46_DATA=0x00000000
LOCAL &__DDRSS0_PHY_47_DATA
&__DDRSS0_PHY_47_DATA=0x00000000
LOCAL &__DDRSS0_PHY_48_DATA
&__DDRSS0_PHY_48_DATA=0x00000000
LOCAL &__DDRSS0_PHY_49_DATA
&__DDRSS0_PHY_49_DATA=0x00000000
LOCAL &__DDRSS0_PHY_50_DATA
&__DDRSS0_PHY_50_DATA=0x00000000
LOCAL &__DDRSS0_PHY_51_DATA
&__DDRSS0_PHY_51_DATA=0x00000000
LOCAL &__DDRSS0_PHY_52_DATA
&__DDRSS0_PHY_52_DATA=0x00000000
LOCAL &__DDRSS0_PHY_53_DATA
&__DDRSS0_PHY_53_DATA=0x00000000
LOCAL &__DDRSS0_PHY_54_DATA
&__DDRSS0_PHY_54_DATA=0x00000000
LOCAL &__DDRSS0_PHY_55_DATA
&__DDRSS0_PHY_55_DATA=0x00000000
LOCAL &__DDRSS0_PHY_56_DATA
&__DDRSS0_PHY_56_DATA=0x00000000
LOCAL &__DDRSS0_PHY_57_DATA
&__DDRSS0_PHY_57_DATA=0x00000000
LOCAL &__DDRSS0_PHY_58_DATA
&__DDRSS0_PHY_58_DATA=0x00000000
LOCAL &__DDRSS0_PHY_59_DATA
&__DDRSS0_PHY_59_DATA=0x00000000
LOCAL &__DDRSS0_PHY_60_DATA
&__DDRSS0_PHY_60_DATA=0x00000000
LOCAL &__DDRSS0_PHY_61_DATA
&__DDRSS0_PHY_61_DATA=0x00000000
LOCAL &__DDRSS0_PHY_62_DATA
&__DDRSS0_PHY_62_DATA=0x00000000
LOCAL &__DDRSS0_PHY_63_DATA
&__DDRSS0_PHY_63_DATA=0x00000000
LOCAL &__DDRSS0_PHY_64_DATA
&__DDRSS0_PHY_64_DATA=0x00000000
LOCAL &__DDRSS0_PHY_65_DATA
&__DDRSS0_PHY_65_DATA=0x00000000
LOCAL &__DDRSS0_PHY_66_DATA
&__DDRSS0_PHY_66_DATA=0x00000104
LOCAL &__DDRSS0_PHY_67_DATA
&__DDRSS0_PHY_67_DATA=0x00000120
LOCAL &__DDRSS0_PHY_68_DATA
&__DDRSS0_PHY_68_DATA=0x00000000
LOCAL &__DDRSS0_PHY_69_DATA
&__DDRSS0_PHY_69_DATA=0x00000000
LOCAL &__DDRSS0_PHY_70_DATA
&__DDRSS0_PHY_70_DATA=0x00000000
LOCAL &__DDRSS0_PHY_71_DATA
&__DDRSS0_PHY_71_DATA=0x00000000
LOCAL &__DDRSS0_PHY_72_DATA
&__DDRSS0_PHY_72_DATA=0x00000000
LOCAL &__DDRSS0_PHY_73_DATA
&__DDRSS0_PHY_73_DATA=0x00000000
LOCAL &__DDRSS0_PHY_74_DATA
&__DDRSS0_PHY_74_DATA=0x00000000
LOCAL &__DDRSS0_PHY_75_DATA
&__DDRSS0_PHY_75_DATA=0x00000001
LOCAL &__DDRSS0_PHY_76_DATA
&__DDRSS0_PHY_76_DATA=0x07FF0000
LOCAL &__DDRSS0_PHY_77_DATA
&__DDRSS0_PHY_77_DATA=0x0080081F
LOCAL &__DDRSS0_PHY_78_DATA
&__DDRSS0_PHY_78_DATA=0x00081020
LOCAL &__DDRSS0_PHY_79_DATA
&__DDRSS0_PHY_79_DATA=0x04010000
LOCAL &__DDRSS0_PHY_80_DATA
&__DDRSS0_PHY_80_DATA=0x00000000
LOCAL &__DDRSS0_PHY_81_DATA
&__DDRSS0_PHY_81_DATA=0x00000000
LOCAL &__DDRSS0_PHY_82_DATA
&__DDRSS0_PHY_82_DATA=0x00000000
LOCAL &__DDRSS0_PHY_83_DATA
&__DDRSS0_PHY_83_DATA=0x00000100
LOCAL &__DDRSS0_PHY_84_DATA
&__DDRSS0_PHY_84_DATA=0x01CC0C01
LOCAL &__DDRSS0_PHY_85_DATA
&__DDRSS0_PHY_85_DATA=0x1003CC0C
LOCAL &__DDRSS0_PHY_86_DATA
&__DDRSS0_PHY_86_DATA=0x20000140
LOCAL &__DDRSS0_PHY_87_DATA
&__DDRSS0_PHY_87_DATA=0x07FF0200
LOCAL &__DDRSS0_PHY_88_DATA
&__DDRSS0_PHY_88_DATA=0x0000DD01
LOCAL &__DDRSS0_PHY_89_DATA
&__DDRSS0_PHY_89_DATA=0x10100303
LOCAL &__DDRSS0_PHY_90_DATA
&__DDRSS0_PHY_90_DATA=0x10101010
LOCAL &__DDRSS0_PHY_91_DATA
&__DDRSS0_PHY_91_DATA=0x10101010
LOCAL &__DDRSS0_PHY_92_DATA
&__DDRSS0_PHY_92_DATA=0x00011010
LOCAL &__DDRSS0_PHY_93_DATA
&__DDRSS0_PHY_93_DATA=0x00100010
LOCAL &__DDRSS0_PHY_94_DATA
&__DDRSS0_PHY_94_DATA=0x00100010
LOCAL &__DDRSS0_PHY_95_DATA
&__DDRSS0_PHY_95_DATA=0x00100010
LOCAL &__DDRSS0_PHY_96_DATA
&__DDRSS0_PHY_96_DATA=0x00100010
LOCAL &__DDRSS0_PHY_97_DATA
&__DDRSS0_PHY_97_DATA=0x00050010
LOCAL &__DDRSS0_PHY_98_DATA
&__DDRSS0_PHY_98_DATA=0x51517041
LOCAL &__DDRSS0_PHY_99_DATA
&__DDRSS0_PHY_99_DATA=0x31C06000
LOCAL &__DDRSS0_PHY_100_DATA
&__DDRSS0_PHY_100_DATA=0x07AB0340
LOCAL &__DDRSS0_PHY_101_DATA
&__DDRSS0_PHY_101_DATA=0x00C0C001
LOCAL &__DDRSS0_PHY_102_DATA
&__DDRSS0_PHY_102_DATA=0x07060001
LOCAL &__DDRSS0_PHY_103_DATA
&__DDRSS0_PHY_103_DATA=0x10001000
LOCAL &__DDRSS0_PHY_104_DATA
&__DDRSS0_PHY_104_DATA=0x0C063E42
LOCAL &__DDRSS0_PHY_105_DATA
&__DDRSS0_PHY_105_DATA=0x0F0C2201
LOCAL &__DDRSS0_PHY_106_DATA
&__DDRSS0_PHY_106_DATA=0x01000140
LOCAL &__DDRSS0_PHY_107_DATA
&__DDRSS0_PHY_107_DATA=0x0C000420
LOCAL &__DDRSS0_PHY_108_DATA
&__DDRSS0_PHY_108_DATA=0x00000198
LOCAL &__DDRSS0_PHY_109_DATA
&__DDRSS0_PHY_109_DATA=0x0A0000D0
LOCAL &__DDRSS0_PHY_110_DATA
&__DDRSS0_PHY_110_DATA=0x00030200
LOCAL &__DDRSS0_PHY_111_DATA
&__DDRSS0_PHY_111_DATA=0x02800000
LOCAL &__DDRSS0_PHY_112_DATA
&__DDRSS0_PHY_112_DATA=0x80800000
LOCAL &__DDRSS0_PHY_113_DATA
&__DDRSS0_PHY_113_DATA=0x00072010
LOCAL &__DDRSS0_PHY_114_DATA
&__DDRSS0_PHY_114_DATA=0x76543210
LOCAL &__DDRSS0_PHY_115_DATA
&__DDRSS0_PHY_115_DATA=0x00000008
LOCAL &__DDRSS0_PHY_116_DATA
&__DDRSS0_PHY_116_DATA=0x02800280
LOCAL &__DDRSS0_PHY_117_DATA
&__DDRSS0_PHY_117_DATA=0x02800280
LOCAL &__DDRSS0_PHY_118_DATA
&__DDRSS0_PHY_118_DATA=0x02800280
LOCAL &__DDRSS0_PHY_119_DATA
&__DDRSS0_PHY_119_DATA=0x02800280
LOCAL &__DDRSS0_PHY_120_DATA
&__DDRSS0_PHY_120_DATA=0x00000280
LOCAL &__DDRSS0_PHY_121_DATA
&__DDRSS0_PHY_121_DATA=0x0000A000
LOCAL &__DDRSS0_PHY_122_DATA
&__DDRSS0_PHY_122_DATA=0x00A000A0
LOCAL &__DDRSS0_PHY_123_DATA
&__DDRSS0_PHY_123_DATA=0x00A000A0
LOCAL &__DDRSS0_PHY_124_DATA
&__DDRSS0_PHY_124_DATA=0x00A000A0
LOCAL &__DDRSS0_PHY_125_DATA
&__DDRSS0_PHY_125_DATA=0x00A000A0
LOCAL &__DDRSS0_PHY_126_DATA
&__DDRSS0_PHY_126_DATA=0x00A000A0
LOCAL &__DDRSS0_PHY_127_DATA
&__DDRSS0_PHY_127_DATA=0x00A000A0
LOCAL &__DDRSS0_PHY_128_DATA
&__DDRSS0_PHY_128_DATA=0x00A000A0
LOCAL &__DDRSS0_PHY_129_DATA
&__DDRSS0_PHY_129_DATA=0x00A000A0
LOCAL &__DDRSS0_PHY_130_DATA
&__DDRSS0_PHY_130_DATA=0x006E00A0
LOCAL &__DDRSS0_PHY_131_DATA
&__DDRSS0_PHY_131_DATA=0x01A00003
LOCAL &__DDRSS0_PHY_132_DATA
&__DDRSS0_PHY_132_DATA=0x00000000
LOCAL &__DDRSS0_PHY_133_DATA
&__DDRSS0_PHY_133_DATA=0x00000000
LOCAL &__DDRSS0_PHY_134_DATA
&__DDRSS0_PHY_134_DATA=0x00080200
LOCAL &__DDRSS0_PHY_135_DATA
&__DDRSS0_PHY_135_DATA=0x00000000
LOCAL &__DDRSS0_PHY_136_DATA
&__DDRSS0_PHY_136_DATA=0x20202000
LOCAL &__DDRSS0_PHY_137_DATA
&__DDRSS0_PHY_137_DATA=0x20202020
LOCAL &__DDRSS0_PHY_138_DATA
&__DDRSS0_PHY_138_DATA=0xF0F02020
LOCAL &__DDRSS0_PHY_139_DATA
&__DDRSS0_PHY_139_DATA=0x00000000
LOCAL &__DDRSS0_PHY_140_DATA
&__DDRSS0_PHY_140_DATA=0x00000000
LOCAL &__DDRSS0_PHY_141_DATA
&__DDRSS0_PHY_141_DATA=0x00000000
LOCAL &__DDRSS0_PHY_142_DATA
&__DDRSS0_PHY_142_DATA=0x00000000
LOCAL &__DDRSS0_PHY_143_DATA
&__DDRSS0_PHY_143_DATA=0x00000000
LOCAL &__DDRSS0_PHY_144_DATA
&__DDRSS0_PHY_144_DATA=0x00000000
LOCAL &__DDRSS0_PHY_145_DATA
&__DDRSS0_PHY_145_DATA=0x00000000
LOCAL &__DDRSS0_PHY_146_DATA
&__DDRSS0_PHY_146_DATA=0x00000000
LOCAL &__DDRSS0_PHY_147_DATA
&__DDRSS0_PHY_147_DATA=0x00000000
LOCAL &__DDRSS0_PHY_148_DATA
&__DDRSS0_PHY_148_DATA=0x00000000
LOCAL &__DDRSS0_PHY_149_DATA
&__DDRSS0_PHY_149_DATA=0x00000000
LOCAL &__DDRSS0_PHY_150_DATA
&__DDRSS0_PHY_150_DATA=0x00000000
LOCAL &__DDRSS0_PHY_151_DATA
&__DDRSS0_PHY_151_DATA=0x00000000
LOCAL &__DDRSS0_PHY_152_DATA
&__DDRSS0_PHY_152_DATA=0x00000000
LOCAL &__DDRSS0_PHY_153_DATA
&__DDRSS0_PHY_153_DATA=0x00000000
LOCAL &__DDRSS0_PHY_154_DATA
&__DDRSS0_PHY_154_DATA=0x00000000
LOCAL &__DDRSS0_PHY_155_DATA
&__DDRSS0_PHY_155_DATA=0x00000000
LOCAL &__DDRSS0_PHY_156_DATA
&__DDRSS0_PHY_156_DATA=0x00000000
LOCAL &__DDRSS0_PHY_157_DATA
&__DDRSS0_PHY_157_DATA=0x00000000
LOCAL &__DDRSS0_PHY_158_DATA
&__DDRSS0_PHY_158_DATA=0x00000000
LOCAL &__DDRSS0_PHY_159_DATA
&__DDRSS0_PHY_159_DATA=0x00000000
LOCAL &__DDRSS0_PHY_160_DATA
&__DDRSS0_PHY_160_DATA=0x00000000
LOCAL &__DDRSS0_PHY_161_DATA
&__DDRSS0_PHY_161_DATA=0x00000000
LOCAL &__DDRSS0_PHY_162_DATA
&__DDRSS0_PHY_162_DATA=0x00000000
LOCAL &__DDRSS0_PHY_163_DATA
&__DDRSS0_PHY_163_DATA=0x00000000
LOCAL &__DDRSS0_PHY_164_DATA
&__DDRSS0_PHY_164_DATA=0x00000000
LOCAL &__DDRSS0_PHY_165_DATA
&__DDRSS0_PHY_165_DATA=0x00000000
LOCAL &__DDRSS0_PHY_166_DATA
&__DDRSS0_PHY_166_DATA=0x00000000
LOCAL &__DDRSS0_PHY_167_DATA
&__DDRSS0_PHY_167_DATA=0x00000000
LOCAL &__DDRSS0_PHY_168_DATA
&__DDRSS0_PHY_168_DATA=0x00000000
LOCAL &__DDRSS0_PHY_169_DATA
&__DDRSS0_PHY_169_DATA=0x00000000
LOCAL &__DDRSS0_PHY_170_DATA
&__DDRSS0_PHY_170_DATA=0x00000000
LOCAL &__DDRSS0_PHY_171_DATA
&__DDRSS0_PHY_171_DATA=0x00000000
LOCAL &__DDRSS0_PHY_172_DATA
&__DDRSS0_PHY_172_DATA=0x00000000
LOCAL &__DDRSS0_PHY_173_DATA
&__DDRSS0_PHY_173_DATA=0x00000000
LOCAL &__DDRSS0_PHY_174_DATA
&__DDRSS0_PHY_174_DATA=0x00000000
LOCAL &__DDRSS0_PHY_175_DATA
&__DDRSS0_PHY_175_DATA=0x00000000
LOCAL &__DDRSS0_PHY_176_DATA
&__DDRSS0_PHY_176_DATA=0x00000000
LOCAL &__DDRSS0_PHY_177_DATA
&__DDRSS0_PHY_177_DATA=0x00000000
LOCAL &__DDRSS0_PHY_178_DATA
&__DDRSS0_PHY_178_DATA=0x00000000
LOCAL &__DDRSS0_PHY_179_DATA
&__DDRSS0_PHY_179_DATA=0x00000000
LOCAL &__DDRSS0_PHY_180_DATA
&__DDRSS0_PHY_180_DATA=0x00000000
LOCAL &__DDRSS0_PHY_181_DATA
&__DDRSS0_PHY_181_DATA=0x00000000
LOCAL &__DDRSS0_PHY_182_DATA
&__DDRSS0_PHY_182_DATA=0x00000000
LOCAL &__DDRSS0_PHY_183_DATA
&__DDRSS0_PHY_183_DATA=0x00000000
LOCAL &__DDRSS0_PHY_184_DATA
&__DDRSS0_PHY_184_DATA=0x00000000
LOCAL &__DDRSS0_PHY_185_DATA
&__DDRSS0_PHY_185_DATA=0x00000000
LOCAL &__DDRSS0_PHY_186_DATA
&__DDRSS0_PHY_186_DATA=0x00000000
LOCAL &__DDRSS0_PHY_187_DATA
&__DDRSS0_PHY_187_DATA=0x00000000
LOCAL &__DDRSS0_PHY_188_DATA
&__DDRSS0_PHY_188_DATA=0x00000000
LOCAL &__DDRSS0_PHY_189_DATA
&__DDRSS0_PHY_189_DATA=0x00000000
LOCAL &__DDRSS0_PHY_190_DATA
&__DDRSS0_PHY_190_DATA=0x00000000
LOCAL &__DDRSS0_PHY_191_DATA
&__DDRSS0_PHY_191_DATA=0x00000000
LOCAL &__DDRSS0_PHY_192_DATA
&__DDRSS0_PHY_192_DATA=0x00000000
LOCAL &__DDRSS0_PHY_193_DATA
&__DDRSS0_PHY_193_DATA=0x00000000
LOCAL &__DDRSS0_PHY_194_DATA
&__DDRSS0_PHY_194_DATA=0x00000000
LOCAL &__DDRSS0_PHY_195_DATA
&__DDRSS0_PHY_195_DATA=0x00000000
LOCAL &__DDRSS0_PHY_196_DATA
&__DDRSS0_PHY_196_DATA=0x00000000
LOCAL &__DDRSS0_PHY_197_DATA
&__DDRSS0_PHY_197_DATA=0x00000000
LOCAL &__DDRSS0_PHY_198_DATA
&__DDRSS0_PHY_198_DATA=0x00000000
LOCAL &__DDRSS0_PHY_199_DATA
&__DDRSS0_PHY_199_DATA=0x00000000
LOCAL &__DDRSS0_PHY_200_DATA
&__DDRSS0_PHY_200_DATA=0x00000000
LOCAL &__DDRSS0_PHY_201_DATA
&__DDRSS0_PHY_201_DATA=0x00000000
LOCAL &__DDRSS0_PHY_202_DATA
&__DDRSS0_PHY_202_DATA=0x00000000
LOCAL &__DDRSS0_PHY_203_DATA
&__DDRSS0_PHY_203_DATA=0x00000000
LOCAL &__DDRSS0_PHY_204_DATA
&__DDRSS0_PHY_204_DATA=0x00000000
LOCAL &__DDRSS0_PHY_205_DATA
&__DDRSS0_PHY_205_DATA=0x00000000
LOCAL &__DDRSS0_PHY_206_DATA
&__DDRSS0_PHY_206_DATA=0x00000000
LOCAL &__DDRSS0_PHY_207_DATA
&__DDRSS0_PHY_207_DATA=0x00000000
LOCAL &__DDRSS0_PHY_208_DATA
&__DDRSS0_PHY_208_DATA=0x00000000
LOCAL &__DDRSS0_PHY_209_DATA
&__DDRSS0_PHY_209_DATA=0x00000000
LOCAL &__DDRSS0_PHY_210_DATA
&__DDRSS0_PHY_210_DATA=0x00000000
LOCAL &__DDRSS0_PHY_211_DATA
&__DDRSS0_PHY_211_DATA=0x00000000
LOCAL &__DDRSS0_PHY_212_DATA
&__DDRSS0_PHY_212_DATA=0x00000000
LOCAL &__DDRSS0_PHY_213_DATA
&__DDRSS0_PHY_213_DATA=0x00000000
LOCAL &__DDRSS0_PHY_214_DATA
&__DDRSS0_PHY_214_DATA=0x00000000
LOCAL &__DDRSS0_PHY_215_DATA
&__DDRSS0_PHY_215_DATA=0x00000000
LOCAL &__DDRSS0_PHY_216_DATA
&__DDRSS0_PHY_216_DATA=0x00000000
LOCAL &__DDRSS0_PHY_217_DATA
&__DDRSS0_PHY_217_DATA=0x00000000
LOCAL &__DDRSS0_PHY_218_DATA
&__DDRSS0_PHY_218_DATA=0x00000000
LOCAL &__DDRSS0_PHY_219_DATA
&__DDRSS0_PHY_219_DATA=0x00000000
LOCAL &__DDRSS0_PHY_220_DATA
&__DDRSS0_PHY_220_DATA=0x00000000
LOCAL &__DDRSS0_PHY_221_DATA
&__DDRSS0_PHY_221_DATA=0x00000000
LOCAL &__DDRSS0_PHY_222_DATA
&__DDRSS0_PHY_222_DATA=0x00000000
LOCAL &__DDRSS0_PHY_223_DATA
&__DDRSS0_PHY_223_DATA=0x00000000
LOCAL &__DDRSS0_PHY_224_DATA
&__DDRSS0_PHY_224_DATA=0x00000000
LOCAL &__DDRSS0_PHY_225_DATA
&__DDRSS0_PHY_225_DATA=0x00000000
LOCAL &__DDRSS0_PHY_226_DATA
&__DDRSS0_PHY_226_DATA=0x00000000
LOCAL &__DDRSS0_PHY_227_DATA
&__DDRSS0_PHY_227_DATA=0x00000000
LOCAL &__DDRSS0_PHY_228_DATA
&__DDRSS0_PHY_228_DATA=0x00000000
LOCAL &__DDRSS0_PHY_229_DATA
&__DDRSS0_PHY_229_DATA=0x00000000
LOCAL &__DDRSS0_PHY_230_DATA
&__DDRSS0_PHY_230_DATA=0x00000000
LOCAL &__DDRSS0_PHY_231_DATA
&__DDRSS0_PHY_231_DATA=0x00000000
LOCAL &__DDRSS0_PHY_232_DATA
&__DDRSS0_PHY_232_DATA=0x00000000
LOCAL &__DDRSS0_PHY_233_DATA
&__DDRSS0_PHY_233_DATA=0x00000000
LOCAL &__DDRSS0_PHY_234_DATA
&__DDRSS0_PHY_234_DATA=0x00000000
LOCAL &__DDRSS0_PHY_235_DATA
&__DDRSS0_PHY_235_DATA=0x00000000
LOCAL &__DDRSS0_PHY_236_DATA
&__DDRSS0_PHY_236_DATA=0x00000000
LOCAL &__DDRSS0_PHY_237_DATA
&__DDRSS0_PHY_237_DATA=0x00000000
LOCAL &__DDRSS0_PHY_238_DATA
&__DDRSS0_PHY_238_DATA=0x00000000
LOCAL &__DDRSS0_PHY_239_DATA
&__DDRSS0_PHY_239_DATA=0x00000000
LOCAL &__DDRSS0_PHY_240_DATA
&__DDRSS0_PHY_240_DATA=0x00000000
LOCAL &__DDRSS0_PHY_241_DATA
&__DDRSS0_PHY_241_DATA=0x00000000
LOCAL &__DDRSS0_PHY_242_DATA
&__DDRSS0_PHY_242_DATA=0x00000000
LOCAL &__DDRSS0_PHY_243_DATA
&__DDRSS0_PHY_243_DATA=0x00000000
LOCAL &__DDRSS0_PHY_244_DATA
&__DDRSS0_PHY_244_DATA=0x00000000
LOCAL &__DDRSS0_PHY_245_DATA
&__DDRSS0_PHY_245_DATA=0x00000000
LOCAL &__DDRSS0_PHY_246_DATA
&__DDRSS0_PHY_246_DATA=0x00000000
LOCAL &__DDRSS0_PHY_247_DATA
&__DDRSS0_PHY_247_DATA=0x00000000
LOCAL &__DDRSS0_PHY_248_DATA
&__DDRSS0_PHY_248_DATA=0x00000000
LOCAL &__DDRSS0_PHY_249_DATA
&__DDRSS0_PHY_249_DATA=0x00000000
LOCAL &__DDRSS0_PHY_250_DATA
&__DDRSS0_PHY_250_DATA=0x00000000
LOCAL &__DDRSS0_PHY_251_DATA
&__DDRSS0_PHY_251_DATA=0x00000000
LOCAL &__DDRSS0_PHY_252_DATA
&__DDRSS0_PHY_252_DATA=0x00000000
LOCAL &__DDRSS0_PHY_253_DATA
&__DDRSS0_PHY_253_DATA=0x00000000
LOCAL &__DDRSS0_PHY_254_DATA
&__DDRSS0_PHY_254_DATA=0x00000000
LOCAL &__DDRSS0_PHY_255_DATA
&__DDRSS0_PHY_255_DATA=0x00000000
LOCAL &__DDRSS0_PHY_256_DATA
&__DDRSS0_PHY_256_DATA=0x000004F0
LOCAL &__DDRSS0_PHY_257_DATA
&__DDRSS0_PHY_257_DATA=0x00000000
LOCAL &__DDRSS0_PHY_258_DATA
&__DDRSS0_PHY_258_DATA=0x00030200
LOCAL &__DDRSS0_PHY_259_DATA
&__DDRSS0_PHY_259_DATA=0x00000000
LOCAL &__DDRSS0_PHY_260_DATA
&__DDRSS0_PHY_260_DATA=0x00000000
LOCAL &__DDRSS0_PHY_261_DATA
&__DDRSS0_PHY_261_DATA=0x01030000
LOCAL &__DDRSS0_PHY_262_DATA
&__DDRSS0_PHY_262_DATA=0x00010000
LOCAL &__DDRSS0_PHY_263_DATA
&__DDRSS0_PHY_263_DATA=0x01030004
LOCAL &__DDRSS0_PHY_264_DATA
&__DDRSS0_PHY_264_DATA=0x01000000
LOCAL &__DDRSS0_PHY_265_DATA
&__DDRSS0_PHY_265_DATA=0x00000000
LOCAL &__DDRSS0_PHY_266_DATA
&__DDRSS0_PHY_266_DATA=0x00000000
LOCAL &__DDRSS0_PHY_267_DATA
&__DDRSS0_PHY_267_DATA=0x01000001
LOCAL &__DDRSS0_PHY_268_DATA
&__DDRSS0_PHY_268_DATA=0x00000100
LOCAL &__DDRSS0_PHY_269_DATA
&__DDRSS0_PHY_269_DATA=0x000800C0
LOCAL &__DDRSS0_PHY_270_DATA
&__DDRSS0_PHY_270_DATA=0x060100CC
LOCAL &__DDRSS0_PHY_271_DATA
&__DDRSS0_PHY_271_DATA=0x00030066
LOCAL &__DDRSS0_PHY_272_DATA
&__DDRSS0_PHY_272_DATA=0x00000000
LOCAL &__DDRSS0_PHY_273_DATA
&__DDRSS0_PHY_273_DATA=0x00000301
LOCAL &__DDRSS0_PHY_274_DATA
&__DDRSS0_PHY_274_DATA=0x0000AAAA
LOCAL &__DDRSS0_PHY_275_DATA
&__DDRSS0_PHY_275_DATA=0x00005555
LOCAL &__DDRSS0_PHY_276_DATA
&__DDRSS0_PHY_276_DATA=0x0000B5B5
LOCAL &__DDRSS0_PHY_277_DATA
&__DDRSS0_PHY_277_DATA=0x00004A4A
LOCAL &__DDRSS0_PHY_278_DATA
&__DDRSS0_PHY_278_DATA=0x00005656
LOCAL &__DDRSS0_PHY_279_DATA
&__DDRSS0_PHY_279_DATA=0x0000A9A9
LOCAL &__DDRSS0_PHY_280_DATA
&__DDRSS0_PHY_280_DATA=0x0000A9A9
LOCAL &__DDRSS0_PHY_281_DATA
&__DDRSS0_PHY_281_DATA=0x0000B5B5
LOCAL &__DDRSS0_PHY_282_DATA
&__DDRSS0_PHY_282_DATA=0x00000000
LOCAL &__DDRSS0_PHY_283_DATA
&__DDRSS0_PHY_283_DATA=0x00000000
LOCAL &__DDRSS0_PHY_284_DATA
&__DDRSS0_PHY_284_DATA=0x2A000000
LOCAL &__DDRSS0_PHY_285_DATA
&__DDRSS0_PHY_285_DATA=0x00000808
LOCAL &__DDRSS0_PHY_286_DATA
&__DDRSS0_PHY_286_DATA=0x0F000000
LOCAL &__DDRSS0_PHY_287_DATA
&__DDRSS0_PHY_287_DATA=0x00000F0F
LOCAL &__DDRSS0_PHY_288_DATA
&__DDRSS0_PHY_288_DATA=0x10200000
LOCAL &__DDRSS0_PHY_289_DATA
&__DDRSS0_PHY_289_DATA=0x0C002006
LOCAL &__DDRSS0_PHY_290_DATA
&__DDRSS0_PHY_290_DATA=0x00000000
LOCAL &__DDRSS0_PHY_291_DATA
&__DDRSS0_PHY_291_DATA=0x00000000
LOCAL &__DDRSS0_PHY_292_DATA
&__DDRSS0_PHY_292_DATA=0x55555555
LOCAL &__DDRSS0_PHY_293_DATA
&__DDRSS0_PHY_293_DATA=0xAAAAAAAA
LOCAL &__DDRSS0_PHY_294_DATA
&__DDRSS0_PHY_294_DATA=0x55555555
LOCAL &__DDRSS0_PHY_295_DATA
&__DDRSS0_PHY_295_DATA=0xAAAAAAAA
LOCAL &__DDRSS0_PHY_296_DATA
&__DDRSS0_PHY_296_DATA=0x00005555
LOCAL &__DDRSS0_PHY_297_DATA
&__DDRSS0_PHY_297_DATA=0x01000100
LOCAL &__DDRSS0_PHY_298_DATA
&__DDRSS0_PHY_298_DATA=0x00800180
LOCAL &__DDRSS0_PHY_299_DATA
&__DDRSS0_PHY_299_DATA=0x00000000
LOCAL &__DDRSS0_PHY_300_DATA
&__DDRSS0_PHY_300_DATA=0x00000000
LOCAL &__DDRSS0_PHY_301_DATA
&__DDRSS0_PHY_301_DATA=0x00000000
LOCAL &__DDRSS0_PHY_302_DATA
&__DDRSS0_PHY_302_DATA=0x00000000
LOCAL &__DDRSS0_PHY_303_DATA
&__DDRSS0_PHY_303_DATA=0x00000000
LOCAL &__DDRSS0_PHY_304_DATA
&__DDRSS0_PHY_304_DATA=0x00000000
LOCAL &__DDRSS0_PHY_305_DATA
&__DDRSS0_PHY_305_DATA=0x00000000
LOCAL &__DDRSS0_PHY_306_DATA
&__DDRSS0_PHY_306_DATA=0x00000000
LOCAL &__DDRSS0_PHY_307_DATA
&__DDRSS0_PHY_307_DATA=0x00000000
LOCAL &__DDRSS0_PHY_308_DATA
&__DDRSS0_PHY_308_DATA=0x00000000
LOCAL &__DDRSS0_PHY_309_DATA
&__DDRSS0_PHY_309_DATA=0x00000000
LOCAL &__DDRSS0_PHY_310_DATA
&__DDRSS0_PHY_310_DATA=0x00000000
LOCAL &__DDRSS0_PHY_311_DATA
&__DDRSS0_PHY_311_DATA=0x00000000
LOCAL &__DDRSS0_PHY_312_DATA
&__DDRSS0_PHY_312_DATA=0x00000000
LOCAL &__DDRSS0_PHY_313_DATA
&__DDRSS0_PHY_313_DATA=0x00000000
LOCAL &__DDRSS0_PHY_314_DATA
&__DDRSS0_PHY_314_DATA=0x00000000
LOCAL &__DDRSS0_PHY_315_DATA
&__DDRSS0_PHY_315_DATA=0x00000000
LOCAL &__DDRSS0_PHY_316_DATA
&__DDRSS0_PHY_316_DATA=0x00000000
LOCAL &__DDRSS0_PHY_317_DATA
&__DDRSS0_PHY_317_DATA=0x00000000
LOCAL &__DDRSS0_PHY_318_DATA
&__DDRSS0_PHY_318_DATA=0x00000000
LOCAL &__DDRSS0_PHY_319_DATA
&__DDRSS0_PHY_319_DATA=0x00000000
LOCAL &__DDRSS0_PHY_320_DATA
&__DDRSS0_PHY_320_DATA=0x00000000
LOCAL &__DDRSS0_PHY_321_DATA
&__DDRSS0_PHY_321_DATA=0x00000000
LOCAL &__DDRSS0_PHY_322_DATA
&__DDRSS0_PHY_322_DATA=0x00000104
LOCAL &__DDRSS0_PHY_323_DATA
&__DDRSS0_PHY_323_DATA=0x00000120
LOCAL &__DDRSS0_PHY_324_DATA
&__DDRSS0_PHY_324_DATA=0x00000000
LOCAL &__DDRSS0_PHY_325_DATA
&__DDRSS0_PHY_325_DATA=0x00000000
LOCAL &__DDRSS0_PHY_326_DATA
&__DDRSS0_PHY_326_DATA=0x00000000
LOCAL &__DDRSS0_PHY_327_DATA
&__DDRSS0_PHY_327_DATA=0x00000000
LOCAL &__DDRSS0_PHY_328_DATA
&__DDRSS0_PHY_328_DATA=0x00000000
LOCAL &__DDRSS0_PHY_329_DATA
&__DDRSS0_PHY_329_DATA=0x00000000
LOCAL &__DDRSS0_PHY_330_DATA
&__DDRSS0_PHY_330_DATA=0x00000000
LOCAL &__DDRSS0_PHY_331_DATA
&__DDRSS0_PHY_331_DATA=0x00000001
LOCAL &__DDRSS0_PHY_332_DATA
&__DDRSS0_PHY_332_DATA=0x07FF0000
LOCAL &__DDRSS0_PHY_333_DATA
&__DDRSS0_PHY_333_DATA=0x0080081F
LOCAL &__DDRSS0_PHY_334_DATA
&__DDRSS0_PHY_334_DATA=0x00081020
LOCAL &__DDRSS0_PHY_335_DATA
&__DDRSS0_PHY_335_DATA=0x04010000
LOCAL &__DDRSS0_PHY_336_DATA
&__DDRSS0_PHY_336_DATA=0x00000000
LOCAL &__DDRSS0_PHY_337_DATA
&__DDRSS0_PHY_337_DATA=0x00000000
LOCAL &__DDRSS0_PHY_338_DATA
&__DDRSS0_PHY_338_DATA=0x00000000
LOCAL &__DDRSS0_PHY_339_DATA
&__DDRSS0_PHY_339_DATA=0x00000100
LOCAL &__DDRSS0_PHY_340_DATA
&__DDRSS0_PHY_340_DATA=0x01CC0C01
LOCAL &__DDRSS0_PHY_341_DATA
&__DDRSS0_PHY_341_DATA=0x1003CC0C
LOCAL &__DDRSS0_PHY_342_DATA
&__DDRSS0_PHY_342_DATA=0x20000140
LOCAL &__DDRSS0_PHY_343_DATA
&__DDRSS0_PHY_343_DATA=0x07FF0200
LOCAL &__DDRSS0_PHY_344_DATA
&__DDRSS0_PHY_344_DATA=0x0000DD01
LOCAL &__DDRSS0_PHY_345_DATA
&__DDRSS0_PHY_345_DATA=0x10100303
LOCAL &__DDRSS0_PHY_346_DATA
&__DDRSS0_PHY_346_DATA=0x10101010
LOCAL &__DDRSS0_PHY_347_DATA
&__DDRSS0_PHY_347_DATA=0x10101010
LOCAL &__DDRSS0_PHY_348_DATA
&__DDRSS0_PHY_348_DATA=0x00011010
LOCAL &__DDRSS0_PHY_349_DATA
&__DDRSS0_PHY_349_DATA=0x00100010
LOCAL &__DDRSS0_PHY_350_DATA
&__DDRSS0_PHY_350_DATA=0x00100010
LOCAL &__DDRSS0_PHY_351_DATA
&__DDRSS0_PHY_351_DATA=0x00100010
LOCAL &__DDRSS0_PHY_352_DATA
&__DDRSS0_PHY_352_DATA=0x00100010
LOCAL &__DDRSS0_PHY_353_DATA
&__DDRSS0_PHY_353_DATA=0x00050010
LOCAL &__DDRSS0_PHY_354_DATA
&__DDRSS0_PHY_354_DATA=0x51517041
LOCAL &__DDRSS0_PHY_355_DATA
&__DDRSS0_PHY_355_DATA=0x31C06000
LOCAL &__DDRSS0_PHY_356_DATA
&__DDRSS0_PHY_356_DATA=0x07AB0340
LOCAL &__DDRSS0_PHY_357_DATA
&__DDRSS0_PHY_357_DATA=0x00C0C001
LOCAL &__DDRSS0_PHY_358_DATA
&__DDRSS0_PHY_358_DATA=0x07060001
LOCAL &__DDRSS0_PHY_359_DATA
&__DDRSS0_PHY_359_DATA=0x10001000
LOCAL &__DDRSS0_PHY_360_DATA
&__DDRSS0_PHY_360_DATA=0x0C063E42
LOCAL &__DDRSS0_PHY_361_DATA
&__DDRSS0_PHY_361_DATA=0x0F0C2201
LOCAL &__DDRSS0_PHY_362_DATA
&__DDRSS0_PHY_362_DATA=0x01000140
LOCAL &__DDRSS0_PHY_363_DATA
&__DDRSS0_PHY_363_DATA=0x0C000420
LOCAL &__DDRSS0_PHY_364_DATA
&__DDRSS0_PHY_364_DATA=0x00000198
LOCAL &__DDRSS0_PHY_365_DATA
&__DDRSS0_PHY_365_DATA=0x0A0000D0
LOCAL &__DDRSS0_PHY_366_DATA
&__DDRSS0_PHY_366_DATA=0x00030200
LOCAL &__DDRSS0_PHY_367_DATA
&__DDRSS0_PHY_367_DATA=0x02800000
LOCAL &__DDRSS0_PHY_368_DATA
&__DDRSS0_PHY_368_DATA=0x80800000
LOCAL &__DDRSS0_PHY_369_DATA
&__DDRSS0_PHY_369_DATA=0x00072010
LOCAL &__DDRSS0_PHY_370_DATA
&__DDRSS0_PHY_370_DATA=0x76543210
LOCAL &__DDRSS0_PHY_371_DATA
&__DDRSS0_PHY_371_DATA=0x00000008
LOCAL &__DDRSS0_PHY_372_DATA
&__DDRSS0_PHY_372_DATA=0x02800280
LOCAL &__DDRSS0_PHY_373_DATA
&__DDRSS0_PHY_373_DATA=0x02800280
LOCAL &__DDRSS0_PHY_374_DATA
&__DDRSS0_PHY_374_DATA=0x02800280
LOCAL &__DDRSS0_PHY_375_DATA
&__DDRSS0_PHY_375_DATA=0x02800280
LOCAL &__DDRSS0_PHY_376_DATA
&__DDRSS0_PHY_376_DATA=0x00000280
LOCAL &__DDRSS0_PHY_377_DATA
&__DDRSS0_PHY_377_DATA=0x0000A000
LOCAL &__DDRSS0_PHY_378_DATA
&__DDRSS0_PHY_378_DATA=0x00A000A0
LOCAL &__DDRSS0_PHY_379_DATA
&__DDRSS0_PHY_379_DATA=0x00A000A0
LOCAL &__DDRSS0_PHY_380_DATA
&__DDRSS0_PHY_380_DATA=0x00A000A0
LOCAL &__DDRSS0_PHY_381_DATA
&__DDRSS0_PHY_381_DATA=0x00A000A0
LOCAL &__DDRSS0_PHY_382_DATA
&__DDRSS0_PHY_382_DATA=0x00A000A0
LOCAL &__DDRSS0_PHY_383_DATA
&__DDRSS0_PHY_383_DATA=0x00A000A0
LOCAL &__DDRSS0_PHY_384_DATA
&__DDRSS0_PHY_384_DATA=0x00A000A0
LOCAL &__DDRSS0_PHY_385_DATA
&__DDRSS0_PHY_385_DATA=0x00A000A0
LOCAL &__DDRSS0_PHY_386_DATA
&__DDRSS0_PHY_386_DATA=0x006E00A0
LOCAL &__DDRSS0_PHY_387_DATA
&__DDRSS0_PHY_387_DATA=0x01A00003
LOCAL &__DDRSS0_PHY_388_DATA
&__DDRSS0_PHY_388_DATA=0x00000000
LOCAL &__DDRSS0_PHY_389_DATA
&__DDRSS0_PHY_389_DATA=0x00000000
LOCAL &__DDRSS0_PHY_390_DATA
&__DDRSS0_PHY_390_DATA=0x00080200
LOCAL &__DDRSS0_PHY_391_DATA
&__DDRSS0_PHY_391_DATA=0x00000000
LOCAL &__DDRSS0_PHY_392_DATA
&__DDRSS0_PHY_392_DATA=0x20202000
LOCAL &__DDRSS0_PHY_393_DATA
&__DDRSS0_PHY_393_DATA=0x20202020
LOCAL &__DDRSS0_PHY_394_DATA
&__DDRSS0_PHY_394_DATA=0xF0F02020
LOCAL &__DDRSS0_PHY_395_DATA
&__DDRSS0_PHY_395_DATA=0x00000000
LOCAL &__DDRSS0_PHY_396_DATA
&__DDRSS0_PHY_396_DATA=0x00000000
LOCAL &__DDRSS0_PHY_397_DATA
&__DDRSS0_PHY_397_DATA=0x00000000
LOCAL &__DDRSS0_PHY_398_DATA
&__DDRSS0_PHY_398_DATA=0x00000000
LOCAL &__DDRSS0_PHY_399_DATA
&__DDRSS0_PHY_399_DATA=0x00000000
LOCAL &__DDRSS0_PHY_400_DATA
&__DDRSS0_PHY_400_DATA=0x00000000
LOCAL &__DDRSS0_PHY_401_DATA
&__DDRSS0_PHY_401_DATA=0x00000000
LOCAL &__DDRSS0_PHY_402_DATA
&__DDRSS0_PHY_402_DATA=0x00000000
LOCAL &__DDRSS0_PHY_403_DATA
&__DDRSS0_PHY_403_DATA=0x00000000
LOCAL &__DDRSS0_PHY_404_DATA
&__DDRSS0_PHY_404_DATA=0x00000000
LOCAL &__DDRSS0_PHY_405_DATA
&__DDRSS0_PHY_405_DATA=0x00000000
LOCAL &__DDRSS0_PHY_406_DATA
&__DDRSS0_PHY_406_DATA=0x00000000
LOCAL &__DDRSS0_PHY_407_DATA
&__DDRSS0_PHY_407_DATA=0x00000000
LOCAL &__DDRSS0_PHY_408_DATA
&__DDRSS0_PHY_408_DATA=0x00000000
LOCAL &__DDRSS0_PHY_409_DATA
&__DDRSS0_PHY_409_DATA=0x00000000
LOCAL &__DDRSS0_PHY_410_DATA
&__DDRSS0_PHY_410_DATA=0x00000000
LOCAL &__DDRSS0_PHY_411_DATA
&__DDRSS0_PHY_411_DATA=0x00000000
LOCAL &__DDRSS0_PHY_412_DATA
&__DDRSS0_PHY_412_DATA=0x00000000
LOCAL &__DDRSS0_PHY_413_DATA
&__DDRSS0_PHY_413_DATA=0x00000000
LOCAL &__DDRSS0_PHY_414_DATA
&__DDRSS0_PHY_414_DATA=0x00000000
LOCAL &__DDRSS0_PHY_415_DATA
&__DDRSS0_PHY_415_DATA=0x00000000
LOCAL &__DDRSS0_PHY_416_DATA
&__DDRSS0_PHY_416_DATA=0x00000000
LOCAL &__DDRSS0_PHY_417_DATA
&__DDRSS0_PHY_417_DATA=0x00000000
LOCAL &__DDRSS0_PHY_418_DATA
&__DDRSS0_PHY_418_DATA=0x00000000
LOCAL &__DDRSS0_PHY_419_DATA
&__DDRSS0_PHY_419_DATA=0x00000000
LOCAL &__DDRSS0_PHY_420_DATA
&__DDRSS0_PHY_420_DATA=0x00000000
LOCAL &__DDRSS0_PHY_421_DATA
&__DDRSS0_PHY_421_DATA=0x00000000
LOCAL &__DDRSS0_PHY_422_DATA
&__DDRSS0_PHY_422_DATA=0x00000000
LOCAL &__DDRSS0_PHY_423_DATA
&__DDRSS0_PHY_423_DATA=0x00000000
LOCAL &__DDRSS0_PHY_424_DATA
&__DDRSS0_PHY_424_DATA=0x00000000
LOCAL &__DDRSS0_PHY_425_DATA
&__DDRSS0_PHY_425_DATA=0x00000000
LOCAL &__DDRSS0_PHY_426_DATA
&__DDRSS0_PHY_426_DATA=0x00000000
LOCAL &__DDRSS0_PHY_427_DATA
&__DDRSS0_PHY_427_DATA=0x00000000
LOCAL &__DDRSS0_PHY_428_DATA
&__DDRSS0_PHY_428_DATA=0x00000000
LOCAL &__DDRSS0_PHY_429_DATA
&__DDRSS0_PHY_429_DATA=0x00000000
LOCAL &__DDRSS0_PHY_430_DATA
&__DDRSS0_PHY_430_DATA=0x00000000
LOCAL &__DDRSS0_PHY_431_DATA
&__DDRSS0_PHY_431_DATA=0x00000000
LOCAL &__DDRSS0_PHY_432_DATA
&__DDRSS0_PHY_432_DATA=0x00000000
LOCAL &__DDRSS0_PHY_433_DATA
&__DDRSS0_PHY_433_DATA=0x00000000
LOCAL &__DDRSS0_PHY_434_DATA
&__DDRSS0_PHY_434_DATA=0x00000000
LOCAL &__DDRSS0_PHY_435_DATA
&__DDRSS0_PHY_435_DATA=0x00000000
LOCAL &__DDRSS0_PHY_436_DATA
&__DDRSS0_PHY_436_DATA=0x00000000
LOCAL &__DDRSS0_PHY_437_DATA
&__DDRSS0_PHY_437_DATA=0x00000000
LOCAL &__DDRSS0_PHY_438_DATA
&__DDRSS0_PHY_438_DATA=0x00000000
LOCAL &__DDRSS0_PHY_439_DATA
&__DDRSS0_PHY_439_DATA=0x00000000
LOCAL &__DDRSS0_PHY_440_DATA
&__DDRSS0_PHY_440_DATA=0x00000000
LOCAL &__DDRSS0_PHY_441_DATA
&__DDRSS0_PHY_441_DATA=0x00000000
LOCAL &__DDRSS0_PHY_442_DATA
&__DDRSS0_PHY_442_DATA=0x00000000
LOCAL &__DDRSS0_PHY_443_DATA
&__DDRSS0_PHY_443_DATA=0x00000000
LOCAL &__DDRSS0_PHY_444_DATA
&__DDRSS0_PHY_444_DATA=0x00000000
LOCAL &__DDRSS0_PHY_445_DATA
&__DDRSS0_PHY_445_DATA=0x00000000
LOCAL &__DDRSS0_PHY_446_DATA
&__DDRSS0_PHY_446_DATA=0x00000000
LOCAL &__DDRSS0_PHY_447_DATA
&__DDRSS0_PHY_447_DATA=0x00000000
LOCAL &__DDRSS0_PHY_448_DATA
&__DDRSS0_PHY_448_DATA=0x00000000
LOCAL &__DDRSS0_PHY_449_DATA
&__DDRSS0_PHY_449_DATA=0x00000000
LOCAL &__DDRSS0_PHY_450_DATA
&__DDRSS0_PHY_450_DATA=0x00000000
LOCAL &__DDRSS0_PHY_451_DATA
&__DDRSS0_PHY_451_DATA=0x00000000
LOCAL &__DDRSS0_PHY_452_DATA
&__DDRSS0_PHY_452_DATA=0x00000000
LOCAL &__DDRSS0_PHY_453_DATA
&__DDRSS0_PHY_453_DATA=0x00000000
LOCAL &__DDRSS0_PHY_454_DATA
&__DDRSS0_PHY_454_DATA=0x00000000
LOCAL &__DDRSS0_PHY_455_DATA
&__DDRSS0_PHY_455_DATA=0x00000000
LOCAL &__DDRSS0_PHY_456_DATA
&__DDRSS0_PHY_456_DATA=0x00000000
LOCAL &__DDRSS0_PHY_457_DATA
&__DDRSS0_PHY_457_DATA=0x00000000
LOCAL &__DDRSS0_PHY_458_DATA
&__DDRSS0_PHY_458_DATA=0x00000000
LOCAL &__DDRSS0_PHY_459_DATA
&__DDRSS0_PHY_459_DATA=0x00000000
LOCAL &__DDRSS0_PHY_460_DATA
&__DDRSS0_PHY_460_DATA=0x00000000
LOCAL &__DDRSS0_PHY_461_DATA
&__DDRSS0_PHY_461_DATA=0x00000000
LOCAL &__DDRSS0_PHY_462_DATA
&__DDRSS0_PHY_462_DATA=0x00000000
LOCAL &__DDRSS0_PHY_463_DATA
&__DDRSS0_PHY_463_DATA=0x00000000
LOCAL &__DDRSS0_PHY_464_DATA
&__DDRSS0_PHY_464_DATA=0x00000000
LOCAL &__DDRSS0_PHY_465_DATA
&__DDRSS0_PHY_465_DATA=0x00000000
LOCAL &__DDRSS0_PHY_466_DATA
&__DDRSS0_PHY_466_DATA=0x00000000
LOCAL &__DDRSS0_PHY_467_DATA
&__DDRSS0_PHY_467_DATA=0x00000000
LOCAL &__DDRSS0_PHY_468_DATA
&__DDRSS0_PHY_468_DATA=0x00000000
LOCAL &__DDRSS0_PHY_469_DATA
&__DDRSS0_PHY_469_DATA=0x00000000
LOCAL &__DDRSS0_PHY_470_DATA
&__DDRSS0_PHY_470_DATA=0x00000000
LOCAL &__DDRSS0_PHY_471_DATA
&__DDRSS0_PHY_471_DATA=0x00000000
LOCAL &__DDRSS0_PHY_472_DATA
&__DDRSS0_PHY_472_DATA=0x00000000
LOCAL &__DDRSS0_PHY_473_DATA
&__DDRSS0_PHY_473_DATA=0x00000000
LOCAL &__DDRSS0_PHY_474_DATA
&__DDRSS0_PHY_474_DATA=0x00000000
LOCAL &__DDRSS0_PHY_475_DATA
&__DDRSS0_PHY_475_DATA=0x00000000
LOCAL &__DDRSS0_PHY_476_DATA
&__DDRSS0_PHY_476_DATA=0x00000000
LOCAL &__DDRSS0_PHY_477_DATA
&__DDRSS0_PHY_477_DATA=0x00000000
LOCAL &__DDRSS0_PHY_478_DATA
&__DDRSS0_PHY_478_DATA=0x00000000
LOCAL &__DDRSS0_PHY_479_DATA
&__DDRSS0_PHY_479_DATA=0x00000000
LOCAL &__DDRSS0_PHY_480_DATA
&__DDRSS0_PHY_480_DATA=0x00000000
LOCAL &__DDRSS0_PHY_481_DATA
&__DDRSS0_PHY_481_DATA=0x00000000
LOCAL &__DDRSS0_PHY_482_DATA
&__DDRSS0_PHY_482_DATA=0x00000000
LOCAL &__DDRSS0_PHY_483_DATA
&__DDRSS0_PHY_483_DATA=0x00000000
LOCAL &__DDRSS0_PHY_484_DATA
&__DDRSS0_PHY_484_DATA=0x00000000
LOCAL &__DDRSS0_PHY_485_DATA
&__DDRSS0_PHY_485_DATA=0x00000000
LOCAL &__DDRSS0_PHY_486_DATA
&__DDRSS0_PHY_486_DATA=0x00000000
LOCAL &__DDRSS0_PHY_487_DATA
&__DDRSS0_PHY_487_DATA=0x00000000
LOCAL &__DDRSS0_PHY_488_DATA
&__DDRSS0_PHY_488_DATA=0x00000000
LOCAL &__DDRSS0_PHY_489_DATA
&__DDRSS0_PHY_489_DATA=0x00000000
LOCAL &__DDRSS0_PHY_490_DATA
&__DDRSS0_PHY_490_DATA=0x00000000
LOCAL &__DDRSS0_PHY_491_DATA
&__DDRSS0_PHY_491_DATA=0x00000000
LOCAL &__DDRSS0_PHY_492_DATA
&__DDRSS0_PHY_492_DATA=0x00000000
LOCAL &__DDRSS0_PHY_493_DATA
&__DDRSS0_PHY_493_DATA=0x00000000
LOCAL &__DDRSS0_PHY_494_DATA
&__DDRSS0_PHY_494_DATA=0x00000000
LOCAL &__DDRSS0_PHY_495_DATA
&__DDRSS0_PHY_495_DATA=0x00000000
LOCAL &__DDRSS0_PHY_496_DATA
&__DDRSS0_PHY_496_DATA=0x00000000
LOCAL &__DDRSS0_PHY_497_DATA
&__DDRSS0_PHY_497_DATA=0x00000000
LOCAL &__DDRSS0_PHY_498_DATA
&__DDRSS0_PHY_498_DATA=0x00000000
LOCAL &__DDRSS0_PHY_499_DATA
&__DDRSS0_PHY_499_DATA=0x00000000
LOCAL &__DDRSS0_PHY_500_DATA
&__DDRSS0_PHY_500_DATA=0x00000000
LOCAL &__DDRSS0_PHY_501_DATA
&__DDRSS0_PHY_501_DATA=0x00000000
LOCAL &__DDRSS0_PHY_502_DATA
&__DDRSS0_PHY_502_DATA=0x00000000
LOCAL &__DDRSS0_PHY_503_DATA
&__DDRSS0_PHY_503_DATA=0x00000000
LOCAL &__DDRSS0_PHY_504_DATA
&__DDRSS0_PHY_504_DATA=0x00000000
LOCAL &__DDRSS0_PHY_505_DATA
&__DDRSS0_PHY_505_DATA=0x00000000
LOCAL &__DDRSS0_PHY_506_DATA
&__DDRSS0_PHY_506_DATA=0x00000000
LOCAL &__DDRSS0_PHY_507_DATA
&__DDRSS0_PHY_507_DATA=0x00000000
LOCAL &__DDRSS0_PHY_508_DATA
&__DDRSS0_PHY_508_DATA=0x00000000
LOCAL &__DDRSS0_PHY_509_DATA
&__DDRSS0_PHY_509_DATA=0x00000000
LOCAL &__DDRSS0_PHY_510_DATA
&__DDRSS0_PHY_510_DATA=0x00000000
LOCAL &__DDRSS0_PHY_511_DATA
&__DDRSS0_PHY_511_DATA=0x00000000
LOCAL &__DDRSS0_PHY_512_DATA
&__DDRSS0_PHY_512_DATA=0x000004F0
LOCAL &__DDRSS0_PHY_513_DATA
&__DDRSS0_PHY_513_DATA=0x00000000
LOCAL &__DDRSS0_PHY_514_DATA
&__DDRSS0_PHY_514_DATA=0x00030200
LOCAL &__DDRSS0_PHY_515_DATA
&__DDRSS0_PHY_515_DATA=0x00000000
LOCAL &__DDRSS0_PHY_516_DATA
&__DDRSS0_PHY_516_DATA=0x00000000
LOCAL &__DDRSS0_PHY_517_DATA
&__DDRSS0_PHY_517_DATA=0x01030000
LOCAL &__DDRSS0_PHY_518_DATA
&__DDRSS0_PHY_518_DATA=0x00010000
LOCAL &__DDRSS0_PHY_519_DATA
&__DDRSS0_PHY_519_DATA=0x01030004
LOCAL &__DDRSS0_PHY_520_DATA
&__DDRSS0_PHY_520_DATA=0x01000000
LOCAL &__DDRSS0_PHY_521_DATA
&__DDRSS0_PHY_521_DATA=0x00000000
LOCAL &__DDRSS0_PHY_522_DATA
&__DDRSS0_PHY_522_DATA=0x00000000
LOCAL &__DDRSS0_PHY_523_DATA
&__DDRSS0_PHY_523_DATA=0x01000001
LOCAL &__DDRSS0_PHY_524_DATA
&__DDRSS0_PHY_524_DATA=0x00000100
LOCAL &__DDRSS0_PHY_525_DATA
&__DDRSS0_PHY_525_DATA=0x000800C0
LOCAL &__DDRSS0_PHY_526_DATA
&__DDRSS0_PHY_526_DATA=0x060100CC
LOCAL &__DDRSS0_PHY_527_DATA
&__DDRSS0_PHY_527_DATA=0x00030066
LOCAL &__DDRSS0_PHY_528_DATA
&__DDRSS0_PHY_528_DATA=0x00000000
LOCAL &__DDRSS0_PHY_529_DATA
&__DDRSS0_PHY_529_DATA=0x00000301
LOCAL &__DDRSS0_PHY_530_DATA
&__DDRSS0_PHY_530_DATA=0x0000AAAA
LOCAL &__DDRSS0_PHY_531_DATA
&__DDRSS0_PHY_531_DATA=0x00005555
LOCAL &__DDRSS0_PHY_532_DATA
&__DDRSS0_PHY_532_DATA=0x0000B5B5
LOCAL &__DDRSS0_PHY_533_DATA
&__DDRSS0_PHY_533_DATA=0x00004A4A
LOCAL &__DDRSS0_PHY_534_DATA
&__DDRSS0_PHY_534_DATA=0x00005656
LOCAL &__DDRSS0_PHY_535_DATA
&__DDRSS0_PHY_535_DATA=0x0000A9A9
LOCAL &__DDRSS0_PHY_536_DATA
&__DDRSS0_PHY_536_DATA=0x0000A9A9
LOCAL &__DDRSS0_PHY_537_DATA
&__DDRSS0_PHY_537_DATA=0x0000B5B5
LOCAL &__DDRSS0_PHY_538_DATA
&__DDRSS0_PHY_538_DATA=0x00000000
LOCAL &__DDRSS0_PHY_539_DATA
&__DDRSS0_PHY_539_DATA=0x00000000
LOCAL &__DDRSS0_PHY_540_DATA
&__DDRSS0_PHY_540_DATA=0x2A000000
LOCAL &__DDRSS0_PHY_541_DATA
&__DDRSS0_PHY_541_DATA=0x00000808
LOCAL &__DDRSS0_PHY_542_DATA
&__DDRSS0_PHY_542_DATA=0x0F000000
LOCAL &__DDRSS0_PHY_543_DATA
&__DDRSS0_PHY_543_DATA=0x00000F0F
LOCAL &__DDRSS0_PHY_544_DATA
&__DDRSS0_PHY_544_DATA=0x10200000
LOCAL &__DDRSS0_PHY_545_DATA
&__DDRSS0_PHY_545_DATA=0x0C002006
LOCAL &__DDRSS0_PHY_546_DATA
&__DDRSS0_PHY_546_DATA=0x00000000
LOCAL &__DDRSS0_PHY_547_DATA
&__DDRSS0_PHY_547_DATA=0x00000000
LOCAL &__DDRSS0_PHY_548_DATA
&__DDRSS0_PHY_548_DATA=0x55555555
LOCAL &__DDRSS0_PHY_549_DATA
&__DDRSS0_PHY_549_DATA=0xAAAAAAAA
LOCAL &__DDRSS0_PHY_550_DATA
&__DDRSS0_PHY_550_DATA=0x55555555
LOCAL &__DDRSS0_PHY_551_DATA
&__DDRSS0_PHY_551_DATA=0xAAAAAAAA
LOCAL &__DDRSS0_PHY_552_DATA
&__DDRSS0_PHY_552_DATA=0x00005555
LOCAL &__DDRSS0_PHY_553_DATA
&__DDRSS0_PHY_553_DATA=0x01000100
LOCAL &__DDRSS0_PHY_554_DATA
&__DDRSS0_PHY_554_DATA=0x00800180
LOCAL &__DDRSS0_PHY_555_DATA
&__DDRSS0_PHY_555_DATA=0x00000001
LOCAL &__DDRSS0_PHY_556_DATA
&__DDRSS0_PHY_556_DATA=0x00000000
LOCAL &__DDRSS0_PHY_557_DATA
&__DDRSS0_PHY_557_DATA=0x00000000
LOCAL &__DDRSS0_PHY_558_DATA
&__DDRSS0_PHY_558_DATA=0x00000000
LOCAL &__DDRSS0_PHY_559_DATA
&__DDRSS0_PHY_559_DATA=0x00000000
LOCAL &__DDRSS0_PHY_560_DATA
&__DDRSS0_PHY_560_DATA=0x00000000
LOCAL &__DDRSS0_PHY_561_DATA
&__DDRSS0_PHY_561_DATA=0x00000000
LOCAL &__DDRSS0_PHY_562_DATA
&__DDRSS0_PHY_562_DATA=0x00000000
LOCAL &__DDRSS0_PHY_563_DATA
&__DDRSS0_PHY_563_DATA=0x00000000
LOCAL &__DDRSS0_PHY_564_DATA
&__DDRSS0_PHY_564_DATA=0x00000000
LOCAL &__DDRSS0_PHY_565_DATA
&__DDRSS0_PHY_565_DATA=0x00000000
LOCAL &__DDRSS0_PHY_566_DATA
&__DDRSS0_PHY_566_DATA=0x00000000
LOCAL &__DDRSS0_PHY_567_DATA
&__DDRSS0_PHY_567_DATA=0x00000000
LOCAL &__DDRSS0_PHY_568_DATA
&__DDRSS0_PHY_568_DATA=0x00000000
LOCAL &__DDRSS0_PHY_569_DATA
&__DDRSS0_PHY_569_DATA=0x00000000
LOCAL &__DDRSS0_PHY_570_DATA
&__DDRSS0_PHY_570_DATA=0x00000000
LOCAL &__DDRSS0_PHY_571_DATA
&__DDRSS0_PHY_571_DATA=0x00000000
LOCAL &__DDRSS0_PHY_572_DATA
&__DDRSS0_PHY_572_DATA=0x00000000
LOCAL &__DDRSS0_PHY_573_DATA
&__DDRSS0_PHY_573_DATA=0x00000000
LOCAL &__DDRSS0_PHY_574_DATA
&__DDRSS0_PHY_574_DATA=0x00000000
LOCAL &__DDRSS0_PHY_575_DATA
&__DDRSS0_PHY_575_DATA=0x00000000
LOCAL &__DDRSS0_PHY_576_DATA
&__DDRSS0_PHY_576_DATA=0x00000000
LOCAL &__DDRSS0_PHY_577_DATA
&__DDRSS0_PHY_577_DATA=0x00000000
LOCAL &__DDRSS0_PHY_578_DATA
&__DDRSS0_PHY_578_DATA=0x00000104
LOCAL &__DDRSS0_PHY_579_DATA
&__DDRSS0_PHY_579_DATA=0x00000120
LOCAL &__DDRSS0_PHY_580_DATA
&__DDRSS0_PHY_580_DATA=0x00000000
LOCAL &__DDRSS0_PHY_581_DATA
&__DDRSS0_PHY_581_DATA=0x00000000
LOCAL &__DDRSS0_PHY_582_DATA
&__DDRSS0_PHY_582_DATA=0x00000000
LOCAL &__DDRSS0_PHY_583_DATA
&__DDRSS0_PHY_583_DATA=0x00000000
LOCAL &__DDRSS0_PHY_584_DATA
&__DDRSS0_PHY_584_DATA=0x00000000
LOCAL &__DDRSS0_PHY_585_DATA
&__DDRSS0_PHY_585_DATA=0x00000000
LOCAL &__DDRSS0_PHY_586_DATA
&__DDRSS0_PHY_586_DATA=0x00000000
LOCAL &__DDRSS0_PHY_587_DATA
&__DDRSS0_PHY_587_DATA=0x00000001
LOCAL &__DDRSS0_PHY_588_DATA
&__DDRSS0_PHY_588_DATA=0x07FF0000
LOCAL &__DDRSS0_PHY_589_DATA
&__DDRSS0_PHY_589_DATA=0x0080081F
LOCAL &__DDRSS0_PHY_590_DATA
&__DDRSS0_PHY_590_DATA=0x00081020
LOCAL &__DDRSS0_PHY_591_DATA
&__DDRSS0_PHY_591_DATA=0x04010000
LOCAL &__DDRSS0_PHY_592_DATA
&__DDRSS0_PHY_592_DATA=0x00000000
LOCAL &__DDRSS0_PHY_593_DATA
&__DDRSS0_PHY_593_DATA=0x00000000
LOCAL &__DDRSS0_PHY_594_DATA
&__DDRSS0_PHY_594_DATA=0x00000000
LOCAL &__DDRSS0_PHY_595_DATA
&__DDRSS0_PHY_595_DATA=0x00000100
LOCAL &__DDRSS0_PHY_596_DATA
&__DDRSS0_PHY_596_DATA=0x01CC0C01
LOCAL &__DDRSS0_PHY_597_DATA
&__DDRSS0_PHY_597_DATA=0x1003CC0C
LOCAL &__DDRSS0_PHY_598_DATA
&__DDRSS0_PHY_598_DATA=0x20000140
LOCAL &__DDRSS0_PHY_599_DATA
&__DDRSS0_PHY_599_DATA=0x07FF0200
LOCAL &__DDRSS0_PHY_600_DATA
&__DDRSS0_PHY_600_DATA=0x0000DD01
LOCAL &__DDRSS0_PHY_601_DATA
&__DDRSS0_PHY_601_DATA=0x10100303
LOCAL &__DDRSS0_PHY_602_DATA
&__DDRSS0_PHY_602_DATA=0x10101010
LOCAL &__DDRSS0_PHY_603_DATA
&__DDRSS0_PHY_603_DATA=0x10101010
LOCAL &__DDRSS0_PHY_604_DATA
&__DDRSS0_PHY_604_DATA=0x00011010
LOCAL &__DDRSS0_PHY_605_DATA
&__DDRSS0_PHY_605_DATA=0x00100010
LOCAL &__DDRSS0_PHY_606_DATA
&__DDRSS0_PHY_606_DATA=0x00100010
LOCAL &__DDRSS0_PHY_607_DATA
&__DDRSS0_PHY_607_DATA=0x00100010
LOCAL &__DDRSS0_PHY_608_DATA
&__DDRSS0_PHY_608_DATA=0x00100010
LOCAL &__DDRSS0_PHY_609_DATA
&__DDRSS0_PHY_609_DATA=0x00050010
LOCAL &__DDRSS0_PHY_610_DATA
&__DDRSS0_PHY_610_DATA=0x51517041
LOCAL &__DDRSS0_PHY_611_DATA
&__DDRSS0_PHY_611_DATA=0x31C06000
LOCAL &__DDRSS0_PHY_612_DATA
&__DDRSS0_PHY_612_DATA=0x07AB0340
LOCAL &__DDRSS0_PHY_613_DATA
&__DDRSS0_PHY_613_DATA=0x00C0C001
LOCAL &__DDRSS0_PHY_614_DATA
&__DDRSS0_PHY_614_DATA=0x07060001
LOCAL &__DDRSS0_PHY_615_DATA
&__DDRSS0_PHY_615_DATA=0x10001000
LOCAL &__DDRSS0_PHY_616_DATA
&__DDRSS0_PHY_616_DATA=0x0C063E42
LOCAL &__DDRSS0_PHY_617_DATA
&__DDRSS0_PHY_617_DATA=0x0F0C2201
LOCAL &__DDRSS0_PHY_618_DATA
&__DDRSS0_PHY_618_DATA=0x01000140
LOCAL &__DDRSS0_PHY_619_DATA
&__DDRSS0_PHY_619_DATA=0x0C000420
LOCAL &__DDRSS0_PHY_620_DATA
&__DDRSS0_PHY_620_DATA=0x00000198
LOCAL &__DDRSS0_PHY_621_DATA
&__DDRSS0_PHY_621_DATA=0x0A0000D0
LOCAL &__DDRSS0_PHY_622_DATA
&__DDRSS0_PHY_622_DATA=0x00030200
LOCAL &__DDRSS0_PHY_623_DATA
&__DDRSS0_PHY_623_DATA=0x02800000
LOCAL &__DDRSS0_PHY_624_DATA
&__DDRSS0_PHY_624_DATA=0x80800000
LOCAL &__DDRSS0_PHY_625_DATA
&__DDRSS0_PHY_625_DATA=0x00072010
LOCAL &__DDRSS0_PHY_626_DATA
&__DDRSS0_PHY_626_DATA=0x76543210
LOCAL &__DDRSS0_PHY_627_DATA
&__DDRSS0_PHY_627_DATA=0x00000008
LOCAL &__DDRSS0_PHY_628_DATA
&__DDRSS0_PHY_628_DATA=0x02800280
LOCAL &__DDRSS0_PHY_629_DATA
&__DDRSS0_PHY_629_DATA=0x02800280
LOCAL &__DDRSS0_PHY_630_DATA
&__DDRSS0_PHY_630_DATA=0x02800280
LOCAL &__DDRSS0_PHY_631_DATA
&__DDRSS0_PHY_631_DATA=0x02800280
LOCAL &__DDRSS0_PHY_632_DATA
&__DDRSS0_PHY_632_DATA=0x00000280
LOCAL &__DDRSS0_PHY_633_DATA
&__DDRSS0_PHY_633_DATA=0x0000A000
LOCAL &__DDRSS0_PHY_634_DATA
&__DDRSS0_PHY_634_DATA=0x00A000A0
LOCAL &__DDRSS0_PHY_635_DATA
&__DDRSS0_PHY_635_DATA=0x00A000A0
LOCAL &__DDRSS0_PHY_636_DATA
&__DDRSS0_PHY_636_DATA=0x00A000A0
LOCAL &__DDRSS0_PHY_637_DATA
&__DDRSS0_PHY_637_DATA=0x00A000A0
LOCAL &__DDRSS0_PHY_638_DATA
&__DDRSS0_PHY_638_DATA=0x00A000A0
LOCAL &__DDRSS0_PHY_639_DATA
&__DDRSS0_PHY_639_DATA=0x00A000A0
LOCAL &__DDRSS0_PHY_640_DATA
&__DDRSS0_PHY_640_DATA=0x00A000A0
LOCAL &__DDRSS0_PHY_641_DATA
&__DDRSS0_PHY_641_DATA=0x00A000A0
LOCAL &__DDRSS0_PHY_642_DATA
&__DDRSS0_PHY_642_DATA=0x006E00A0
LOCAL &__DDRSS0_PHY_643_DATA
&__DDRSS0_PHY_643_DATA=0x01A00003
LOCAL &__DDRSS0_PHY_644_DATA
&__DDRSS0_PHY_644_DATA=0x00000000
LOCAL &__DDRSS0_PHY_645_DATA
&__DDRSS0_PHY_645_DATA=0x00000000
LOCAL &__DDRSS0_PHY_646_DATA
&__DDRSS0_PHY_646_DATA=0x00080200
LOCAL &__DDRSS0_PHY_647_DATA
&__DDRSS0_PHY_647_DATA=0x00000000
LOCAL &__DDRSS0_PHY_648_DATA
&__DDRSS0_PHY_648_DATA=0x20202000
LOCAL &__DDRSS0_PHY_649_DATA
&__DDRSS0_PHY_649_DATA=0x20202020
LOCAL &__DDRSS0_PHY_650_DATA
&__DDRSS0_PHY_650_DATA=0xF0F02020
LOCAL &__DDRSS0_PHY_651_DATA
&__DDRSS0_PHY_651_DATA=0x00000000
LOCAL &__DDRSS0_PHY_652_DATA
&__DDRSS0_PHY_652_DATA=0x00000000
LOCAL &__DDRSS0_PHY_653_DATA
&__DDRSS0_PHY_653_DATA=0x00000000
LOCAL &__DDRSS0_PHY_654_DATA
&__DDRSS0_PHY_654_DATA=0x00000000
LOCAL &__DDRSS0_PHY_655_DATA
&__DDRSS0_PHY_655_DATA=0x00000000
LOCAL &__DDRSS0_PHY_656_DATA
&__DDRSS0_PHY_656_DATA=0x00000000
LOCAL &__DDRSS0_PHY_657_DATA
&__DDRSS0_PHY_657_DATA=0x00000000
LOCAL &__DDRSS0_PHY_658_DATA
&__DDRSS0_PHY_658_DATA=0x00000000
LOCAL &__DDRSS0_PHY_659_DATA
&__DDRSS0_PHY_659_DATA=0x00000000
LOCAL &__DDRSS0_PHY_660_DATA
&__DDRSS0_PHY_660_DATA=0x00000000
LOCAL &__DDRSS0_PHY_661_DATA
&__DDRSS0_PHY_661_DATA=0x00000000
LOCAL &__DDRSS0_PHY_662_DATA
&__DDRSS0_PHY_662_DATA=0x00000000
LOCAL &__DDRSS0_PHY_663_DATA
&__DDRSS0_PHY_663_DATA=0x00000000
LOCAL &__DDRSS0_PHY_664_DATA
&__DDRSS0_PHY_664_DATA=0x00000000
LOCAL &__DDRSS0_PHY_665_DATA
&__DDRSS0_PHY_665_DATA=0x00000000
LOCAL &__DDRSS0_PHY_666_DATA
&__DDRSS0_PHY_666_DATA=0x00000000
LOCAL &__DDRSS0_PHY_667_DATA
&__DDRSS0_PHY_667_DATA=0x00000000
LOCAL &__DDRSS0_PHY_668_DATA
&__DDRSS0_PHY_668_DATA=0x00000000
LOCAL &__DDRSS0_PHY_669_DATA
&__DDRSS0_PHY_669_DATA=0x00000000
LOCAL &__DDRSS0_PHY_670_DATA
&__DDRSS0_PHY_670_DATA=0x00000000
LOCAL &__DDRSS0_PHY_671_DATA
&__DDRSS0_PHY_671_DATA=0x00000000
LOCAL &__DDRSS0_PHY_672_DATA
&__DDRSS0_PHY_672_DATA=0x00000000
LOCAL &__DDRSS0_PHY_673_DATA
&__DDRSS0_PHY_673_DATA=0x00000000
LOCAL &__DDRSS0_PHY_674_DATA
&__DDRSS0_PHY_674_DATA=0x00000000
LOCAL &__DDRSS0_PHY_675_DATA
&__DDRSS0_PHY_675_DATA=0x00000000
LOCAL &__DDRSS0_PHY_676_DATA
&__DDRSS0_PHY_676_DATA=0x00000000
LOCAL &__DDRSS0_PHY_677_DATA
&__DDRSS0_PHY_677_DATA=0x00000000
LOCAL &__DDRSS0_PHY_678_DATA
&__DDRSS0_PHY_678_DATA=0x00000000
LOCAL &__DDRSS0_PHY_679_DATA
&__DDRSS0_PHY_679_DATA=0x00000000
LOCAL &__DDRSS0_PHY_680_DATA
&__DDRSS0_PHY_680_DATA=0x00000000
LOCAL &__DDRSS0_PHY_681_DATA
&__DDRSS0_PHY_681_DATA=0x00000000
LOCAL &__DDRSS0_PHY_682_DATA
&__DDRSS0_PHY_682_DATA=0x00000000
LOCAL &__DDRSS0_PHY_683_DATA
&__DDRSS0_PHY_683_DATA=0x00000000
LOCAL &__DDRSS0_PHY_684_DATA
&__DDRSS0_PHY_684_DATA=0x00000000
LOCAL &__DDRSS0_PHY_685_DATA
&__DDRSS0_PHY_685_DATA=0x00000000
LOCAL &__DDRSS0_PHY_686_DATA
&__DDRSS0_PHY_686_DATA=0x00000000
LOCAL &__DDRSS0_PHY_687_DATA
&__DDRSS0_PHY_687_DATA=0x00000000
LOCAL &__DDRSS0_PHY_688_DATA
&__DDRSS0_PHY_688_DATA=0x00000000
LOCAL &__DDRSS0_PHY_689_DATA
&__DDRSS0_PHY_689_DATA=0x00000000
LOCAL &__DDRSS0_PHY_690_DATA
&__DDRSS0_PHY_690_DATA=0x00000000
LOCAL &__DDRSS0_PHY_691_DATA
&__DDRSS0_PHY_691_DATA=0x00000000
LOCAL &__DDRSS0_PHY_692_DATA
&__DDRSS0_PHY_692_DATA=0x00000000
LOCAL &__DDRSS0_PHY_693_DATA
&__DDRSS0_PHY_693_DATA=0x00000000
LOCAL &__DDRSS0_PHY_694_DATA
&__DDRSS0_PHY_694_DATA=0x00000000
LOCAL &__DDRSS0_PHY_695_DATA
&__DDRSS0_PHY_695_DATA=0x00000000
LOCAL &__DDRSS0_PHY_696_DATA
&__DDRSS0_PHY_696_DATA=0x00000000
LOCAL &__DDRSS0_PHY_697_DATA
&__DDRSS0_PHY_697_DATA=0x00000000
LOCAL &__DDRSS0_PHY_698_DATA
&__DDRSS0_PHY_698_DATA=0x00000000
LOCAL &__DDRSS0_PHY_699_DATA
&__DDRSS0_PHY_699_DATA=0x00000000
LOCAL &__DDRSS0_PHY_700_DATA
&__DDRSS0_PHY_700_DATA=0x00000000
LOCAL &__DDRSS0_PHY_701_DATA
&__DDRSS0_PHY_701_DATA=0x00000000
LOCAL &__DDRSS0_PHY_702_DATA
&__DDRSS0_PHY_702_DATA=0x00000000
LOCAL &__DDRSS0_PHY_703_DATA
&__DDRSS0_PHY_703_DATA=0x00000000
LOCAL &__DDRSS0_PHY_704_DATA
&__DDRSS0_PHY_704_DATA=0x00000000
LOCAL &__DDRSS0_PHY_705_DATA
&__DDRSS0_PHY_705_DATA=0x00000000
LOCAL &__DDRSS0_PHY_706_DATA
&__DDRSS0_PHY_706_DATA=0x00000000
LOCAL &__DDRSS0_PHY_707_DATA
&__DDRSS0_PHY_707_DATA=0x00000000
LOCAL &__DDRSS0_PHY_708_DATA
&__DDRSS0_PHY_708_DATA=0x00000000
LOCAL &__DDRSS0_PHY_709_DATA
&__DDRSS0_PHY_709_DATA=0x00000000
LOCAL &__DDRSS0_PHY_710_DATA
&__DDRSS0_PHY_710_DATA=0x00000000
LOCAL &__DDRSS0_PHY_711_DATA
&__DDRSS0_PHY_711_DATA=0x00000000
LOCAL &__DDRSS0_PHY_712_DATA
&__DDRSS0_PHY_712_DATA=0x00000000
LOCAL &__DDRSS0_PHY_713_DATA
&__DDRSS0_PHY_713_DATA=0x00000000
LOCAL &__DDRSS0_PHY_714_DATA
&__DDRSS0_PHY_714_DATA=0x00000000
LOCAL &__DDRSS0_PHY_715_DATA
&__DDRSS0_PHY_715_DATA=0x00000000
LOCAL &__DDRSS0_PHY_716_DATA
&__DDRSS0_PHY_716_DATA=0x00000000
LOCAL &__DDRSS0_PHY_717_DATA
&__DDRSS0_PHY_717_DATA=0x00000000
LOCAL &__DDRSS0_PHY_718_DATA
&__DDRSS0_PHY_718_DATA=0x00000000
LOCAL &__DDRSS0_PHY_719_DATA
&__DDRSS0_PHY_719_DATA=0x00000000
LOCAL &__DDRSS0_PHY_720_DATA
&__DDRSS0_PHY_720_DATA=0x00000000
LOCAL &__DDRSS0_PHY_721_DATA
&__DDRSS0_PHY_721_DATA=0x00000000
LOCAL &__DDRSS0_PHY_722_DATA
&__DDRSS0_PHY_722_DATA=0x00000000
LOCAL &__DDRSS0_PHY_723_DATA
&__DDRSS0_PHY_723_DATA=0x00000000
LOCAL &__DDRSS0_PHY_724_DATA
&__DDRSS0_PHY_724_DATA=0x00000000
LOCAL &__DDRSS0_PHY_725_DATA
&__DDRSS0_PHY_725_DATA=0x00000000
LOCAL &__DDRSS0_PHY_726_DATA
&__DDRSS0_PHY_726_DATA=0x00000000
LOCAL &__DDRSS0_PHY_727_DATA
&__DDRSS0_PHY_727_DATA=0x00000000
LOCAL &__DDRSS0_PHY_728_DATA
&__DDRSS0_PHY_728_DATA=0x00000000
LOCAL &__DDRSS0_PHY_729_DATA
&__DDRSS0_PHY_729_DATA=0x00000000
LOCAL &__DDRSS0_PHY_730_DATA
&__DDRSS0_PHY_730_DATA=0x00000000
LOCAL &__DDRSS0_PHY_731_DATA
&__DDRSS0_PHY_731_DATA=0x00000000
LOCAL &__DDRSS0_PHY_732_DATA
&__DDRSS0_PHY_732_DATA=0x00000000
LOCAL &__DDRSS0_PHY_733_DATA
&__DDRSS0_PHY_733_DATA=0x00000000
LOCAL &__DDRSS0_PHY_734_DATA
&__DDRSS0_PHY_734_DATA=0x00000000
LOCAL &__DDRSS0_PHY_735_DATA
&__DDRSS0_PHY_735_DATA=0x00000000
LOCAL &__DDRSS0_PHY_736_DATA
&__DDRSS0_PHY_736_DATA=0x00000000
LOCAL &__DDRSS0_PHY_737_DATA
&__DDRSS0_PHY_737_DATA=0x00000000
LOCAL &__DDRSS0_PHY_738_DATA
&__DDRSS0_PHY_738_DATA=0x00000000
LOCAL &__DDRSS0_PHY_739_DATA
&__DDRSS0_PHY_739_DATA=0x00000000
LOCAL &__DDRSS0_PHY_740_DATA
&__DDRSS0_PHY_740_DATA=0x00000000
LOCAL &__DDRSS0_PHY_741_DATA
&__DDRSS0_PHY_741_DATA=0x00000000
LOCAL &__DDRSS0_PHY_742_DATA
&__DDRSS0_PHY_742_DATA=0x00000000
LOCAL &__DDRSS0_PHY_743_DATA
&__DDRSS0_PHY_743_DATA=0x00000000
LOCAL &__DDRSS0_PHY_744_DATA
&__DDRSS0_PHY_744_DATA=0x00000000
LOCAL &__DDRSS0_PHY_745_DATA
&__DDRSS0_PHY_745_DATA=0x00000000
LOCAL &__DDRSS0_PHY_746_DATA
&__DDRSS0_PHY_746_DATA=0x00000000
LOCAL &__DDRSS0_PHY_747_DATA
&__DDRSS0_PHY_747_DATA=0x00000000
LOCAL &__DDRSS0_PHY_748_DATA
&__DDRSS0_PHY_748_DATA=0x00000000
LOCAL &__DDRSS0_PHY_749_DATA
&__DDRSS0_PHY_749_DATA=0x00000000
LOCAL &__DDRSS0_PHY_750_DATA
&__DDRSS0_PHY_750_DATA=0x00000000
LOCAL &__DDRSS0_PHY_751_DATA
&__DDRSS0_PHY_751_DATA=0x00000000
LOCAL &__DDRSS0_PHY_752_DATA
&__DDRSS0_PHY_752_DATA=0x00000000
LOCAL &__DDRSS0_PHY_753_DATA
&__DDRSS0_PHY_753_DATA=0x00000000
LOCAL &__DDRSS0_PHY_754_DATA
&__DDRSS0_PHY_754_DATA=0x00000000
LOCAL &__DDRSS0_PHY_755_DATA
&__DDRSS0_PHY_755_DATA=0x00000000
LOCAL &__DDRSS0_PHY_756_DATA
&__DDRSS0_PHY_756_DATA=0x00000000
LOCAL &__DDRSS0_PHY_757_DATA
&__DDRSS0_PHY_757_DATA=0x00000000
LOCAL &__DDRSS0_PHY_758_DATA
&__DDRSS0_PHY_758_DATA=0x00000000
LOCAL &__DDRSS0_PHY_759_DATA
&__DDRSS0_PHY_759_DATA=0x00000000
LOCAL &__DDRSS0_PHY_760_DATA
&__DDRSS0_PHY_760_DATA=0x00000000
LOCAL &__DDRSS0_PHY_761_DATA
&__DDRSS0_PHY_761_DATA=0x00000000
LOCAL &__DDRSS0_PHY_762_DATA
&__DDRSS0_PHY_762_DATA=0x00000000
LOCAL &__DDRSS0_PHY_763_DATA
&__DDRSS0_PHY_763_DATA=0x00000000
LOCAL &__DDRSS0_PHY_764_DATA
&__DDRSS0_PHY_764_DATA=0x00000000
LOCAL &__DDRSS0_PHY_765_DATA
&__DDRSS0_PHY_765_DATA=0x00000000
LOCAL &__DDRSS0_PHY_766_DATA
&__DDRSS0_PHY_766_DATA=0x00000000
LOCAL &__DDRSS0_PHY_767_DATA
&__DDRSS0_PHY_767_DATA=0x00000000
LOCAL &__DDRSS0_PHY_768_DATA
&__DDRSS0_PHY_768_DATA=0x000004F0
LOCAL &__DDRSS0_PHY_769_DATA
&__DDRSS0_PHY_769_DATA=0x00000000
LOCAL &__DDRSS0_PHY_770_DATA
&__DDRSS0_PHY_770_DATA=0x00030200
LOCAL &__DDRSS0_PHY_771_DATA
&__DDRSS0_PHY_771_DATA=0x00000000
LOCAL &__DDRSS0_PHY_772_DATA
&__DDRSS0_PHY_772_DATA=0x00000000
LOCAL &__DDRSS0_PHY_773_DATA
&__DDRSS0_PHY_773_DATA=0x01030000
LOCAL &__DDRSS0_PHY_774_DATA
&__DDRSS0_PHY_774_DATA=0x00010000
LOCAL &__DDRSS0_PHY_775_DATA
&__DDRSS0_PHY_775_DATA=0x01030004
LOCAL &__DDRSS0_PHY_776_DATA
&__DDRSS0_PHY_776_DATA=0x01000000
LOCAL &__DDRSS0_PHY_777_DATA
&__DDRSS0_PHY_777_DATA=0x00000000
LOCAL &__DDRSS0_PHY_778_DATA
&__DDRSS0_PHY_778_DATA=0x00000000
LOCAL &__DDRSS0_PHY_779_DATA
&__DDRSS0_PHY_779_DATA=0x01000001
LOCAL &__DDRSS0_PHY_780_DATA
&__DDRSS0_PHY_780_DATA=0x00000100
LOCAL &__DDRSS0_PHY_781_DATA
&__DDRSS0_PHY_781_DATA=0x000800C0
LOCAL &__DDRSS0_PHY_782_DATA
&__DDRSS0_PHY_782_DATA=0x060100CC
LOCAL &__DDRSS0_PHY_783_DATA
&__DDRSS0_PHY_783_DATA=0x00030066
LOCAL &__DDRSS0_PHY_784_DATA
&__DDRSS0_PHY_784_DATA=0x00000000
LOCAL &__DDRSS0_PHY_785_DATA
&__DDRSS0_PHY_785_DATA=0x00000301
LOCAL &__DDRSS0_PHY_786_DATA
&__DDRSS0_PHY_786_DATA=0x0000AAAA
LOCAL &__DDRSS0_PHY_787_DATA
&__DDRSS0_PHY_787_DATA=0x00005555
LOCAL &__DDRSS0_PHY_788_DATA
&__DDRSS0_PHY_788_DATA=0x0000B5B5
LOCAL &__DDRSS0_PHY_789_DATA
&__DDRSS0_PHY_789_DATA=0x00004A4A
LOCAL &__DDRSS0_PHY_790_DATA
&__DDRSS0_PHY_790_DATA=0x00005656
LOCAL &__DDRSS0_PHY_791_DATA
&__DDRSS0_PHY_791_DATA=0x0000A9A9
LOCAL &__DDRSS0_PHY_792_DATA
&__DDRSS0_PHY_792_DATA=0x0000A9A9
LOCAL &__DDRSS0_PHY_793_DATA
&__DDRSS0_PHY_793_DATA=0x0000B5B5
LOCAL &__DDRSS0_PHY_794_DATA
&__DDRSS0_PHY_794_DATA=0x00000000
LOCAL &__DDRSS0_PHY_795_DATA
&__DDRSS0_PHY_795_DATA=0x00000000
LOCAL &__DDRSS0_PHY_796_DATA
&__DDRSS0_PHY_796_DATA=0x2A000000
LOCAL &__DDRSS0_PHY_797_DATA
&__DDRSS0_PHY_797_DATA=0x00000808
LOCAL &__DDRSS0_PHY_798_DATA
&__DDRSS0_PHY_798_DATA=0x0F000000
LOCAL &__DDRSS0_PHY_799_DATA
&__DDRSS0_PHY_799_DATA=0x00000F0F
LOCAL &__DDRSS0_PHY_800_DATA
&__DDRSS0_PHY_800_DATA=0x10200000
LOCAL &__DDRSS0_PHY_801_DATA
&__DDRSS0_PHY_801_DATA=0x0C002006
LOCAL &__DDRSS0_PHY_802_DATA
&__DDRSS0_PHY_802_DATA=0x00000000
LOCAL &__DDRSS0_PHY_803_DATA
&__DDRSS0_PHY_803_DATA=0x00000000
LOCAL &__DDRSS0_PHY_804_DATA
&__DDRSS0_PHY_804_DATA=0x55555555
LOCAL &__DDRSS0_PHY_805_DATA
&__DDRSS0_PHY_805_DATA=0xAAAAAAAA
LOCAL &__DDRSS0_PHY_806_DATA
&__DDRSS0_PHY_806_DATA=0x55555555
LOCAL &__DDRSS0_PHY_807_DATA
&__DDRSS0_PHY_807_DATA=0xAAAAAAAA
LOCAL &__DDRSS0_PHY_808_DATA
&__DDRSS0_PHY_808_DATA=0x00005555
LOCAL &__DDRSS0_PHY_809_DATA
&__DDRSS0_PHY_809_DATA=0x01000100
LOCAL &__DDRSS0_PHY_810_DATA
&__DDRSS0_PHY_810_DATA=0x00800180
LOCAL &__DDRSS0_PHY_811_DATA
&__DDRSS0_PHY_811_DATA=0x00000000
LOCAL &__DDRSS0_PHY_812_DATA
&__DDRSS0_PHY_812_DATA=0x00000000
LOCAL &__DDRSS0_PHY_813_DATA
&__DDRSS0_PHY_813_DATA=0x00000000
LOCAL &__DDRSS0_PHY_814_DATA
&__DDRSS0_PHY_814_DATA=0x00000000
LOCAL &__DDRSS0_PHY_815_DATA
&__DDRSS0_PHY_815_DATA=0x00000000
LOCAL &__DDRSS0_PHY_816_DATA
&__DDRSS0_PHY_816_DATA=0x00000000
LOCAL &__DDRSS0_PHY_817_DATA
&__DDRSS0_PHY_817_DATA=0x00000000
LOCAL &__DDRSS0_PHY_818_DATA
&__DDRSS0_PHY_818_DATA=0x00000000
LOCAL &__DDRSS0_PHY_819_DATA
&__DDRSS0_PHY_819_DATA=0x00000000
LOCAL &__DDRSS0_PHY_820_DATA
&__DDRSS0_PHY_820_DATA=0x00000000
LOCAL &__DDRSS0_PHY_821_DATA
&__DDRSS0_PHY_821_DATA=0x00000000
LOCAL &__DDRSS0_PHY_822_DATA
&__DDRSS0_PHY_822_DATA=0x00000000
LOCAL &__DDRSS0_PHY_823_DATA
&__DDRSS0_PHY_823_DATA=0x00000000
LOCAL &__DDRSS0_PHY_824_DATA
&__DDRSS0_PHY_824_DATA=0x00000000
LOCAL &__DDRSS0_PHY_825_DATA
&__DDRSS0_PHY_825_DATA=0x00000000
LOCAL &__DDRSS0_PHY_826_DATA
&__DDRSS0_PHY_826_DATA=0x00000000
LOCAL &__DDRSS0_PHY_827_DATA
&__DDRSS0_PHY_827_DATA=0x00000000
LOCAL &__DDRSS0_PHY_828_DATA
&__DDRSS0_PHY_828_DATA=0x00000000
LOCAL &__DDRSS0_PHY_829_DATA
&__DDRSS0_PHY_829_DATA=0x00000000
LOCAL &__DDRSS0_PHY_830_DATA
&__DDRSS0_PHY_830_DATA=0x00000000
LOCAL &__DDRSS0_PHY_831_DATA
&__DDRSS0_PHY_831_DATA=0x00000000
LOCAL &__DDRSS0_PHY_832_DATA
&__DDRSS0_PHY_832_DATA=0x00000000
LOCAL &__DDRSS0_PHY_833_DATA
&__DDRSS0_PHY_833_DATA=0x00000000
LOCAL &__DDRSS0_PHY_834_DATA
&__DDRSS0_PHY_834_DATA=0x00000104
LOCAL &__DDRSS0_PHY_835_DATA
&__DDRSS0_PHY_835_DATA=0x00000120
LOCAL &__DDRSS0_PHY_836_DATA
&__DDRSS0_PHY_836_DATA=0x00000000
LOCAL &__DDRSS0_PHY_837_DATA
&__DDRSS0_PHY_837_DATA=0x00000000
LOCAL &__DDRSS0_PHY_838_DATA
&__DDRSS0_PHY_838_DATA=0x00000000
LOCAL &__DDRSS0_PHY_839_DATA
&__DDRSS0_PHY_839_DATA=0x00000000
LOCAL &__DDRSS0_PHY_840_DATA
&__DDRSS0_PHY_840_DATA=0x00000000
LOCAL &__DDRSS0_PHY_841_DATA
&__DDRSS0_PHY_841_DATA=0x00000000
LOCAL &__DDRSS0_PHY_842_DATA
&__DDRSS0_PHY_842_DATA=0x00000000
LOCAL &__DDRSS0_PHY_843_DATA
&__DDRSS0_PHY_843_DATA=0x00000001
LOCAL &__DDRSS0_PHY_844_DATA
&__DDRSS0_PHY_844_DATA=0x07FF0000
LOCAL &__DDRSS0_PHY_845_DATA
&__DDRSS0_PHY_845_DATA=0x0080081F
LOCAL &__DDRSS0_PHY_846_DATA
&__DDRSS0_PHY_846_DATA=0x00081020
LOCAL &__DDRSS0_PHY_847_DATA
&__DDRSS0_PHY_847_DATA=0x04010000
LOCAL &__DDRSS0_PHY_848_DATA
&__DDRSS0_PHY_848_DATA=0x00000000
LOCAL &__DDRSS0_PHY_849_DATA
&__DDRSS0_PHY_849_DATA=0x00000000
LOCAL &__DDRSS0_PHY_850_DATA
&__DDRSS0_PHY_850_DATA=0x00000000
LOCAL &__DDRSS0_PHY_851_DATA
&__DDRSS0_PHY_851_DATA=0x00000100
LOCAL &__DDRSS0_PHY_852_DATA
&__DDRSS0_PHY_852_DATA=0x01CC0C01
LOCAL &__DDRSS0_PHY_853_DATA
&__DDRSS0_PHY_853_DATA=0x1003CC0C
LOCAL &__DDRSS0_PHY_854_DATA
&__DDRSS0_PHY_854_DATA=0x20000140
LOCAL &__DDRSS0_PHY_855_DATA
&__DDRSS0_PHY_855_DATA=0x07FF0200
LOCAL &__DDRSS0_PHY_856_DATA
&__DDRSS0_PHY_856_DATA=0x0000DD01
LOCAL &__DDRSS0_PHY_857_DATA
&__DDRSS0_PHY_857_DATA=0x10100303
LOCAL &__DDRSS0_PHY_858_DATA
&__DDRSS0_PHY_858_DATA=0x10101010
LOCAL &__DDRSS0_PHY_859_DATA
&__DDRSS0_PHY_859_DATA=0x10101010
LOCAL &__DDRSS0_PHY_860_DATA
&__DDRSS0_PHY_860_DATA=0x00011010
LOCAL &__DDRSS0_PHY_861_DATA
&__DDRSS0_PHY_861_DATA=0x00100010
LOCAL &__DDRSS0_PHY_862_DATA
&__DDRSS0_PHY_862_DATA=0x00100010
LOCAL &__DDRSS0_PHY_863_DATA
&__DDRSS0_PHY_863_DATA=0x00100010
LOCAL &__DDRSS0_PHY_864_DATA
&__DDRSS0_PHY_864_DATA=0x00100010
LOCAL &__DDRSS0_PHY_865_DATA
&__DDRSS0_PHY_865_DATA=0x00050010
LOCAL &__DDRSS0_PHY_866_DATA
&__DDRSS0_PHY_866_DATA=0x51517041
LOCAL &__DDRSS0_PHY_867_DATA
&__DDRSS0_PHY_867_DATA=0x31C06000
LOCAL &__DDRSS0_PHY_868_DATA
&__DDRSS0_PHY_868_DATA=0x07AB0340
LOCAL &__DDRSS0_PHY_869_DATA
&__DDRSS0_PHY_869_DATA=0x00C0C001
LOCAL &__DDRSS0_PHY_870_DATA
&__DDRSS0_PHY_870_DATA=0x07060001
LOCAL &__DDRSS0_PHY_871_DATA
&__DDRSS0_PHY_871_DATA=0x10001000
LOCAL &__DDRSS0_PHY_872_DATA
&__DDRSS0_PHY_872_DATA=0x0C063E42
LOCAL &__DDRSS0_PHY_873_DATA
&__DDRSS0_PHY_873_DATA=0x0F0C2201
LOCAL &__DDRSS0_PHY_874_DATA
&__DDRSS0_PHY_874_DATA=0x01000140
LOCAL &__DDRSS0_PHY_875_DATA
&__DDRSS0_PHY_875_DATA=0x0C000420
LOCAL &__DDRSS0_PHY_876_DATA
&__DDRSS0_PHY_876_DATA=0x00000198
LOCAL &__DDRSS0_PHY_877_DATA
&__DDRSS0_PHY_877_DATA=0x0A0000D0
LOCAL &__DDRSS0_PHY_878_DATA
&__DDRSS0_PHY_878_DATA=0x00030200
LOCAL &__DDRSS0_PHY_879_DATA
&__DDRSS0_PHY_879_DATA=0x02800000
LOCAL &__DDRSS0_PHY_880_DATA
&__DDRSS0_PHY_880_DATA=0x80800000
LOCAL &__DDRSS0_PHY_881_DATA
&__DDRSS0_PHY_881_DATA=0x00072010
LOCAL &__DDRSS0_PHY_882_DATA
&__DDRSS0_PHY_882_DATA=0x76543210
LOCAL &__DDRSS0_PHY_883_DATA
&__DDRSS0_PHY_883_DATA=0x00000008
LOCAL &__DDRSS0_PHY_884_DATA
&__DDRSS0_PHY_884_DATA=0x02800280
LOCAL &__DDRSS0_PHY_885_DATA
&__DDRSS0_PHY_885_DATA=0x02800280
LOCAL &__DDRSS0_PHY_886_DATA
&__DDRSS0_PHY_886_DATA=0x02800280
LOCAL &__DDRSS0_PHY_887_DATA
&__DDRSS0_PHY_887_DATA=0x02800280
LOCAL &__DDRSS0_PHY_888_DATA
&__DDRSS0_PHY_888_DATA=0x00000280
LOCAL &__DDRSS0_PHY_889_DATA
&__DDRSS0_PHY_889_DATA=0x0000A000
LOCAL &__DDRSS0_PHY_890_DATA
&__DDRSS0_PHY_890_DATA=0x00A000A0
LOCAL &__DDRSS0_PHY_891_DATA
&__DDRSS0_PHY_891_DATA=0x00A000A0
LOCAL &__DDRSS0_PHY_892_DATA
&__DDRSS0_PHY_892_DATA=0x00A000A0
LOCAL &__DDRSS0_PHY_893_DATA
&__DDRSS0_PHY_893_DATA=0x00A000A0
LOCAL &__DDRSS0_PHY_894_DATA
&__DDRSS0_PHY_894_DATA=0x00A000A0
LOCAL &__DDRSS0_PHY_895_DATA
&__DDRSS0_PHY_895_DATA=0x00A000A0
LOCAL &__DDRSS0_PHY_896_DATA
&__DDRSS0_PHY_896_DATA=0x00A000A0
LOCAL &__DDRSS0_PHY_897_DATA
&__DDRSS0_PHY_897_DATA=0x00A000A0
LOCAL &__DDRSS0_PHY_898_DATA
&__DDRSS0_PHY_898_DATA=0x006E00A0
LOCAL &__DDRSS0_PHY_899_DATA
&__DDRSS0_PHY_899_DATA=0x01A00003
LOCAL &__DDRSS0_PHY_900_DATA
&__DDRSS0_PHY_900_DATA=0x00000000
LOCAL &__DDRSS0_PHY_901_DATA
&__DDRSS0_PHY_901_DATA=0x00000000
LOCAL &__DDRSS0_PHY_902_DATA
&__DDRSS0_PHY_902_DATA=0x00080200
LOCAL &__DDRSS0_PHY_903_DATA
&__DDRSS0_PHY_903_DATA=0x00000000
LOCAL &__DDRSS0_PHY_904_DATA
&__DDRSS0_PHY_904_DATA=0x20202000
LOCAL &__DDRSS0_PHY_905_DATA
&__DDRSS0_PHY_905_DATA=0x20202020
LOCAL &__DDRSS0_PHY_906_DATA
&__DDRSS0_PHY_906_DATA=0xF0F02020
LOCAL &__DDRSS0_PHY_907_DATA
&__DDRSS0_PHY_907_DATA=0x00000000
LOCAL &__DDRSS0_PHY_908_DATA
&__DDRSS0_PHY_908_DATA=0x00000000
LOCAL &__DDRSS0_PHY_909_DATA
&__DDRSS0_PHY_909_DATA=0x00000000
LOCAL &__DDRSS0_PHY_910_DATA
&__DDRSS0_PHY_910_DATA=0x00000000
LOCAL &__DDRSS0_PHY_911_DATA
&__DDRSS0_PHY_911_DATA=0x00000000
LOCAL &__DDRSS0_PHY_912_DATA
&__DDRSS0_PHY_912_DATA=0x00000000
LOCAL &__DDRSS0_PHY_913_DATA
&__DDRSS0_PHY_913_DATA=0x00000000
LOCAL &__DDRSS0_PHY_914_DATA
&__DDRSS0_PHY_914_DATA=0x00000000
LOCAL &__DDRSS0_PHY_915_DATA
&__DDRSS0_PHY_915_DATA=0x00000000
LOCAL &__DDRSS0_PHY_916_DATA
&__DDRSS0_PHY_916_DATA=0x00000000
LOCAL &__DDRSS0_PHY_917_DATA
&__DDRSS0_PHY_917_DATA=0x00000000
LOCAL &__DDRSS0_PHY_918_DATA
&__DDRSS0_PHY_918_DATA=0x00000000
LOCAL &__DDRSS0_PHY_919_DATA
&__DDRSS0_PHY_919_DATA=0x00000000
LOCAL &__DDRSS0_PHY_920_DATA
&__DDRSS0_PHY_920_DATA=0x00000000
LOCAL &__DDRSS0_PHY_921_DATA
&__DDRSS0_PHY_921_DATA=0x00000000
LOCAL &__DDRSS0_PHY_922_DATA
&__DDRSS0_PHY_922_DATA=0x00000000
LOCAL &__DDRSS0_PHY_923_DATA
&__DDRSS0_PHY_923_DATA=0x00000000
LOCAL &__DDRSS0_PHY_924_DATA
&__DDRSS0_PHY_924_DATA=0x00000000
LOCAL &__DDRSS0_PHY_925_DATA
&__DDRSS0_PHY_925_DATA=0x00000000
LOCAL &__DDRSS0_PHY_926_DATA
&__DDRSS0_PHY_926_DATA=0x00000000
LOCAL &__DDRSS0_PHY_927_DATA
&__DDRSS0_PHY_927_DATA=0x00000000
LOCAL &__DDRSS0_PHY_928_DATA
&__DDRSS0_PHY_928_DATA=0x00000000
LOCAL &__DDRSS0_PHY_929_DATA
&__DDRSS0_PHY_929_DATA=0x00000000
LOCAL &__DDRSS0_PHY_930_DATA
&__DDRSS0_PHY_930_DATA=0x00000000
LOCAL &__DDRSS0_PHY_931_DATA
&__DDRSS0_PHY_931_DATA=0x00000000
LOCAL &__DDRSS0_PHY_932_DATA
&__DDRSS0_PHY_932_DATA=0x00000000
LOCAL &__DDRSS0_PHY_933_DATA
&__DDRSS0_PHY_933_DATA=0x00000000
LOCAL &__DDRSS0_PHY_934_DATA
&__DDRSS0_PHY_934_DATA=0x00000000
LOCAL &__DDRSS0_PHY_935_DATA
&__DDRSS0_PHY_935_DATA=0x00000000
LOCAL &__DDRSS0_PHY_936_DATA
&__DDRSS0_PHY_936_DATA=0x00000000
LOCAL &__DDRSS0_PHY_937_DATA
&__DDRSS0_PHY_937_DATA=0x00000000
LOCAL &__DDRSS0_PHY_938_DATA
&__DDRSS0_PHY_938_DATA=0x00000000
LOCAL &__DDRSS0_PHY_939_DATA
&__DDRSS0_PHY_939_DATA=0x00000000
LOCAL &__DDRSS0_PHY_940_DATA
&__DDRSS0_PHY_940_DATA=0x00000000
LOCAL &__DDRSS0_PHY_941_DATA
&__DDRSS0_PHY_941_DATA=0x00000000
LOCAL &__DDRSS0_PHY_942_DATA
&__DDRSS0_PHY_942_DATA=0x00000000
LOCAL &__DDRSS0_PHY_943_DATA
&__DDRSS0_PHY_943_DATA=0x00000000
LOCAL &__DDRSS0_PHY_944_DATA
&__DDRSS0_PHY_944_DATA=0x00000000
LOCAL &__DDRSS0_PHY_945_DATA
&__DDRSS0_PHY_945_DATA=0x00000000
LOCAL &__DDRSS0_PHY_946_DATA
&__DDRSS0_PHY_946_DATA=0x00000000
LOCAL &__DDRSS0_PHY_947_DATA
&__DDRSS0_PHY_947_DATA=0x00000000
LOCAL &__DDRSS0_PHY_948_DATA
&__DDRSS0_PHY_948_DATA=0x00000000
LOCAL &__DDRSS0_PHY_949_DATA
&__DDRSS0_PHY_949_DATA=0x00000000
LOCAL &__DDRSS0_PHY_950_DATA
&__DDRSS0_PHY_950_DATA=0x00000000
LOCAL &__DDRSS0_PHY_951_DATA
&__DDRSS0_PHY_951_DATA=0x00000000
LOCAL &__DDRSS0_PHY_952_DATA
&__DDRSS0_PHY_952_DATA=0x00000000
LOCAL &__DDRSS0_PHY_953_DATA
&__DDRSS0_PHY_953_DATA=0x00000000
LOCAL &__DDRSS0_PHY_954_DATA
&__DDRSS0_PHY_954_DATA=0x00000000
LOCAL &__DDRSS0_PHY_955_DATA
&__DDRSS0_PHY_955_DATA=0x00000000
LOCAL &__DDRSS0_PHY_956_DATA
&__DDRSS0_PHY_956_DATA=0x00000000
LOCAL &__DDRSS0_PHY_957_DATA
&__DDRSS0_PHY_957_DATA=0x00000000
LOCAL &__DDRSS0_PHY_958_DATA
&__DDRSS0_PHY_958_DATA=0x00000000
LOCAL &__DDRSS0_PHY_959_DATA
&__DDRSS0_PHY_959_DATA=0x00000000
LOCAL &__DDRSS0_PHY_960_DATA
&__DDRSS0_PHY_960_DATA=0x00000000
LOCAL &__DDRSS0_PHY_961_DATA
&__DDRSS0_PHY_961_DATA=0x00000000
LOCAL &__DDRSS0_PHY_962_DATA
&__DDRSS0_PHY_962_DATA=0x00000000
LOCAL &__DDRSS0_PHY_963_DATA
&__DDRSS0_PHY_963_DATA=0x00000000
LOCAL &__DDRSS0_PHY_964_DATA
&__DDRSS0_PHY_964_DATA=0x00000000
LOCAL &__DDRSS0_PHY_965_DATA
&__DDRSS0_PHY_965_DATA=0x00000000
LOCAL &__DDRSS0_PHY_966_DATA
&__DDRSS0_PHY_966_DATA=0x00000000
LOCAL &__DDRSS0_PHY_967_DATA
&__DDRSS0_PHY_967_DATA=0x00000000
LOCAL &__DDRSS0_PHY_968_DATA
&__DDRSS0_PHY_968_DATA=0x00000000
LOCAL &__DDRSS0_PHY_969_DATA
&__DDRSS0_PHY_969_DATA=0x00000000
LOCAL &__DDRSS0_PHY_970_DATA
&__DDRSS0_PHY_970_DATA=0x00000000
LOCAL &__DDRSS0_PHY_971_DATA
&__DDRSS0_PHY_971_DATA=0x00000000
LOCAL &__DDRSS0_PHY_972_DATA
&__DDRSS0_PHY_972_DATA=0x00000000
LOCAL &__DDRSS0_PHY_973_DATA
&__DDRSS0_PHY_973_DATA=0x00000000
LOCAL &__DDRSS0_PHY_974_DATA
&__DDRSS0_PHY_974_DATA=0x00000000
LOCAL &__DDRSS0_PHY_975_DATA
&__DDRSS0_PHY_975_DATA=0x00000000
LOCAL &__DDRSS0_PHY_976_DATA
&__DDRSS0_PHY_976_DATA=0x00000000
LOCAL &__DDRSS0_PHY_977_DATA
&__DDRSS0_PHY_977_DATA=0x00000000
LOCAL &__DDRSS0_PHY_978_DATA
&__DDRSS0_PHY_978_DATA=0x00000000
LOCAL &__DDRSS0_PHY_979_DATA
&__DDRSS0_PHY_979_DATA=0x00000000
LOCAL &__DDRSS0_PHY_980_DATA
&__DDRSS0_PHY_980_DATA=0x00000000
LOCAL &__DDRSS0_PHY_981_DATA
&__DDRSS0_PHY_981_DATA=0x00000000
LOCAL &__DDRSS0_PHY_982_DATA
&__DDRSS0_PHY_982_DATA=0x00000000
LOCAL &__DDRSS0_PHY_983_DATA
&__DDRSS0_PHY_983_DATA=0x00000000
LOCAL &__DDRSS0_PHY_984_DATA
&__DDRSS0_PHY_984_DATA=0x00000000
LOCAL &__DDRSS0_PHY_985_DATA
&__DDRSS0_PHY_985_DATA=0x00000000
LOCAL &__DDRSS0_PHY_986_DATA
&__DDRSS0_PHY_986_DATA=0x00000000
LOCAL &__DDRSS0_PHY_987_DATA
&__DDRSS0_PHY_987_DATA=0x00000000
LOCAL &__DDRSS0_PHY_988_DATA
&__DDRSS0_PHY_988_DATA=0x00000000
LOCAL &__DDRSS0_PHY_989_DATA
&__DDRSS0_PHY_989_DATA=0x00000000
LOCAL &__DDRSS0_PHY_990_DATA
&__DDRSS0_PHY_990_DATA=0x00000000
LOCAL &__DDRSS0_PHY_991_DATA
&__DDRSS0_PHY_991_DATA=0x00000000
LOCAL &__DDRSS0_PHY_992_DATA
&__DDRSS0_PHY_992_DATA=0x00000000
LOCAL &__DDRSS0_PHY_993_DATA
&__DDRSS0_PHY_993_DATA=0x00000000
LOCAL &__DDRSS0_PHY_994_DATA
&__DDRSS0_PHY_994_DATA=0x00000000
LOCAL &__DDRSS0_PHY_995_DATA
&__DDRSS0_PHY_995_DATA=0x00000000
LOCAL &__DDRSS0_PHY_996_DATA
&__DDRSS0_PHY_996_DATA=0x00000000
LOCAL &__DDRSS0_PHY_997_DATA
&__DDRSS0_PHY_997_DATA=0x00000000
LOCAL &__DDRSS0_PHY_998_DATA
&__DDRSS0_PHY_998_DATA=0x00000000
LOCAL &__DDRSS0_PHY_999_DATA
&__DDRSS0_PHY_999_DATA=0x00000000
LOCAL &__DDRSS0_PHY_1000_DATA
&__DDRSS0_PHY_1000_DATA=0x00000000
LOCAL &__DDRSS0_PHY_1001_DATA
&__DDRSS0_PHY_1001_DATA=0x00000000
LOCAL &__DDRSS0_PHY_1002_DATA
&__DDRSS0_PHY_1002_DATA=0x00000000
LOCAL &__DDRSS0_PHY_1003_DATA
&__DDRSS0_PHY_1003_DATA=0x00000000
LOCAL &__DDRSS0_PHY_1004_DATA
&__DDRSS0_PHY_1004_DATA=0x00000000
LOCAL &__DDRSS0_PHY_1005_DATA
&__DDRSS0_PHY_1005_DATA=0x00000000
LOCAL &__DDRSS0_PHY_1006_DATA
&__DDRSS0_PHY_1006_DATA=0x00000000
LOCAL &__DDRSS0_PHY_1007_DATA
&__DDRSS0_PHY_1007_DATA=0x00000000
LOCAL &__DDRSS0_PHY_1008_DATA
&__DDRSS0_PHY_1008_DATA=0x00000000
LOCAL &__DDRSS0_PHY_1009_DATA
&__DDRSS0_PHY_1009_DATA=0x00000000
LOCAL &__DDRSS0_PHY_1010_DATA
&__DDRSS0_PHY_1010_DATA=0x00000000
LOCAL &__DDRSS0_PHY_1011_DATA
&__DDRSS0_PHY_1011_DATA=0x00000000
LOCAL &__DDRSS0_PHY_1012_DATA
&__DDRSS0_PHY_1012_DATA=0x00000000
LOCAL &__DDRSS0_PHY_1013_DATA
&__DDRSS0_PHY_1013_DATA=0x00000000
LOCAL &__DDRSS0_PHY_1014_DATA
&__DDRSS0_PHY_1014_DATA=0x00000000
LOCAL &__DDRSS0_PHY_1015_DATA
&__DDRSS0_PHY_1015_DATA=0x00000000
LOCAL &__DDRSS0_PHY_1016_DATA
&__DDRSS0_PHY_1016_DATA=0x00000000
LOCAL &__DDRSS0_PHY_1017_DATA
&__DDRSS0_PHY_1017_DATA=0x00000000
LOCAL &__DDRSS0_PHY_1018_DATA
&__DDRSS0_PHY_1018_DATA=0x00000000
LOCAL &__DDRSS0_PHY_1019_DATA
&__DDRSS0_PHY_1019_DATA=0x00000000
LOCAL &__DDRSS0_PHY_1020_DATA
&__DDRSS0_PHY_1020_DATA=0x00000000
LOCAL &__DDRSS0_PHY_1021_DATA
&__DDRSS0_PHY_1021_DATA=0x00000000
LOCAL &__DDRSS0_PHY_1022_DATA
&__DDRSS0_PHY_1022_DATA=0x00000000
LOCAL &__DDRSS0_PHY_1023_DATA
&__DDRSS0_PHY_1023_DATA=0x00000000
LOCAL &__DDRSS0_PHY_1024_DATA
&__DDRSS0_PHY_1024_DATA=0x00000000
LOCAL &__DDRSS0_PHY_1025_DATA
&__DDRSS0_PHY_1025_DATA=0x00000000
LOCAL &__DDRSS0_PHY_1026_DATA
&__DDRSS0_PHY_1026_DATA=0x00000000
LOCAL &__DDRSS0_PHY_1027_DATA
&__DDRSS0_PHY_1027_DATA=0x00000000
LOCAL &__DDRSS0_PHY_1028_DATA
&__DDRSS0_PHY_1028_DATA=0x00000000
LOCAL &__DDRSS0_PHY_1029_DATA
&__DDRSS0_PHY_1029_DATA=0x00000100
LOCAL &__DDRSS0_PHY_1030_DATA
&__DDRSS0_PHY_1030_DATA=0x00000200
LOCAL &__DDRSS0_PHY_1031_DATA
&__DDRSS0_PHY_1031_DATA=0x00000000
LOCAL &__DDRSS0_PHY_1032_DATA
&__DDRSS0_PHY_1032_DATA=0x00000000
LOCAL &__DDRSS0_PHY_1033_DATA
&__DDRSS0_PHY_1033_DATA=0x00000000
LOCAL &__DDRSS0_PHY_1034_DATA
&__DDRSS0_PHY_1034_DATA=0x00000000
LOCAL &__DDRSS0_PHY_1035_DATA
&__DDRSS0_PHY_1035_DATA=0x00400000
LOCAL &__DDRSS0_PHY_1036_DATA
&__DDRSS0_PHY_1036_DATA=0x00000080
LOCAL &__DDRSS0_PHY_1037_DATA
&__DDRSS0_PHY_1037_DATA=0x00DCBA98
LOCAL &__DDRSS0_PHY_1038_DATA
&__DDRSS0_PHY_1038_DATA=0x03000000
LOCAL &__DDRSS0_PHY_1039_DATA
&__DDRSS0_PHY_1039_DATA=0x00200000
LOCAL &__DDRSS0_PHY_1040_DATA
&__DDRSS0_PHY_1040_DATA=0x00000000
LOCAL &__DDRSS0_PHY_1041_DATA
&__DDRSS0_PHY_1041_DATA=0x00000000
LOCAL &__DDRSS0_PHY_1042_DATA
&__DDRSS0_PHY_1042_DATA=0x00000000
LOCAL &__DDRSS0_PHY_1043_DATA
&__DDRSS0_PHY_1043_DATA=0x00000000
LOCAL &__DDRSS0_PHY_1044_DATA
&__DDRSS0_PHY_1044_DATA=0x00000000
LOCAL &__DDRSS0_PHY_1045_DATA
&__DDRSS0_PHY_1045_DATA=0x0000002A
LOCAL &__DDRSS0_PHY_1046_DATA
&__DDRSS0_PHY_1046_DATA=0x00000015
LOCAL &__DDRSS0_PHY_1047_DATA
&__DDRSS0_PHY_1047_DATA=0x00000015
LOCAL &__DDRSS0_PHY_1048_DATA
&__DDRSS0_PHY_1048_DATA=0x0000002A
LOCAL &__DDRSS0_PHY_1049_DATA
&__DDRSS0_PHY_1049_DATA=0x00000033
LOCAL &__DDRSS0_PHY_1050_DATA
&__DDRSS0_PHY_1050_DATA=0x0000000C
LOCAL &__DDRSS0_PHY_1051_DATA
&__DDRSS0_PHY_1051_DATA=0x0000000C
LOCAL &__DDRSS0_PHY_1052_DATA
&__DDRSS0_PHY_1052_DATA=0x00000033
LOCAL &__DDRSS0_PHY_1053_DATA
&__DDRSS0_PHY_1053_DATA=0x00543210
LOCAL &__DDRSS0_PHY_1054_DATA
&__DDRSS0_PHY_1054_DATA=0x003F0000
LOCAL &__DDRSS0_PHY_1055_DATA
&__DDRSS0_PHY_1055_DATA=0x000F013F
LOCAL &__DDRSS0_PHY_1056_DATA
&__DDRSS0_PHY_1056_DATA=0x20202003
LOCAL &__DDRSS0_PHY_1057_DATA
&__DDRSS0_PHY_1057_DATA=0x00202020
LOCAL &__DDRSS0_PHY_1058_DATA
&__DDRSS0_PHY_1058_DATA=0x20008008
LOCAL &__DDRSS0_PHY_1059_DATA
&__DDRSS0_PHY_1059_DATA=0x00000810
LOCAL &__DDRSS0_PHY_1060_DATA
&__DDRSS0_PHY_1060_DATA=0x00000F00
LOCAL &__DDRSS0_PHY_1061_DATA
&__DDRSS0_PHY_1061_DATA=0x00000000
LOCAL &__DDRSS0_PHY_1062_DATA
&__DDRSS0_PHY_1062_DATA=0x00000000
LOCAL &__DDRSS0_PHY_1063_DATA
&__DDRSS0_PHY_1063_DATA=0x00000000
LOCAL &__DDRSS0_PHY_1064_DATA
&__DDRSS0_PHY_1064_DATA=0x000205CC
LOCAL &__DDRSS0_PHY_1065_DATA
&__DDRSS0_PHY_1065_DATA=0x00030000
LOCAL &__DDRSS0_PHY_1066_DATA
&__DDRSS0_PHY_1066_DATA=0x00000300
LOCAL &__DDRSS0_PHY_1067_DATA
&__DDRSS0_PHY_1067_DATA=0x00000300
LOCAL &__DDRSS0_PHY_1068_DATA
&__DDRSS0_PHY_1068_DATA=0x00000300
LOCAL &__DDRSS0_PHY_1069_DATA
&__DDRSS0_PHY_1069_DATA=0x00000300
LOCAL &__DDRSS0_PHY_1070_DATA
&__DDRSS0_PHY_1070_DATA=0x00000300
LOCAL &__DDRSS0_PHY_1071_DATA
&__DDRSS0_PHY_1071_DATA=0x42080010
LOCAL &__DDRSS0_PHY_1072_DATA
&__DDRSS0_PHY_1072_DATA=0x0000803E
LOCAL &__DDRSS0_PHY_1073_DATA
&__DDRSS0_PHY_1073_DATA=0x00000001
LOCAL &__DDRSS0_PHY_1074_DATA
&__DDRSS0_PHY_1074_DATA=0x01000102
LOCAL &__DDRSS0_PHY_1075_DATA
&__DDRSS0_PHY_1075_DATA=0x00008000
LOCAL &__DDRSS0_PHY_1076_DATA
&__DDRSS0_PHY_1076_DATA=0x00000000
LOCAL &__DDRSS0_PHY_1077_DATA
&__DDRSS0_PHY_1077_DATA=0x00000000
LOCAL &__DDRSS0_PHY_1078_DATA
&__DDRSS0_PHY_1078_DATA=0x00000000
LOCAL &__DDRSS0_PHY_1079_DATA
&__DDRSS0_PHY_1079_DATA=0x00000000
LOCAL &__DDRSS0_PHY_1080_DATA
&__DDRSS0_PHY_1080_DATA=0x00000000
LOCAL &__DDRSS0_PHY_1081_DATA
&__DDRSS0_PHY_1081_DATA=0x00000000
LOCAL &__DDRSS0_PHY_1082_DATA
&__DDRSS0_PHY_1082_DATA=0x00000000
LOCAL &__DDRSS0_PHY_1083_DATA
&__DDRSS0_PHY_1083_DATA=0x00000000
LOCAL &__DDRSS0_PHY_1084_DATA
&__DDRSS0_PHY_1084_DATA=0x00000000
LOCAL &__DDRSS0_PHY_1085_DATA
&__DDRSS0_PHY_1085_DATA=0x00000000
LOCAL &__DDRSS0_PHY_1086_DATA
&__DDRSS0_PHY_1086_DATA=0x00000000
LOCAL &__DDRSS0_PHY_1087_DATA
&__DDRSS0_PHY_1087_DATA=0x00000000
LOCAL &__DDRSS0_PHY_1088_DATA
&__DDRSS0_PHY_1088_DATA=0x00000000
LOCAL &__DDRSS0_PHY_1089_DATA
&__DDRSS0_PHY_1089_DATA=0x00000000
LOCAL &__DDRSS0_PHY_1090_DATA
&__DDRSS0_PHY_1090_DATA=0x00000000
LOCAL &__DDRSS0_PHY_1091_DATA
&__DDRSS0_PHY_1091_DATA=0x00000000
LOCAL &__DDRSS0_PHY_1092_DATA
&__DDRSS0_PHY_1092_DATA=0x00000000
LOCAL &__DDRSS0_PHY_1093_DATA
&__DDRSS0_PHY_1093_DATA=0x00000000
LOCAL &__DDRSS0_PHY_1094_DATA
&__DDRSS0_PHY_1094_DATA=0x00000000
LOCAL &__DDRSS0_PHY_1095_DATA
&__DDRSS0_PHY_1095_DATA=0x00000000
LOCAL &__DDRSS0_PHY_1096_DATA
&__DDRSS0_PHY_1096_DATA=0x00000000
LOCAL &__DDRSS0_PHY_1097_DATA
&__DDRSS0_PHY_1097_DATA=0x00000000
LOCAL &__DDRSS0_PHY_1098_DATA
&__DDRSS0_PHY_1098_DATA=0x00000000
LOCAL &__DDRSS0_PHY_1099_DATA
&__DDRSS0_PHY_1099_DATA=0x00000000
LOCAL &__DDRSS0_PHY_1100_DATA
&__DDRSS0_PHY_1100_DATA=0x00000000
LOCAL &__DDRSS0_PHY_1101_DATA
&__DDRSS0_PHY_1101_DATA=0x00000000
LOCAL &__DDRSS0_PHY_1102_DATA
&__DDRSS0_PHY_1102_DATA=0x00000000
LOCAL &__DDRSS0_PHY_1103_DATA
&__DDRSS0_PHY_1103_DATA=0x00000000
LOCAL &__DDRSS0_PHY_1104_DATA
&__DDRSS0_PHY_1104_DATA=0x00000000
LOCAL &__DDRSS0_PHY_1105_DATA
&__DDRSS0_PHY_1105_DATA=0x00000000
LOCAL &__DDRSS0_PHY_1106_DATA
&__DDRSS0_PHY_1106_DATA=0x00000000
LOCAL &__DDRSS0_PHY_1107_DATA
&__DDRSS0_PHY_1107_DATA=0x00000000
LOCAL &__DDRSS0_PHY_1108_DATA
&__DDRSS0_PHY_1108_DATA=0x00000000
LOCAL &__DDRSS0_PHY_1109_DATA
&__DDRSS0_PHY_1109_DATA=0x00000000
LOCAL &__DDRSS0_PHY_1110_DATA
&__DDRSS0_PHY_1110_DATA=0x00000000
LOCAL &__DDRSS0_PHY_1111_DATA
&__DDRSS0_PHY_1111_DATA=0x00000000
LOCAL &__DDRSS0_PHY_1112_DATA
&__DDRSS0_PHY_1112_DATA=0x00000000
LOCAL &__DDRSS0_PHY_1113_DATA
&__DDRSS0_PHY_1113_DATA=0x00000000
LOCAL &__DDRSS0_PHY_1114_DATA
&__DDRSS0_PHY_1114_DATA=0x00000000
LOCAL &__DDRSS0_PHY_1115_DATA
&__DDRSS0_PHY_1115_DATA=0x00000000
LOCAL &__DDRSS0_PHY_1116_DATA
&__DDRSS0_PHY_1116_DATA=0x00000000
LOCAL &__DDRSS0_PHY_1117_DATA
&__DDRSS0_PHY_1117_DATA=0x00000000
LOCAL &__DDRSS0_PHY_1118_DATA
&__DDRSS0_PHY_1118_DATA=0x00000000
LOCAL &__DDRSS0_PHY_1119_DATA
&__DDRSS0_PHY_1119_DATA=0x00000000
LOCAL &__DDRSS0_PHY_1120_DATA
&__DDRSS0_PHY_1120_DATA=0x00000000
LOCAL &__DDRSS0_PHY_1121_DATA
&__DDRSS0_PHY_1121_DATA=0x00000000
LOCAL &__DDRSS0_PHY_1122_DATA
&__DDRSS0_PHY_1122_DATA=0x00000000
LOCAL &__DDRSS0_PHY_1123_DATA
&__DDRSS0_PHY_1123_DATA=0x00000000
LOCAL &__DDRSS0_PHY_1124_DATA
&__DDRSS0_PHY_1124_DATA=0x00000000
LOCAL &__DDRSS0_PHY_1125_DATA
&__DDRSS0_PHY_1125_DATA=0x00000000
LOCAL &__DDRSS0_PHY_1126_DATA
&__DDRSS0_PHY_1126_DATA=0x00000000
LOCAL &__DDRSS0_PHY_1127_DATA
&__DDRSS0_PHY_1127_DATA=0x00000000
LOCAL &__DDRSS0_PHY_1128_DATA
&__DDRSS0_PHY_1128_DATA=0x00000000
LOCAL &__DDRSS0_PHY_1129_DATA
&__DDRSS0_PHY_1129_DATA=0x00000000
LOCAL &__DDRSS0_PHY_1130_DATA
&__DDRSS0_PHY_1130_DATA=0x00000000
LOCAL &__DDRSS0_PHY_1131_DATA
&__DDRSS0_PHY_1131_DATA=0x00000000
LOCAL &__DDRSS0_PHY_1132_DATA
&__DDRSS0_PHY_1132_DATA=0x00000000
LOCAL &__DDRSS0_PHY_1133_DATA
&__DDRSS0_PHY_1133_DATA=0x00000000
LOCAL &__DDRSS0_PHY_1134_DATA
&__DDRSS0_PHY_1134_DATA=0x00000000
LOCAL &__DDRSS0_PHY_1135_DATA
&__DDRSS0_PHY_1135_DATA=0x00000000
LOCAL &__DDRSS0_PHY_1136_DATA
&__DDRSS0_PHY_1136_DATA=0x00000000
LOCAL &__DDRSS0_PHY_1137_DATA
&__DDRSS0_PHY_1137_DATA=0x00000000
LOCAL &__DDRSS0_PHY_1138_DATA
&__DDRSS0_PHY_1138_DATA=0x00000000
LOCAL &__DDRSS0_PHY_1139_DATA
&__DDRSS0_PHY_1139_DATA=0x00000000
LOCAL &__DDRSS0_PHY_1140_DATA
&__DDRSS0_PHY_1140_DATA=0x00000000
LOCAL &__DDRSS0_PHY_1141_DATA
&__DDRSS0_PHY_1141_DATA=0x00000000
LOCAL &__DDRSS0_PHY_1142_DATA
&__DDRSS0_PHY_1142_DATA=0x00000000
LOCAL &__DDRSS0_PHY_1143_DATA
&__DDRSS0_PHY_1143_DATA=0x00000000
LOCAL &__DDRSS0_PHY_1144_DATA
&__DDRSS0_PHY_1144_DATA=0x00000000
LOCAL &__DDRSS0_PHY_1145_DATA
&__DDRSS0_PHY_1145_DATA=0x00000000
LOCAL &__DDRSS0_PHY_1146_DATA
&__DDRSS0_PHY_1146_DATA=0x00000000
LOCAL &__DDRSS0_PHY_1147_DATA
&__DDRSS0_PHY_1147_DATA=0x00000000
LOCAL &__DDRSS0_PHY_1148_DATA
&__DDRSS0_PHY_1148_DATA=0x00000000
LOCAL &__DDRSS0_PHY_1149_DATA
&__DDRSS0_PHY_1149_DATA=0x00000000
LOCAL &__DDRSS0_PHY_1150_DATA
&__DDRSS0_PHY_1150_DATA=0x00000000
LOCAL &__DDRSS0_PHY_1151_DATA
&__DDRSS0_PHY_1151_DATA=0x00000000
LOCAL &__DDRSS0_PHY_1152_DATA
&__DDRSS0_PHY_1152_DATA=0x00000000
LOCAL &__DDRSS0_PHY_1153_DATA
&__DDRSS0_PHY_1153_DATA=0x00000000
LOCAL &__DDRSS0_PHY_1154_DATA
&__DDRSS0_PHY_1154_DATA=0x00000000
LOCAL &__DDRSS0_PHY_1155_DATA
&__DDRSS0_PHY_1155_DATA=0x00000000
LOCAL &__DDRSS0_PHY_1156_DATA
&__DDRSS0_PHY_1156_DATA=0x00000000
LOCAL &__DDRSS0_PHY_1157_DATA
&__DDRSS0_PHY_1157_DATA=0x00000000
LOCAL &__DDRSS0_PHY_1158_DATA
&__DDRSS0_PHY_1158_DATA=0x00000000
LOCAL &__DDRSS0_PHY_1159_DATA
&__DDRSS0_PHY_1159_DATA=0x00000000
LOCAL &__DDRSS0_PHY_1160_DATA
&__DDRSS0_PHY_1160_DATA=0x00000000
LOCAL &__DDRSS0_PHY_1161_DATA
&__DDRSS0_PHY_1161_DATA=0x00000000
LOCAL &__DDRSS0_PHY_1162_DATA
&__DDRSS0_PHY_1162_DATA=0x00000000
LOCAL &__DDRSS0_PHY_1163_DATA
&__DDRSS0_PHY_1163_DATA=0x00000000
LOCAL &__DDRSS0_PHY_1164_DATA
&__DDRSS0_PHY_1164_DATA=0x00000000
LOCAL &__DDRSS0_PHY_1165_DATA
&__DDRSS0_PHY_1165_DATA=0x00000000
LOCAL &__DDRSS0_PHY_1166_DATA
&__DDRSS0_PHY_1166_DATA=0x00000000
LOCAL &__DDRSS0_PHY_1167_DATA
&__DDRSS0_PHY_1167_DATA=0x00000000
LOCAL &__DDRSS0_PHY_1168_DATA
&__DDRSS0_PHY_1168_DATA=0x00000000
LOCAL &__DDRSS0_PHY_1169_DATA
&__DDRSS0_PHY_1169_DATA=0x00000000
LOCAL &__DDRSS0_PHY_1170_DATA
&__DDRSS0_PHY_1170_DATA=0x00000000
LOCAL &__DDRSS0_PHY_1171_DATA
&__DDRSS0_PHY_1171_DATA=0x00000000
LOCAL &__DDRSS0_PHY_1172_DATA
&__DDRSS0_PHY_1172_DATA=0x00000000
LOCAL &__DDRSS0_PHY_1173_DATA
&__DDRSS0_PHY_1173_DATA=0x00000000
LOCAL &__DDRSS0_PHY_1174_DATA
&__DDRSS0_PHY_1174_DATA=0x00000000
LOCAL &__DDRSS0_PHY_1175_DATA
&__DDRSS0_PHY_1175_DATA=0x00000000
LOCAL &__DDRSS0_PHY_1176_DATA
&__DDRSS0_PHY_1176_DATA=0x00000000
LOCAL &__DDRSS0_PHY_1177_DATA
&__DDRSS0_PHY_1177_DATA=0x00000000
LOCAL &__DDRSS0_PHY_1178_DATA
&__DDRSS0_PHY_1178_DATA=0x00000000
LOCAL &__DDRSS0_PHY_1179_DATA
&__DDRSS0_PHY_1179_DATA=0x00000000
LOCAL &__DDRSS0_PHY_1180_DATA
&__DDRSS0_PHY_1180_DATA=0x00000000
LOCAL &__DDRSS0_PHY_1181_DATA
&__DDRSS0_PHY_1181_DATA=0x00000000
LOCAL &__DDRSS0_PHY_1182_DATA
&__DDRSS0_PHY_1182_DATA=0x00000000
LOCAL &__DDRSS0_PHY_1183_DATA
&__DDRSS0_PHY_1183_DATA=0x00000000
LOCAL &__DDRSS0_PHY_1184_DATA
&__DDRSS0_PHY_1184_DATA=0x00000000
LOCAL &__DDRSS0_PHY_1185_DATA
&__DDRSS0_PHY_1185_DATA=0x00000000
LOCAL &__DDRSS0_PHY_1186_DATA
&__DDRSS0_PHY_1186_DATA=0x00000000
LOCAL &__DDRSS0_PHY_1187_DATA
&__DDRSS0_PHY_1187_DATA=0x00000000
LOCAL &__DDRSS0_PHY_1188_DATA
&__DDRSS0_PHY_1188_DATA=0x00000000
LOCAL &__DDRSS0_PHY_1189_DATA
&__DDRSS0_PHY_1189_DATA=0x00000000
LOCAL &__DDRSS0_PHY_1190_DATA
&__DDRSS0_PHY_1190_DATA=0x00000000
LOCAL &__DDRSS0_PHY_1191_DATA
&__DDRSS0_PHY_1191_DATA=0x00000000
LOCAL &__DDRSS0_PHY_1192_DATA
&__DDRSS0_PHY_1192_DATA=0x00000000
LOCAL &__DDRSS0_PHY_1193_DATA
&__DDRSS0_PHY_1193_DATA=0x00000000
LOCAL &__DDRSS0_PHY_1194_DATA
&__DDRSS0_PHY_1194_DATA=0x00000000
LOCAL &__DDRSS0_PHY_1195_DATA
&__DDRSS0_PHY_1195_DATA=0x00000000
LOCAL &__DDRSS0_PHY_1196_DATA
&__DDRSS0_PHY_1196_DATA=0x00000000
LOCAL &__DDRSS0_PHY_1197_DATA
&__DDRSS0_PHY_1197_DATA=0x00000000
LOCAL &__DDRSS0_PHY_1198_DATA
&__DDRSS0_PHY_1198_DATA=0x00000000
LOCAL &__DDRSS0_PHY_1199_DATA
&__DDRSS0_PHY_1199_DATA=0x00000000
LOCAL &__DDRSS0_PHY_1200_DATA
&__DDRSS0_PHY_1200_DATA=0x00000000
LOCAL &__DDRSS0_PHY_1201_DATA
&__DDRSS0_PHY_1201_DATA=0x00000000
LOCAL &__DDRSS0_PHY_1202_DATA
&__DDRSS0_PHY_1202_DATA=0x00000000
LOCAL &__DDRSS0_PHY_1203_DATA
&__DDRSS0_PHY_1203_DATA=0x00000000
LOCAL &__DDRSS0_PHY_1204_DATA
&__DDRSS0_PHY_1204_DATA=0x00000000
LOCAL &__DDRSS0_PHY_1205_DATA
&__DDRSS0_PHY_1205_DATA=0x00000000
LOCAL &__DDRSS0_PHY_1206_DATA
&__DDRSS0_PHY_1206_DATA=0x00000000
LOCAL &__DDRSS0_PHY_1207_DATA
&__DDRSS0_PHY_1207_DATA=0x00000000
LOCAL &__DDRSS0_PHY_1208_DATA
&__DDRSS0_PHY_1208_DATA=0x00000000
LOCAL &__DDRSS0_PHY_1209_DATA
&__DDRSS0_PHY_1209_DATA=0x00000000
LOCAL &__DDRSS0_PHY_1210_DATA
&__DDRSS0_PHY_1210_DATA=0x00000000
LOCAL &__DDRSS0_PHY_1211_DATA
&__DDRSS0_PHY_1211_DATA=0x00000000
LOCAL &__DDRSS0_PHY_1212_DATA
&__DDRSS0_PHY_1212_DATA=0x00000000
LOCAL &__DDRSS0_PHY_1213_DATA
&__DDRSS0_PHY_1213_DATA=0x00000000
LOCAL &__DDRSS0_PHY_1214_DATA
&__DDRSS0_PHY_1214_DATA=0x00000000
LOCAL &__DDRSS0_PHY_1215_DATA
&__DDRSS0_PHY_1215_DATA=0x00000000
LOCAL &__DDRSS0_PHY_1216_DATA
&__DDRSS0_PHY_1216_DATA=0x00000000
LOCAL &__DDRSS0_PHY_1217_DATA
&__DDRSS0_PHY_1217_DATA=0x00000000
LOCAL &__DDRSS0_PHY_1218_DATA
&__DDRSS0_PHY_1218_DATA=0x00000000
LOCAL &__DDRSS0_PHY_1219_DATA
&__DDRSS0_PHY_1219_DATA=0x00000000
LOCAL &__DDRSS0_PHY_1220_DATA
&__DDRSS0_PHY_1220_DATA=0x00000000
LOCAL &__DDRSS0_PHY_1221_DATA
&__DDRSS0_PHY_1221_DATA=0x00000000
LOCAL &__DDRSS0_PHY_1222_DATA
&__DDRSS0_PHY_1222_DATA=0x00000000
LOCAL &__DDRSS0_PHY_1223_DATA
&__DDRSS0_PHY_1223_DATA=0x00000000
LOCAL &__DDRSS0_PHY_1224_DATA
&__DDRSS0_PHY_1224_DATA=0x00000000
LOCAL &__DDRSS0_PHY_1225_DATA
&__DDRSS0_PHY_1225_DATA=0x00000000
LOCAL &__DDRSS0_PHY_1226_DATA
&__DDRSS0_PHY_1226_DATA=0x00000000
LOCAL &__DDRSS0_PHY_1227_DATA
&__DDRSS0_PHY_1227_DATA=0x00000000
LOCAL &__DDRSS0_PHY_1228_DATA
&__DDRSS0_PHY_1228_DATA=0x00000000
LOCAL &__DDRSS0_PHY_1229_DATA
&__DDRSS0_PHY_1229_DATA=0x00000000
LOCAL &__DDRSS0_PHY_1230_DATA
&__DDRSS0_PHY_1230_DATA=0x00000000
LOCAL &__DDRSS0_PHY_1231_DATA
&__DDRSS0_PHY_1231_DATA=0x00000000
LOCAL &__DDRSS0_PHY_1232_DATA
&__DDRSS0_PHY_1232_DATA=0x00000000
LOCAL &__DDRSS0_PHY_1233_DATA
&__DDRSS0_PHY_1233_DATA=0x00000000
LOCAL &__DDRSS0_PHY_1234_DATA
&__DDRSS0_PHY_1234_DATA=0x00000000
LOCAL &__DDRSS0_PHY_1235_DATA
&__DDRSS0_PHY_1235_DATA=0x00000000
LOCAL &__DDRSS0_PHY_1236_DATA
&__DDRSS0_PHY_1236_DATA=0x00000000
LOCAL &__DDRSS0_PHY_1237_DATA
&__DDRSS0_PHY_1237_DATA=0x00000000
LOCAL &__DDRSS0_PHY_1238_DATA
&__DDRSS0_PHY_1238_DATA=0x00000000
LOCAL &__DDRSS0_PHY_1239_DATA
&__DDRSS0_PHY_1239_DATA=0x00000000
LOCAL &__DDRSS0_PHY_1240_DATA
&__DDRSS0_PHY_1240_DATA=0x00000000
LOCAL &__DDRSS0_PHY_1241_DATA
&__DDRSS0_PHY_1241_DATA=0x00000000
LOCAL &__DDRSS0_PHY_1242_DATA
&__DDRSS0_PHY_1242_DATA=0x00000000
LOCAL &__DDRSS0_PHY_1243_DATA
&__DDRSS0_PHY_1243_DATA=0x00000000
LOCAL &__DDRSS0_PHY_1244_DATA
&__DDRSS0_PHY_1244_DATA=0x00000000
LOCAL &__DDRSS0_PHY_1245_DATA
&__DDRSS0_PHY_1245_DATA=0x00000000
LOCAL &__DDRSS0_PHY_1246_DATA
&__DDRSS0_PHY_1246_DATA=0x00000000
LOCAL &__DDRSS0_PHY_1247_DATA
&__DDRSS0_PHY_1247_DATA=0x00000000
LOCAL &__DDRSS0_PHY_1248_DATA
&__DDRSS0_PHY_1248_DATA=0x00000000
LOCAL &__DDRSS0_PHY_1249_DATA
&__DDRSS0_PHY_1249_DATA=0x00000000
LOCAL &__DDRSS0_PHY_1250_DATA
&__DDRSS0_PHY_1250_DATA=0x00000000
LOCAL &__DDRSS0_PHY_1251_DATA
&__DDRSS0_PHY_1251_DATA=0x00000000
LOCAL &__DDRSS0_PHY_1252_DATA
&__DDRSS0_PHY_1252_DATA=0x00000000
LOCAL &__DDRSS0_PHY_1253_DATA
&__DDRSS0_PHY_1253_DATA=0x00000000
LOCAL &__DDRSS0_PHY_1254_DATA
&__DDRSS0_PHY_1254_DATA=0x00000000
LOCAL &__DDRSS0_PHY_1255_DATA
&__DDRSS0_PHY_1255_DATA=0x00000000
LOCAL &__DDRSS0_PHY_1256_DATA
&__DDRSS0_PHY_1256_DATA=0x00000000
LOCAL &__DDRSS0_PHY_1257_DATA
&__DDRSS0_PHY_1257_DATA=0x00000000
LOCAL &__DDRSS0_PHY_1258_DATA
&__DDRSS0_PHY_1258_DATA=0x00000000
LOCAL &__DDRSS0_PHY_1259_DATA
&__DDRSS0_PHY_1259_DATA=0x00000000
LOCAL &__DDRSS0_PHY_1260_DATA
&__DDRSS0_PHY_1260_DATA=0x00000000
LOCAL &__DDRSS0_PHY_1261_DATA
&__DDRSS0_PHY_1261_DATA=0x00000000
LOCAL &__DDRSS0_PHY_1262_DATA
&__DDRSS0_PHY_1262_DATA=0x00000000
LOCAL &__DDRSS0_PHY_1263_DATA
&__DDRSS0_PHY_1263_DATA=0x00000000
LOCAL &__DDRSS0_PHY_1264_DATA
&__DDRSS0_PHY_1264_DATA=0x00000000
LOCAL &__DDRSS0_PHY_1265_DATA
&__DDRSS0_PHY_1265_DATA=0x00000000
LOCAL &__DDRSS0_PHY_1266_DATA
&__DDRSS0_PHY_1266_DATA=0x00000000
LOCAL &__DDRSS0_PHY_1267_DATA
&__DDRSS0_PHY_1267_DATA=0x00000000
LOCAL &__DDRSS0_PHY_1268_DATA
&__DDRSS0_PHY_1268_DATA=0x00000000
LOCAL &__DDRSS0_PHY_1269_DATA
&__DDRSS0_PHY_1269_DATA=0x00000000
LOCAL &__DDRSS0_PHY_1270_DATA
&__DDRSS0_PHY_1270_DATA=0x00000000
LOCAL &__DDRSS0_PHY_1271_DATA
&__DDRSS0_PHY_1271_DATA=0x00000000
LOCAL &__DDRSS0_PHY_1272_DATA
&__DDRSS0_PHY_1272_DATA=0x00000000
LOCAL &__DDRSS0_PHY_1273_DATA
&__DDRSS0_PHY_1273_DATA=0x00000000
LOCAL &__DDRSS0_PHY_1274_DATA
&__DDRSS0_PHY_1274_DATA=0x00000000
LOCAL &__DDRSS0_PHY_1275_DATA
&__DDRSS0_PHY_1275_DATA=0x00000000
LOCAL &__DDRSS0_PHY_1276_DATA
&__DDRSS0_PHY_1276_DATA=0x00000000
LOCAL &__DDRSS0_PHY_1277_DATA
&__DDRSS0_PHY_1277_DATA=0x00000000
LOCAL &__DDRSS0_PHY_1278_DATA
&__DDRSS0_PHY_1278_DATA=0x00000000
LOCAL &__DDRSS0_PHY_1279_DATA
&__DDRSS0_PHY_1279_DATA=0x00000000
LOCAL &__DDRSS0_PHY_1280_DATA
&__DDRSS0_PHY_1280_DATA=0x00000000
LOCAL &__DDRSS0_PHY_1281_DATA
&__DDRSS0_PHY_1281_DATA=0x00010100
LOCAL &__DDRSS0_PHY_1282_DATA
&__DDRSS0_PHY_1282_DATA=0x00000000
LOCAL &__DDRSS0_PHY_1283_DATA
&__DDRSS0_PHY_1283_DATA=0x00000000
LOCAL &__DDRSS0_PHY_1284_DATA
&__DDRSS0_PHY_1284_DATA=0x00050000
LOCAL &__DDRSS0_PHY_1285_DATA
&__DDRSS0_PHY_1285_DATA=0x04000000
LOCAL &__DDRSS0_PHY_1286_DATA
&__DDRSS0_PHY_1286_DATA=0x00000055
LOCAL &__DDRSS0_PHY_1287_DATA
&__DDRSS0_PHY_1287_DATA=0x00000000
LOCAL &__DDRSS0_PHY_1288_DATA
&__DDRSS0_PHY_1288_DATA=0x00000000
LOCAL &__DDRSS0_PHY_1289_DATA
&__DDRSS0_PHY_1289_DATA=0x00000000
LOCAL &__DDRSS0_PHY_1290_DATA
&__DDRSS0_PHY_1290_DATA=0x00000000
LOCAL &__DDRSS0_PHY_1291_DATA
&__DDRSS0_PHY_1291_DATA=0x00002001
LOCAL &__DDRSS0_PHY_1292_DATA
&__DDRSS0_PHY_1292_DATA=0x0000400F
LOCAL &__DDRSS0_PHY_1293_DATA
&__DDRSS0_PHY_1293_DATA=0x50020028
LOCAL &__DDRSS0_PHY_1294_DATA
&__DDRSS0_PHY_1294_DATA=0x01010000
LOCAL &__DDRSS0_PHY_1295_DATA
&__DDRSS0_PHY_1295_DATA=0x80080001
LOCAL &__DDRSS0_PHY_1296_DATA
&__DDRSS0_PHY_1296_DATA=0x10200000
LOCAL &__DDRSS0_PHY_1297_DATA
&__DDRSS0_PHY_1297_DATA=0x00000008
LOCAL &__DDRSS0_PHY_1298_DATA
&__DDRSS0_PHY_1298_DATA=0x00000000
LOCAL &__DDRSS0_PHY_1299_DATA
&__DDRSS0_PHY_1299_DATA=0x01090E00
LOCAL &__DDRSS0_PHY_1300_DATA
&__DDRSS0_PHY_1300_DATA=0x00040101
LOCAL &__DDRSS0_PHY_1301_DATA
&__DDRSS0_PHY_1301_DATA=0x0000010F
LOCAL &__DDRSS0_PHY_1302_DATA
&__DDRSS0_PHY_1302_DATA=0x00000000
LOCAL &__DDRSS0_PHY_1303_DATA
&__DDRSS0_PHY_1303_DATA=0x0000FFFF
LOCAL &__DDRSS0_PHY_1304_DATA
&__DDRSS0_PHY_1304_DATA=0x00000000
LOCAL &__DDRSS0_PHY_1305_DATA
&__DDRSS0_PHY_1305_DATA=0x01010000
LOCAL &__DDRSS0_PHY_1306_DATA
&__DDRSS0_PHY_1306_DATA=0x01080402
LOCAL &__DDRSS0_PHY_1307_DATA
&__DDRSS0_PHY_1307_DATA=0x01200F02
LOCAL &__DDRSS0_PHY_1308_DATA
&__DDRSS0_PHY_1308_DATA=0x00194280
LOCAL &__DDRSS0_PHY_1309_DATA
&__DDRSS0_PHY_1309_DATA=0x00000004
LOCAL &__DDRSS0_PHY_1310_DATA
&__DDRSS0_PHY_1310_DATA=0x00052000
LOCAL &__DDRSS0_PHY_1311_DATA
&__DDRSS0_PHY_1311_DATA=0x00000000
LOCAL &__DDRSS0_PHY_1312_DATA
&__DDRSS0_PHY_1312_DATA=0x00000000
LOCAL &__DDRSS0_PHY_1313_DATA
&__DDRSS0_PHY_1313_DATA=0x00000000
LOCAL &__DDRSS0_PHY_1314_DATA
&__DDRSS0_PHY_1314_DATA=0x00000000
LOCAL &__DDRSS0_PHY_1315_DATA
&__DDRSS0_PHY_1315_DATA=0x00000000
LOCAL &__DDRSS0_PHY_1316_DATA
&__DDRSS0_PHY_1316_DATA=0x00000000
LOCAL &__DDRSS0_PHY_1317_DATA
&__DDRSS0_PHY_1317_DATA=0x01000000
LOCAL &__DDRSS0_PHY_1318_DATA
&__DDRSS0_PHY_1318_DATA=0x00000705
LOCAL &__DDRSS0_PHY_1319_DATA
&__DDRSS0_PHY_1319_DATA=0x00000054
LOCAL &__DDRSS0_PHY_1320_DATA
&__DDRSS0_PHY_1320_DATA=0x00030820
LOCAL &__DDRSS0_PHY_1321_DATA
&__DDRSS0_PHY_1321_DATA=0x00010820
LOCAL &__DDRSS0_PHY_1322_DATA
&__DDRSS0_PHY_1322_DATA=0x00010820
LOCAL &__DDRSS0_PHY_1323_DATA
&__DDRSS0_PHY_1323_DATA=0x00010820
LOCAL &__DDRSS0_PHY_1324_DATA
&__DDRSS0_PHY_1324_DATA=0x00010820
LOCAL &__DDRSS0_PHY_1325_DATA
&__DDRSS0_PHY_1325_DATA=0x00010820
LOCAL &__DDRSS0_PHY_1326_DATA
&__DDRSS0_PHY_1326_DATA=0x00010820
LOCAL &__DDRSS0_PHY_1327_DATA
&__DDRSS0_PHY_1327_DATA=0x00010820
LOCAL &__DDRSS0_PHY_1328_DATA
&__DDRSS0_PHY_1328_DATA=0x00010820
LOCAL &__DDRSS0_PHY_1329_DATA
&__DDRSS0_PHY_1329_DATA=0x00000000
LOCAL &__DDRSS0_PHY_1330_DATA
&__DDRSS0_PHY_1330_DATA=0x00000074
LOCAL &__DDRSS0_PHY_1331_DATA
&__DDRSS0_PHY_1331_DATA=0x00000400
LOCAL &__DDRSS0_PHY_1332_DATA
&__DDRSS0_PHY_1332_DATA=0x00000108
LOCAL &__DDRSS0_PHY_1333_DATA
&__DDRSS0_PHY_1333_DATA=0x00000000
LOCAL &__DDRSS0_PHY_1334_DATA
&__DDRSS0_PHY_1334_DATA=0x00000000
LOCAL &__DDRSS0_PHY_1335_DATA
&__DDRSS0_PHY_1335_DATA=0x00000000
LOCAL &__DDRSS0_PHY_1336_DATA
&__DDRSS0_PHY_1336_DATA=0x00000000
LOCAL &__DDRSS0_PHY_1337_DATA
&__DDRSS0_PHY_1337_DATA=0x00000000
LOCAL &__DDRSS0_PHY_1338_DATA
&__DDRSS0_PHY_1338_DATA=0x03000000
LOCAL &__DDRSS0_PHY_1339_DATA
&__DDRSS0_PHY_1339_DATA=0x00000000
LOCAL &__DDRSS0_PHY_1340_DATA
&__DDRSS0_PHY_1340_DATA=0x00000000
LOCAL &__DDRSS0_PHY_1341_DATA
&__DDRSS0_PHY_1341_DATA=0x00000000
LOCAL &__DDRSS0_PHY_1342_DATA
&__DDRSS0_PHY_1342_DATA=0x04102006
LOCAL &__DDRSS0_PHY_1343_DATA
&__DDRSS0_PHY_1343_DATA=0x00041020
LOCAL &__DDRSS0_PHY_1344_DATA
&__DDRSS0_PHY_1344_DATA=0x01C98C98
LOCAL &__DDRSS0_PHY_1345_DATA
&__DDRSS0_PHY_1345_DATA=0x3F400000
LOCAL &__DDRSS0_PHY_1346_DATA
&__DDRSS0_PHY_1346_DATA=0x3F3F1F3F
LOCAL &__DDRSS0_PHY_1347_DATA
&__DDRSS0_PHY_1347_DATA=0x0000001F
LOCAL &__DDRSS0_PHY_1348_DATA
&__DDRSS0_PHY_1348_DATA=0x00000000
LOCAL &__DDRSS0_PHY_1349_DATA
&__DDRSS0_PHY_1349_DATA=0x00000000
LOCAL &__DDRSS0_PHY_1350_DATA
&__DDRSS0_PHY_1350_DATA=0x00000000
LOCAL &__DDRSS0_PHY_1351_DATA
&__DDRSS0_PHY_1351_DATA=0x00010000
LOCAL &__DDRSS0_PHY_1352_DATA
&__DDRSS0_PHY_1352_DATA=0x00000000
LOCAL &__DDRSS0_PHY_1353_DATA
&__DDRSS0_PHY_1353_DATA=0x00000000
LOCAL &__DDRSS0_PHY_1354_DATA
&__DDRSS0_PHY_1354_DATA=0x00000000
LOCAL &__DDRSS0_PHY_1355_DATA
&__DDRSS0_PHY_1355_DATA=0x00000000
LOCAL &__DDRSS0_PHY_1356_DATA
&__DDRSS0_PHY_1356_DATA=0x76543210
LOCAL &__DDRSS0_PHY_1357_DATA
&__DDRSS0_PHY_1357_DATA=0x00010198
LOCAL &__DDRSS0_PHY_1358_DATA
&__DDRSS0_PHY_1358_DATA=0x00000000
LOCAL &__DDRSS0_PHY_1359_DATA
&__DDRSS0_PHY_1359_DATA=0x00000000
LOCAL &__DDRSS0_PHY_1360_DATA
&__DDRSS0_PHY_1360_DATA=0x00000000
LOCAL &__DDRSS0_PHY_1361_DATA
&__DDRSS0_PHY_1361_DATA=0x00040700
LOCAL &__DDRSS0_PHY_1362_DATA
&__DDRSS0_PHY_1362_DATA=0x00000000
LOCAL &__DDRSS0_PHY_1363_DATA
&__DDRSS0_PHY_1363_DATA=0x00000000
LOCAL &__DDRSS0_PHY_1364_DATA
&__DDRSS0_PHY_1364_DATA=0x00000000
LOCAL &__DDRSS0_PHY_1365_DATA
&__DDRSS0_PHY_1365_DATA=0x00000000
LOCAL &__DDRSS0_PHY_1366_DATA
&__DDRSS0_PHY_1366_DATA=0x00000000
LOCAL &__DDRSS0_PHY_1367_DATA
&__DDRSS0_PHY_1367_DATA=0x00000002
LOCAL &__DDRSS0_PHY_1368_DATA
&__DDRSS0_PHY_1368_DATA=0x00000000
LOCAL &__DDRSS0_PHY_1369_DATA
&__DDRSS0_PHY_1369_DATA=0x00000000
LOCAL &__DDRSS0_PHY_1370_DATA
&__DDRSS0_PHY_1370_DATA=0x00000000
LOCAL &__DDRSS0_PHY_1371_DATA
&__DDRSS0_PHY_1371_DATA=0x00000000
LOCAL &__DDRSS0_PHY_1372_DATA
&__DDRSS0_PHY_1372_DATA=0x00000000
LOCAL &__DDRSS0_PHY_1373_DATA
&__DDRSS0_PHY_1373_DATA=0x00000000
LOCAL &__DDRSS0_PHY_1374_DATA
&__DDRSS0_PHY_1374_DATA=0x00080000
LOCAL &__DDRSS0_PHY_1375_DATA
&__DDRSS0_PHY_1375_DATA=0x000007FF
LOCAL &__DDRSS0_PHY_1376_DATA
&__DDRSS0_PHY_1376_DATA=0x00000000
LOCAL &__DDRSS0_PHY_1377_DATA
&__DDRSS0_PHY_1377_DATA=0x00000000
LOCAL &__DDRSS0_PHY_1378_DATA
&__DDRSS0_PHY_1378_DATA=0x00000000
LOCAL &__DDRSS0_PHY_1379_DATA
&__DDRSS0_PHY_1379_DATA=0x00000000
LOCAL &__DDRSS0_PHY_1380_DATA
&__DDRSS0_PHY_1380_DATA=0x00000000
LOCAL &__DDRSS0_PHY_1381_DATA
&__DDRSS0_PHY_1381_DATA=0x00000000
LOCAL &__DDRSS0_PHY_1382_DATA
&__DDRSS0_PHY_1382_DATA=0x000FFFFF
LOCAL &__DDRSS0_PHY_1383_DATA
&__DDRSS0_PHY_1383_DATA=0x000FFFFF
LOCAL &__DDRSS0_PHY_1384_DATA
&__DDRSS0_PHY_1384_DATA=0x0000FFFF
LOCAL &__DDRSS0_PHY_1385_DATA
&__DDRSS0_PHY_1385_DATA=0xFFFFFFF0
LOCAL &__DDRSS0_PHY_1386_DATA
&__DDRSS0_PHY_1386_DATA=0x030FFFFF
LOCAL &__DDRSS0_PHY_1387_DATA
&__DDRSS0_PHY_1387_DATA=0x01FFFFFF
LOCAL &__DDRSS0_PHY_1388_DATA
&__DDRSS0_PHY_1388_DATA=0x0000FFFF
LOCAL &__DDRSS0_PHY_1389_DATA
&__DDRSS0_PHY_1389_DATA=0x00000000
LOCAL &__DDRSS0_PHY_1390_DATA
&__DDRSS0_PHY_1390_DATA=0x00000000
LOCAL &__DDRSS0_PHY_1391_DATA
&__DDRSS0_PHY_1391_DATA=0x00000000
LOCAL &__DDRSS0_PHY_1392_DATA
&__DDRSS0_PHY_1392_DATA=0x00000000
LOCAL &__DDRSS0_PHY_1393_DATA
&__DDRSS0_PHY_1393_DATA=0x0001F7C0
LOCAL &__DDRSS0_PHY_1394_DATA
&__DDRSS0_PHY_1394_DATA=0x00000002
LOCAL &__DDRSS0_PHY_1395_DATA
&__DDRSS0_PHY_1395_DATA=0x00000000
LOCAL &__DDRSS0_PHY_1396_DATA
&__DDRSS0_PHY_1396_DATA=0x00001142
LOCAL &__DDRSS0_PHY_1397_DATA
&__DDRSS0_PHY_1397_DATA=0x010207AB
LOCAL &__DDRSS0_PHY_1398_DATA
&__DDRSS0_PHY_1398_DATA=0x01000080
LOCAL &__DDRSS0_PHY_1399_DATA
&__DDRSS0_PHY_1399_DATA=0x03900390
LOCAL &__DDRSS0_PHY_1400_DATA
&__DDRSS0_PHY_1400_DATA=0x03900390
LOCAL &__DDRSS0_PHY_1401_DATA
&__DDRSS0_PHY_1401_DATA=0x00000390
LOCAL &__DDRSS0_PHY_1402_DATA
&__DDRSS0_PHY_1402_DATA=0x00000390
LOCAL &__DDRSS0_PHY_1403_DATA
&__DDRSS0_PHY_1403_DATA=0x00000390
LOCAL &__DDRSS0_PHY_1404_DATA
&__DDRSS0_PHY_1404_DATA=0x00000390
LOCAL &__DDRSS0_PHY_1405_DATA
&__DDRSS0_PHY_1405_DATA=0x00000005
LOCAL &__DDRSS0_PHY_1406_DATA
&__DDRSS0_PHY_1406_DATA=0x01813FCC
LOCAL &__DDRSS0_PHY_1407_DATA
&__DDRSS0_PHY_1407_DATA=0x000000CC
LOCAL &__DDRSS0_PHY_1408_DATA
&__DDRSS0_PHY_1408_DATA=0x0C000DFF
LOCAL &__DDRSS0_PHY_1409_DATA
&__DDRSS0_PHY_1409_DATA=0x30000DFF
LOCAL &__DDRSS0_PHY_1410_DATA
&__DDRSS0_PHY_1410_DATA=0x3F0DFF11
LOCAL &__DDRSS0_PHY_1411_DATA
&__DDRSS0_PHY_1411_DATA=0x000100F0
LOCAL &__DDRSS0_PHY_1412_DATA
&__DDRSS0_PHY_1412_DATA=0x780DFFCC
LOCAL &__DDRSS0_PHY_1413_DATA
&__DDRSS0_PHY_1413_DATA=0x00007E31
LOCAL &__DDRSS0_PHY_1414_DATA
&__DDRSS0_PHY_1414_DATA=0x000CBF11
LOCAL &__DDRSS0_PHY_1415_DATA
&__DDRSS0_PHY_1415_DATA=0x01990010
LOCAL &__DDRSS0_PHY_1416_DATA
&__DDRSS0_PHY_1416_DATA=0x000CBF11
LOCAL &__DDRSS0_PHY_1417_DATA
&__DDRSS0_PHY_1417_DATA=0x01990010
LOCAL &__DDRSS0_PHY_1418_DATA
&__DDRSS0_PHY_1418_DATA=0x3F0DFF11
LOCAL &__DDRSS0_PHY_1419_DATA
&__DDRSS0_PHY_1419_DATA=0x00EF00F0
LOCAL &__DDRSS0_PHY_1420_DATA
&__DDRSS0_PHY_1420_DATA=0x3F0DFF11
LOCAL &__DDRSS0_PHY_1421_DATA
&__DDRSS0_PHY_1421_DATA=0x01FF00F0
LOCAL &__DDRSS0_PHY_1422_DATA
&__DDRSS0_PHY_1422_DATA=0x20040006
LOCAL &__DDRSS1_CTL_00_DATA
&__DDRSS1_CTL_00_DATA=0x00000B00
LOCAL &__DDRSS1_CTL_01_DATA
&__DDRSS1_CTL_01_DATA=0x00000000
LOCAL &__DDRSS1_CTL_02_DATA
&__DDRSS1_CTL_02_DATA=0x00000000
LOCAL &__DDRSS1_CTL_03_DATA
&__DDRSS1_CTL_03_DATA=0x00000000
LOCAL &__DDRSS1_CTL_04_DATA
&__DDRSS1_CTL_04_DATA=0x00000000
LOCAL &__DDRSS1_CTL_05_DATA
&__DDRSS1_CTL_05_DATA=0x00000000
LOCAL &__DDRSS1_CTL_06_DATA
&__DDRSS1_CTL_06_DATA=0x00000000
LOCAL &__DDRSS1_CTL_07_DATA
&__DDRSS1_CTL_07_DATA=0x00002AF8
LOCAL &__DDRSS1_CTL_08_DATA
&__DDRSS1_CTL_08_DATA=0x0001ADAF
LOCAL &__DDRSS1_CTL_09_DATA
&__DDRSS1_CTL_09_DATA=0x00000005
LOCAL &__DDRSS1_CTL_10_DATA
&__DDRSS1_CTL_10_DATA=0x0000006E
LOCAL &__DDRSS1_CTL_11_DATA
&__DDRSS1_CTL_11_DATA=0x000340E4
LOCAL &__DDRSS1_CTL_12_DATA
&__DDRSS1_CTL_12_DATA=0x002088E5
LOCAL &__DDRSS1_CTL_13_DATA
&__DDRSS1_CTL_13_DATA=0x00000005
LOCAL &__DDRSS1_CTL_14_DATA
&__DDRSS1_CTL_14_DATA=0x00000855
LOCAL &__DDRSS1_CTL_15_DATA
&__DDRSS1_CTL_15_DATA=0x000340E4
LOCAL &__DDRSS1_CTL_16_DATA
&__DDRSS1_CTL_16_DATA=0x002088E5
LOCAL &__DDRSS1_CTL_17_DATA
&__DDRSS1_CTL_17_DATA=0x00000005
LOCAL &__DDRSS1_CTL_18_DATA
&__DDRSS1_CTL_18_DATA=0x00000855
LOCAL &__DDRSS1_CTL_19_DATA
&__DDRSS1_CTL_19_DATA=0x01010000
LOCAL &__DDRSS1_CTL_20_DATA
&__DDRSS1_CTL_20_DATA=0x02011001
LOCAL &__DDRSS1_CTL_21_DATA
&__DDRSS1_CTL_21_DATA=0x02010000
LOCAL &__DDRSS1_CTL_22_DATA
&__DDRSS1_CTL_22_DATA=0x00020100
LOCAL &__DDRSS1_CTL_23_DATA
&__DDRSS1_CTL_23_DATA=0x0000000B
LOCAL &__DDRSS1_CTL_24_DATA
&__DDRSS1_CTL_24_DATA=0x0000001C
LOCAL &__DDRSS1_CTL_25_DATA
&__DDRSS1_CTL_25_DATA=0x00000000
LOCAL &__DDRSS1_CTL_26_DATA
&__DDRSS1_CTL_26_DATA=0x00000000
LOCAL &__DDRSS1_CTL_27_DATA
&__DDRSS1_CTL_27_DATA=0x03020200
LOCAL &__DDRSS1_CTL_28_DATA
&__DDRSS1_CTL_28_DATA=0x00002B2B
LOCAL &__DDRSS1_CTL_29_DATA
&__DDRSS1_CTL_29_DATA=0x00100000
LOCAL &__DDRSS1_CTL_30_DATA
&__DDRSS1_CTL_30_DATA=0x00000000
LOCAL &__DDRSS1_CTL_31_DATA
&__DDRSS1_CTL_31_DATA=0x00000000
LOCAL &__DDRSS1_CTL_32_DATA
&__DDRSS1_CTL_32_DATA=0x00000000
LOCAL &__DDRSS1_CTL_33_DATA
&__DDRSS1_CTL_33_DATA=0x00000000
LOCAL &__DDRSS1_CTL_34_DATA
&__DDRSS1_CTL_34_DATA=0x040C0000
LOCAL &__DDRSS1_CTL_35_DATA
&__DDRSS1_CTL_35_DATA=0x0A280A28
LOCAL &__DDRSS1_CTL_36_DATA
&__DDRSS1_CTL_36_DATA=0x00050804
LOCAL &__DDRSS1_CTL_37_DATA
&__DDRSS1_CTL_37_DATA=0x09040008
LOCAL &__DDRSS1_CTL_38_DATA
&__DDRSS1_CTL_38_DATA=0x0B000204
LOCAL &__DDRSS1_CTL_39_DATA
&__DDRSS1_CTL_39_DATA=0x0C300046
LOCAL &__DDRSS1_CTL_40_DATA
&__DDRSS1_CTL_40_DATA=0x0B002116
LOCAL &__DDRSS1_CTL_41_DATA
&__DDRSS1_CTL_41_DATA=0x0C300046
LOCAL &__DDRSS1_CTL_42_DATA
&__DDRSS1_CTL_42_DATA=0x20002116
LOCAL &__DDRSS1_CTL_43_DATA
&__DDRSS1_CTL_43_DATA=0x000A0A09
LOCAL &__DDRSS1_CTL_44_DATA
&__DDRSS1_CTL_44_DATA=0x0400078A
LOCAL &__DDRSS1_CTL_45_DATA
&__DDRSS1_CTL_45_DATA=0x0F0B0904
LOCAL &__DDRSS1_CTL_46_DATA
&__DDRSS1_CTL_46_DATA=0x0800922C
LOCAL &__DDRSS1_CTL_47_DATA
&__DDRSS1_CTL_47_DATA=0x0F0B0908
LOCAL &__DDRSS1_CTL_48_DATA
&__DDRSS1_CTL_48_DATA=0x0800922C
LOCAL &__DDRSS1_CTL_49_DATA
&__DDRSS1_CTL_49_DATA=0x02030408
LOCAL &__DDRSS1_CTL_50_DATA
&__DDRSS1_CTL_50_DATA=0x16040500
LOCAL &__DDRSS1_CTL_51_DATA
&__DDRSS1_CTL_51_DATA=0x08151615
LOCAL &__DDRSS1_CTL_52_DATA
&__DDRSS1_CTL_52_DATA=0x14000E0A
LOCAL &__DDRSS1_CTL_53_DATA
&__DDRSS1_CTL_53_DATA=0x02010A0A
LOCAL &__DDRSS1_CTL_54_DATA
&__DDRSS1_CTL_54_DATA=0x01010002
LOCAL &__DDRSS1_CTL_55_DATA
&__DDRSS1_CTL_55_DATA=0x042B2B08
LOCAL &__DDRSS1_CTL_56_DATA
&__DDRSS1_CTL_56_DATA=0x04191904
LOCAL &__DDRSS1_CTL_57_DATA
&__DDRSS1_CTL_57_DATA=0x00001919
LOCAL &__DDRSS1_CTL_58_DATA
&__DDRSS1_CTL_58_DATA=0x00010100
LOCAL &__DDRSS1_CTL_59_DATA
&__DDRSS1_CTL_59_DATA=0x03010000
LOCAL &__DDRSS1_CTL_60_DATA
&__DDRSS1_CTL_60_DATA=0x00001508
LOCAL &__DDRSS1_CTL_61_DATA
&__DDRSS1_CTL_61_DATA=0x000000CE
LOCAL &__DDRSS1_CTL_62_DATA
&__DDRSS1_CTL_62_DATA=0x00000196
LOCAL &__DDRSS1_CTL_63_DATA
&__DDRSS1_CTL_63_DATA=0x00001035
LOCAL &__DDRSS1_CTL_64_DATA
&__DDRSS1_CTL_64_DATA=0x00000196
LOCAL &__DDRSS1_CTL_65_DATA
&__DDRSS1_CTL_65_DATA=0x00001035
LOCAL &__DDRSS1_CTL_66_DATA
&__DDRSS1_CTL_66_DATA=0x00000005
LOCAL &__DDRSS1_CTL_67_DATA
&__DDRSS1_CTL_67_DATA=0x00050000
LOCAL &__DDRSS1_CTL_68_DATA
&__DDRSS1_CTL_68_DATA=0x00650012
LOCAL &__DDRSS1_CTL_69_DATA
&__DDRSS1_CTL_69_DATA=0x00650200
LOCAL &__DDRSS1_CTL_70_DATA
&__DDRSS1_CTL_70_DATA=0x00400200
LOCAL &__DDRSS1_CTL_71_DATA
&__DDRSS1_CTL_71_DATA=0x00120103
LOCAL &__DDRSS1_CTL_72_DATA
&__DDRSS1_CTL_72_DATA=0x00080005
LOCAL &__DDRSS1_CTL_73_DATA
&__DDRSS1_CTL_73_DATA=0x19080008
LOCAL &__DDRSS1_CTL_74_DATA
&__DDRSS1_CTL_74_DATA=0x05050119
LOCAL &__DDRSS1_CTL_75_DATA
&__DDRSS1_CTL_75_DATA=0x0201030A
LOCAL &__DDRSS1_CTL_76_DATA
&__DDRSS1_CTL_76_DATA=0x030F0806
LOCAL &__DDRSS1_CTL_77_DATA
&__DDRSS1_CTL_77_DATA=0x08060201
LOCAL &__DDRSS1_CTL_78_DATA
&__DDRSS1_CTL_78_DATA=0x0001030F
LOCAL &__DDRSS1_CTL_79_DATA
&__DDRSS1_CTL_79_DATA=0x00160016
LOCAL &__DDRSS1_CTL_80_DATA
&__DDRSS1_CTL_80_DATA=0x019E019E
LOCAL &__DDRSS1_CTL_81_DATA
&__DDRSS1_CTL_81_DATA=0x019E019E
LOCAL &__DDRSS1_CTL_82_DATA
&__DDRSS1_CTL_82_DATA=0x03050505
LOCAL &__DDRSS1_CTL_83_DATA
&__DDRSS1_CTL_83_DATA=0x03010303
LOCAL &__DDRSS1_CTL_84_DATA
&__DDRSS1_CTL_84_DATA=0x10060806
LOCAL &__DDRSS1_CTL_85_DATA
&__DDRSS1_CTL_85_DATA=0x03020803
LOCAL &__DDRSS1_CTL_86_DATA
&__DDRSS1_CTL_86_DATA=0x10060806
LOCAL &__DDRSS1_CTL_87_DATA
&__DDRSS1_CTL_87_DATA=0x03020803
LOCAL &__DDRSS1_CTL_88_DATA
&__DDRSS1_CTL_88_DATA=0x03010000
LOCAL &__DDRSS1_CTL_89_DATA
&__DDRSS1_CTL_89_DATA=0x00010000
LOCAL &__DDRSS1_CTL_90_DATA
&__DDRSS1_CTL_90_DATA=0x00000000
LOCAL &__DDRSS1_CTL_91_DATA
&__DDRSS1_CTL_91_DATA=0x00000000
LOCAL &__DDRSS1_CTL_92_DATA
&__DDRSS1_CTL_92_DATA=0x01000000
LOCAL &__DDRSS1_CTL_93_DATA
&__DDRSS1_CTL_93_DATA=0x80104002
LOCAL &__DDRSS1_CTL_94_DATA
&__DDRSS1_CTL_94_DATA=0x00000000
LOCAL &__DDRSS1_CTL_95_DATA
&__DDRSS1_CTL_95_DATA=0x00040005
LOCAL &__DDRSS1_CTL_96_DATA
&__DDRSS1_CTL_96_DATA=0x00000000
LOCAL &__DDRSS1_CTL_97_DATA
&__DDRSS1_CTL_97_DATA=0x00050000
LOCAL &__DDRSS1_CTL_98_DATA
&__DDRSS1_CTL_98_DATA=0x00000004
LOCAL &__DDRSS1_CTL_99_DATA
&__DDRSS1_CTL_99_DATA=0x00000000
LOCAL &__DDRSS1_CTL_100_DATA
&__DDRSS1_CTL_100_DATA=0x00040005
LOCAL &__DDRSS1_CTL_101_DATA
&__DDRSS1_CTL_101_DATA=0x00000000
LOCAL &__DDRSS1_CTL_102_DATA
&__DDRSS1_CTL_102_DATA=0x00003380
LOCAL &__DDRSS1_CTL_103_DATA
&__DDRSS1_CTL_103_DATA=0x00003380
LOCAL &__DDRSS1_CTL_104_DATA
&__DDRSS1_CTL_104_DATA=0x00003380
LOCAL &__DDRSS1_CTL_105_DATA
&__DDRSS1_CTL_105_DATA=0x00003380
LOCAL &__DDRSS1_CTL_106_DATA
&__DDRSS1_CTL_106_DATA=0x00003380
LOCAL &__DDRSS1_CTL_107_DATA
&__DDRSS1_CTL_107_DATA=0x00000000
LOCAL &__DDRSS1_CTL_108_DATA
&__DDRSS1_CTL_108_DATA=0x000005A2
LOCAL &__DDRSS1_CTL_109_DATA
&__DDRSS1_CTL_109_DATA=0x00040D40
LOCAL &__DDRSS1_CTL_110_DATA
&__DDRSS1_CTL_110_DATA=0x00040D40
LOCAL &__DDRSS1_CTL_111_DATA
&__DDRSS1_CTL_111_DATA=0x00040D40
LOCAL &__DDRSS1_CTL_112_DATA
&__DDRSS1_CTL_112_DATA=0x00040D40
LOCAL &__DDRSS1_CTL_113_DATA
&__DDRSS1_CTL_113_DATA=0x00040D40
LOCAL &__DDRSS1_CTL_114_DATA
&__DDRSS1_CTL_114_DATA=0x00000000
LOCAL &__DDRSS1_CTL_115_DATA
&__DDRSS1_CTL_115_DATA=0x00007173
LOCAL &__DDRSS1_CTL_116_DATA
&__DDRSS1_CTL_116_DATA=0x00040D40
LOCAL &__DDRSS1_CTL_117_DATA
&__DDRSS1_CTL_117_DATA=0x00040D40
LOCAL &__DDRSS1_CTL_118_DATA
&__DDRSS1_CTL_118_DATA=0x00040D40
LOCAL &__DDRSS1_CTL_119_DATA
&__DDRSS1_CTL_119_DATA=0x00040D40
LOCAL &__DDRSS1_CTL_120_DATA
&__DDRSS1_CTL_120_DATA=0x00040D40
LOCAL &__DDRSS1_CTL_121_DATA
&__DDRSS1_CTL_121_DATA=0x00000000
LOCAL &__DDRSS1_CTL_122_DATA
&__DDRSS1_CTL_122_DATA=0x00007173
LOCAL &__DDRSS1_CTL_123_DATA
&__DDRSS1_CTL_123_DATA=0x00000000
LOCAL &__DDRSS1_CTL_124_DATA
&__DDRSS1_CTL_124_DATA=0x00000000
LOCAL &__DDRSS1_CTL_125_DATA
&__DDRSS1_CTL_125_DATA=0x00000000
LOCAL &__DDRSS1_CTL_126_DATA
&__DDRSS1_CTL_126_DATA=0x00000000
LOCAL &__DDRSS1_CTL_127_DATA
&__DDRSS1_CTL_127_DATA=0x00000000
LOCAL &__DDRSS1_CTL_128_DATA
&__DDRSS1_CTL_128_DATA=0x00000000
LOCAL &__DDRSS1_CTL_129_DATA
&__DDRSS1_CTL_129_DATA=0x00000000
LOCAL &__DDRSS1_CTL_130_DATA
&__DDRSS1_CTL_130_DATA=0x00000000
LOCAL &__DDRSS1_CTL_131_DATA
&__DDRSS1_CTL_131_DATA=0x06030500
LOCAL &__DDRSS1_CTL_132_DATA
&__DDRSS1_CTL_132_DATA=0x00030603
LOCAL &__DDRSS1_CTL_133_DATA
&__DDRSS1_CTL_133_DATA=0x0A090000
LOCAL &__DDRSS1_CTL_134_DATA
&__DDRSS1_CTL_134_DATA=0x0A090701
LOCAL &__DDRSS1_CTL_135_DATA
&__DDRSS1_CTL_135_DATA=0x0900000E
LOCAL &__DDRSS1_CTL_136_DATA
&__DDRSS1_CTL_136_DATA=0x0907010A
LOCAL &__DDRSS1_CTL_137_DATA
&__DDRSS1_CTL_137_DATA=0x00000E0A
LOCAL &__DDRSS1_CTL_138_DATA
&__DDRSS1_CTL_138_DATA=0x07010A09
LOCAL &__DDRSS1_CTL_139_DATA
&__DDRSS1_CTL_139_DATA=0x000E0A09
LOCAL &__DDRSS1_CTL_140_DATA
&__DDRSS1_CTL_140_DATA=0x07000401
LOCAL &__DDRSS1_CTL_141_DATA
&__DDRSS1_CTL_141_DATA=0x00000000
LOCAL &__DDRSS1_CTL_142_DATA
&__DDRSS1_CTL_142_DATA=0x00000000
LOCAL &__DDRSS1_CTL_143_DATA
&__DDRSS1_CTL_143_DATA=0x00000000
LOCAL &__DDRSS1_CTL_144_DATA
&__DDRSS1_CTL_144_DATA=0x00000000
LOCAL &__DDRSS1_CTL_145_DATA
&__DDRSS1_CTL_145_DATA=0x00000000
LOCAL &__DDRSS1_CTL_146_DATA
&__DDRSS1_CTL_146_DATA=0x00000000
LOCAL &__DDRSS1_CTL_147_DATA
&__DDRSS1_CTL_147_DATA=0x00000000
LOCAL &__DDRSS1_CTL_148_DATA
&__DDRSS1_CTL_148_DATA=0x08080000
LOCAL &__DDRSS1_CTL_149_DATA
&__DDRSS1_CTL_149_DATA=0x01000000
LOCAL &__DDRSS1_CTL_150_DATA
&__DDRSS1_CTL_150_DATA=0x800000C0
LOCAL &__DDRSS1_CTL_151_DATA
&__DDRSS1_CTL_151_DATA=0x800000C0
LOCAL &__DDRSS1_CTL_152_DATA
&__DDRSS1_CTL_152_DATA=0x800000C0
LOCAL &__DDRSS1_CTL_153_DATA
&__DDRSS1_CTL_153_DATA=0x00000000
LOCAL &__DDRSS1_CTL_154_DATA
&__DDRSS1_CTL_154_DATA=0x00001500
LOCAL &__DDRSS1_CTL_155_DATA
&__DDRSS1_CTL_155_DATA=0x00000000
LOCAL &__DDRSS1_CTL_156_DATA
&__DDRSS1_CTL_156_DATA=0x00000001
LOCAL &__DDRSS1_CTL_157_DATA
&__DDRSS1_CTL_157_DATA=0x00000002
LOCAL &__DDRSS1_CTL_158_DATA
&__DDRSS1_CTL_158_DATA=0x0000100E
LOCAL &__DDRSS1_CTL_159_DATA
&__DDRSS1_CTL_159_DATA=0x00000000
LOCAL &__DDRSS1_CTL_160_DATA
&__DDRSS1_CTL_160_DATA=0x00000000
LOCAL &__DDRSS1_CTL_161_DATA
&__DDRSS1_CTL_161_DATA=0x00000000
LOCAL &__DDRSS1_CTL_162_DATA
&__DDRSS1_CTL_162_DATA=0x00000000
LOCAL &__DDRSS1_CTL_163_DATA
&__DDRSS1_CTL_163_DATA=0x00000000
LOCAL &__DDRSS1_CTL_164_DATA
&__DDRSS1_CTL_164_DATA=0x000B0000
LOCAL &__DDRSS1_CTL_165_DATA
&__DDRSS1_CTL_165_DATA=0x000E0006
LOCAL &__DDRSS1_CTL_166_DATA
&__DDRSS1_CTL_166_DATA=0x000E0404
LOCAL &__DDRSS1_CTL_167_DATA
&__DDRSS1_CTL_167_DATA=0x006B00D6
LOCAL &__DDRSS1_CTL_168_DATA
&__DDRSS1_CTL_168_DATA=0x0808010B
LOCAL &__DDRSS1_CTL_169_DATA
&__DDRSS1_CTL_169_DATA=0x00D6010B
LOCAL &__DDRSS1_CTL_170_DATA
&__DDRSS1_CTL_170_DATA=0x010B006B
LOCAL &__DDRSS1_CTL_171_DATA
&__DDRSS1_CTL_171_DATA=0x010B0808
LOCAL &__DDRSS1_CTL_172_DATA
&__DDRSS1_CTL_172_DATA=0x00000000
LOCAL &__DDRSS1_CTL_173_DATA
&__DDRSS1_CTL_173_DATA=0x00000000
LOCAL &__DDRSS1_CTL_174_DATA
&__DDRSS1_CTL_174_DATA=0x00000000
LOCAL &__DDRSS1_CTL_175_DATA
&__DDRSS1_CTL_175_DATA=0x1BB40084
LOCAL &__DDRSS1_CTL_176_DATA
&__DDRSS1_CTL_176_DATA=0x33001BB4
LOCAL &__DDRSS1_CTL_177_DATA
&__DDRSS1_CTL_177_DATA=0x00003333
LOCAL &__DDRSS1_CTL_178_DATA
&__DDRSS1_CTL_178_DATA=0x56000000
LOCAL &__DDRSS1_CTL_179_DATA
&__DDRSS1_CTL_179_DATA=0x27270056
LOCAL &__DDRSS1_CTL_180_DATA
&__DDRSS1_CTL_180_DATA=0x0F0F0000
LOCAL &__DDRSS1_CTL_181_DATA
&__DDRSS1_CTL_181_DATA=0x16000000
LOCAL &__DDRSS1_CTL_182_DATA
&__DDRSS1_CTL_182_DATA=0x00841616
LOCAL &__DDRSS1_CTL_183_DATA
&__DDRSS1_CTL_183_DATA=0x1BB41BB4
LOCAL &__DDRSS1_CTL_184_DATA
&__DDRSS1_CTL_184_DATA=0x33333300
LOCAL &__DDRSS1_CTL_185_DATA
&__DDRSS1_CTL_185_DATA=0x00000000
LOCAL &__DDRSS1_CTL_186_DATA
&__DDRSS1_CTL_186_DATA=0x00565600
LOCAL &__DDRSS1_CTL_187_DATA
&__DDRSS1_CTL_187_DATA=0x00002727
LOCAL &__DDRSS1_CTL_188_DATA
&__DDRSS1_CTL_188_DATA=0x00000F0F
LOCAL &__DDRSS1_CTL_189_DATA
&__DDRSS1_CTL_189_DATA=0x16161600
LOCAL &__DDRSS1_CTL_190_DATA
&__DDRSS1_CTL_190_DATA=0x00000020
LOCAL &__DDRSS1_CTL_191_DATA
&__DDRSS1_CTL_191_DATA=0x00000000
LOCAL &__DDRSS1_CTL_192_DATA
&__DDRSS1_CTL_192_DATA=0x00000001
LOCAL &__DDRSS1_CTL_193_DATA
&__DDRSS1_CTL_193_DATA=0x00000000
LOCAL &__DDRSS1_CTL_194_DATA
&__DDRSS1_CTL_194_DATA=0x01000000
LOCAL &__DDRSS1_CTL_195_DATA
&__DDRSS1_CTL_195_DATA=0x00000001
LOCAL &__DDRSS1_CTL_196_DATA
&__DDRSS1_CTL_196_DATA=0x00000000
LOCAL &__DDRSS1_CTL_197_DATA
&__DDRSS1_CTL_197_DATA=0x00000000
LOCAL &__DDRSS1_CTL_198_DATA
&__DDRSS1_CTL_198_DATA=0x00000000
LOCAL &__DDRSS1_CTL_199_DATA
&__DDRSS1_CTL_199_DATA=0x00000000
LOCAL &__DDRSS1_CTL_200_DATA
&__DDRSS1_CTL_200_DATA=0x00000000
LOCAL &__DDRSS1_CTL_201_DATA
&__DDRSS1_CTL_201_DATA=0x00000000
LOCAL &__DDRSS1_CTL_202_DATA
&__DDRSS1_CTL_202_DATA=0x00000000
LOCAL &__DDRSS1_CTL_203_DATA
&__DDRSS1_CTL_203_DATA=0x00000000
LOCAL &__DDRSS1_CTL_204_DATA
&__DDRSS1_CTL_204_DATA=0x00000000
LOCAL &__DDRSS1_CTL_205_DATA
&__DDRSS1_CTL_205_DATA=0x00000000
LOCAL &__DDRSS1_CTL_206_DATA
&__DDRSS1_CTL_206_DATA=0x02000000
LOCAL &__DDRSS1_CTL_207_DATA
&__DDRSS1_CTL_207_DATA=0x01080101
LOCAL &__DDRSS1_CTL_208_DATA
&__DDRSS1_CTL_208_DATA=0x00000000
LOCAL &__DDRSS1_CTL_209_DATA
&__DDRSS1_CTL_209_DATA=0x00000000
LOCAL &__DDRSS1_CTL_210_DATA
&__DDRSS1_CTL_210_DATA=0x00000000
LOCAL &__DDRSS1_CTL_211_DATA
&__DDRSS1_CTL_211_DATA=0x00000000
LOCAL &__DDRSS1_CTL_212_DATA
&__DDRSS1_CTL_212_DATA=0x00000000
LOCAL &__DDRSS1_CTL_213_DATA
&__DDRSS1_CTL_213_DATA=0x00000000
LOCAL &__DDRSS1_CTL_214_DATA
&__DDRSS1_CTL_214_DATA=0x00000000
LOCAL &__DDRSS1_CTL_215_DATA
&__DDRSS1_CTL_215_DATA=0x00000000
LOCAL &__DDRSS1_CTL_216_DATA
&__DDRSS1_CTL_216_DATA=0x00000000
LOCAL &__DDRSS1_CTL_217_DATA
&__DDRSS1_CTL_217_DATA=0x00000000
LOCAL &__DDRSS1_CTL_218_DATA
&__DDRSS1_CTL_218_DATA=0x00000000
LOCAL &__DDRSS1_CTL_219_DATA
&__DDRSS1_CTL_219_DATA=0x00000000
LOCAL &__DDRSS1_CTL_220_DATA
&__DDRSS1_CTL_220_DATA=0x00000000
LOCAL &__DDRSS1_CTL_221_DATA
&__DDRSS1_CTL_221_DATA=0x00000000
LOCAL &__DDRSS1_CTL_222_DATA
&__DDRSS1_CTL_222_DATA=0x00001000
LOCAL &__DDRSS1_CTL_223_DATA
&__DDRSS1_CTL_223_DATA=0x006403E8
LOCAL &__DDRSS1_CTL_224_DATA
&__DDRSS1_CTL_224_DATA=0x00000000
LOCAL &__DDRSS1_CTL_225_DATA
&__DDRSS1_CTL_225_DATA=0x00000000
LOCAL &__DDRSS1_CTL_226_DATA
&__DDRSS1_CTL_226_DATA=0x00000000
LOCAL &__DDRSS1_CTL_227_DATA
&__DDRSS1_CTL_227_DATA=0x15110000
LOCAL &__DDRSS1_CTL_228_DATA
&__DDRSS1_CTL_228_DATA=0x00040C18
LOCAL &__DDRSS1_CTL_229_DATA
&__DDRSS1_CTL_229_DATA=0x00000000
LOCAL &__DDRSS1_CTL_230_DATA
&__DDRSS1_CTL_230_DATA=0x00000000
LOCAL &__DDRSS1_CTL_231_DATA
&__DDRSS1_CTL_231_DATA=0x00000000
LOCAL &__DDRSS1_CTL_232_DATA
&__DDRSS1_CTL_232_DATA=0x00000000
LOCAL &__DDRSS1_CTL_233_DATA
&__DDRSS1_CTL_233_DATA=0x00000000
LOCAL &__DDRSS1_CTL_234_DATA
&__DDRSS1_CTL_234_DATA=0x00000000
LOCAL &__DDRSS1_CTL_235_DATA
&__DDRSS1_CTL_235_DATA=0x00000000
LOCAL &__DDRSS1_CTL_236_DATA
&__DDRSS1_CTL_236_DATA=0x00000000
LOCAL &__DDRSS1_CTL_237_DATA
&__DDRSS1_CTL_237_DATA=0x00000000
LOCAL &__DDRSS1_CTL_238_DATA
&__DDRSS1_CTL_238_DATA=0x00000000
LOCAL &__DDRSS1_CTL_239_DATA
&__DDRSS1_CTL_239_DATA=0x00000000
LOCAL &__DDRSS1_CTL_240_DATA
&__DDRSS1_CTL_240_DATA=0x00000000
LOCAL &__DDRSS1_CTL_241_DATA
&__DDRSS1_CTL_241_DATA=0x00000000
LOCAL &__DDRSS1_CTL_242_DATA
&__DDRSS1_CTL_242_DATA=0x00030000
LOCAL &__DDRSS1_CTL_243_DATA
&__DDRSS1_CTL_243_DATA=0x00000000
LOCAL &__DDRSS1_CTL_244_DATA
&__DDRSS1_CTL_244_DATA=0x00000000
LOCAL &__DDRSS1_CTL_245_DATA
&__DDRSS1_CTL_245_DATA=0x00000000
LOCAL &__DDRSS1_CTL_246_DATA
&__DDRSS1_CTL_246_DATA=0x00000000
LOCAL &__DDRSS1_CTL_247_DATA
&__DDRSS1_CTL_247_DATA=0x00000000
LOCAL &__DDRSS1_CTL_248_DATA
&__DDRSS1_CTL_248_DATA=0x00000000
LOCAL &__DDRSS1_CTL_249_DATA
&__DDRSS1_CTL_249_DATA=0x00000000
LOCAL &__DDRSS1_CTL_250_DATA
&__DDRSS1_CTL_250_DATA=0x00000000
LOCAL &__DDRSS1_CTL_251_DATA
&__DDRSS1_CTL_251_DATA=0x00000000
LOCAL &__DDRSS1_CTL_252_DATA
&__DDRSS1_CTL_252_DATA=0x00000000
LOCAL &__DDRSS1_CTL_253_DATA
&__DDRSS1_CTL_253_DATA=0x00000000
LOCAL &__DDRSS1_CTL_254_DATA
&__DDRSS1_CTL_254_DATA=0x00000000
LOCAL &__DDRSS1_CTL_255_DATA
&__DDRSS1_CTL_255_DATA=0x00000000
LOCAL &__DDRSS1_CTL_256_DATA
&__DDRSS1_CTL_256_DATA=0x00000000
LOCAL &__DDRSS1_CTL_257_DATA
&__DDRSS1_CTL_257_DATA=0x01000200
LOCAL &__DDRSS1_CTL_258_DATA
&__DDRSS1_CTL_258_DATA=0x00370040
LOCAL &__DDRSS1_CTL_259_DATA
&__DDRSS1_CTL_259_DATA=0x00020008
LOCAL &__DDRSS1_CTL_260_DATA
&__DDRSS1_CTL_260_DATA=0x00400100
LOCAL &__DDRSS1_CTL_261_DATA
&__DDRSS1_CTL_261_DATA=0x0020042B
LOCAL &__DDRSS1_CTL_262_DATA
&__DDRSS1_CTL_262_DATA=0x01000200
LOCAL &__DDRSS1_CTL_263_DATA
&__DDRSS1_CTL_263_DATA=0x042B0040
LOCAL &__DDRSS1_CTL_264_DATA
&__DDRSS1_CTL_264_DATA=0x00000020
LOCAL &__DDRSS1_CTL_265_DATA
&__DDRSS1_CTL_265_DATA=0x00360003
LOCAL &__DDRSS1_CTL_266_DATA
&__DDRSS1_CTL_266_DATA=0x01000036
LOCAL &__DDRSS1_CTL_267_DATA
&__DDRSS1_CTL_267_DATA=0x00000000
LOCAL &__DDRSS1_CTL_268_DATA
&__DDRSS1_CTL_268_DATA=0x00000000
LOCAL &__DDRSS1_CTL_269_DATA
&__DDRSS1_CTL_269_DATA=0x00000202
LOCAL &__DDRSS1_CTL_270_DATA
&__DDRSS1_CTL_270_DATA=0x00001FFF
LOCAL &__DDRSS1_CTL_271_DATA
&__DDRSS1_CTL_271_DATA=0x3FFF2000
LOCAL &__DDRSS1_CTL_272_DATA
&__DDRSS1_CTL_272_DATA=0x03FF0000
LOCAL &__DDRSS1_CTL_273_DATA
&__DDRSS1_CTL_273_DATA=0x000103FF
LOCAL &__DDRSS1_CTL_274_DATA
&__DDRSS1_CTL_274_DATA=0x0FFF0B00
LOCAL &__DDRSS1_CTL_275_DATA
&__DDRSS1_CTL_275_DATA=0x01010001
LOCAL &__DDRSS1_CTL_276_DATA
&__DDRSS1_CTL_276_DATA=0x01010101
LOCAL &__DDRSS1_CTL_277_DATA
&__DDRSS1_CTL_277_DATA=0x01180101
LOCAL &__DDRSS1_CTL_278_DATA
&__DDRSS1_CTL_278_DATA=0x00030000
LOCAL &__DDRSS1_CTL_279_DATA
&__DDRSS1_CTL_279_DATA=0x00000000
LOCAL &__DDRSS1_CTL_280_DATA
&__DDRSS1_CTL_280_DATA=0x00000000
LOCAL &__DDRSS1_CTL_281_DATA
&__DDRSS1_CTL_281_DATA=0x00000000
LOCAL &__DDRSS1_CTL_282_DATA
&__DDRSS1_CTL_282_DATA=0x00000000
LOCAL &__DDRSS1_CTL_283_DATA
&__DDRSS1_CTL_283_DATA=0x00000000
LOCAL &__DDRSS1_CTL_284_DATA
&__DDRSS1_CTL_284_DATA=0x00000000
LOCAL &__DDRSS1_CTL_285_DATA
&__DDRSS1_CTL_285_DATA=0x00000000
LOCAL &__DDRSS1_CTL_286_DATA
&__DDRSS1_CTL_286_DATA=0x00040101
LOCAL &__DDRSS1_CTL_287_DATA
&__DDRSS1_CTL_287_DATA=0x04010100
LOCAL &__DDRSS1_CTL_288_DATA
&__DDRSS1_CTL_288_DATA=0x00000000
LOCAL &__DDRSS1_CTL_289_DATA
&__DDRSS1_CTL_289_DATA=0x00000000
LOCAL &__DDRSS1_CTL_290_DATA
&__DDRSS1_CTL_290_DATA=0x03030300
LOCAL &__DDRSS1_CTL_291_DATA
&__DDRSS1_CTL_291_DATA=0x00000001
LOCAL &__DDRSS1_CTL_292_DATA
&__DDRSS1_CTL_292_DATA=0x00000000
LOCAL &__DDRSS1_CTL_293_DATA
&__DDRSS1_CTL_293_DATA=0x00000000
LOCAL &__DDRSS1_CTL_294_DATA
&__DDRSS1_CTL_294_DATA=0x00000000
LOCAL &__DDRSS1_CTL_295_DATA
&__DDRSS1_CTL_295_DATA=0x00000000
LOCAL &__DDRSS1_CTL_296_DATA
&__DDRSS1_CTL_296_DATA=0x00000000
LOCAL &__DDRSS1_CTL_297_DATA
&__DDRSS1_CTL_297_DATA=0x00000000
LOCAL &__DDRSS1_CTL_298_DATA
&__DDRSS1_CTL_298_DATA=0x00000000
LOCAL &__DDRSS1_CTL_299_DATA
&__DDRSS1_CTL_299_DATA=0x00000000
LOCAL &__DDRSS1_CTL_300_DATA
&__DDRSS1_CTL_300_DATA=0x00000000
LOCAL &__DDRSS1_CTL_301_DATA
&__DDRSS1_CTL_301_DATA=0x00000000
LOCAL &__DDRSS1_CTL_302_DATA
&__DDRSS1_CTL_302_DATA=0x00000000
LOCAL &__DDRSS1_CTL_303_DATA
&__DDRSS1_CTL_303_DATA=0x00000000
LOCAL &__DDRSS1_CTL_304_DATA
&__DDRSS1_CTL_304_DATA=0x00000000
LOCAL &__DDRSS1_CTL_305_DATA
&__DDRSS1_CTL_305_DATA=0x00000000
LOCAL &__DDRSS1_CTL_306_DATA
&__DDRSS1_CTL_306_DATA=0x00000000
LOCAL &__DDRSS1_CTL_307_DATA
&__DDRSS1_CTL_307_DATA=0x00000000
LOCAL &__DDRSS1_CTL_308_DATA
&__DDRSS1_CTL_308_DATA=0x00000000
LOCAL &__DDRSS1_CTL_309_DATA
&__DDRSS1_CTL_309_DATA=0x00000000
LOCAL &__DDRSS1_CTL_310_DATA
&__DDRSS1_CTL_310_DATA=0x00000000
LOCAL &__DDRSS1_CTL_311_DATA
&__DDRSS1_CTL_311_DATA=0x00000000
LOCAL &__DDRSS1_CTL_312_DATA
&__DDRSS1_CTL_312_DATA=0x00000000
LOCAL &__DDRSS1_CTL_313_DATA
&__DDRSS1_CTL_313_DATA=0x01000000
LOCAL &__DDRSS1_CTL_314_DATA
&__DDRSS1_CTL_314_DATA=0x00020201
LOCAL &__DDRSS1_CTL_315_DATA
&__DDRSS1_CTL_315_DATA=0x01000101
LOCAL &__DDRSS1_CTL_316_DATA
&__DDRSS1_CTL_316_DATA=0x01010001
LOCAL &__DDRSS1_CTL_317_DATA
&__DDRSS1_CTL_317_DATA=0x00010101
LOCAL &__DDRSS1_CTL_318_DATA
&__DDRSS1_CTL_318_DATA=0x05060603
LOCAL &__DDRSS1_CTL_319_DATA
&__DDRSS1_CTL_319_DATA=0x08081111
LOCAL &__DDRSS1_CTL_320_DATA
&__DDRSS1_CTL_320_DATA=0x00090308
LOCAL &__DDRSS1_CTL_321_DATA
&__DDRSS1_CTL_321_DATA=0x070A030F
LOCAL &__DDRSS1_CTL_322_DATA
&__DDRSS1_CTL_322_DATA=0x070A0306
LOCAL &__DDRSS1_CTL_323_DATA
&__DDRSS1_CTL_323_DATA=0x0A090006
LOCAL &__DDRSS1_CTL_324_DATA
&__DDRSS1_CTL_324_DATA=0x0100000A
LOCAL &__DDRSS1_CTL_325_DATA
&__DDRSS1_CTL_325_DATA=0x04020401
LOCAL &__DDRSS1_CTL_326_DATA
&__DDRSS1_CTL_326_DATA=0x00000002
LOCAL &__DDRSS1_CTL_327_DATA
&__DDRSS1_CTL_327_DATA=0x00000000
LOCAL &__DDRSS1_CTL_328_DATA
&__DDRSS1_CTL_328_DATA=0x00010000
LOCAL &__DDRSS1_CTL_329_DATA
&__DDRSS1_CTL_329_DATA=0x00280D00
LOCAL &__DDRSS1_CTL_330_DATA
&__DDRSS1_CTL_330_DATA=0x00000001
LOCAL &__DDRSS1_CTL_331_DATA
&__DDRSS1_CTL_331_DATA=0x00030001
LOCAL &__DDRSS1_CTL_332_DATA
&__DDRSS1_CTL_332_DATA=0x00000000
LOCAL &__DDRSS1_CTL_333_DATA
&__DDRSS1_CTL_333_DATA=0x00000000
LOCAL &__DDRSS1_CTL_334_DATA
&__DDRSS1_CTL_334_DATA=0x00000000
LOCAL &__DDRSS1_CTL_335_DATA
&__DDRSS1_CTL_335_DATA=0x00000000
LOCAL &__DDRSS1_CTL_336_DATA
&__DDRSS1_CTL_336_DATA=0x00000000
LOCAL &__DDRSS1_CTL_337_DATA
&__DDRSS1_CTL_337_DATA=0x00000000
LOCAL &__DDRSS1_CTL_338_DATA
&__DDRSS1_CTL_338_DATA=0x00000000
LOCAL &__DDRSS1_CTL_339_DATA
&__DDRSS1_CTL_339_DATA=0x00000000
LOCAL &__DDRSS1_CTL_340_DATA
&__DDRSS1_CTL_340_DATA=0x01000000
LOCAL &__DDRSS1_CTL_341_DATA
&__DDRSS1_CTL_341_DATA=0x00000001
LOCAL &__DDRSS1_CTL_342_DATA
&__DDRSS1_CTL_342_DATA=0x00010100
LOCAL &__DDRSS1_CTL_343_DATA
&__DDRSS1_CTL_343_DATA=0x03030000
LOCAL &__DDRSS1_CTL_344_DATA
&__DDRSS1_CTL_344_DATA=0x00000000
LOCAL &__DDRSS1_CTL_345_DATA
&__DDRSS1_CTL_345_DATA=0x00000000
LOCAL &__DDRSS1_CTL_346_DATA
&__DDRSS1_CTL_346_DATA=0x00000000
LOCAL &__DDRSS1_CTL_347_DATA
&__DDRSS1_CTL_347_DATA=0x00000000
LOCAL &__DDRSS1_CTL_348_DATA
&__DDRSS1_CTL_348_DATA=0x00000000
LOCAL &__DDRSS1_CTL_349_DATA
&__DDRSS1_CTL_349_DATA=0x00000000
LOCAL &__DDRSS1_CTL_350_DATA
&__DDRSS1_CTL_350_DATA=0x00000000
LOCAL &__DDRSS1_CTL_351_DATA
&__DDRSS1_CTL_351_DATA=0x00000000
LOCAL &__DDRSS1_CTL_352_DATA
&__DDRSS1_CTL_352_DATA=0x00000000
LOCAL &__DDRSS1_CTL_353_DATA
&__DDRSS1_CTL_353_DATA=0x00000000
LOCAL &__DDRSS1_CTL_354_DATA
&__DDRSS1_CTL_354_DATA=0x00000000
LOCAL &__DDRSS1_CTL_355_DATA
&__DDRSS1_CTL_355_DATA=0x00000000
LOCAL &__DDRSS1_CTL_356_DATA
&__DDRSS1_CTL_356_DATA=0x00000000
LOCAL &__DDRSS1_CTL_357_DATA
&__DDRSS1_CTL_357_DATA=0x00000000
LOCAL &__DDRSS1_CTL_358_DATA
&__DDRSS1_CTL_358_DATA=0x00000000
LOCAL &__DDRSS1_CTL_359_DATA
&__DDRSS1_CTL_359_DATA=0x00000000
LOCAL &__DDRSS1_CTL_360_DATA
&__DDRSS1_CTL_360_DATA=0x000556AA
LOCAL &__DDRSS1_CTL_361_DATA
&__DDRSS1_CTL_361_DATA=0x000AAAAA
LOCAL &__DDRSS1_CTL_362_DATA
&__DDRSS1_CTL_362_DATA=0x000AA955
LOCAL &__DDRSS1_CTL_363_DATA
&__DDRSS1_CTL_363_DATA=0x00055555
LOCAL &__DDRSS1_CTL_364_DATA
&__DDRSS1_CTL_364_DATA=0x000B3133
LOCAL &__DDRSS1_CTL_365_DATA
&__DDRSS1_CTL_365_DATA=0x0004CD33
LOCAL &__DDRSS1_CTL_366_DATA
&__DDRSS1_CTL_366_DATA=0x0004CECC
LOCAL &__DDRSS1_CTL_367_DATA
&__DDRSS1_CTL_367_DATA=0x000B32CC
LOCAL &__DDRSS1_CTL_368_DATA
&__DDRSS1_CTL_368_DATA=0x00010300
LOCAL &__DDRSS1_CTL_369_DATA
&__DDRSS1_CTL_369_DATA=0x03000100
LOCAL &__DDRSS1_CTL_370_DATA
&__DDRSS1_CTL_370_DATA=0x00000000
LOCAL &__DDRSS1_CTL_371_DATA
&__DDRSS1_CTL_371_DATA=0x00000000
LOCAL &__DDRSS1_CTL_372_DATA
&__DDRSS1_CTL_372_DATA=0x00000000
LOCAL &__DDRSS1_CTL_373_DATA
&__DDRSS1_CTL_373_DATA=0x00000000
LOCAL &__DDRSS1_CTL_374_DATA
&__DDRSS1_CTL_374_DATA=0x00000000
LOCAL &__DDRSS1_CTL_375_DATA
&__DDRSS1_CTL_375_DATA=0x00000000
LOCAL &__DDRSS1_CTL_376_DATA
&__DDRSS1_CTL_376_DATA=0x00000000
LOCAL &__DDRSS1_CTL_377_DATA
&__DDRSS1_CTL_377_DATA=0x00010000
LOCAL &__DDRSS1_CTL_378_DATA
&__DDRSS1_CTL_378_DATA=0x00000404
LOCAL &__DDRSS1_CTL_379_DATA
&__DDRSS1_CTL_379_DATA=0x00000000
LOCAL &__DDRSS1_CTL_380_DATA
&__DDRSS1_CTL_380_DATA=0x00000000
LOCAL &__DDRSS1_CTL_381_DATA
&__DDRSS1_CTL_381_DATA=0x00000000
LOCAL &__DDRSS1_CTL_382_DATA
&__DDRSS1_CTL_382_DATA=0x00000000
LOCAL &__DDRSS1_CTL_383_DATA
&__DDRSS1_CTL_383_DATA=0x00000000
LOCAL &__DDRSS1_CTL_384_DATA
&__DDRSS1_CTL_384_DATA=0x00000000
LOCAL &__DDRSS1_CTL_385_DATA
&__DDRSS1_CTL_385_DATA=0x00000000
LOCAL &__DDRSS1_CTL_386_DATA
&__DDRSS1_CTL_386_DATA=0x00000000
LOCAL &__DDRSS1_CTL_387_DATA
&__DDRSS1_CTL_387_DATA=0x2A2A1B00
LOCAL &__DDRSS1_CTL_388_DATA
&__DDRSS1_CTL_388_DATA=0x000A0000
LOCAL &__DDRSS1_CTL_389_DATA
&__DDRSS1_CTL_389_DATA=0x0000019C
LOCAL &__DDRSS1_CTL_390_DATA
&__DDRSS1_CTL_390_DATA=0x00000200
LOCAL &__DDRSS1_CTL_391_DATA
&__DDRSS1_CTL_391_DATA=0x00000200
LOCAL &__DDRSS1_CTL_392_DATA
&__DDRSS1_CTL_392_DATA=0x00000200
LOCAL &__DDRSS1_CTL_393_DATA
&__DDRSS1_CTL_393_DATA=0x00000200
LOCAL &__DDRSS1_CTL_394_DATA
&__DDRSS1_CTL_394_DATA=0x000004D4
LOCAL &__DDRSS1_CTL_395_DATA
&__DDRSS1_CTL_395_DATA=0x00001018
LOCAL &__DDRSS1_CTL_396_DATA
&__DDRSS1_CTL_396_DATA=0x00000204
LOCAL &__DDRSS1_CTL_397_DATA
&__DDRSS1_CTL_397_DATA=0x0000206A
LOCAL &__DDRSS1_CTL_398_DATA
&__DDRSS1_CTL_398_DATA=0x00000200
LOCAL &__DDRSS1_CTL_399_DATA
&__DDRSS1_CTL_399_DATA=0x00000200
LOCAL &__DDRSS1_CTL_400_DATA
&__DDRSS1_CTL_400_DATA=0x00000200
LOCAL &__DDRSS1_CTL_401_DATA
&__DDRSS1_CTL_401_DATA=0x00000200
LOCAL &__DDRSS1_CTL_402_DATA
&__DDRSS1_CTL_402_DATA=0x0000613E
LOCAL &__DDRSS1_CTL_403_DATA
&__DDRSS1_CTL_403_DATA=0x00014424
LOCAL &__DDRSS1_CTL_404_DATA
&__DDRSS1_CTL_404_DATA=0x0000060C
LOCAL &__DDRSS1_CTL_405_DATA
&__DDRSS1_CTL_405_DATA=0x0000206A
LOCAL &__DDRSS1_CTL_406_DATA
&__DDRSS1_CTL_406_DATA=0x00000200
LOCAL &__DDRSS1_CTL_407_DATA
&__DDRSS1_CTL_407_DATA=0x00000200
LOCAL &__DDRSS1_CTL_408_DATA
&__DDRSS1_CTL_408_DATA=0x00000200
LOCAL &__DDRSS1_CTL_409_DATA
&__DDRSS1_CTL_409_DATA=0x00000200
LOCAL &__DDRSS1_CTL_410_DATA
&__DDRSS1_CTL_410_DATA=0x0000613E
LOCAL &__DDRSS1_CTL_411_DATA
&__DDRSS1_CTL_411_DATA=0x00014424
LOCAL &__DDRSS1_CTL_412_DATA
&__DDRSS1_CTL_412_DATA=0x0202060C
LOCAL &__DDRSS1_CTL_413_DATA
&__DDRSS1_CTL_413_DATA=0x03030202
LOCAL &__DDRSS1_CTL_414_DATA
&__DDRSS1_CTL_414_DATA=0x00000022
LOCAL &__DDRSS1_CTL_415_DATA
&__DDRSS1_CTL_415_DATA=0x00000000
LOCAL &__DDRSS1_CTL_416_DATA
&__DDRSS1_CTL_416_DATA=0x00000000
LOCAL &__DDRSS1_CTL_417_DATA
&__DDRSS1_CTL_417_DATA=0x00001403
LOCAL &__DDRSS1_CTL_418_DATA
&__DDRSS1_CTL_418_DATA=0x000007D0
LOCAL &__DDRSS1_CTL_419_DATA
&__DDRSS1_CTL_419_DATA=0x00000000
LOCAL &__DDRSS1_CTL_420_DATA
&__DDRSS1_CTL_420_DATA=0x00000000
LOCAL &__DDRSS1_CTL_421_DATA
&__DDRSS1_CTL_421_DATA=0x00030000
LOCAL &__DDRSS1_CTL_422_DATA
&__DDRSS1_CTL_422_DATA=0x0007001F
LOCAL &__DDRSS1_CTL_423_DATA
&__DDRSS1_CTL_423_DATA=0x00110029
LOCAL &__DDRSS1_CTL_424_DATA
&__DDRSS1_CTL_424_DATA=0x00110029
LOCAL &__DDRSS1_CTL_425_DATA
&__DDRSS1_CTL_425_DATA=0x00000000
LOCAL &__DDRSS1_CTL_426_DATA
&__DDRSS1_CTL_426_DATA=0x00000000
LOCAL &__DDRSS1_CTL_427_DATA
&__DDRSS1_CTL_427_DATA=0x02000000
LOCAL &__DDRSS1_CTL_428_DATA
&__DDRSS1_CTL_428_DATA=0x01000404
LOCAL &__DDRSS1_CTL_429_DATA
&__DDRSS1_CTL_429_DATA=0x030E030E
LOCAL &__DDRSS1_CTL_430_DATA
&__DDRSS1_CTL_430_DATA=0x00000105
LOCAL &__DDRSS1_CTL_431_DATA
&__DDRSS1_CTL_431_DATA=0x00010101
LOCAL &__DDRSS1_CTL_432_DATA
&__DDRSS1_CTL_432_DATA=0x00010101
LOCAL &__DDRSS1_CTL_433_DATA
&__DDRSS1_CTL_433_DATA=0x00010001
LOCAL &__DDRSS1_CTL_434_DATA
&__DDRSS1_CTL_434_DATA=0x00000101
LOCAL &__DDRSS1_CTL_435_DATA
&__DDRSS1_CTL_435_DATA=0x02000201
LOCAL &__DDRSS1_CTL_436_DATA
&__DDRSS1_CTL_436_DATA=0x02010000
LOCAL &__DDRSS1_CTL_437_DATA
&__DDRSS1_CTL_437_DATA=0x00000200
LOCAL &__DDRSS1_CTL_438_DATA
&__DDRSS1_CTL_438_DATA=0x14060000
LOCAL &__DDRSS1_CTL_439_DATA
&__DDRSS1_CTL_439_DATA=0x00000114
LOCAL &__DDRSS1_CTL_440_DATA
&__DDRSS1_CTL_440_DATA=0xFFFFFFFF
LOCAL &__DDRSS1_CTL_441_DATA
&__DDRSS1_CTL_441_DATA=0xFFFFFFFF
LOCAL &__DDRSS1_CTL_442_DATA
&__DDRSS1_CTL_442_DATA=0x00000000
LOCAL &__DDRSS1_CTL_443_DATA
&__DDRSS1_CTL_443_DATA=0x00000000
LOCAL &__DDRSS1_CTL_444_DATA
&__DDRSS1_CTL_444_DATA=0x00000000
LOCAL &__DDRSS1_CTL_445_DATA
&__DDRSS1_CTL_445_DATA=0x00000000
LOCAL &__DDRSS1_CTL_446_DATA
&__DDRSS1_CTL_446_DATA=0x00000000
LOCAL &__DDRSS1_CTL_447_DATA
&__DDRSS1_CTL_447_DATA=0x00000000
LOCAL &__DDRSS1_CTL_448_DATA
&__DDRSS1_CTL_448_DATA=0x00000000
LOCAL &__DDRSS1_CTL_449_DATA
&__DDRSS1_CTL_449_DATA=0x00000000
LOCAL &__DDRSS1_CTL_450_DATA
&__DDRSS1_CTL_450_DATA=0x00000000
LOCAL &__DDRSS1_CTL_451_DATA
&__DDRSS1_CTL_451_DATA=0x00000000
LOCAL &__DDRSS1_CTL_452_DATA
&__DDRSS1_CTL_452_DATA=0x00000000
LOCAL &__DDRSS1_CTL_453_DATA
&__DDRSS1_CTL_453_DATA=0x00000000
LOCAL &__DDRSS1_CTL_454_DATA
&__DDRSS1_CTL_454_DATA=0x00000000
LOCAL &__DDRSS1_CTL_455_DATA
&__DDRSS1_CTL_455_DATA=0x00000000
LOCAL &__DDRSS1_CTL_456_DATA
&__DDRSS1_CTL_456_DATA=0x00000000
LOCAL &__DDRSS1_CTL_457_DATA
&__DDRSS1_CTL_457_DATA=0x00000000
LOCAL &__DDRSS1_CTL_458_DATA
&__DDRSS1_CTL_458_DATA=0x00000000
LOCAL &__DDRSS1_PI_00_DATA
&__DDRSS1_PI_00_DATA=0x00000B00
LOCAL &__DDRSS1_PI_01_DATA
&__DDRSS1_PI_01_DATA=0x00000000
LOCAL &__DDRSS1_PI_02_DATA
&__DDRSS1_PI_02_DATA=0x00000000
LOCAL &__DDRSS1_PI_03_DATA
&__DDRSS1_PI_03_DATA=0x00000000
LOCAL &__DDRSS1_PI_04_DATA
&__DDRSS1_PI_04_DATA=0x00000000
LOCAL &__DDRSS1_PI_05_DATA
&__DDRSS1_PI_05_DATA=0x00000101
LOCAL &__DDRSS1_PI_06_DATA
&__DDRSS1_PI_06_DATA=0x00640000
LOCAL &__DDRSS1_PI_07_DATA
&__DDRSS1_PI_07_DATA=0x00000001
LOCAL &__DDRSS1_PI_08_DATA
&__DDRSS1_PI_08_DATA=0x00000000
LOCAL &__DDRSS1_PI_09_DATA
&__DDRSS1_PI_09_DATA=0x00000000
LOCAL &__DDRSS1_PI_10_DATA
&__DDRSS1_PI_10_DATA=0x00000000
LOCAL &__DDRSS1_PI_11_DATA
&__DDRSS1_PI_11_DATA=0x00000000
LOCAL &__DDRSS1_PI_12_DATA
&__DDRSS1_PI_12_DATA=0x00000007
LOCAL &__DDRSS1_PI_13_DATA
&__DDRSS1_PI_13_DATA=0x00010002
LOCAL &__DDRSS1_PI_14_DATA
&__DDRSS1_PI_14_DATA=0x0800000F
LOCAL &__DDRSS1_PI_15_DATA
&__DDRSS1_PI_15_DATA=0x00000103
LOCAL &__DDRSS1_PI_16_DATA
&__DDRSS1_PI_16_DATA=0x00000005
LOCAL &__DDRSS1_PI_17_DATA
&__DDRSS1_PI_17_DATA=0x00000000
LOCAL &__DDRSS1_PI_18_DATA
&__DDRSS1_PI_18_DATA=0x00000000
LOCAL &__DDRSS1_PI_19_DATA
&__DDRSS1_PI_19_DATA=0x00000000
LOCAL &__DDRSS1_PI_20_DATA
&__DDRSS1_PI_20_DATA=0x00000000
LOCAL &__DDRSS1_PI_21_DATA
&__DDRSS1_PI_21_DATA=0x00000000
LOCAL &__DDRSS1_PI_22_DATA
&__DDRSS1_PI_22_DATA=0x00000000
LOCAL &__DDRSS1_PI_23_DATA
&__DDRSS1_PI_23_DATA=0x00000000
LOCAL &__DDRSS1_PI_24_DATA
&__DDRSS1_PI_24_DATA=0x00000000
LOCAL &__DDRSS1_PI_25_DATA
&__DDRSS1_PI_25_DATA=0x00000000
LOCAL &__DDRSS1_PI_26_DATA
&__DDRSS1_PI_26_DATA=0x00010100
LOCAL &__DDRSS1_PI_27_DATA
&__DDRSS1_PI_27_DATA=0x00280A00
LOCAL &__DDRSS1_PI_28_DATA
&__DDRSS1_PI_28_DATA=0x00000000
LOCAL &__DDRSS1_PI_29_DATA
&__DDRSS1_PI_29_DATA=0x0F000000
LOCAL &__DDRSS1_PI_30_DATA
&__DDRSS1_PI_30_DATA=0x00003200
LOCAL &__DDRSS1_PI_31_DATA
&__DDRSS1_PI_31_DATA=0x00000000
LOCAL &__DDRSS1_PI_32_DATA
&__DDRSS1_PI_32_DATA=0x00000000
LOCAL &__DDRSS1_PI_33_DATA
&__DDRSS1_PI_33_DATA=0x01010102
LOCAL &__DDRSS1_PI_34_DATA
&__DDRSS1_PI_34_DATA=0x00000000
LOCAL &__DDRSS1_PI_35_DATA
&__DDRSS1_PI_35_DATA=0x000000AA
LOCAL &__DDRSS1_PI_36_DATA
&__DDRSS1_PI_36_DATA=0x00000055
LOCAL &__DDRSS1_PI_37_DATA
&__DDRSS1_PI_37_DATA=0x000000B5
LOCAL &__DDRSS1_PI_38_DATA
&__DDRSS1_PI_38_DATA=0x0000004A
LOCAL &__DDRSS1_PI_39_DATA
&__DDRSS1_PI_39_DATA=0x00000056
LOCAL &__DDRSS1_PI_40_DATA
&__DDRSS1_PI_40_DATA=0x000000A9
LOCAL &__DDRSS1_PI_41_DATA
&__DDRSS1_PI_41_DATA=0x000000A9
LOCAL &__DDRSS1_PI_42_DATA
&__DDRSS1_PI_42_DATA=0x000000B5
LOCAL &__DDRSS1_PI_43_DATA
&__DDRSS1_PI_43_DATA=0x00000000
LOCAL &__DDRSS1_PI_44_DATA
&__DDRSS1_PI_44_DATA=0x00000000
LOCAL &__DDRSS1_PI_45_DATA
&__DDRSS1_PI_45_DATA=0x000F0F00
LOCAL &__DDRSS1_PI_46_DATA
&__DDRSS1_PI_46_DATA=0x00000016
LOCAL &__DDRSS1_PI_47_DATA
&__DDRSS1_PI_47_DATA=0x000007D0
LOCAL &__DDRSS1_PI_48_DATA
&__DDRSS1_PI_48_DATA=0x00000300
LOCAL &__DDRSS1_PI_49_DATA
&__DDRSS1_PI_49_DATA=0x00000000
LOCAL &__DDRSS1_PI_50_DATA
&__DDRSS1_PI_50_DATA=0x00000000
LOCAL &__DDRSS1_PI_51_DATA
&__DDRSS1_PI_51_DATA=0x01000000
LOCAL &__DDRSS1_PI_52_DATA
&__DDRSS1_PI_52_DATA=0x00010101
LOCAL &__DDRSS1_PI_53_DATA
&__DDRSS1_PI_53_DATA=0x00000000
LOCAL &__DDRSS1_PI_54_DATA
&__DDRSS1_PI_54_DATA=0x00030000
LOCAL &__DDRSS1_PI_55_DATA
&__DDRSS1_PI_55_DATA=0x0F000000
LOCAL &__DDRSS1_PI_56_DATA
&__DDRSS1_PI_56_DATA=0x00000017
LOCAL &__DDRSS1_PI_57_DATA
&__DDRSS1_PI_57_DATA=0x00000000
LOCAL &__DDRSS1_PI_58_DATA
&__DDRSS1_PI_58_DATA=0x00000000
LOCAL &__DDRSS1_PI_59_DATA
&__DDRSS1_PI_59_DATA=0x00000000
LOCAL &__DDRSS1_PI_60_DATA
&__DDRSS1_PI_60_DATA=0x0A0A140A
LOCAL &__DDRSS1_PI_61_DATA
&__DDRSS1_PI_61_DATA=0x10020101
LOCAL &__DDRSS1_PI_62_DATA
&__DDRSS1_PI_62_DATA=0x00020805
LOCAL &__DDRSS1_PI_63_DATA
&__DDRSS1_PI_63_DATA=0x01000404
LOCAL &__DDRSS1_PI_64_DATA
&__DDRSS1_PI_64_DATA=0x00000000
LOCAL &__DDRSS1_PI_65_DATA
&__DDRSS1_PI_65_DATA=0x00000000
LOCAL &__DDRSS1_PI_66_DATA
&__DDRSS1_PI_66_DATA=0x00000100
LOCAL &__DDRSS1_PI_67_DATA
&__DDRSS1_PI_67_DATA=0x0001010F
LOCAL &__DDRSS1_PI_68_DATA
&__DDRSS1_PI_68_DATA=0x00340000
LOCAL &__DDRSS1_PI_69_DATA
&__DDRSS1_PI_69_DATA=0x00000000
LOCAL &__DDRSS1_PI_70_DATA
&__DDRSS1_PI_70_DATA=0x00000000
LOCAL &__DDRSS1_PI_71_DATA
&__DDRSS1_PI_71_DATA=0x0000FFFF
LOCAL &__DDRSS1_PI_72_DATA
&__DDRSS1_PI_72_DATA=0x00000000
LOCAL &__DDRSS1_PI_73_DATA
&__DDRSS1_PI_73_DATA=0x00080000
LOCAL &__DDRSS1_PI_74_DATA
&__DDRSS1_PI_74_DATA=0x02000200
LOCAL &__DDRSS1_PI_75_DATA
&__DDRSS1_PI_75_DATA=0x01000100
LOCAL &__DDRSS1_PI_76_DATA
&__DDRSS1_PI_76_DATA=0x01000000
LOCAL &__DDRSS1_PI_77_DATA
&__DDRSS1_PI_77_DATA=0x02000200
LOCAL &__DDRSS1_PI_78_DATA
&__DDRSS1_PI_78_DATA=0x00000200
LOCAL &__DDRSS1_PI_79_DATA
&__DDRSS1_PI_79_DATA=0x00000000
LOCAL &__DDRSS1_PI_80_DATA
&__DDRSS1_PI_80_DATA=0x00000000
LOCAL &__DDRSS1_PI_81_DATA
&__DDRSS1_PI_81_DATA=0x00000000
LOCAL &__DDRSS1_PI_82_DATA
&__DDRSS1_PI_82_DATA=0x00000000
LOCAL &__DDRSS1_PI_83_DATA
&__DDRSS1_PI_83_DATA=0x00000000
LOCAL &__DDRSS1_PI_84_DATA
&__DDRSS1_PI_84_DATA=0x00000000
LOCAL &__DDRSS1_PI_85_DATA
&__DDRSS1_PI_85_DATA=0x00000000
LOCAL &__DDRSS1_PI_86_DATA
&__DDRSS1_PI_86_DATA=0x00000000
LOCAL &__DDRSS1_PI_87_DATA
&__DDRSS1_PI_87_DATA=0x00000000
LOCAL &__DDRSS1_PI_88_DATA
&__DDRSS1_PI_88_DATA=0x00000000
LOCAL &__DDRSS1_PI_89_DATA
&__DDRSS1_PI_89_DATA=0x00000000
LOCAL &__DDRSS1_PI_90_DATA
&__DDRSS1_PI_90_DATA=0x00000000
LOCAL &__DDRSS1_PI_91_DATA
&__DDRSS1_PI_91_DATA=0x00000400
LOCAL &__DDRSS1_PI_92_DATA
&__DDRSS1_PI_92_DATA=0x02010000
LOCAL &__DDRSS1_PI_93_DATA
&__DDRSS1_PI_93_DATA=0x00080003
LOCAL &__DDRSS1_PI_94_DATA
&__DDRSS1_PI_94_DATA=0x00080000
LOCAL &__DDRSS1_PI_95_DATA
&__DDRSS1_PI_95_DATA=0x00000001
LOCAL &__DDRSS1_PI_96_DATA
&__DDRSS1_PI_96_DATA=0x00000000
LOCAL &__DDRSS1_PI_97_DATA
&__DDRSS1_PI_97_DATA=0x0000AA00
LOCAL &__DDRSS1_PI_98_DATA
&__DDRSS1_PI_98_DATA=0x00000000
LOCAL &__DDRSS1_PI_99_DATA
&__DDRSS1_PI_99_DATA=0x00000000
LOCAL &__DDRSS1_PI_100_DATA
&__DDRSS1_PI_100_DATA=0x00010000
LOCAL &__DDRSS1_PI_101_DATA
&__DDRSS1_PI_101_DATA=0x00000000
LOCAL &__DDRSS1_PI_102_DATA
&__DDRSS1_PI_102_DATA=0x00000000
LOCAL &__DDRSS1_PI_103_DATA
&__DDRSS1_PI_103_DATA=0x00000000
LOCAL &__DDRSS1_PI_104_DATA
&__DDRSS1_PI_104_DATA=0x00000000
LOCAL &__DDRSS1_PI_105_DATA
&__DDRSS1_PI_105_DATA=0x00000000
LOCAL &__DDRSS1_PI_106_DATA
&__DDRSS1_PI_106_DATA=0x00000000
LOCAL &__DDRSS1_PI_107_DATA
&__DDRSS1_PI_107_DATA=0x00000000
LOCAL &__DDRSS1_PI_108_DATA
&__DDRSS1_PI_108_DATA=0x00000000
LOCAL &__DDRSS1_PI_109_DATA
&__DDRSS1_PI_109_DATA=0x00000000
LOCAL &__DDRSS1_PI_110_DATA
&__DDRSS1_PI_110_DATA=0x00000000
LOCAL &__DDRSS1_PI_111_DATA
&__DDRSS1_PI_111_DATA=0x00000000
LOCAL &__DDRSS1_PI_112_DATA
&__DDRSS1_PI_112_DATA=0x00000000
LOCAL &__DDRSS1_PI_113_DATA
&__DDRSS1_PI_113_DATA=0x00000000
LOCAL &__DDRSS1_PI_114_DATA
&__DDRSS1_PI_114_DATA=0x00000000
LOCAL &__DDRSS1_PI_115_DATA
&__DDRSS1_PI_115_DATA=0x00000000
LOCAL &__DDRSS1_PI_116_DATA
&__DDRSS1_PI_116_DATA=0x00000000
LOCAL &__DDRSS1_PI_117_DATA
&__DDRSS1_PI_117_DATA=0x00000000
LOCAL &__DDRSS1_PI_118_DATA
&__DDRSS1_PI_118_DATA=0x00000000
LOCAL &__DDRSS1_PI_119_DATA
&__DDRSS1_PI_119_DATA=0x00000000
LOCAL &__DDRSS1_PI_120_DATA
&__DDRSS1_PI_120_DATA=0x00000000
LOCAL &__DDRSS1_PI_121_DATA
&__DDRSS1_PI_121_DATA=0x00000000
LOCAL &__DDRSS1_PI_122_DATA
&__DDRSS1_PI_122_DATA=0x00000000
LOCAL &__DDRSS1_PI_123_DATA
&__DDRSS1_PI_123_DATA=0x00000000
LOCAL &__DDRSS1_PI_124_DATA
&__DDRSS1_PI_124_DATA=0x00000000
LOCAL &__DDRSS1_PI_125_DATA
&__DDRSS1_PI_125_DATA=0x00000008
LOCAL &__DDRSS1_PI_126_DATA
&__DDRSS1_PI_126_DATA=0x00000000
LOCAL &__DDRSS1_PI_127_DATA
&__DDRSS1_PI_127_DATA=0x00000000
LOCAL &__DDRSS1_PI_128_DATA
&__DDRSS1_PI_128_DATA=0x00000000
LOCAL &__DDRSS1_PI_129_DATA
&__DDRSS1_PI_129_DATA=0x00000000
LOCAL &__DDRSS1_PI_130_DATA
&__DDRSS1_PI_130_DATA=0x00000000
LOCAL &__DDRSS1_PI_131_DATA
&__DDRSS1_PI_131_DATA=0x00000000
LOCAL &__DDRSS1_PI_132_DATA
&__DDRSS1_PI_132_DATA=0x00000000
LOCAL &__DDRSS1_PI_133_DATA
&__DDRSS1_PI_133_DATA=0x00000000
LOCAL &__DDRSS1_PI_134_DATA
&__DDRSS1_PI_134_DATA=0x00000002
LOCAL &__DDRSS1_PI_135_DATA
&__DDRSS1_PI_135_DATA=0x00000000
LOCAL &__DDRSS1_PI_136_DATA
&__DDRSS1_PI_136_DATA=0x00000000
LOCAL &__DDRSS1_PI_137_DATA
&__DDRSS1_PI_137_DATA=0x0000000A
LOCAL &__DDRSS1_PI_138_DATA
&__DDRSS1_PI_138_DATA=0x00000019
LOCAL &__DDRSS1_PI_139_DATA
&__DDRSS1_PI_139_DATA=0x00000100
LOCAL &__DDRSS1_PI_140_DATA
&__DDRSS1_PI_140_DATA=0x00000000
LOCAL &__DDRSS1_PI_141_DATA
&__DDRSS1_PI_141_DATA=0x00000000
LOCAL &__DDRSS1_PI_142_DATA
&__DDRSS1_PI_142_DATA=0x00000000
LOCAL &__DDRSS1_PI_143_DATA
&__DDRSS1_PI_143_DATA=0x00000000
LOCAL &__DDRSS1_PI_144_DATA
&__DDRSS1_PI_144_DATA=0x01000000
LOCAL &__DDRSS1_PI_145_DATA
&__DDRSS1_PI_145_DATA=0x00010003
LOCAL &__DDRSS1_PI_146_DATA
&__DDRSS1_PI_146_DATA=0x02000101
LOCAL &__DDRSS1_PI_147_DATA
&__DDRSS1_PI_147_DATA=0x01030001
LOCAL &__DDRSS1_PI_148_DATA
&__DDRSS1_PI_148_DATA=0x00010400
LOCAL &__DDRSS1_PI_149_DATA
&__DDRSS1_PI_149_DATA=0x06000105
LOCAL &__DDRSS1_PI_150_DATA
&__DDRSS1_PI_150_DATA=0x01070001
LOCAL &__DDRSS1_PI_151_DATA
&__DDRSS1_PI_151_DATA=0x00000000
LOCAL &__DDRSS1_PI_152_DATA
&__DDRSS1_PI_152_DATA=0x00000000
LOCAL &__DDRSS1_PI_153_DATA
&__DDRSS1_PI_153_DATA=0x00000000
LOCAL &__DDRSS1_PI_154_DATA
&__DDRSS1_PI_154_DATA=0x00010001
LOCAL &__DDRSS1_PI_155_DATA
&__DDRSS1_PI_155_DATA=0x00000000
LOCAL &__DDRSS1_PI_156_DATA
&__DDRSS1_PI_156_DATA=0x00000000
LOCAL &__DDRSS1_PI_157_DATA
&__DDRSS1_PI_157_DATA=0x00000000
LOCAL &__DDRSS1_PI_158_DATA
&__DDRSS1_PI_158_DATA=0x00000000
LOCAL &__DDRSS1_PI_159_DATA
&__DDRSS1_PI_159_DATA=0x00000401
LOCAL &__DDRSS1_PI_160_DATA
&__DDRSS1_PI_160_DATA=0x00000000
LOCAL &__DDRSS1_PI_161_DATA
&__DDRSS1_PI_161_DATA=0x00010000
LOCAL &__DDRSS1_PI_162_DATA
&__DDRSS1_PI_162_DATA=0x00000000
LOCAL &__DDRSS1_PI_163_DATA
&__DDRSS1_PI_163_DATA=0x16160200
LOCAL &__DDRSS1_PI_164_DATA
&__DDRSS1_PI_164_DATA=0x00000034
LOCAL &__DDRSS1_PI_165_DATA
&__DDRSS1_PI_165_DATA=0x0000004B
LOCAL &__DDRSS1_PI_166_DATA
&__DDRSS1_PI_166_DATA=0x0002004B
LOCAL &__DDRSS1_PI_167_DATA
&__DDRSS1_PI_167_DATA=0x02000200
LOCAL &__DDRSS1_PI_168_DATA
&__DDRSS1_PI_168_DATA=0x280A0C04
LOCAL &__DDRSS1_PI_169_DATA
&__DDRSS1_PI_169_DATA=0x0015280A
LOCAL &__DDRSS1_PI_170_DATA
&__DDRSS1_PI_170_DATA=0x000000CE
LOCAL &__DDRSS1_PI_171_DATA
&__DDRSS1_PI_171_DATA=0x00000196
LOCAL &__DDRSS1_PI_172_DATA
&__DDRSS1_PI_172_DATA=0x00001035
LOCAL &__DDRSS1_PI_173_DATA
&__DDRSS1_PI_173_DATA=0x00000196
LOCAL &__DDRSS1_PI_174_DATA
&__DDRSS1_PI_174_DATA=0x04001035
LOCAL &__DDRSS1_PI_175_DATA
&__DDRSS1_PI_175_DATA=0x01010404
LOCAL &__DDRSS1_PI_176_DATA
&__DDRSS1_PI_176_DATA=0x00001501
LOCAL &__DDRSS1_PI_177_DATA
&__DDRSS1_PI_177_DATA=0x00150015
LOCAL &__DDRSS1_PI_178_DATA
&__DDRSS1_PI_178_DATA=0x01000100
LOCAL &__DDRSS1_PI_179_DATA
&__DDRSS1_PI_179_DATA=0x00000100
LOCAL &__DDRSS1_PI_180_DATA
&__DDRSS1_PI_180_DATA=0x00000000
LOCAL &__DDRSS1_PI_181_DATA
&__DDRSS1_PI_181_DATA=0x01010101
LOCAL &__DDRSS1_PI_182_DATA
&__DDRSS1_PI_182_DATA=0x00000101
LOCAL &__DDRSS1_PI_183_DATA
&__DDRSS1_PI_183_DATA=0x00000000
LOCAL &__DDRSS1_PI_184_DATA
&__DDRSS1_PI_184_DATA=0x00000000
LOCAL &__DDRSS1_PI_185_DATA
&__DDRSS1_PI_185_DATA=0x0C040000
LOCAL &__DDRSS1_PI_186_DATA
&__DDRSS1_PI_186_DATA=0x0606020C
LOCAL &__DDRSS1_PI_187_DATA
&__DDRSS1_PI_187_DATA=0x00040402
LOCAL &__DDRSS1_PI_188_DATA
&__DDRSS1_PI_188_DATA=0x000D0035
LOCAL &__DDRSS1_PI_189_DATA
&__DDRSS1_PI_189_DATA=0x0017003F
LOCAL &__DDRSS1_PI_190_DATA
&__DDRSS1_PI_190_DATA=0x0017003F
LOCAL &__DDRSS1_PI_191_DATA
&__DDRSS1_PI_191_DATA=0x01010101
LOCAL &__DDRSS1_PI_192_DATA
&__DDRSS1_PI_192_DATA=0x0002000E
LOCAL &__DDRSS1_PI_193_DATA
&__DDRSS1_PI_193_DATA=0x0002010B
LOCAL &__DDRSS1_PI_194_DATA
&__DDRSS1_PI_194_DATA=0x0100010B
LOCAL &__DDRSS1_PI_195_DATA
&__DDRSS1_PI_195_DATA=0x000F000F
LOCAL &__DDRSS1_PI_196_DATA
&__DDRSS1_PI_196_DATA=0x010C0100
LOCAL &__DDRSS1_PI_197_DATA
&__DDRSS1_PI_197_DATA=0x0100010C
LOCAL &__DDRSS1_PI_198_DATA
&__DDRSS1_PI_198_DATA=0x010C010C
LOCAL &__DDRSS1_PI_199_DATA
&__DDRSS1_PI_199_DATA=0x32103200
LOCAL &__DDRSS1_PI_200_DATA
&__DDRSS1_PI_200_DATA=0x01013210
LOCAL &__DDRSS1_PI_201_DATA
&__DDRSS1_PI_201_DATA=0x0A070601
LOCAL &__DDRSS1_PI_202_DATA
&__DDRSS1_PI_202_DATA=0x100B080D
LOCAL &__DDRSS1_PI_203_DATA
&__DDRSS1_PI_203_DATA=0x100B080F
LOCAL &__DDRSS1_PI_204_DATA
&__DDRSS1_PI_204_DATA=0x0000C00F
LOCAL &__DDRSS1_PI_205_DATA
&__DDRSS1_PI_205_DATA=0x00C01000
LOCAL &__DDRSS1_PI_206_DATA
&__DDRSS1_PI_206_DATA=0x00C01000
LOCAL &__DDRSS1_PI_207_DATA
&__DDRSS1_PI_207_DATA=0x00021000
LOCAL &__DDRSS1_PI_208_DATA
&__DDRSS1_PI_208_DATA=0x0019000E
LOCAL &__DDRSS1_PI_209_DATA
&__DDRSS1_PI_209_DATA=0x0019010B
LOCAL &__DDRSS1_PI_210_DATA
&__DDRSS1_PI_210_DATA=0x0011010B
LOCAL &__DDRSS1_PI_211_DATA
&__DDRSS1_PI_211_DATA=0x32000056
LOCAL &__DDRSS1_PI_212_DATA
&__DDRSS1_PI_212_DATA=0x00000301
LOCAL &__DDRSS1_PI_213_DATA
&__DDRSS1_PI_213_DATA=0x005A0023
LOCAL &__DDRSS1_PI_214_DATA
&__DDRSS1_PI_214_DATA=0x03013212
LOCAL &__DDRSS1_PI_215_DATA
&__DDRSS1_PI_215_DATA=0x00002300
LOCAL &__DDRSS1_PI_216_DATA
&__DDRSS1_PI_216_DATA=0x3212005A
LOCAL &__DDRSS1_PI_217_DATA
&__DDRSS1_PI_217_DATA=0x09000301
LOCAL &__DDRSS1_PI_218_DATA
&__DDRSS1_PI_218_DATA=0x04010504
LOCAL &__DDRSS1_PI_219_DATA
&__DDRSS1_PI_219_DATA=0x040006C9
LOCAL &__DDRSS1_PI_220_DATA
&__DDRSS1_PI_220_DATA=0x0A032001
LOCAL &__DDRSS1_PI_221_DATA
&__DDRSS1_PI_221_DATA=0x1619090A
LOCAL &__DDRSS1_PI_222_DATA
&__DDRSS1_PI_222_DATA=0x0000150D
LOCAL &__DDRSS1_PI_223_DATA
&__DDRSS1_PI_223_DATA=0x3000838E
LOCAL &__DDRSS1_PI_224_DATA
&__DDRSS1_PI_224_DATA=0x0F102004
LOCAL &__DDRSS1_PI_225_DATA
&__DDRSS1_PI_225_DATA=0x1619090B
LOCAL &__DDRSS1_PI_226_DATA
&__DDRSS1_PI_226_DATA=0x0000150D
LOCAL &__DDRSS1_PI_227_DATA
&__DDRSS1_PI_227_DATA=0x3000838E
LOCAL &__DDRSS1_PI_228_DATA
&__DDRSS1_PI_228_DATA=0x0F102004
LOCAL &__DDRSS1_PI_229_DATA
&__DDRSS1_PI_229_DATA=0x00019C0B
LOCAL &__DDRSS1_PI_230_DATA
&__DDRSS1_PI_230_DATA=0x00001018
LOCAL &__DDRSS1_PI_231_DATA
&__DDRSS1_PI_231_DATA=0x0000206A
LOCAL &__DDRSS1_PI_232_DATA
&__DDRSS1_PI_232_DATA=0x00014424
LOCAL &__DDRSS1_PI_233_DATA
&__DDRSS1_PI_233_DATA=0x0000206A
LOCAL &__DDRSS1_PI_234_DATA
&__DDRSS1_PI_234_DATA=0x00014424
LOCAL &__DDRSS1_PI_235_DATA
&__DDRSS1_PI_235_DATA=0x019E0016
LOCAL &__DDRSS1_PI_236_DATA
&__DDRSS1_PI_236_DATA=0x0303019E
LOCAL &__DDRSS1_PI_237_DATA
&__DDRSS1_PI_237_DATA=0x002AF803
LOCAL &__DDRSS1_PI_238_DATA
&__DDRSS1_PI_238_DATA=0x0001ADAF
LOCAL &__DDRSS1_PI_239_DATA
&__DDRSS1_PI_239_DATA=0x00000005
LOCAL &__DDRSS1_PI_240_DATA
&__DDRSS1_PI_240_DATA=0x0000006E
LOCAL &__DDRSS1_PI_241_DATA
&__DDRSS1_PI_241_DATA=0x00000016
LOCAL &__DDRSS1_PI_242_DATA
&__DDRSS1_PI_242_DATA=0x000340E4
LOCAL &__DDRSS1_PI_243_DATA
&__DDRSS1_PI_243_DATA=0x0001ADAF
LOCAL &__DDRSS1_PI_244_DATA
&__DDRSS1_PI_244_DATA=0x00000005
LOCAL &__DDRSS1_PI_245_DATA
&__DDRSS1_PI_245_DATA=0x00000855
LOCAL &__DDRSS1_PI_246_DATA
&__DDRSS1_PI_246_DATA=0x0000019E
LOCAL &__DDRSS1_PI_247_DATA
&__DDRSS1_PI_247_DATA=0x000340E4
LOCAL &__DDRSS1_PI_248_DATA
&__DDRSS1_PI_248_DATA=0x0001ADAF
LOCAL &__DDRSS1_PI_249_DATA
&__DDRSS1_PI_249_DATA=0x00000005
LOCAL &__DDRSS1_PI_250_DATA
&__DDRSS1_PI_250_DATA=0x00000855
LOCAL &__DDRSS1_PI_251_DATA
&__DDRSS1_PI_251_DATA=0x0100019E
LOCAL &__DDRSS1_PI_252_DATA
&__DDRSS1_PI_252_DATA=0x00370040
LOCAL &__DDRSS1_PI_253_DATA
&__DDRSS1_PI_253_DATA=0x00010008
LOCAL &__DDRSS1_PI_254_DATA
&__DDRSS1_PI_254_DATA=0x042B0040
LOCAL &__DDRSS1_PI_255_DATA
&__DDRSS1_PI_255_DATA=0x00010020
LOCAL &__DDRSS1_PI_256_DATA
&__DDRSS1_PI_256_DATA=0x042B0040
LOCAL &__DDRSS1_PI_257_DATA
&__DDRSS1_PI_257_DATA=0x00000320
LOCAL &__DDRSS1_PI_258_DATA
&__DDRSS1_PI_258_DATA=0x00360036
LOCAL &__DDRSS1_PI_259_DATA
&__DDRSS1_PI_259_DATA=0x08040404
LOCAL &__DDRSS1_PI_260_DATA
&__DDRSS1_PI_260_DATA=0x00000055
LOCAL &__DDRSS1_PI_261_DATA
&__DDRSS1_PI_261_DATA=0x55083C5A
LOCAL &__DDRSS1_PI_262_DATA
&__DDRSS1_PI_262_DATA=0x5A000000
LOCAL &__DDRSS1_PI_263_DATA
&__DDRSS1_PI_263_DATA=0x0055083C
LOCAL &__DDRSS1_PI_264_DATA
&__DDRSS1_PI_264_DATA=0x3C5A0000
LOCAL &__DDRSS1_PI_265_DATA
&__DDRSS1_PI_265_DATA=0x00005508
LOCAL &__DDRSS1_PI_266_DATA
&__DDRSS1_PI_266_DATA=0x0C3C5A00
LOCAL &__DDRSS1_PI_267_DATA
&__DDRSS1_PI_267_DATA=0x080F0E0D
LOCAL &__DDRSS1_PI_268_DATA
&__DDRSS1_PI_268_DATA=0x000B0A09
LOCAL &__DDRSS1_PI_269_DATA
&__DDRSS1_PI_269_DATA=0x00030201
LOCAL &__DDRSS1_PI_270_DATA
&__DDRSS1_PI_270_DATA=0x01000000
LOCAL &__DDRSS1_PI_271_DATA
&__DDRSS1_PI_271_DATA=0x04020201
LOCAL &__DDRSS1_PI_272_DATA
&__DDRSS1_PI_272_DATA=0x00080804
LOCAL &__DDRSS1_PI_273_DATA
&__DDRSS1_PI_273_DATA=0x00000000
LOCAL &__DDRSS1_PI_274_DATA
&__DDRSS1_PI_274_DATA=0x00000000
LOCAL &__DDRSS1_PI_275_DATA
&__DDRSS1_PI_275_DATA=0x00330084
LOCAL &__DDRSS1_PI_276_DATA
&__DDRSS1_PI_276_DATA=0x00160000
LOCAL &__DDRSS1_PI_277_DATA
&__DDRSS1_PI_277_DATA=0x56331BB4
LOCAL &__DDRSS1_PI_278_DATA
&__DDRSS1_PI_278_DATA=0x00160F27
LOCAL &__DDRSS1_PI_279_DATA
&__DDRSS1_PI_279_DATA=0x56331BB4
LOCAL &__DDRSS1_PI_280_DATA
&__DDRSS1_PI_280_DATA=0x00160F27
LOCAL &__DDRSS1_PI_281_DATA
&__DDRSS1_PI_281_DATA=0x00330084
LOCAL &__DDRSS1_PI_282_DATA
&__DDRSS1_PI_282_DATA=0x00160000
LOCAL &__DDRSS1_PI_283_DATA
&__DDRSS1_PI_283_DATA=0x56331BB4
LOCAL &__DDRSS1_PI_284_DATA
&__DDRSS1_PI_284_DATA=0x00160F27
LOCAL &__DDRSS1_PI_285_DATA
&__DDRSS1_PI_285_DATA=0x56331BB4
LOCAL &__DDRSS1_PI_286_DATA
&__DDRSS1_PI_286_DATA=0x00160F27
LOCAL &__DDRSS1_PI_287_DATA
&__DDRSS1_PI_287_DATA=0x00330084
LOCAL &__DDRSS1_PI_288_DATA
&__DDRSS1_PI_288_DATA=0x00160000
LOCAL &__DDRSS1_PI_289_DATA
&__DDRSS1_PI_289_DATA=0x56331BB4
LOCAL &__DDRSS1_PI_290_DATA
&__DDRSS1_PI_290_DATA=0x00160F27
LOCAL &__DDRSS1_PI_291_DATA
&__DDRSS1_PI_291_DATA=0x56331BB4
LOCAL &__DDRSS1_PI_292_DATA
&__DDRSS1_PI_292_DATA=0x00160F27
LOCAL &__DDRSS1_PI_293_DATA
&__DDRSS1_PI_293_DATA=0x00330084
LOCAL &__DDRSS1_PI_294_DATA
&__DDRSS1_PI_294_DATA=0x00160000
LOCAL &__DDRSS1_PI_295_DATA
&__DDRSS1_PI_295_DATA=0x56331BB4
LOCAL &__DDRSS1_PI_296_DATA
&__DDRSS1_PI_296_DATA=0x00160F27
LOCAL &__DDRSS1_PI_297_DATA
&__DDRSS1_PI_297_DATA=0x56331BB4
LOCAL &__DDRSS1_PI_298_DATA
&__DDRSS1_PI_298_DATA=0x00160F27
LOCAL &__DDRSS1_PI_299_DATA
&__DDRSS1_PI_299_DATA=0x00000000
LOCAL &__DDRSS1_PHY_00_DATA
&__DDRSS1_PHY_00_DATA=0x000004F0
LOCAL &__DDRSS1_PHY_01_DATA
&__DDRSS1_PHY_01_DATA=0x00000000
LOCAL &__DDRSS1_PHY_02_DATA
&__DDRSS1_PHY_02_DATA=0x00030200
LOCAL &__DDRSS1_PHY_03_DATA
&__DDRSS1_PHY_03_DATA=0x00000000
LOCAL &__DDRSS1_PHY_04_DATA
&__DDRSS1_PHY_04_DATA=0x00000000
LOCAL &__DDRSS1_PHY_05_DATA
&__DDRSS1_PHY_05_DATA=0x01030000
LOCAL &__DDRSS1_PHY_06_DATA
&__DDRSS1_PHY_06_DATA=0x00010000
LOCAL &__DDRSS1_PHY_07_DATA
&__DDRSS1_PHY_07_DATA=0x01030004
LOCAL &__DDRSS1_PHY_08_DATA
&__DDRSS1_PHY_08_DATA=0x01000000
LOCAL &__DDRSS1_PHY_09_DATA
&__DDRSS1_PHY_09_DATA=0x00000000
LOCAL &__DDRSS1_PHY_10_DATA
&__DDRSS1_PHY_10_DATA=0x00000000
LOCAL &__DDRSS1_PHY_11_DATA
&__DDRSS1_PHY_11_DATA=0x01000001
LOCAL &__DDRSS1_PHY_12_DATA
&__DDRSS1_PHY_12_DATA=0x00000100
LOCAL &__DDRSS1_PHY_13_DATA
&__DDRSS1_PHY_13_DATA=0x000800C0
LOCAL &__DDRSS1_PHY_14_DATA
&__DDRSS1_PHY_14_DATA=0x060100CC
LOCAL &__DDRSS1_PHY_15_DATA
&__DDRSS1_PHY_15_DATA=0x00030066
LOCAL &__DDRSS1_PHY_16_DATA
&__DDRSS1_PHY_16_DATA=0x00000000
LOCAL &__DDRSS1_PHY_17_DATA
&__DDRSS1_PHY_17_DATA=0x00000301
LOCAL &__DDRSS1_PHY_18_DATA
&__DDRSS1_PHY_18_DATA=0x0000AAAA
LOCAL &__DDRSS1_PHY_19_DATA
&__DDRSS1_PHY_19_DATA=0x00005555
LOCAL &__DDRSS1_PHY_20_DATA
&__DDRSS1_PHY_20_DATA=0x0000B5B5
LOCAL &__DDRSS1_PHY_21_DATA
&__DDRSS1_PHY_21_DATA=0x00004A4A
LOCAL &__DDRSS1_PHY_22_DATA
&__DDRSS1_PHY_22_DATA=0x00005656
LOCAL &__DDRSS1_PHY_23_DATA
&__DDRSS1_PHY_23_DATA=0x0000A9A9
LOCAL &__DDRSS1_PHY_24_DATA
&__DDRSS1_PHY_24_DATA=0x0000A9A9
LOCAL &__DDRSS1_PHY_25_DATA
&__DDRSS1_PHY_25_DATA=0x0000B5B5
LOCAL &__DDRSS1_PHY_26_DATA
&__DDRSS1_PHY_26_DATA=0x00000000
LOCAL &__DDRSS1_PHY_27_DATA
&__DDRSS1_PHY_27_DATA=0x00000000
LOCAL &__DDRSS1_PHY_28_DATA
&__DDRSS1_PHY_28_DATA=0x2A000000
LOCAL &__DDRSS1_PHY_29_DATA
&__DDRSS1_PHY_29_DATA=0x00000808
LOCAL &__DDRSS1_PHY_30_DATA
&__DDRSS1_PHY_30_DATA=0x0F000000
LOCAL &__DDRSS1_PHY_31_DATA
&__DDRSS1_PHY_31_DATA=0x00000F0F
LOCAL &__DDRSS1_PHY_32_DATA
&__DDRSS1_PHY_32_DATA=0x10200000
LOCAL &__DDRSS1_PHY_33_DATA
&__DDRSS1_PHY_33_DATA=0x0C002006
LOCAL &__DDRSS1_PHY_34_DATA
&__DDRSS1_PHY_34_DATA=0x00000000
LOCAL &__DDRSS1_PHY_35_DATA
&__DDRSS1_PHY_35_DATA=0x00000000
LOCAL &__DDRSS1_PHY_36_DATA
&__DDRSS1_PHY_36_DATA=0x55555555
LOCAL &__DDRSS1_PHY_37_DATA
&__DDRSS1_PHY_37_DATA=0xAAAAAAAA
LOCAL &__DDRSS1_PHY_38_DATA
&__DDRSS1_PHY_38_DATA=0x55555555
LOCAL &__DDRSS1_PHY_39_DATA
&__DDRSS1_PHY_39_DATA=0xAAAAAAAA
LOCAL &__DDRSS1_PHY_40_DATA
&__DDRSS1_PHY_40_DATA=0x00005555
LOCAL &__DDRSS1_PHY_41_DATA
&__DDRSS1_PHY_41_DATA=0x01000100
LOCAL &__DDRSS1_PHY_42_DATA
&__DDRSS1_PHY_42_DATA=0x00800180
LOCAL &__DDRSS1_PHY_43_DATA
&__DDRSS1_PHY_43_DATA=0x00000001
LOCAL &__DDRSS1_PHY_44_DATA
&__DDRSS1_PHY_44_DATA=0x00000000
LOCAL &__DDRSS1_PHY_45_DATA
&__DDRSS1_PHY_45_DATA=0x00000000
LOCAL &__DDRSS1_PHY_46_DATA
&__DDRSS1_PHY_46_DATA=0x00000000
LOCAL &__DDRSS1_PHY_47_DATA
&__DDRSS1_PHY_47_DATA=0x00000000
LOCAL &__DDRSS1_PHY_48_DATA
&__DDRSS1_PHY_48_DATA=0x00000000
LOCAL &__DDRSS1_PHY_49_DATA
&__DDRSS1_PHY_49_DATA=0x00000000
LOCAL &__DDRSS1_PHY_50_DATA
&__DDRSS1_PHY_50_DATA=0x00000000
LOCAL &__DDRSS1_PHY_51_DATA
&__DDRSS1_PHY_51_DATA=0x00000000
LOCAL &__DDRSS1_PHY_52_DATA
&__DDRSS1_PHY_52_DATA=0x00000000
LOCAL &__DDRSS1_PHY_53_DATA
&__DDRSS1_PHY_53_DATA=0x00000000
LOCAL &__DDRSS1_PHY_54_DATA
&__DDRSS1_PHY_54_DATA=0x00000000
LOCAL &__DDRSS1_PHY_55_DATA
&__DDRSS1_PHY_55_DATA=0x00000000
LOCAL &__DDRSS1_PHY_56_DATA
&__DDRSS1_PHY_56_DATA=0x00000000
LOCAL &__DDRSS1_PHY_57_DATA
&__DDRSS1_PHY_57_DATA=0x00000000
LOCAL &__DDRSS1_PHY_58_DATA
&__DDRSS1_PHY_58_DATA=0x00000000
LOCAL &__DDRSS1_PHY_59_DATA
&__DDRSS1_PHY_59_DATA=0x00000000
LOCAL &__DDRSS1_PHY_60_DATA
&__DDRSS1_PHY_60_DATA=0x00000000
LOCAL &__DDRSS1_PHY_61_DATA
&__DDRSS1_PHY_61_DATA=0x00000000
LOCAL &__DDRSS1_PHY_62_DATA
&__DDRSS1_PHY_62_DATA=0x00000000
LOCAL &__DDRSS1_PHY_63_DATA
&__DDRSS1_PHY_63_DATA=0x00000000
LOCAL &__DDRSS1_PHY_64_DATA
&__DDRSS1_PHY_64_DATA=0x00000000
LOCAL &__DDRSS1_PHY_65_DATA
&__DDRSS1_PHY_65_DATA=0x00000000
LOCAL &__DDRSS1_PHY_66_DATA
&__DDRSS1_PHY_66_DATA=0x00000104
LOCAL &__DDRSS1_PHY_67_DATA
&__DDRSS1_PHY_67_DATA=0x00000120
LOCAL &__DDRSS1_PHY_68_DATA
&__DDRSS1_PHY_68_DATA=0x00000000
LOCAL &__DDRSS1_PHY_69_DATA
&__DDRSS1_PHY_69_DATA=0x00000000
LOCAL &__DDRSS1_PHY_70_DATA
&__DDRSS1_PHY_70_DATA=0x00000000
LOCAL &__DDRSS1_PHY_71_DATA
&__DDRSS1_PHY_71_DATA=0x00000000
LOCAL &__DDRSS1_PHY_72_DATA
&__DDRSS1_PHY_72_DATA=0x00000000
LOCAL &__DDRSS1_PHY_73_DATA
&__DDRSS1_PHY_73_DATA=0x00000000
LOCAL &__DDRSS1_PHY_74_DATA
&__DDRSS1_PHY_74_DATA=0x00000000
LOCAL &__DDRSS1_PHY_75_DATA
&__DDRSS1_PHY_75_DATA=0x00000001
LOCAL &__DDRSS1_PHY_76_DATA
&__DDRSS1_PHY_76_DATA=0x07FF0000
LOCAL &__DDRSS1_PHY_77_DATA
&__DDRSS1_PHY_77_DATA=0x0080081F
LOCAL &__DDRSS1_PHY_78_DATA
&__DDRSS1_PHY_78_DATA=0x00081020
LOCAL &__DDRSS1_PHY_79_DATA
&__DDRSS1_PHY_79_DATA=0x04010000
LOCAL &__DDRSS1_PHY_80_DATA
&__DDRSS1_PHY_80_DATA=0x00000000
LOCAL &__DDRSS1_PHY_81_DATA
&__DDRSS1_PHY_81_DATA=0x00000000
LOCAL &__DDRSS1_PHY_82_DATA
&__DDRSS1_PHY_82_DATA=0x00000000
LOCAL &__DDRSS1_PHY_83_DATA
&__DDRSS1_PHY_83_DATA=0x00000100
LOCAL &__DDRSS1_PHY_84_DATA
&__DDRSS1_PHY_84_DATA=0x01CC0C01
LOCAL &__DDRSS1_PHY_85_DATA
&__DDRSS1_PHY_85_DATA=0x1003CC0C
LOCAL &__DDRSS1_PHY_86_DATA
&__DDRSS1_PHY_86_DATA=0x20000140
LOCAL &__DDRSS1_PHY_87_DATA
&__DDRSS1_PHY_87_DATA=0x07FF0200
LOCAL &__DDRSS1_PHY_88_DATA
&__DDRSS1_PHY_88_DATA=0x0000DD01
LOCAL &__DDRSS1_PHY_89_DATA
&__DDRSS1_PHY_89_DATA=0x10100303
LOCAL &__DDRSS1_PHY_90_DATA
&__DDRSS1_PHY_90_DATA=0x10101010
LOCAL &__DDRSS1_PHY_91_DATA
&__DDRSS1_PHY_91_DATA=0x10101010
LOCAL &__DDRSS1_PHY_92_DATA
&__DDRSS1_PHY_92_DATA=0x00011010
LOCAL &__DDRSS1_PHY_93_DATA
&__DDRSS1_PHY_93_DATA=0x00100010
LOCAL &__DDRSS1_PHY_94_DATA
&__DDRSS1_PHY_94_DATA=0x00100010
LOCAL &__DDRSS1_PHY_95_DATA
&__DDRSS1_PHY_95_DATA=0x00100010
LOCAL &__DDRSS1_PHY_96_DATA
&__DDRSS1_PHY_96_DATA=0x00100010
LOCAL &__DDRSS1_PHY_97_DATA
&__DDRSS1_PHY_97_DATA=0x00050010
LOCAL &__DDRSS1_PHY_98_DATA
&__DDRSS1_PHY_98_DATA=0x51517041
LOCAL &__DDRSS1_PHY_99_DATA
&__DDRSS1_PHY_99_DATA=0x31C06000
LOCAL &__DDRSS1_PHY_100_DATA
&__DDRSS1_PHY_100_DATA=0x07AB0340
LOCAL &__DDRSS1_PHY_101_DATA
&__DDRSS1_PHY_101_DATA=0x00C0C001
LOCAL &__DDRSS1_PHY_102_DATA
&__DDRSS1_PHY_102_DATA=0x07060001
LOCAL &__DDRSS1_PHY_103_DATA
&__DDRSS1_PHY_103_DATA=0x10001000
LOCAL &__DDRSS1_PHY_104_DATA
&__DDRSS1_PHY_104_DATA=0x0C063E42
LOCAL &__DDRSS1_PHY_105_DATA
&__DDRSS1_PHY_105_DATA=0x0F0C2201
LOCAL &__DDRSS1_PHY_106_DATA
&__DDRSS1_PHY_106_DATA=0x01000140
LOCAL &__DDRSS1_PHY_107_DATA
&__DDRSS1_PHY_107_DATA=0x0C000420
LOCAL &__DDRSS1_PHY_108_DATA
&__DDRSS1_PHY_108_DATA=0x00000198
LOCAL &__DDRSS1_PHY_109_DATA
&__DDRSS1_PHY_109_DATA=0x0A0000D0
LOCAL &__DDRSS1_PHY_110_DATA
&__DDRSS1_PHY_110_DATA=0x00030200
LOCAL &__DDRSS1_PHY_111_DATA
&__DDRSS1_PHY_111_DATA=0x02800000
LOCAL &__DDRSS1_PHY_112_DATA
&__DDRSS1_PHY_112_DATA=0x80800000
LOCAL &__DDRSS1_PHY_113_DATA
&__DDRSS1_PHY_113_DATA=0x00072010
LOCAL &__DDRSS1_PHY_114_DATA
&__DDRSS1_PHY_114_DATA=0x76543210
LOCAL &__DDRSS1_PHY_115_DATA
&__DDRSS1_PHY_115_DATA=0x00000008
LOCAL &__DDRSS1_PHY_116_DATA
&__DDRSS1_PHY_116_DATA=0x02800280
LOCAL &__DDRSS1_PHY_117_DATA
&__DDRSS1_PHY_117_DATA=0x02800280
LOCAL &__DDRSS1_PHY_118_DATA
&__DDRSS1_PHY_118_DATA=0x02800280
LOCAL &__DDRSS1_PHY_119_DATA
&__DDRSS1_PHY_119_DATA=0x02800280
LOCAL &__DDRSS1_PHY_120_DATA
&__DDRSS1_PHY_120_DATA=0x00000280
LOCAL &__DDRSS1_PHY_121_DATA
&__DDRSS1_PHY_121_DATA=0x0000A000
LOCAL &__DDRSS1_PHY_122_DATA
&__DDRSS1_PHY_122_DATA=0x00A000A0
LOCAL &__DDRSS1_PHY_123_DATA
&__DDRSS1_PHY_123_DATA=0x00A000A0
LOCAL &__DDRSS1_PHY_124_DATA
&__DDRSS1_PHY_124_DATA=0x00A000A0
LOCAL &__DDRSS1_PHY_125_DATA
&__DDRSS1_PHY_125_DATA=0x00A000A0
LOCAL &__DDRSS1_PHY_126_DATA
&__DDRSS1_PHY_126_DATA=0x00A000A0
LOCAL &__DDRSS1_PHY_127_DATA
&__DDRSS1_PHY_127_DATA=0x00A000A0
LOCAL &__DDRSS1_PHY_128_DATA
&__DDRSS1_PHY_128_DATA=0x00A000A0
LOCAL &__DDRSS1_PHY_129_DATA
&__DDRSS1_PHY_129_DATA=0x00A000A0
LOCAL &__DDRSS1_PHY_130_DATA
&__DDRSS1_PHY_130_DATA=0x006E00A0
LOCAL &__DDRSS1_PHY_131_DATA
&__DDRSS1_PHY_131_DATA=0x01A00003
LOCAL &__DDRSS1_PHY_132_DATA
&__DDRSS1_PHY_132_DATA=0x00000000
LOCAL &__DDRSS1_PHY_133_DATA
&__DDRSS1_PHY_133_DATA=0x00000000
LOCAL &__DDRSS1_PHY_134_DATA
&__DDRSS1_PHY_134_DATA=0x00080200
LOCAL &__DDRSS1_PHY_135_DATA
&__DDRSS1_PHY_135_DATA=0x00000000
LOCAL &__DDRSS1_PHY_136_DATA
&__DDRSS1_PHY_136_DATA=0x20202000
LOCAL &__DDRSS1_PHY_137_DATA
&__DDRSS1_PHY_137_DATA=0x20202020
LOCAL &__DDRSS1_PHY_138_DATA
&__DDRSS1_PHY_138_DATA=0xF0F02020
LOCAL &__DDRSS1_PHY_139_DATA
&__DDRSS1_PHY_139_DATA=0x00000000
LOCAL &__DDRSS1_PHY_140_DATA
&__DDRSS1_PHY_140_DATA=0x00000000
LOCAL &__DDRSS1_PHY_141_DATA
&__DDRSS1_PHY_141_DATA=0x00000000
LOCAL &__DDRSS1_PHY_142_DATA
&__DDRSS1_PHY_142_DATA=0x00000000
LOCAL &__DDRSS1_PHY_143_DATA
&__DDRSS1_PHY_143_DATA=0x00000000
LOCAL &__DDRSS1_PHY_144_DATA
&__DDRSS1_PHY_144_DATA=0x00000000
LOCAL &__DDRSS1_PHY_145_DATA
&__DDRSS1_PHY_145_DATA=0x00000000
LOCAL &__DDRSS1_PHY_146_DATA
&__DDRSS1_PHY_146_DATA=0x00000000
LOCAL &__DDRSS1_PHY_147_DATA
&__DDRSS1_PHY_147_DATA=0x00000000
LOCAL &__DDRSS1_PHY_148_DATA
&__DDRSS1_PHY_148_DATA=0x00000000
LOCAL &__DDRSS1_PHY_149_DATA
&__DDRSS1_PHY_149_DATA=0x00000000
LOCAL &__DDRSS1_PHY_150_DATA
&__DDRSS1_PHY_150_DATA=0x00000000
LOCAL &__DDRSS1_PHY_151_DATA
&__DDRSS1_PHY_151_DATA=0x00000000
LOCAL &__DDRSS1_PHY_152_DATA
&__DDRSS1_PHY_152_DATA=0x00000000
LOCAL &__DDRSS1_PHY_153_DATA
&__DDRSS1_PHY_153_DATA=0x00000000
LOCAL &__DDRSS1_PHY_154_DATA
&__DDRSS1_PHY_154_DATA=0x00000000
LOCAL &__DDRSS1_PHY_155_DATA
&__DDRSS1_PHY_155_DATA=0x00000000
LOCAL &__DDRSS1_PHY_156_DATA
&__DDRSS1_PHY_156_DATA=0x00000000
LOCAL &__DDRSS1_PHY_157_DATA
&__DDRSS1_PHY_157_DATA=0x00000000
LOCAL &__DDRSS1_PHY_158_DATA
&__DDRSS1_PHY_158_DATA=0x00000000
LOCAL &__DDRSS1_PHY_159_DATA
&__DDRSS1_PHY_159_DATA=0x00000000
LOCAL &__DDRSS1_PHY_160_DATA
&__DDRSS1_PHY_160_DATA=0x00000000
LOCAL &__DDRSS1_PHY_161_DATA
&__DDRSS1_PHY_161_DATA=0x00000000
LOCAL &__DDRSS1_PHY_162_DATA
&__DDRSS1_PHY_162_DATA=0x00000000
LOCAL &__DDRSS1_PHY_163_DATA
&__DDRSS1_PHY_163_DATA=0x00000000
LOCAL &__DDRSS1_PHY_164_DATA
&__DDRSS1_PHY_164_DATA=0x00000000
LOCAL &__DDRSS1_PHY_165_DATA
&__DDRSS1_PHY_165_DATA=0x00000000
LOCAL &__DDRSS1_PHY_166_DATA
&__DDRSS1_PHY_166_DATA=0x00000000
LOCAL &__DDRSS1_PHY_167_DATA
&__DDRSS1_PHY_167_DATA=0x00000000
LOCAL &__DDRSS1_PHY_168_DATA
&__DDRSS1_PHY_168_DATA=0x00000000
LOCAL &__DDRSS1_PHY_169_DATA
&__DDRSS1_PHY_169_DATA=0x00000000
LOCAL &__DDRSS1_PHY_170_DATA
&__DDRSS1_PHY_170_DATA=0x00000000
LOCAL &__DDRSS1_PHY_171_DATA
&__DDRSS1_PHY_171_DATA=0x00000000
LOCAL &__DDRSS1_PHY_172_DATA
&__DDRSS1_PHY_172_DATA=0x00000000
LOCAL &__DDRSS1_PHY_173_DATA
&__DDRSS1_PHY_173_DATA=0x00000000
LOCAL &__DDRSS1_PHY_174_DATA
&__DDRSS1_PHY_174_DATA=0x00000000
LOCAL &__DDRSS1_PHY_175_DATA
&__DDRSS1_PHY_175_DATA=0x00000000
LOCAL &__DDRSS1_PHY_176_DATA
&__DDRSS1_PHY_176_DATA=0x00000000
LOCAL &__DDRSS1_PHY_177_DATA
&__DDRSS1_PHY_177_DATA=0x00000000
LOCAL &__DDRSS1_PHY_178_DATA
&__DDRSS1_PHY_178_DATA=0x00000000
LOCAL &__DDRSS1_PHY_179_DATA
&__DDRSS1_PHY_179_DATA=0x00000000
LOCAL &__DDRSS1_PHY_180_DATA
&__DDRSS1_PHY_180_DATA=0x00000000
LOCAL &__DDRSS1_PHY_181_DATA
&__DDRSS1_PHY_181_DATA=0x00000000
LOCAL &__DDRSS1_PHY_182_DATA
&__DDRSS1_PHY_182_DATA=0x00000000
LOCAL &__DDRSS1_PHY_183_DATA
&__DDRSS1_PHY_183_DATA=0x00000000
LOCAL &__DDRSS1_PHY_184_DATA
&__DDRSS1_PHY_184_DATA=0x00000000
LOCAL &__DDRSS1_PHY_185_DATA
&__DDRSS1_PHY_185_DATA=0x00000000
LOCAL &__DDRSS1_PHY_186_DATA
&__DDRSS1_PHY_186_DATA=0x00000000
LOCAL &__DDRSS1_PHY_187_DATA
&__DDRSS1_PHY_187_DATA=0x00000000
LOCAL &__DDRSS1_PHY_188_DATA
&__DDRSS1_PHY_188_DATA=0x00000000
LOCAL &__DDRSS1_PHY_189_DATA
&__DDRSS1_PHY_189_DATA=0x00000000
LOCAL &__DDRSS1_PHY_190_DATA
&__DDRSS1_PHY_190_DATA=0x00000000
LOCAL &__DDRSS1_PHY_191_DATA
&__DDRSS1_PHY_191_DATA=0x00000000
LOCAL &__DDRSS1_PHY_192_DATA
&__DDRSS1_PHY_192_DATA=0x00000000
LOCAL &__DDRSS1_PHY_193_DATA
&__DDRSS1_PHY_193_DATA=0x00000000
LOCAL &__DDRSS1_PHY_194_DATA
&__DDRSS1_PHY_194_DATA=0x00000000
LOCAL &__DDRSS1_PHY_195_DATA
&__DDRSS1_PHY_195_DATA=0x00000000
LOCAL &__DDRSS1_PHY_196_DATA
&__DDRSS1_PHY_196_DATA=0x00000000
LOCAL &__DDRSS1_PHY_197_DATA
&__DDRSS1_PHY_197_DATA=0x00000000
LOCAL &__DDRSS1_PHY_198_DATA
&__DDRSS1_PHY_198_DATA=0x00000000
LOCAL &__DDRSS1_PHY_199_DATA
&__DDRSS1_PHY_199_DATA=0x00000000
LOCAL &__DDRSS1_PHY_200_DATA
&__DDRSS1_PHY_200_DATA=0x00000000
LOCAL &__DDRSS1_PHY_201_DATA
&__DDRSS1_PHY_201_DATA=0x00000000
LOCAL &__DDRSS1_PHY_202_DATA
&__DDRSS1_PHY_202_DATA=0x00000000
LOCAL &__DDRSS1_PHY_203_DATA
&__DDRSS1_PHY_203_DATA=0x00000000
LOCAL &__DDRSS1_PHY_204_DATA
&__DDRSS1_PHY_204_DATA=0x00000000
LOCAL &__DDRSS1_PHY_205_DATA
&__DDRSS1_PHY_205_DATA=0x00000000
LOCAL &__DDRSS1_PHY_206_DATA
&__DDRSS1_PHY_206_DATA=0x00000000
LOCAL &__DDRSS1_PHY_207_DATA
&__DDRSS1_PHY_207_DATA=0x00000000
LOCAL &__DDRSS1_PHY_208_DATA
&__DDRSS1_PHY_208_DATA=0x00000000
LOCAL &__DDRSS1_PHY_209_DATA
&__DDRSS1_PHY_209_DATA=0x00000000
LOCAL &__DDRSS1_PHY_210_DATA
&__DDRSS1_PHY_210_DATA=0x00000000
LOCAL &__DDRSS1_PHY_211_DATA
&__DDRSS1_PHY_211_DATA=0x00000000
LOCAL &__DDRSS1_PHY_212_DATA
&__DDRSS1_PHY_212_DATA=0x00000000
LOCAL &__DDRSS1_PHY_213_DATA
&__DDRSS1_PHY_213_DATA=0x00000000
LOCAL &__DDRSS1_PHY_214_DATA
&__DDRSS1_PHY_214_DATA=0x00000000
LOCAL &__DDRSS1_PHY_215_DATA
&__DDRSS1_PHY_215_DATA=0x00000000
LOCAL &__DDRSS1_PHY_216_DATA
&__DDRSS1_PHY_216_DATA=0x00000000
LOCAL &__DDRSS1_PHY_217_DATA
&__DDRSS1_PHY_217_DATA=0x00000000
LOCAL &__DDRSS1_PHY_218_DATA
&__DDRSS1_PHY_218_DATA=0x00000000
LOCAL &__DDRSS1_PHY_219_DATA
&__DDRSS1_PHY_219_DATA=0x00000000
LOCAL &__DDRSS1_PHY_220_DATA
&__DDRSS1_PHY_220_DATA=0x00000000
LOCAL &__DDRSS1_PHY_221_DATA
&__DDRSS1_PHY_221_DATA=0x00000000
LOCAL &__DDRSS1_PHY_222_DATA
&__DDRSS1_PHY_222_DATA=0x00000000
LOCAL &__DDRSS1_PHY_223_DATA
&__DDRSS1_PHY_223_DATA=0x00000000
LOCAL &__DDRSS1_PHY_224_DATA
&__DDRSS1_PHY_224_DATA=0x00000000
LOCAL &__DDRSS1_PHY_225_DATA
&__DDRSS1_PHY_225_DATA=0x00000000
LOCAL &__DDRSS1_PHY_226_DATA
&__DDRSS1_PHY_226_DATA=0x00000000
LOCAL &__DDRSS1_PHY_227_DATA
&__DDRSS1_PHY_227_DATA=0x00000000
LOCAL &__DDRSS1_PHY_228_DATA
&__DDRSS1_PHY_228_DATA=0x00000000
LOCAL &__DDRSS1_PHY_229_DATA
&__DDRSS1_PHY_229_DATA=0x00000000
LOCAL &__DDRSS1_PHY_230_DATA
&__DDRSS1_PHY_230_DATA=0x00000000
LOCAL &__DDRSS1_PHY_231_DATA
&__DDRSS1_PHY_231_DATA=0x00000000
LOCAL &__DDRSS1_PHY_232_DATA
&__DDRSS1_PHY_232_DATA=0x00000000
LOCAL &__DDRSS1_PHY_233_DATA
&__DDRSS1_PHY_233_DATA=0x00000000
LOCAL &__DDRSS1_PHY_234_DATA
&__DDRSS1_PHY_234_DATA=0x00000000
LOCAL &__DDRSS1_PHY_235_DATA
&__DDRSS1_PHY_235_DATA=0x00000000
LOCAL &__DDRSS1_PHY_236_DATA
&__DDRSS1_PHY_236_DATA=0x00000000
LOCAL &__DDRSS1_PHY_237_DATA
&__DDRSS1_PHY_237_DATA=0x00000000
LOCAL &__DDRSS1_PHY_238_DATA
&__DDRSS1_PHY_238_DATA=0x00000000
LOCAL &__DDRSS1_PHY_239_DATA
&__DDRSS1_PHY_239_DATA=0x00000000
LOCAL &__DDRSS1_PHY_240_DATA
&__DDRSS1_PHY_240_DATA=0x00000000
LOCAL &__DDRSS1_PHY_241_DATA
&__DDRSS1_PHY_241_DATA=0x00000000
LOCAL &__DDRSS1_PHY_242_DATA
&__DDRSS1_PHY_242_DATA=0x00000000
LOCAL &__DDRSS1_PHY_243_DATA
&__DDRSS1_PHY_243_DATA=0x00000000
LOCAL &__DDRSS1_PHY_244_DATA
&__DDRSS1_PHY_244_DATA=0x00000000
LOCAL &__DDRSS1_PHY_245_DATA
&__DDRSS1_PHY_245_DATA=0x00000000
LOCAL &__DDRSS1_PHY_246_DATA
&__DDRSS1_PHY_246_DATA=0x00000000
LOCAL &__DDRSS1_PHY_247_DATA
&__DDRSS1_PHY_247_DATA=0x00000000
LOCAL &__DDRSS1_PHY_248_DATA
&__DDRSS1_PHY_248_DATA=0x00000000
LOCAL &__DDRSS1_PHY_249_DATA
&__DDRSS1_PHY_249_DATA=0x00000000
LOCAL &__DDRSS1_PHY_250_DATA
&__DDRSS1_PHY_250_DATA=0x00000000
LOCAL &__DDRSS1_PHY_251_DATA
&__DDRSS1_PHY_251_DATA=0x00000000
LOCAL &__DDRSS1_PHY_252_DATA
&__DDRSS1_PHY_252_DATA=0x00000000
LOCAL &__DDRSS1_PHY_253_DATA
&__DDRSS1_PHY_253_DATA=0x00000000
LOCAL &__DDRSS1_PHY_254_DATA
&__DDRSS1_PHY_254_DATA=0x00000000
LOCAL &__DDRSS1_PHY_255_DATA
&__DDRSS1_PHY_255_DATA=0x00000000
LOCAL &__DDRSS1_PHY_256_DATA
&__DDRSS1_PHY_256_DATA=0x000004F0
LOCAL &__DDRSS1_PHY_257_DATA
&__DDRSS1_PHY_257_DATA=0x00000000
LOCAL &__DDRSS1_PHY_258_DATA
&__DDRSS1_PHY_258_DATA=0x00030200
LOCAL &__DDRSS1_PHY_259_DATA
&__DDRSS1_PHY_259_DATA=0x00000000
LOCAL &__DDRSS1_PHY_260_DATA
&__DDRSS1_PHY_260_DATA=0x00000000
LOCAL &__DDRSS1_PHY_261_DATA
&__DDRSS1_PHY_261_DATA=0x01030000
LOCAL &__DDRSS1_PHY_262_DATA
&__DDRSS1_PHY_262_DATA=0x00010000
LOCAL &__DDRSS1_PHY_263_DATA
&__DDRSS1_PHY_263_DATA=0x01030004
LOCAL &__DDRSS1_PHY_264_DATA
&__DDRSS1_PHY_264_DATA=0x01000000
LOCAL &__DDRSS1_PHY_265_DATA
&__DDRSS1_PHY_265_DATA=0x00000000
LOCAL &__DDRSS1_PHY_266_DATA
&__DDRSS1_PHY_266_DATA=0x00000000
LOCAL &__DDRSS1_PHY_267_DATA
&__DDRSS1_PHY_267_DATA=0x01000001
LOCAL &__DDRSS1_PHY_268_DATA
&__DDRSS1_PHY_268_DATA=0x00000100
LOCAL &__DDRSS1_PHY_269_DATA
&__DDRSS1_PHY_269_DATA=0x000800C0
LOCAL &__DDRSS1_PHY_270_DATA
&__DDRSS1_PHY_270_DATA=0x060100CC
LOCAL &__DDRSS1_PHY_271_DATA
&__DDRSS1_PHY_271_DATA=0x00030066
LOCAL &__DDRSS1_PHY_272_DATA
&__DDRSS1_PHY_272_DATA=0x00000000
LOCAL &__DDRSS1_PHY_273_DATA
&__DDRSS1_PHY_273_DATA=0x00000301
LOCAL &__DDRSS1_PHY_274_DATA
&__DDRSS1_PHY_274_DATA=0x0000AAAA
LOCAL &__DDRSS1_PHY_275_DATA
&__DDRSS1_PHY_275_DATA=0x00005555
LOCAL &__DDRSS1_PHY_276_DATA
&__DDRSS1_PHY_276_DATA=0x0000B5B5
LOCAL &__DDRSS1_PHY_277_DATA
&__DDRSS1_PHY_277_DATA=0x00004A4A
LOCAL &__DDRSS1_PHY_278_DATA
&__DDRSS1_PHY_278_DATA=0x00005656
LOCAL &__DDRSS1_PHY_279_DATA
&__DDRSS1_PHY_279_DATA=0x0000A9A9
LOCAL &__DDRSS1_PHY_280_DATA
&__DDRSS1_PHY_280_DATA=0x0000A9A9
LOCAL &__DDRSS1_PHY_281_DATA
&__DDRSS1_PHY_281_DATA=0x0000B5B5
LOCAL &__DDRSS1_PHY_282_DATA
&__DDRSS1_PHY_282_DATA=0x00000000
LOCAL &__DDRSS1_PHY_283_DATA
&__DDRSS1_PHY_283_DATA=0x00000000
LOCAL &__DDRSS1_PHY_284_DATA
&__DDRSS1_PHY_284_DATA=0x2A000000
LOCAL &__DDRSS1_PHY_285_DATA
&__DDRSS1_PHY_285_DATA=0x00000808
LOCAL &__DDRSS1_PHY_286_DATA
&__DDRSS1_PHY_286_DATA=0x0F000000
LOCAL &__DDRSS1_PHY_287_DATA
&__DDRSS1_PHY_287_DATA=0x00000F0F
LOCAL &__DDRSS1_PHY_288_DATA
&__DDRSS1_PHY_288_DATA=0x10200000
LOCAL &__DDRSS1_PHY_289_DATA
&__DDRSS1_PHY_289_DATA=0x0C002006
LOCAL &__DDRSS1_PHY_290_DATA
&__DDRSS1_PHY_290_DATA=0x00000000
LOCAL &__DDRSS1_PHY_291_DATA
&__DDRSS1_PHY_291_DATA=0x00000000
LOCAL &__DDRSS1_PHY_292_DATA
&__DDRSS1_PHY_292_DATA=0x55555555
LOCAL &__DDRSS1_PHY_293_DATA
&__DDRSS1_PHY_293_DATA=0xAAAAAAAA
LOCAL &__DDRSS1_PHY_294_DATA
&__DDRSS1_PHY_294_DATA=0x55555555
LOCAL &__DDRSS1_PHY_295_DATA
&__DDRSS1_PHY_295_DATA=0xAAAAAAAA
LOCAL &__DDRSS1_PHY_296_DATA
&__DDRSS1_PHY_296_DATA=0x00005555
LOCAL &__DDRSS1_PHY_297_DATA
&__DDRSS1_PHY_297_DATA=0x01000100
LOCAL &__DDRSS1_PHY_298_DATA
&__DDRSS1_PHY_298_DATA=0x00800180
LOCAL &__DDRSS1_PHY_299_DATA
&__DDRSS1_PHY_299_DATA=0x00000000
LOCAL &__DDRSS1_PHY_300_DATA
&__DDRSS1_PHY_300_DATA=0x00000000
LOCAL &__DDRSS1_PHY_301_DATA
&__DDRSS1_PHY_301_DATA=0x00000000
LOCAL &__DDRSS1_PHY_302_DATA
&__DDRSS1_PHY_302_DATA=0x00000000
LOCAL &__DDRSS1_PHY_303_DATA
&__DDRSS1_PHY_303_DATA=0x00000000
LOCAL &__DDRSS1_PHY_304_DATA
&__DDRSS1_PHY_304_DATA=0x00000000
LOCAL &__DDRSS1_PHY_305_DATA
&__DDRSS1_PHY_305_DATA=0x00000000
LOCAL &__DDRSS1_PHY_306_DATA
&__DDRSS1_PHY_306_DATA=0x00000000
LOCAL &__DDRSS1_PHY_307_DATA
&__DDRSS1_PHY_307_DATA=0x00000000
LOCAL &__DDRSS1_PHY_308_DATA
&__DDRSS1_PHY_308_DATA=0x00000000
LOCAL &__DDRSS1_PHY_309_DATA
&__DDRSS1_PHY_309_DATA=0x00000000
LOCAL &__DDRSS1_PHY_310_DATA
&__DDRSS1_PHY_310_DATA=0x00000000
LOCAL &__DDRSS1_PHY_311_DATA
&__DDRSS1_PHY_311_DATA=0x00000000
LOCAL &__DDRSS1_PHY_312_DATA
&__DDRSS1_PHY_312_DATA=0x00000000
LOCAL &__DDRSS1_PHY_313_DATA
&__DDRSS1_PHY_313_DATA=0x00000000
LOCAL &__DDRSS1_PHY_314_DATA
&__DDRSS1_PHY_314_DATA=0x00000000
LOCAL &__DDRSS1_PHY_315_DATA
&__DDRSS1_PHY_315_DATA=0x00000000
LOCAL &__DDRSS1_PHY_316_DATA
&__DDRSS1_PHY_316_DATA=0x00000000
LOCAL &__DDRSS1_PHY_317_DATA
&__DDRSS1_PHY_317_DATA=0x00000000
LOCAL &__DDRSS1_PHY_318_DATA
&__DDRSS1_PHY_318_DATA=0x00000000
LOCAL &__DDRSS1_PHY_319_DATA
&__DDRSS1_PHY_319_DATA=0x00000000
LOCAL &__DDRSS1_PHY_320_DATA
&__DDRSS1_PHY_320_DATA=0x00000000
LOCAL &__DDRSS1_PHY_321_DATA
&__DDRSS1_PHY_321_DATA=0x00000000
LOCAL &__DDRSS1_PHY_322_DATA
&__DDRSS1_PHY_322_DATA=0x00000104
LOCAL &__DDRSS1_PHY_323_DATA
&__DDRSS1_PHY_323_DATA=0x00000120
LOCAL &__DDRSS1_PHY_324_DATA
&__DDRSS1_PHY_324_DATA=0x00000000
LOCAL &__DDRSS1_PHY_325_DATA
&__DDRSS1_PHY_325_DATA=0x00000000
LOCAL &__DDRSS1_PHY_326_DATA
&__DDRSS1_PHY_326_DATA=0x00000000
LOCAL &__DDRSS1_PHY_327_DATA
&__DDRSS1_PHY_327_DATA=0x00000000
LOCAL &__DDRSS1_PHY_328_DATA
&__DDRSS1_PHY_328_DATA=0x00000000
LOCAL &__DDRSS1_PHY_329_DATA
&__DDRSS1_PHY_329_DATA=0x00000000
LOCAL &__DDRSS1_PHY_330_DATA
&__DDRSS1_PHY_330_DATA=0x00000000
LOCAL &__DDRSS1_PHY_331_DATA
&__DDRSS1_PHY_331_DATA=0x00000001
LOCAL &__DDRSS1_PHY_332_DATA
&__DDRSS1_PHY_332_DATA=0x07FF0000
LOCAL &__DDRSS1_PHY_333_DATA
&__DDRSS1_PHY_333_DATA=0x0080081F
LOCAL &__DDRSS1_PHY_334_DATA
&__DDRSS1_PHY_334_DATA=0x00081020
LOCAL &__DDRSS1_PHY_335_DATA
&__DDRSS1_PHY_335_DATA=0x04010000
LOCAL &__DDRSS1_PHY_336_DATA
&__DDRSS1_PHY_336_DATA=0x00000000
LOCAL &__DDRSS1_PHY_337_DATA
&__DDRSS1_PHY_337_DATA=0x00000000
LOCAL &__DDRSS1_PHY_338_DATA
&__DDRSS1_PHY_338_DATA=0x00000000
LOCAL &__DDRSS1_PHY_339_DATA
&__DDRSS1_PHY_339_DATA=0x00000100
LOCAL &__DDRSS1_PHY_340_DATA
&__DDRSS1_PHY_340_DATA=0x01CC0C01
LOCAL &__DDRSS1_PHY_341_DATA
&__DDRSS1_PHY_341_DATA=0x1003CC0C
LOCAL &__DDRSS1_PHY_342_DATA
&__DDRSS1_PHY_342_DATA=0x20000140
LOCAL &__DDRSS1_PHY_343_DATA
&__DDRSS1_PHY_343_DATA=0x07FF0200
LOCAL &__DDRSS1_PHY_344_DATA
&__DDRSS1_PHY_344_DATA=0x0000DD01
LOCAL &__DDRSS1_PHY_345_DATA
&__DDRSS1_PHY_345_DATA=0x10100303
LOCAL &__DDRSS1_PHY_346_DATA
&__DDRSS1_PHY_346_DATA=0x10101010
LOCAL &__DDRSS1_PHY_347_DATA
&__DDRSS1_PHY_347_DATA=0x10101010
LOCAL &__DDRSS1_PHY_348_DATA
&__DDRSS1_PHY_348_DATA=0x00011010
LOCAL &__DDRSS1_PHY_349_DATA
&__DDRSS1_PHY_349_DATA=0x00100010
LOCAL &__DDRSS1_PHY_350_DATA
&__DDRSS1_PHY_350_DATA=0x00100010
LOCAL &__DDRSS1_PHY_351_DATA
&__DDRSS1_PHY_351_DATA=0x00100010
LOCAL &__DDRSS1_PHY_352_DATA
&__DDRSS1_PHY_352_DATA=0x00100010
LOCAL &__DDRSS1_PHY_353_DATA
&__DDRSS1_PHY_353_DATA=0x00050010
LOCAL &__DDRSS1_PHY_354_DATA
&__DDRSS1_PHY_354_DATA=0x51517041
LOCAL &__DDRSS1_PHY_355_DATA
&__DDRSS1_PHY_355_DATA=0x31C06000
LOCAL &__DDRSS1_PHY_356_DATA
&__DDRSS1_PHY_356_DATA=0x07AB0340
LOCAL &__DDRSS1_PHY_357_DATA
&__DDRSS1_PHY_357_DATA=0x00C0C001
LOCAL &__DDRSS1_PHY_358_DATA
&__DDRSS1_PHY_358_DATA=0x07060001
LOCAL &__DDRSS1_PHY_359_DATA
&__DDRSS1_PHY_359_DATA=0x10001000
LOCAL &__DDRSS1_PHY_360_DATA
&__DDRSS1_PHY_360_DATA=0x0C063E42
LOCAL &__DDRSS1_PHY_361_DATA
&__DDRSS1_PHY_361_DATA=0x0F0C2201
LOCAL &__DDRSS1_PHY_362_DATA
&__DDRSS1_PHY_362_DATA=0x01000140
LOCAL &__DDRSS1_PHY_363_DATA
&__DDRSS1_PHY_363_DATA=0x0C000420
LOCAL &__DDRSS1_PHY_364_DATA
&__DDRSS1_PHY_364_DATA=0x00000198
LOCAL &__DDRSS1_PHY_365_DATA
&__DDRSS1_PHY_365_DATA=0x0A0000D0
LOCAL &__DDRSS1_PHY_366_DATA
&__DDRSS1_PHY_366_DATA=0x00030200
LOCAL &__DDRSS1_PHY_367_DATA
&__DDRSS1_PHY_367_DATA=0x02800000
LOCAL &__DDRSS1_PHY_368_DATA
&__DDRSS1_PHY_368_DATA=0x80800000
LOCAL &__DDRSS1_PHY_369_DATA
&__DDRSS1_PHY_369_DATA=0x00072010
LOCAL &__DDRSS1_PHY_370_DATA
&__DDRSS1_PHY_370_DATA=0x76543210
LOCAL &__DDRSS1_PHY_371_DATA
&__DDRSS1_PHY_371_DATA=0x00000008
LOCAL &__DDRSS1_PHY_372_DATA
&__DDRSS1_PHY_372_DATA=0x02800280
LOCAL &__DDRSS1_PHY_373_DATA
&__DDRSS1_PHY_373_DATA=0x02800280
LOCAL &__DDRSS1_PHY_374_DATA
&__DDRSS1_PHY_374_DATA=0x02800280
LOCAL &__DDRSS1_PHY_375_DATA
&__DDRSS1_PHY_375_DATA=0x02800280
LOCAL &__DDRSS1_PHY_376_DATA
&__DDRSS1_PHY_376_DATA=0x00000280
LOCAL &__DDRSS1_PHY_377_DATA
&__DDRSS1_PHY_377_DATA=0x0000A000
LOCAL &__DDRSS1_PHY_378_DATA
&__DDRSS1_PHY_378_DATA=0x00A000A0
LOCAL &__DDRSS1_PHY_379_DATA
&__DDRSS1_PHY_379_DATA=0x00A000A0
LOCAL &__DDRSS1_PHY_380_DATA
&__DDRSS1_PHY_380_DATA=0x00A000A0
LOCAL &__DDRSS1_PHY_381_DATA
&__DDRSS1_PHY_381_DATA=0x00A000A0
LOCAL &__DDRSS1_PHY_382_DATA
&__DDRSS1_PHY_382_DATA=0x00A000A0
LOCAL &__DDRSS1_PHY_383_DATA
&__DDRSS1_PHY_383_DATA=0x00A000A0
LOCAL &__DDRSS1_PHY_384_DATA
&__DDRSS1_PHY_384_DATA=0x00A000A0
LOCAL &__DDRSS1_PHY_385_DATA
&__DDRSS1_PHY_385_DATA=0x00A000A0
LOCAL &__DDRSS1_PHY_386_DATA
&__DDRSS1_PHY_386_DATA=0x006E00A0
LOCAL &__DDRSS1_PHY_387_DATA
&__DDRSS1_PHY_387_DATA=0x01A00003
LOCAL &__DDRSS1_PHY_388_DATA
&__DDRSS1_PHY_388_DATA=0x00000000
LOCAL &__DDRSS1_PHY_389_DATA
&__DDRSS1_PHY_389_DATA=0x00000000
LOCAL &__DDRSS1_PHY_390_DATA
&__DDRSS1_PHY_390_DATA=0x00080200
LOCAL &__DDRSS1_PHY_391_DATA
&__DDRSS1_PHY_391_DATA=0x00000000
LOCAL &__DDRSS1_PHY_392_DATA
&__DDRSS1_PHY_392_DATA=0x20202000
LOCAL &__DDRSS1_PHY_393_DATA
&__DDRSS1_PHY_393_DATA=0x20202020
LOCAL &__DDRSS1_PHY_394_DATA
&__DDRSS1_PHY_394_DATA=0xF0F02020
LOCAL &__DDRSS1_PHY_395_DATA
&__DDRSS1_PHY_395_DATA=0x00000000
LOCAL &__DDRSS1_PHY_396_DATA
&__DDRSS1_PHY_396_DATA=0x00000000
LOCAL &__DDRSS1_PHY_397_DATA
&__DDRSS1_PHY_397_DATA=0x00000000
LOCAL &__DDRSS1_PHY_398_DATA
&__DDRSS1_PHY_398_DATA=0x00000000
LOCAL &__DDRSS1_PHY_399_DATA
&__DDRSS1_PHY_399_DATA=0x00000000
LOCAL &__DDRSS1_PHY_400_DATA
&__DDRSS1_PHY_400_DATA=0x00000000
LOCAL &__DDRSS1_PHY_401_DATA
&__DDRSS1_PHY_401_DATA=0x00000000
LOCAL &__DDRSS1_PHY_402_DATA
&__DDRSS1_PHY_402_DATA=0x00000000
LOCAL &__DDRSS1_PHY_403_DATA
&__DDRSS1_PHY_403_DATA=0x00000000
LOCAL &__DDRSS1_PHY_404_DATA
&__DDRSS1_PHY_404_DATA=0x00000000
LOCAL &__DDRSS1_PHY_405_DATA
&__DDRSS1_PHY_405_DATA=0x00000000
LOCAL &__DDRSS1_PHY_406_DATA
&__DDRSS1_PHY_406_DATA=0x00000000
LOCAL &__DDRSS1_PHY_407_DATA
&__DDRSS1_PHY_407_DATA=0x00000000
LOCAL &__DDRSS1_PHY_408_DATA
&__DDRSS1_PHY_408_DATA=0x00000000
LOCAL &__DDRSS1_PHY_409_DATA
&__DDRSS1_PHY_409_DATA=0x00000000
LOCAL &__DDRSS1_PHY_410_DATA
&__DDRSS1_PHY_410_DATA=0x00000000
LOCAL &__DDRSS1_PHY_411_DATA
&__DDRSS1_PHY_411_DATA=0x00000000
LOCAL &__DDRSS1_PHY_412_DATA
&__DDRSS1_PHY_412_DATA=0x00000000
LOCAL &__DDRSS1_PHY_413_DATA
&__DDRSS1_PHY_413_DATA=0x00000000
LOCAL &__DDRSS1_PHY_414_DATA
&__DDRSS1_PHY_414_DATA=0x00000000
LOCAL &__DDRSS1_PHY_415_DATA
&__DDRSS1_PHY_415_DATA=0x00000000
LOCAL &__DDRSS1_PHY_416_DATA
&__DDRSS1_PHY_416_DATA=0x00000000
LOCAL &__DDRSS1_PHY_417_DATA
&__DDRSS1_PHY_417_DATA=0x00000000
LOCAL &__DDRSS1_PHY_418_DATA
&__DDRSS1_PHY_418_DATA=0x00000000
LOCAL &__DDRSS1_PHY_419_DATA
&__DDRSS1_PHY_419_DATA=0x00000000
LOCAL &__DDRSS1_PHY_420_DATA
&__DDRSS1_PHY_420_DATA=0x00000000
LOCAL &__DDRSS1_PHY_421_DATA
&__DDRSS1_PHY_421_DATA=0x00000000
LOCAL &__DDRSS1_PHY_422_DATA
&__DDRSS1_PHY_422_DATA=0x00000000
LOCAL &__DDRSS1_PHY_423_DATA
&__DDRSS1_PHY_423_DATA=0x00000000
LOCAL &__DDRSS1_PHY_424_DATA
&__DDRSS1_PHY_424_DATA=0x00000000
LOCAL &__DDRSS1_PHY_425_DATA
&__DDRSS1_PHY_425_DATA=0x00000000
LOCAL &__DDRSS1_PHY_426_DATA
&__DDRSS1_PHY_426_DATA=0x00000000
LOCAL &__DDRSS1_PHY_427_DATA
&__DDRSS1_PHY_427_DATA=0x00000000
LOCAL &__DDRSS1_PHY_428_DATA
&__DDRSS1_PHY_428_DATA=0x00000000
LOCAL &__DDRSS1_PHY_429_DATA
&__DDRSS1_PHY_429_DATA=0x00000000
LOCAL &__DDRSS1_PHY_430_DATA
&__DDRSS1_PHY_430_DATA=0x00000000
LOCAL &__DDRSS1_PHY_431_DATA
&__DDRSS1_PHY_431_DATA=0x00000000
LOCAL &__DDRSS1_PHY_432_DATA
&__DDRSS1_PHY_432_DATA=0x00000000
LOCAL &__DDRSS1_PHY_433_DATA
&__DDRSS1_PHY_433_DATA=0x00000000
LOCAL &__DDRSS1_PHY_434_DATA
&__DDRSS1_PHY_434_DATA=0x00000000
LOCAL &__DDRSS1_PHY_435_DATA
&__DDRSS1_PHY_435_DATA=0x00000000
LOCAL &__DDRSS1_PHY_436_DATA
&__DDRSS1_PHY_436_DATA=0x00000000
LOCAL &__DDRSS1_PHY_437_DATA
&__DDRSS1_PHY_437_DATA=0x00000000
LOCAL &__DDRSS1_PHY_438_DATA
&__DDRSS1_PHY_438_DATA=0x00000000
LOCAL &__DDRSS1_PHY_439_DATA
&__DDRSS1_PHY_439_DATA=0x00000000
LOCAL &__DDRSS1_PHY_440_DATA
&__DDRSS1_PHY_440_DATA=0x00000000
LOCAL &__DDRSS1_PHY_441_DATA
&__DDRSS1_PHY_441_DATA=0x00000000
LOCAL &__DDRSS1_PHY_442_DATA
&__DDRSS1_PHY_442_DATA=0x00000000
LOCAL &__DDRSS1_PHY_443_DATA
&__DDRSS1_PHY_443_DATA=0x00000000
LOCAL &__DDRSS1_PHY_444_DATA
&__DDRSS1_PHY_444_DATA=0x00000000
LOCAL &__DDRSS1_PHY_445_DATA
&__DDRSS1_PHY_445_DATA=0x00000000
LOCAL &__DDRSS1_PHY_446_DATA
&__DDRSS1_PHY_446_DATA=0x00000000
LOCAL &__DDRSS1_PHY_447_DATA
&__DDRSS1_PHY_447_DATA=0x00000000
LOCAL &__DDRSS1_PHY_448_DATA
&__DDRSS1_PHY_448_DATA=0x00000000
LOCAL &__DDRSS1_PHY_449_DATA
&__DDRSS1_PHY_449_DATA=0x00000000
LOCAL &__DDRSS1_PHY_450_DATA
&__DDRSS1_PHY_450_DATA=0x00000000
LOCAL &__DDRSS1_PHY_451_DATA
&__DDRSS1_PHY_451_DATA=0x00000000
LOCAL &__DDRSS1_PHY_452_DATA
&__DDRSS1_PHY_452_DATA=0x00000000
LOCAL &__DDRSS1_PHY_453_DATA
&__DDRSS1_PHY_453_DATA=0x00000000
LOCAL &__DDRSS1_PHY_454_DATA
&__DDRSS1_PHY_454_DATA=0x00000000
LOCAL &__DDRSS1_PHY_455_DATA
&__DDRSS1_PHY_455_DATA=0x00000000
LOCAL &__DDRSS1_PHY_456_DATA
&__DDRSS1_PHY_456_DATA=0x00000000
LOCAL &__DDRSS1_PHY_457_DATA
&__DDRSS1_PHY_457_DATA=0x00000000
LOCAL &__DDRSS1_PHY_458_DATA
&__DDRSS1_PHY_458_DATA=0x00000000
LOCAL &__DDRSS1_PHY_459_DATA
&__DDRSS1_PHY_459_DATA=0x00000000
LOCAL &__DDRSS1_PHY_460_DATA
&__DDRSS1_PHY_460_DATA=0x00000000
LOCAL &__DDRSS1_PHY_461_DATA
&__DDRSS1_PHY_461_DATA=0x00000000
LOCAL &__DDRSS1_PHY_462_DATA
&__DDRSS1_PHY_462_DATA=0x00000000
LOCAL &__DDRSS1_PHY_463_DATA
&__DDRSS1_PHY_463_DATA=0x00000000
LOCAL &__DDRSS1_PHY_464_DATA
&__DDRSS1_PHY_464_DATA=0x00000000
LOCAL &__DDRSS1_PHY_465_DATA
&__DDRSS1_PHY_465_DATA=0x00000000
LOCAL &__DDRSS1_PHY_466_DATA
&__DDRSS1_PHY_466_DATA=0x00000000
LOCAL &__DDRSS1_PHY_467_DATA
&__DDRSS1_PHY_467_DATA=0x00000000
LOCAL &__DDRSS1_PHY_468_DATA
&__DDRSS1_PHY_468_DATA=0x00000000
LOCAL &__DDRSS1_PHY_469_DATA
&__DDRSS1_PHY_469_DATA=0x00000000
LOCAL &__DDRSS1_PHY_470_DATA
&__DDRSS1_PHY_470_DATA=0x00000000
LOCAL &__DDRSS1_PHY_471_DATA
&__DDRSS1_PHY_471_DATA=0x00000000
LOCAL &__DDRSS1_PHY_472_DATA
&__DDRSS1_PHY_472_DATA=0x00000000
LOCAL &__DDRSS1_PHY_473_DATA
&__DDRSS1_PHY_473_DATA=0x00000000
LOCAL &__DDRSS1_PHY_474_DATA
&__DDRSS1_PHY_474_DATA=0x00000000
LOCAL &__DDRSS1_PHY_475_DATA
&__DDRSS1_PHY_475_DATA=0x00000000
LOCAL &__DDRSS1_PHY_476_DATA
&__DDRSS1_PHY_476_DATA=0x00000000
LOCAL &__DDRSS1_PHY_477_DATA
&__DDRSS1_PHY_477_DATA=0x00000000
LOCAL &__DDRSS1_PHY_478_DATA
&__DDRSS1_PHY_478_DATA=0x00000000
LOCAL &__DDRSS1_PHY_479_DATA
&__DDRSS1_PHY_479_DATA=0x00000000
LOCAL &__DDRSS1_PHY_480_DATA
&__DDRSS1_PHY_480_DATA=0x00000000
LOCAL &__DDRSS1_PHY_481_DATA
&__DDRSS1_PHY_481_DATA=0x00000000
LOCAL &__DDRSS1_PHY_482_DATA
&__DDRSS1_PHY_482_DATA=0x00000000
LOCAL &__DDRSS1_PHY_483_DATA
&__DDRSS1_PHY_483_DATA=0x00000000
LOCAL &__DDRSS1_PHY_484_DATA
&__DDRSS1_PHY_484_DATA=0x00000000
LOCAL &__DDRSS1_PHY_485_DATA
&__DDRSS1_PHY_485_DATA=0x00000000
LOCAL &__DDRSS1_PHY_486_DATA
&__DDRSS1_PHY_486_DATA=0x00000000
LOCAL &__DDRSS1_PHY_487_DATA
&__DDRSS1_PHY_487_DATA=0x00000000
LOCAL &__DDRSS1_PHY_488_DATA
&__DDRSS1_PHY_488_DATA=0x00000000
LOCAL &__DDRSS1_PHY_489_DATA
&__DDRSS1_PHY_489_DATA=0x00000000
LOCAL &__DDRSS1_PHY_490_DATA
&__DDRSS1_PHY_490_DATA=0x00000000
LOCAL &__DDRSS1_PHY_491_DATA
&__DDRSS1_PHY_491_DATA=0x00000000
LOCAL &__DDRSS1_PHY_492_DATA
&__DDRSS1_PHY_492_DATA=0x00000000
LOCAL &__DDRSS1_PHY_493_DATA
&__DDRSS1_PHY_493_DATA=0x00000000
LOCAL &__DDRSS1_PHY_494_DATA
&__DDRSS1_PHY_494_DATA=0x00000000
LOCAL &__DDRSS1_PHY_495_DATA
&__DDRSS1_PHY_495_DATA=0x00000000
LOCAL &__DDRSS1_PHY_496_DATA
&__DDRSS1_PHY_496_DATA=0x00000000
LOCAL &__DDRSS1_PHY_497_DATA
&__DDRSS1_PHY_497_DATA=0x00000000
LOCAL &__DDRSS1_PHY_498_DATA
&__DDRSS1_PHY_498_DATA=0x00000000
LOCAL &__DDRSS1_PHY_499_DATA
&__DDRSS1_PHY_499_DATA=0x00000000
LOCAL &__DDRSS1_PHY_500_DATA
&__DDRSS1_PHY_500_DATA=0x00000000
LOCAL &__DDRSS1_PHY_501_DATA
&__DDRSS1_PHY_501_DATA=0x00000000
LOCAL &__DDRSS1_PHY_502_DATA
&__DDRSS1_PHY_502_DATA=0x00000000
LOCAL &__DDRSS1_PHY_503_DATA
&__DDRSS1_PHY_503_DATA=0x00000000
LOCAL &__DDRSS1_PHY_504_DATA
&__DDRSS1_PHY_504_DATA=0x00000000
LOCAL &__DDRSS1_PHY_505_DATA
&__DDRSS1_PHY_505_DATA=0x00000000
LOCAL &__DDRSS1_PHY_506_DATA
&__DDRSS1_PHY_506_DATA=0x00000000
LOCAL &__DDRSS1_PHY_507_DATA
&__DDRSS1_PHY_507_DATA=0x00000000
LOCAL &__DDRSS1_PHY_508_DATA
&__DDRSS1_PHY_508_DATA=0x00000000
LOCAL &__DDRSS1_PHY_509_DATA
&__DDRSS1_PHY_509_DATA=0x00000000
LOCAL &__DDRSS1_PHY_510_DATA
&__DDRSS1_PHY_510_DATA=0x00000000
LOCAL &__DDRSS1_PHY_511_DATA
&__DDRSS1_PHY_511_DATA=0x00000000
LOCAL &__DDRSS1_PHY_512_DATA
&__DDRSS1_PHY_512_DATA=0x000004F0
LOCAL &__DDRSS1_PHY_513_DATA
&__DDRSS1_PHY_513_DATA=0x00000000
LOCAL &__DDRSS1_PHY_514_DATA
&__DDRSS1_PHY_514_DATA=0x00030200
LOCAL &__DDRSS1_PHY_515_DATA
&__DDRSS1_PHY_515_DATA=0x00000000
LOCAL &__DDRSS1_PHY_516_DATA
&__DDRSS1_PHY_516_DATA=0x00000000
LOCAL &__DDRSS1_PHY_517_DATA
&__DDRSS1_PHY_517_DATA=0x01030000
LOCAL &__DDRSS1_PHY_518_DATA
&__DDRSS1_PHY_518_DATA=0x00010000
LOCAL &__DDRSS1_PHY_519_DATA
&__DDRSS1_PHY_519_DATA=0x01030004
LOCAL &__DDRSS1_PHY_520_DATA
&__DDRSS1_PHY_520_DATA=0x01000000
LOCAL &__DDRSS1_PHY_521_DATA
&__DDRSS1_PHY_521_DATA=0x00000000
LOCAL &__DDRSS1_PHY_522_DATA
&__DDRSS1_PHY_522_DATA=0x00000000
LOCAL &__DDRSS1_PHY_523_DATA
&__DDRSS1_PHY_523_DATA=0x01000001
LOCAL &__DDRSS1_PHY_524_DATA
&__DDRSS1_PHY_524_DATA=0x00000100
LOCAL &__DDRSS1_PHY_525_DATA
&__DDRSS1_PHY_525_DATA=0x000800C0
LOCAL &__DDRSS1_PHY_526_DATA
&__DDRSS1_PHY_526_DATA=0x060100CC
LOCAL &__DDRSS1_PHY_527_DATA
&__DDRSS1_PHY_527_DATA=0x00030066
LOCAL &__DDRSS1_PHY_528_DATA
&__DDRSS1_PHY_528_DATA=0x00000000
LOCAL &__DDRSS1_PHY_529_DATA
&__DDRSS1_PHY_529_DATA=0x00000301
LOCAL &__DDRSS1_PHY_530_DATA
&__DDRSS1_PHY_530_DATA=0x0000AAAA
LOCAL &__DDRSS1_PHY_531_DATA
&__DDRSS1_PHY_531_DATA=0x00005555
LOCAL &__DDRSS1_PHY_532_DATA
&__DDRSS1_PHY_532_DATA=0x0000B5B5
LOCAL &__DDRSS1_PHY_533_DATA
&__DDRSS1_PHY_533_DATA=0x00004A4A
LOCAL &__DDRSS1_PHY_534_DATA
&__DDRSS1_PHY_534_DATA=0x00005656
LOCAL &__DDRSS1_PHY_535_DATA
&__DDRSS1_PHY_535_DATA=0x0000A9A9
LOCAL &__DDRSS1_PHY_536_DATA
&__DDRSS1_PHY_536_DATA=0x0000A9A9
LOCAL &__DDRSS1_PHY_537_DATA
&__DDRSS1_PHY_537_DATA=0x0000B5B5
LOCAL &__DDRSS1_PHY_538_DATA
&__DDRSS1_PHY_538_DATA=0x00000000
LOCAL &__DDRSS1_PHY_539_DATA
&__DDRSS1_PHY_539_DATA=0x00000000
LOCAL &__DDRSS1_PHY_540_DATA
&__DDRSS1_PHY_540_DATA=0x2A000000
LOCAL &__DDRSS1_PHY_541_DATA
&__DDRSS1_PHY_541_DATA=0x00000808
LOCAL &__DDRSS1_PHY_542_DATA
&__DDRSS1_PHY_542_DATA=0x0F000000
LOCAL &__DDRSS1_PHY_543_DATA
&__DDRSS1_PHY_543_DATA=0x00000F0F
LOCAL &__DDRSS1_PHY_544_DATA
&__DDRSS1_PHY_544_DATA=0x10200000
LOCAL &__DDRSS1_PHY_545_DATA
&__DDRSS1_PHY_545_DATA=0x0C002006
LOCAL &__DDRSS1_PHY_546_DATA
&__DDRSS1_PHY_546_DATA=0x00000000
LOCAL &__DDRSS1_PHY_547_DATA
&__DDRSS1_PHY_547_DATA=0x00000000
LOCAL &__DDRSS1_PHY_548_DATA
&__DDRSS1_PHY_548_DATA=0x55555555
LOCAL &__DDRSS1_PHY_549_DATA
&__DDRSS1_PHY_549_DATA=0xAAAAAAAA
LOCAL &__DDRSS1_PHY_550_DATA
&__DDRSS1_PHY_550_DATA=0x55555555
LOCAL &__DDRSS1_PHY_551_DATA
&__DDRSS1_PHY_551_DATA=0xAAAAAAAA
LOCAL &__DDRSS1_PHY_552_DATA
&__DDRSS1_PHY_552_DATA=0x00005555
LOCAL &__DDRSS1_PHY_553_DATA
&__DDRSS1_PHY_553_DATA=0x01000100
LOCAL &__DDRSS1_PHY_554_DATA
&__DDRSS1_PHY_554_DATA=0x00800180
LOCAL &__DDRSS1_PHY_555_DATA
&__DDRSS1_PHY_555_DATA=0x00000001
LOCAL &__DDRSS1_PHY_556_DATA
&__DDRSS1_PHY_556_DATA=0x00000000
LOCAL &__DDRSS1_PHY_557_DATA
&__DDRSS1_PHY_557_DATA=0x00000000
LOCAL &__DDRSS1_PHY_558_DATA
&__DDRSS1_PHY_558_DATA=0x00000000
LOCAL &__DDRSS1_PHY_559_DATA
&__DDRSS1_PHY_559_DATA=0x00000000
LOCAL &__DDRSS1_PHY_560_DATA
&__DDRSS1_PHY_560_DATA=0x00000000
LOCAL &__DDRSS1_PHY_561_DATA
&__DDRSS1_PHY_561_DATA=0x00000000
LOCAL &__DDRSS1_PHY_562_DATA
&__DDRSS1_PHY_562_DATA=0x00000000
LOCAL &__DDRSS1_PHY_563_DATA
&__DDRSS1_PHY_563_DATA=0x00000000
LOCAL &__DDRSS1_PHY_564_DATA
&__DDRSS1_PHY_564_DATA=0x00000000
LOCAL &__DDRSS1_PHY_565_DATA
&__DDRSS1_PHY_565_DATA=0x00000000
LOCAL &__DDRSS1_PHY_566_DATA
&__DDRSS1_PHY_566_DATA=0x00000000
LOCAL &__DDRSS1_PHY_567_DATA
&__DDRSS1_PHY_567_DATA=0x00000000
LOCAL &__DDRSS1_PHY_568_DATA
&__DDRSS1_PHY_568_DATA=0x00000000
LOCAL &__DDRSS1_PHY_569_DATA
&__DDRSS1_PHY_569_DATA=0x00000000
LOCAL &__DDRSS1_PHY_570_DATA
&__DDRSS1_PHY_570_DATA=0x00000000
LOCAL &__DDRSS1_PHY_571_DATA
&__DDRSS1_PHY_571_DATA=0x00000000
LOCAL &__DDRSS1_PHY_572_DATA
&__DDRSS1_PHY_572_DATA=0x00000000
LOCAL &__DDRSS1_PHY_573_DATA
&__DDRSS1_PHY_573_DATA=0x00000000
LOCAL &__DDRSS1_PHY_574_DATA
&__DDRSS1_PHY_574_DATA=0x00000000
LOCAL &__DDRSS1_PHY_575_DATA
&__DDRSS1_PHY_575_DATA=0x00000000
LOCAL &__DDRSS1_PHY_576_DATA
&__DDRSS1_PHY_576_DATA=0x00000000
LOCAL &__DDRSS1_PHY_577_DATA
&__DDRSS1_PHY_577_DATA=0x00000000
LOCAL &__DDRSS1_PHY_578_DATA
&__DDRSS1_PHY_578_DATA=0x00000104
LOCAL &__DDRSS1_PHY_579_DATA
&__DDRSS1_PHY_579_DATA=0x00000120
LOCAL &__DDRSS1_PHY_580_DATA
&__DDRSS1_PHY_580_DATA=0x00000000
LOCAL &__DDRSS1_PHY_581_DATA
&__DDRSS1_PHY_581_DATA=0x00000000
LOCAL &__DDRSS1_PHY_582_DATA
&__DDRSS1_PHY_582_DATA=0x00000000
LOCAL &__DDRSS1_PHY_583_DATA
&__DDRSS1_PHY_583_DATA=0x00000000
LOCAL &__DDRSS1_PHY_584_DATA
&__DDRSS1_PHY_584_DATA=0x00000000
LOCAL &__DDRSS1_PHY_585_DATA
&__DDRSS1_PHY_585_DATA=0x00000000
LOCAL &__DDRSS1_PHY_586_DATA
&__DDRSS1_PHY_586_DATA=0x00000000
LOCAL &__DDRSS1_PHY_587_DATA
&__DDRSS1_PHY_587_DATA=0x00000001
LOCAL &__DDRSS1_PHY_588_DATA
&__DDRSS1_PHY_588_DATA=0x07FF0000
LOCAL &__DDRSS1_PHY_589_DATA
&__DDRSS1_PHY_589_DATA=0x0080081F
LOCAL &__DDRSS1_PHY_590_DATA
&__DDRSS1_PHY_590_DATA=0x00081020
LOCAL &__DDRSS1_PHY_591_DATA
&__DDRSS1_PHY_591_DATA=0x04010000
LOCAL &__DDRSS1_PHY_592_DATA
&__DDRSS1_PHY_592_DATA=0x00000000
LOCAL &__DDRSS1_PHY_593_DATA
&__DDRSS1_PHY_593_DATA=0x00000000
LOCAL &__DDRSS1_PHY_594_DATA
&__DDRSS1_PHY_594_DATA=0x00000000
LOCAL &__DDRSS1_PHY_595_DATA
&__DDRSS1_PHY_595_DATA=0x00000100
LOCAL &__DDRSS1_PHY_596_DATA
&__DDRSS1_PHY_596_DATA=0x01CC0C01
LOCAL &__DDRSS1_PHY_597_DATA
&__DDRSS1_PHY_597_DATA=0x1003CC0C
LOCAL &__DDRSS1_PHY_598_DATA
&__DDRSS1_PHY_598_DATA=0x20000140
LOCAL &__DDRSS1_PHY_599_DATA
&__DDRSS1_PHY_599_DATA=0x07FF0200
LOCAL &__DDRSS1_PHY_600_DATA
&__DDRSS1_PHY_600_DATA=0x0000DD01
LOCAL &__DDRSS1_PHY_601_DATA
&__DDRSS1_PHY_601_DATA=0x10100303
LOCAL &__DDRSS1_PHY_602_DATA
&__DDRSS1_PHY_602_DATA=0x10101010
LOCAL &__DDRSS1_PHY_603_DATA
&__DDRSS1_PHY_603_DATA=0x10101010
LOCAL &__DDRSS1_PHY_604_DATA
&__DDRSS1_PHY_604_DATA=0x00011010
LOCAL &__DDRSS1_PHY_605_DATA
&__DDRSS1_PHY_605_DATA=0x00100010
LOCAL &__DDRSS1_PHY_606_DATA
&__DDRSS1_PHY_606_DATA=0x00100010
LOCAL &__DDRSS1_PHY_607_DATA
&__DDRSS1_PHY_607_DATA=0x00100010
LOCAL &__DDRSS1_PHY_608_DATA
&__DDRSS1_PHY_608_DATA=0x00100010
LOCAL &__DDRSS1_PHY_609_DATA
&__DDRSS1_PHY_609_DATA=0x00050010
LOCAL &__DDRSS1_PHY_610_DATA
&__DDRSS1_PHY_610_DATA=0x51517041
LOCAL &__DDRSS1_PHY_611_DATA
&__DDRSS1_PHY_611_DATA=0x31C06000
LOCAL &__DDRSS1_PHY_612_DATA
&__DDRSS1_PHY_612_DATA=0x07AB0340
LOCAL &__DDRSS1_PHY_613_DATA
&__DDRSS1_PHY_613_DATA=0x00C0C001
LOCAL &__DDRSS1_PHY_614_DATA
&__DDRSS1_PHY_614_DATA=0x07060001
LOCAL &__DDRSS1_PHY_615_DATA
&__DDRSS1_PHY_615_DATA=0x10001000
LOCAL &__DDRSS1_PHY_616_DATA
&__DDRSS1_PHY_616_DATA=0x0C063E42
LOCAL &__DDRSS1_PHY_617_DATA
&__DDRSS1_PHY_617_DATA=0x0F0C2201
LOCAL &__DDRSS1_PHY_618_DATA
&__DDRSS1_PHY_618_DATA=0x01000140
LOCAL &__DDRSS1_PHY_619_DATA
&__DDRSS1_PHY_619_DATA=0x0C000420
LOCAL &__DDRSS1_PHY_620_DATA
&__DDRSS1_PHY_620_DATA=0x00000198
LOCAL &__DDRSS1_PHY_621_DATA
&__DDRSS1_PHY_621_DATA=0x0A0000D0
LOCAL &__DDRSS1_PHY_622_DATA
&__DDRSS1_PHY_622_DATA=0x00030200
LOCAL &__DDRSS1_PHY_623_DATA
&__DDRSS1_PHY_623_DATA=0x02800000
LOCAL &__DDRSS1_PHY_624_DATA
&__DDRSS1_PHY_624_DATA=0x80800000
LOCAL &__DDRSS1_PHY_625_DATA
&__DDRSS1_PHY_625_DATA=0x00072010
LOCAL &__DDRSS1_PHY_626_DATA
&__DDRSS1_PHY_626_DATA=0x76543210
LOCAL &__DDRSS1_PHY_627_DATA
&__DDRSS1_PHY_627_DATA=0x00000008
LOCAL &__DDRSS1_PHY_628_DATA
&__DDRSS1_PHY_628_DATA=0x02800280
LOCAL &__DDRSS1_PHY_629_DATA
&__DDRSS1_PHY_629_DATA=0x02800280
LOCAL &__DDRSS1_PHY_630_DATA
&__DDRSS1_PHY_630_DATA=0x02800280
LOCAL &__DDRSS1_PHY_631_DATA
&__DDRSS1_PHY_631_DATA=0x02800280
LOCAL &__DDRSS1_PHY_632_DATA
&__DDRSS1_PHY_632_DATA=0x00000280
LOCAL &__DDRSS1_PHY_633_DATA
&__DDRSS1_PHY_633_DATA=0x0000A000
LOCAL &__DDRSS1_PHY_634_DATA
&__DDRSS1_PHY_634_DATA=0x00A000A0
LOCAL &__DDRSS1_PHY_635_DATA
&__DDRSS1_PHY_635_DATA=0x00A000A0
LOCAL &__DDRSS1_PHY_636_DATA
&__DDRSS1_PHY_636_DATA=0x00A000A0
LOCAL &__DDRSS1_PHY_637_DATA
&__DDRSS1_PHY_637_DATA=0x00A000A0
LOCAL &__DDRSS1_PHY_638_DATA
&__DDRSS1_PHY_638_DATA=0x00A000A0
LOCAL &__DDRSS1_PHY_639_DATA
&__DDRSS1_PHY_639_DATA=0x00A000A0
LOCAL &__DDRSS1_PHY_640_DATA
&__DDRSS1_PHY_640_DATA=0x00A000A0
LOCAL &__DDRSS1_PHY_641_DATA
&__DDRSS1_PHY_641_DATA=0x00A000A0
LOCAL &__DDRSS1_PHY_642_DATA
&__DDRSS1_PHY_642_DATA=0x006E00A0
LOCAL &__DDRSS1_PHY_643_DATA
&__DDRSS1_PHY_643_DATA=0x01A00003
LOCAL &__DDRSS1_PHY_644_DATA
&__DDRSS1_PHY_644_DATA=0x00000000
LOCAL &__DDRSS1_PHY_645_DATA
&__DDRSS1_PHY_645_DATA=0x00000000
LOCAL &__DDRSS1_PHY_646_DATA
&__DDRSS1_PHY_646_DATA=0x00080200
LOCAL &__DDRSS1_PHY_647_DATA
&__DDRSS1_PHY_647_DATA=0x00000000
LOCAL &__DDRSS1_PHY_648_DATA
&__DDRSS1_PHY_648_DATA=0x20202000
LOCAL &__DDRSS1_PHY_649_DATA
&__DDRSS1_PHY_649_DATA=0x20202020
LOCAL &__DDRSS1_PHY_650_DATA
&__DDRSS1_PHY_650_DATA=0xF0F02020
LOCAL &__DDRSS1_PHY_651_DATA
&__DDRSS1_PHY_651_DATA=0x00000000
LOCAL &__DDRSS1_PHY_652_DATA
&__DDRSS1_PHY_652_DATA=0x00000000
LOCAL &__DDRSS1_PHY_653_DATA
&__DDRSS1_PHY_653_DATA=0x00000000
LOCAL &__DDRSS1_PHY_654_DATA
&__DDRSS1_PHY_654_DATA=0x00000000
LOCAL &__DDRSS1_PHY_655_DATA
&__DDRSS1_PHY_655_DATA=0x00000000
LOCAL &__DDRSS1_PHY_656_DATA
&__DDRSS1_PHY_656_DATA=0x00000000
LOCAL &__DDRSS1_PHY_657_DATA
&__DDRSS1_PHY_657_DATA=0x00000000
LOCAL &__DDRSS1_PHY_658_DATA
&__DDRSS1_PHY_658_DATA=0x00000000
LOCAL &__DDRSS1_PHY_659_DATA
&__DDRSS1_PHY_659_DATA=0x00000000
LOCAL &__DDRSS1_PHY_660_DATA
&__DDRSS1_PHY_660_DATA=0x00000000
LOCAL &__DDRSS1_PHY_661_DATA
&__DDRSS1_PHY_661_DATA=0x00000000
LOCAL &__DDRSS1_PHY_662_DATA
&__DDRSS1_PHY_662_DATA=0x00000000
LOCAL &__DDRSS1_PHY_663_DATA
&__DDRSS1_PHY_663_DATA=0x00000000
LOCAL &__DDRSS1_PHY_664_DATA
&__DDRSS1_PHY_664_DATA=0x00000000
LOCAL &__DDRSS1_PHY_665_DATA
&__DDRSS1_PHY_665_DATA=0x00000000
LOCAL &__DDRSS1_PHY_666_DATA
&__DDRSS1_PHY_666_DATA=0x00000000
LOCAL &__DDRSS1_PHY_667_DATA
&__DDRSS1_PHY_667_DATA=0x00000000
LOCAL &__DDRSS1_PHY_668_DATA
&__DDRSS1_PHY_668_DATA=0x00000000
LOCAL &__DDRSS1_PHY_669_DATA
&__DDRSS1_PHY_669_DATA=0x00000000
LOCAL &__DDRSS1_PHY_670_DATA
&__DDRSS1_PHY_670_DATA=0x00000000
LOCAL &__DDRSS1_PHY_671_DATA
&__DDRSS1_PHY_671_DATA=0x00000000
LOCAL &__DDRSS1_PHY_672_DATA
&__DDRSS1_PHY_672_DATA=0x00000000
LOCAL &__DDRSS1_PHY_673_DATA
&__DDRSS1_PHY_673_DATA=0x00000000
LOCAL &__DDRSS1_PHY_674_DATA
&__DDRSS1_PHY_674_DATA=0x00000000
LOCAL &__DDRSS1_PHY_675_DATA
&__DDRSS1_PHY_675_DATA=0x00000000
LOCAL &__DDRSS1_PHY_676_DATA
&__DDRSS1_PHY_676_DATA=0x00000000
LOCAL &__DDRSS1_PHY_677_DATA
&__DDRSS1_PHY_677_DATA=0x00000000
LOCAL &__DDRSS1_PHY_678_DATA
&__DDRSS1_PHY_678_DATA=0x00000000
LOCAL &__DDRSS1_PHY_679_DATA
&__DDRSS1_PHY_679_DATA=0x00000000
LOCAL &__DDRSS1_PHY_680_DATA
&__DDRSS1_PHY_680_DATA=0x00000000
LOCAL &__DDRSS1_PHY_681_DATA
&__DDRSS1_PHY_681_DATA=0x00000000
LOCAL &__DDRSS1_PHY_682_DATA
&__DDRSS1_PHY_682_DATA=0x00000000
LOCAL &__DDRSS1_PHY_683_DATA
&__DDRSS1_PHY_683_DATA=0x00000000
LOCAL &__DDRSS1_PHY_684_DATA
&__DDRSS1_PHY_684_DATA=0x00000000
LOCAL &__DDRSS1_PHY_685_DATA
&__DDRSS1_PHY_685_DATA=0x00000000
LOCAL &__DDRSS1_PHY_686_DATA
&__DDRSS1_PHY_686_DATA=0x00000000
LOCAL &__DDRSS1_PHY_687_DATA
&__DDRSS1_PHY_687_DATA=0x00000000
LOCAL &__DDRSS1_PHY_688_DATA
&__DDRSS1_PHY_688_DATA=0x00000000
LOCAL &__DDRSS1_PHY_689_DATA
&__DDRSS1_PHY_689_DATA=0x00000000
LOCAL &__DDRSS1_PHY_690_DATA
&__DDRSS1_PHY_690_DATA=0x00000000
LOCAL &__DDRSS1_PHY_691_DATA
&__DDRSS1_PHY_691_DATA=0x00000000
LOCAL &__DDRSS1_PHY_692_DATA
&__DDRSS1_PHY_692_DATA=0x00000000
LOCAL &__DDRSS1_PHY_693_DATA
&__DDRSS1_PHY_693_DATA=0x00000000
LOCAL &__DDRSS1_PHY_694_DATA
&__DDRSS1_PHY_694_DATA=0x00000000
LOCAL &__DDRSS1_PHY_695_DATA
&__DDRSS1_PHY_695_DATA=0x00000000
LOCAL &__DDRSS1_PHY_696_DATA
&__DDRSS1_PHY_696_DATA=0x00000000
LOCAL &__DDRSS1_PHY_697_DATA
&__DDRSS1_PHY_697_DATA=0x00000000
LOCAL &__DDRSS1_PHY_698_DATA
&__DDRSS1_PHY_698_DATA=0x00000000
LOCAL &__DDRSS1_PHY_699_DATA
&__DDRSS1_PHY_699_DATA=0x00000000
LOCAL &__DDRSS1_PHY_700_DATA
&__DDRSS1_PHY_700_DATA=0x00000000
LOCAL &__DDRSS1_PHY_701_DATA
&__DDRSS1_PHY_701_DATA=0x00000000
LOCAL &__DDRSS1_PHY_702_DATA
&__DDRSS1_PHY_702_DATA=0x00000000
LOCAL &__DDRSS1_PHY_703_DATA
&__DDRSS1_PHY_703_DATA=0x00000000
LOCAL &__DDRSS1_PHY_704_DATA
&__DDRSS1_PHY_704_DATA=0x00000000
LOCAL &__DDRSS1_PHY_705_DATA
&__DDRSS1_PHY_705_DATA=0x00000000
LOCAL &__DDRSS1_PHY_706_DATA
&__DDRSS1_PHY_706_DATA=0x00000000
LOCAL &__DDRSS1_PHY_707_DATA
&__DDRSS1_PHY_707_DATA=0x00000000
LOCAL &__DDRSS1_PHY_708_DATA
&__DDRSS1_PHY_708_DATA=0x00000000
LOCAL &__DDRSS1_PHY_709_DATA
&__DDRSS1_PHY_709_DATA=0x00000000
LOCAL &__DDRSS1_PHY_710_DATA
&__DDRSS1_PHY_710_DATA=0x00000000
LOCAL &__DDRSS1_PHY_711_DATA
&__DDRSS1_PHY_711_DATA=0x00000000
LOCAL &__DDRSS1_PHY_712_DATA
&__DDRSS1_PHY_712_DATA=0x00000000
LOCAL &__DDRSS1_PHY_713_DATA
&__DDRSS1_PHY_713_DATA=0x00000000
LOCAL &__DDRSS1_PHY_714_DATA
&__DDRSS1_PHY_714_DATA=0x00000000
LOCAL &__DDRSS1_PHY_715_DATA
&__DDRSS1_PHY_715_DATA=0x00000000
LOCAL &__DDRSS1_PHY_716_DATA
&__DDRSS1_PHY_716_DATA=0x00000000
LOCAL &__DDRSS1_PHY_717_DATA
&__DDRSS1_PHY_717_DATA=0x00000000
LOCAL &__DDRSS1_PHY_718_DATA
&__DDRSS1_PHY_718_DATA=0x00000000
LOCAL &__DDRSS1_PHY_719_DATA
&__DDRSS1_PHY_719_DATA=0x00000000
LOCAL &__DDRSS1_PHY_720_DATA
&__DDRSS1_PHY_720_DATA=0x00000000
LOCAL &__DDRSS1_PHY_721_DATA
&__DDRSS1_PHY_721_DATA=0x00000000
LOCAL &__DDRSS1_PHY_722_DATA
&__DDRSS1_PHY_722_DATA=0x00000000
LOCAL &__DDRSS1_PHY_723_DATA
&__DDRSS1_PHY_723_DATA=0x00000000
LOCAL &__DDRSS1_PHY_724_DATA
&__DDRSS1_PHY_724_DATA=0x00000000
LOCAL &__DDRSS1_PHY_725_DATA
&__DDRSS1_PHY_725_DATA=0x00000000
LOCAL &__DDRSS1_PHY_726_DATA
&__DDRSS1_PHY_726_DATA=0x00000000
LOCAL &__DDRSS1_PHY_727_DATA
&__DDRSS1_PHY_727_DATA=0x00000000
LOCAL &__DDRSS1_PHY_728_DATA
&__DDRSS1_PHY_728_DATA=0x00000000
LOCAL &__DDRSS1_PHY_729_DATA
&__DDRSS1_PHY_729_DATA=0x00000000
LOCAL &__DDRSS1_PHY_730_DATA
&__DDRSS1_PHY_730_DATA=0x00000000
LOCAL &__DDRSS1_PHY_731_DATA
&__DDRSS1_PHY_731_DATA=0x00000000
LOCAL &__DDRSS1_PHY_732_DATA
&__DDRSS1_PHY_732_DATA=0x00000000
LOCAL &__DDRSS1_PHY_733_DATA
&__DDRSS1_PHY_733_DATA=0x00000000
LOCAL &__DDRSS1_PHY_734_DATA
&__DDRSS1_PHY_734_DATA=0x00000000
LOCAL &__DDRSS1_PHY_735_DATA
&__DDRSS1_PHY_735_DATA=0x00000000
LOCAL &__DDRSS1_PHY_736_DATA
&__DDRSS1_PHY_736_DATA=0x00000000
LOCAL &__DDRSS1_PHY_737_DATA
&__DDRSS1_PHY_737_DATA=0x00000000
LOCAL &__DDRSS1_PHY_738_DATA
&__DDRSS1_PHY_738_DATA=0x00000000
LOCAL &__DDRSS1_PHY_739_DATA
&__DDRSS1_PHY_739_DATA=0x00000000
LOCAL &__DDRSS1_PHY_740_DATA
&__DDRSS1_PHY_740_DATA=0x00000000
LOCAL &__DDRSS1_PHY_741_DATA
&__DDRSS1_PHY_741_DATA=0x00000000
LOCAL &__DDRSS1_PHY_742_DATA
&__DDRSS1_PHY_742_DATA=0x00000000
LOCAL &__DDRSS1_PHY_743_DATA
&__DDRSS1_PHY_743_DATA=0x00000000
LOCAL &__DDRSS1_PHY_744_DATA
&__DDRSS1_PHY_744_DATA=0x00000000
LOCAL &__DDRSS1_PHY_745_DATA
&__DDRSS1_PHY_745_DATA=0x00000000
LOCAL &__DDRSS1_PHY_746_DATA
&__DDRSS1_PHY_746_DATA=0x00000000
LOCAL &__DDRSS1_PHY_747_DATA
&__DDRSS1_PHY_747_DATA=0x00000000
LOCAL &__DDRSS1_PHY_748_DATA
&__DDRSS1_PHY_748_DATA=0x00000000
LOCAL &__DDRSS1_PHY_749_DATA
&__DDRSS1_PHY_749_DATA=0x00000000
LOCAL &__DDRSS1_PHY_750_DATA
&__DDRSS1_PHY_750_DATA=0x00000000
LOCAL &__DDRSS1_PHY_751_DATA
&__DDRSS1_PHY_751_DATA=0x00000000
LOCAL &__DDRSS1_PHY_752_DATA
&__DDRSS1_PHY_752_DATA=0x00000000
LOCAL &__DDRSS1_PHY_753_DATA
&__DDRSS1_PHY_753_DATA=0x00000000
LOCAL &__DDRSS1_PHY_754_DATA
&__DDRSS1_PHY_754_DATA=0x00000000
LOCAL &__DDRSS1_PHY_755_DATA
&__DDRSS1_PHY_755_DATA=0x00000000
LOCAL &__DDRSS1_PHY_756_DATA
&__DDRSS1_PHY_756_DATA=0x00000000
LOCAL &__DDRSS1_PHY_757_DATA
&__DDRSS1_PHY_757_DATA=0x00000000
LOCAL &__DDRSS1_PHY_758_DATA
&__DDRSS1_PHY_758_DATA=0x00000000
LOCAL &__DDRSS1_PHY_759_DATA
&__DDRSS1_PHY_759_DATA=0x00000000
LOCAL &__DDRSS1_PHY_760_DATA
&__DDRSS1_PHY_760_DATA=0x00000000
LOCAL &__DDRSS1_PHY_761_DATA
&__DDRSS1_PHY_761_DATA=0x00000000
LOCAL &__DDRSS1_PHY_762_DATA
&__DDRSS1_PHY_762_DATA=0x00000000
LOCAL &__DDRSS1_PHY_763_DATA
&__DDRSS1_PHY_763_DATA=0x00000000
LOCAL &__DDRSS1_PHY_764_DATA
&__DDRSS1_PHY_764_DATA=0x00000000
LOCAL &__DDRSS1_PHY_765_DATA
&__DDRSS1_PHY_765_DATA=0x00000000
LOCAL &__DDRSS1_PHY_766_DATA
&__DDRSS1_PHY_766_DATA=0x00000000
LOCAL &__DDRSS1_PHY_767_DATA
&__DDRSS1_PHY_767_DATA=0x00000000
LOCAL &__DDRSS1_PHY_768_DATA
&__DDRSS1_PHY_768_DATA=0x000004F0
LOCAL &__DDRSS1_PHY_769_DATA
&__DDRSS1_PHY_769_DATA=0x00000000
LOCAL &__DDRSS1_PHY_770_DATA
&__DDRSS1_PHY_770_DATA=0x00030200
LOCAL &__DDRSS1_PHY_771_DATA
&__DDRSS1_PHY_771_DATA=0x00000000
LOCAL &__DDRSS1_PHY_772_DATA
&__DDRSS1_PHY_772_DATA=0x00000000
LOCAL &__DDRSS1_PHY_773_DATA
&__DDRSS1_PHY_773_DATA=0x01030000
LOCAL &__DDRSS1_PHY_774_DATA
&__DDRSS1_PHY_774_DATA=0x00010000
LOCAL &__DDRSS1_PHY_775_DATA
&__DDRSS1_PHY_775_DATA=0x01030004
LOCAL &__DDRSS1_PHY_776_DATA
&__DDRSS1_PHY_776_DATA=0x01000000
LOCAL &__DDRSS1_PHY_777_DATA
&__DDRSS1_PHY_777_DATA=0x00000000
LOCAL &__DDRSS1_PHY_778_DATA
&__DDRSS1_PHY_778_DATA=0x00000000
LOCAL &__DDRSS1_PHY_779_DATA
&__DDRSS1_PHY_779_DATA=0x01000001
LOCAL &__DDRSS1_PHY_780_DATA
&__DDRSS1_PHY_780_DATA=0x00000100
LOCAL &__DDRSS1_PHY_781_DATA
&__DDRSS1_PHY_781_DATA=0x000800C0
LOCAL &__DDRSS1_PHY_782_DATA
&__DDRSS1_PHY_782_DATA=0x060100CC
LOCAL &__DDRSS1_PHY_783_DATA
&__DDRSS1_PHY_783_DATA=0x00030066
LOCAL &__DDRSS1_PHY_784_DATA
&__DDRSS1_PHY_784_DATA=0x00000000
LOCAL &__DDRSS1_PHY_785_DATA
&__DDRSS1_PHY_785_DATA=0x00000301
LOCAL &__DDRSS1_PHY_786_DATA
&__DDRSS1_PHY_786_DATA=0x0000AAAA
LOCAL &__DDRSS1_PHY_787_DATA
&__DDRSS1_PHY_787_DATA=0x00005555
LOCAL &__DDRSS1_PHY_788_DATA
&__DDRSS1_PHY_788_DATA=0x0000B5B5
LOCAL &__DDRSS1_PHY_789_DATA
&__DDRSS1_PHY_789_DATA=0x00004A4A
LOCAL &__DDRSS1_PHY_790_DATA
&__DDRSS1_PHY_790_DATA=0x00005656
LOCAL &__DDRSS1_PHY_791_DATA
&__DDRSS1_PHY_791_DATA=0x0000A9A9
LOCAL &__DDRSS1_PHY_792_DATA
&__DDRSS1_PHY_792_DATA=0x0000A9A9
LOCAL &__DDRSS1_PHY_793_DATA
&__DDRSS1_PHY_793_DATA=0x0000B5B5
LOCAL &__DDRSS1_PHY_794_DATA
&__DDRSS1_PHY_794_DATA=0x00000000
LOCAL &__DDRSS1_PHY_795_DATA
&__DDRSS1_PHY_795_DATA=0x00000000
LOCAL &__DDRSS1_PHY_796_DATA
&__DDRSS1_PHY_796_DATA=0x2A000000
LOCAL &__DDRSS1_PHY_797_DATA
&__DDRSS1_PHY_797_DATA=0x00000808
LOCAL &__DDRSS1_PHY_798_DATA
&__DDRSS1_PHY_798_DATA=0x0F000000
LOCAL &__DDRSS1_PHY_799_DATA
&__DDRSS1_PHY_799_DATA=0x00000F0F
LOCAL &__DDRSS1_PHY_800_DATA
&__DDRSS1_PHY_800_DATA=0x10200000
LOCAL &__DDRSS1_PHY_801_DATA
&__DDRSS1_PHY_801_DATA=0x0C002006
LOCAL &__DDRSS1_PHY_802_DATA
&__DDRSS1_PHY_802_DATA=0x00000000
LOCAL &__DDRSS1_PHY_803_DATA
&__DDRSS1_PHY_803_DATA=0x00000000
LOCAL &__DDRSS1_PHY_804_DATA
&__DDRSS1_PHY_804_DATA=0x55555555
LOCAL &__DDRSS1_PHY_805_DATA
&__DDRSS1_PHY_805_DATA=0xAAAAAAAA
LOCAL &__DDRSS1_PHY_806_DATA
&__DDRSS1_PHY_806_DATA=0x55555555
LOCAL &__DDRSS1_PHY_807_DATA
&__DDRSS1_PHY_807_DATA=0xAAAAAAAA
LOCAL &__DDRSS1_PHY_808_DATA
&__DDRSS1_PHY_808_DATA=0x00005555
LOCAL &__DDRSS1_PHY_809_DATA
&__DDRSS1_PHY_809_DATA=0x01000100
LOCAL &__DDRSS1_PHY_810_DATA
&__DDRSS1_PHY_810_DATA=0x00800180
LOCAL &__DDRSS1_PHY_811_DATA
&__DDRSS1_PHY_811_DATA=0x00000000
LOCAL &__DDRSS1_PHY_812_DATA
&__DDRSS1_PHY_812_DATA=0x00000000
LOCAL &__DDRSS1_PHY_813_DATA
&__DDRSS1_PHY_813_DATA=0x00000000
LOCAL &__DDRSS1_PHY_814_DATA
&__DDRSS1_PHY_814_DATA=0x00000000
LOCAL &__DDRSS1_PHY_815_DATA
&__DDRSS1_PHY_815_DATA=0x00000000
LOCAL &__DDRSS1_PHY_816_DATA
&__DDRSS1_PHY_816_DATA=0x00000000
LOCAL &__DDRSS1_PHY_817_DATA
&__DDRSS1_PHY_817_DATA=0x00000000
LOCAL &__DDRSS1_PHY_818_DATA
&__DDRSS1_PHY_818_DATA=0x00000000
LOCAL &__DDRSS1_PHY_819_DATA
&__DDRSS1_PHY_819_DATA=0x00000000
LOCAL &__DDRSS1_PHY_820_DATA
&__DDRSS1_PHY_820_DATA=0x00000000
LOCAL &__DDRSS1_PHY_821_DATA
&__DDRSS1_PHY_821_DATA=0x00000000
LOCAL &__DDRSS1_PHY_822_DATA
&__DDRSS1_PHY_822_DATA=0x00000000
LOCAL &__DDRSS1_PHY_823_DATA
&__DDRSS1_PHY_823_DATA=0x00000000
LOCAL &__DDRSS1_PHY_824_DATA
&__DDRSS1_PHY_824_DATA=0x00000000
LOCAL &__DDRSS1_PHY_825_DATA
&__DDRSS1_PHY_825_DATA=0x00000000
LOCAL &__DDRSS1_PHY_826_DATA
&__DDRSS1_PHY_826_DATA=0x00000000
LOCAL &__DDRSS1_PHY_827_DATA
&__DDRSS1_PHY_827_DATA=0x00000000
LOCAL &__DDRSS1_PHY_828_DATA
&__DDRSS1_PHY_828_DATA=0x00000000
LOCAL &__DDRSS1_PHY_829_DATA
&__DDRSS1_PHY_829_DATA=0x00000000
LOCAL &__DDRSS1_PHY_830_DATA
&__DDRSS1_PHY_830_DATA=0x00000000
LOCAL &__DDRSS1_PHY_831_DATA
&__DDRSS1_PHY_831_DATA=0x00000000
LOCAL &__DDRSS1_PHY_832_DATA
&__DDRSS1_PHY_832_DATA=0x00000000
LOCAL &__DDRSS1_PHY_833_DATA
&__DDRSS1_PHY_833_DATA=0x00000000
LOCAL &__DDRSS1_PHY_834_DATA
&__DDRSS1_PHY_834_DATA=0x00000104
LOCAL &__DDRSS1_PHY_835_DATA
&__DDRSS1_PHY_835_DATA=0x00000120
LOCAL &__DDRSS1_PHY_836_DATA
&__DDRSS1_PHY_836_DATA=0x00000000
LOCAL &__DDRSS1_PHY_837_DATA
&__DDRSS1_PHY_837_DATA=0x00000000
LOCAL &__DDRSS1_PHY_838_DATA
&__DDRSS1_PHY_838_DATA=0x00000000
LOCAL &__DDRSS1_PHY_839_DATA
&__DDRSS1_PHY_839_DATA=0x00000000
LOCAL &__DDRSS1_PHY_840_DATA
&__DDRSS1_PHY_840_DATA=0x00000000
LOCAL &__DDRSS1_PHY_841_DATA
&__DDRSS1_PHY_841_DATA=0x00000000
LOCAL &__DDRSS1_PHY_842_DATA
&__DDRSS1_PHY_842_DATA=0x00000000
LOCAL &__DDRSS1_PHY_843_DATA
&__DDRSS1_PHY_843_DATA=0x00000001
LOCAL &__DDRSS1_PHY_844_DATA
&__DDRSS1_PHY_844_DATA=0x07FF0000
LOCAL &__DDRSS1_PHY_845_DATA
&__DDRSS1_PHY_845_DATA=0x0080081F
LOCAL &__DDRSS1_PHY_846_DATA
&__DDRSS1_PHY_846_DATA=0x00081020
LOCAL &__DDRSS1_PHY_847_DATA
&__DDRSS1_PHY_847_DATA=0x04010000
LOCAL &__DDRSS1_PHY_848_DATA
&__DDRSS1_PHY_848_DATA=0x00000000
LOCAL &__DDRSS1_PHY_849_DATA
&__DDRSS1_PHY_849_DATA=0x00000000
LOCAL &__DDRSS1_PHY_850_DATA
&__DDRSS1_PHY_850_DATA=0x00000000
LOCAL &__DDRSS1_PHY_851_DATA
&__DDRSS1_PHY_851_DATA=0x00000100
LOCAL &__DDRSS1_PHY_852_DATA
&__DDRSS1_PHY_852_DATA=0x01CC0C01
LOCAL &__DDRSS1_PHY_853_DATA
&__DDRSS1_PHY_853_DATA=0x1003CC0C
LOCAL &__DDRSS1_PHY_854_DATA
&__DDRSS1_PHY_854_DATA=0x20000140
LOCAL &__DDRSS1_PHY_855_DATA
&__DDRSS1_PHY_855_DATA=0x07FF0200
LOCAL &__DDRSS1_PHY_856_DATA
&__DDRSS1_PHY_856_DATA=0x0000DD01
LOCAL &__DDRSS1_PHY_857_DATA
&__DDRSS1_PHY_857_DATA=0x10100303
LOCAL &__DDRSS1_PHY_858_DATA
&__DDRSS1_PHY_858_DATA=0x10101010
LOCAL &__DDRSS1_PHY_859_DATA
&__DDRSS1_PHY_859_DATA=0x10101010
LOCAL &__DDRSS1_PHY_860_DATA
&__DDRSS1_PHY_860_DATA=0x00011010
LOCAL &__DDRSS1_PHY_861_DATA
&__DDRSS1_PHY_861_DATA=0x00100010
LOCAL &__DDRSS1_PHY_862_DATA
&__DDRSS1_PHY_862_DATA=0x00100010
LOCAL &__DDRSS1_PHY_863_DATA
&__DDRSS1_PHY_863_DATA=0x00100010
LOCAL &__DDRSS1_PHY_864_DATA
&__DDRSS1_PHY_864_DATA=0x00100010
LOCAL &__DDRSS1_PHY_865_DATA
&__DDRSS1_PHY_865_DATA=0x00050010
LOCAL &__DDRSS1_PHY_866_DATA
&__DDRSS1_PHY_866_DATA=0x51517041
LOCAL &__DDRSS1_PHY_867_DATA
&__DDRSS1_PHY_867_DATA=0x31C06000
LOCAL &__DDRSS1_PHY_868_DATA
&__DDRSS1_PHY_868_DATA=0x07AB0340
LOCAL &__DDRSS1_PHY_869_DATA
&__DDRSS1_PHY_869_DATA=0x00C0C001
LOCAL &__DDRSS1_PHY_870_DATA
&__DDRSS1_PHY_870_DATA=0x07060001
LOCAL &__DDRSS1_PHY_871_DATA
&__DDRSS1_PHY_871_DATA=0x10001000
LOCAL &__DDRSS1_PHY_872_DATA
&__DDRSS1_PHY_872_DATA=0x0C063E42
LOCAL &__DDRSS1_PHY_873_DATA
&__DDRSS1_PHY_873_DATA=0x0F0C2201
LOCAL &__DDRSS1_PHY_874_DATA
&__DDRSS1_PHY_874_DATA=0x01000140
LOCAL &__DDRSS1_PHY_875_DATA
&__DDRSS1_PHY_875_DATA=0x0C000420
LOCAL &__DDRSS1_PHY_876_DATA
&__DDRSS1_PHY_876_DATA=0x00000198
LOCAL &__DDRSS1_PHY_877_DATA
&__DDRSS1_PHY_877_DATA=0x0A0000D0
LOCAL &__DDRSS1_PHY_878_DATA
&__DDRSS1_PHY_878_DATA=0x00030200
LOCAL &__DDRSS1_PHY_879_DATA
&__DDRSS1_PHY_879_DATA=0x02800000
LOCAL &__DDRSS1_PHY_880_DATA
&__DDRSS1_PHY_880_DATA=0x80800000
LOCAL &__DDRSS1_PHY_881_DATA
&__DDRSS1_PHY_881_DATA=0x00072010
LOCAL &__DDRSS1_PHY_882_DATA
&__DDRSS1_PHY_882_DATA=0x76543210
LOCAL &__DDRSS1_PHY_883_DATA
&__DDRSS1_PHY_883_DATA=0x00000008
LOCAL &__DDRSS1_PHY_884_DATA
&__DDRSS1_PHY_884_DATA=0x02800280
LOCAL &__DDRSS1_PHY_885_DATA
&__DDRSS1_PHY_885_DATA=0x02800280
LOCAL &__DDRSS1_PHY_886_DATA
&__DDRSS1_PHY_886_DATA=0x02800280
LOCAL &__DDRSS1_PHY_887_DATA
&__DDRSS1_PHY_887_DATA=0x02800280
LOCAL &__DDRSS1_PHY_888_DATA
&__DDRSS1_PHY_888_DATA=0x00000280
LOCAL &__DDRSS1_PHY_889_DATA
&__DDRSS1_PHY_889_DATA=0x0000A000
LOCAL &__DDRSS1_PHY_890_DATA
&__DDRSS1_PHY_890_DATA=0x00A000A0
LOCAL &__DDRSS1_PHY_891_DATA
&__DDRSS1_PHY_891_DATA=0x00A000A0
LOCAL &__DDRSS1_PHY_892_DATA
&__DDRSS1_PHY_892_DATA=0x00A000A0
LOCAL &__DDRSS1_PHY_893_DATA
&__DDRSS1_PHY_893_DATA=0x00A000A0
LOCAL &__DDRSS1_PHY_894_DATA
&__DDRSS1_PHY_894_DATA=0x00A000A0
LOCAL &__DDRSS1_PHY_895_DATA
&__DDRSS1_PHY_895_DATA=0x00A000A0
LOCAL &__DDRSS1_PHY_896_DATA
&__DDRSS1_PHY_896_DATA=0x00A000A0
LOCAL &__DDRSS1_PHY_897_DATA
&__DDRSS1_PHY_897_DATA=0x00A000A0
LOCAL &__DDRSS1_PHY_898_DATA
&__DDRSS1_PHY_898_DATA=0x006E00A0
LOCAL &__DDRSS1_PHY_899_DATA
&__DDRSS1_PHY_899_DATA=0x01A00003
LOCAL &__DDRSS1_PHY_900_DATA
&__DDRSS1_PHY_900_DATA=0x00000000
LOCAL &__DDRSS1_PHY_901_DATA
&__DDRSS1_PHY_901_DATA=0x00000000
LOCAL &__DDRSS1_PHY_902_DATA
&__DDRSS1_PHY_902_DATA=0x00080200
LOCAL &__DDRSS1_PHY_903_DATA
&__DDRSS1_PHY_903_DATA=0x00000000
LOCAL &__DDRSS1_PHY_904_DATA
&__DDRSS1_PHY_904_DATA=0x20202000
LOCAL &__DDRSS1_PHY_905_DATA
&__DDRSS1_PHY_905_DATA=0x20202020
LOCAL &__DDRSS1_PHY_906_DATA
&__DDRSS1_PHY_906_DATA=0xF0F02020
LOCAL &__DDRSS1_PHY_907_DATA
&__DDRSS1_PHY_907_DATA=0x00000000
LOCAL &__DDRSS1_PHY_908_DATA
&__DDRSS1_PHY_908_DATA=0x00000000
LOCAL &__DDRSS1_PHY_909_DATA
&__DDRSS1_PHY_909_DATA=0x00000000
LOCAL &__DDRSS1_PHY_910_DATA
&__DDRSS1_PHY_910_DATA=0x00000000
LOCAL &__DDRSS1_PHY_911_DATA
&__DDRSS1_PHY_911_DATA=0x00000000
LOCAL &__DDRSS1_PHY_912_DATA
&__DDRSS1_PHY_912_DATA=0x00000000
LOCAL &__DDRSS1_PHY_913_DATA
&__DDRSS1_PHY_913_DATA=0x00000000
LOCAL &__DDRSS1_PHY_914_DATA
&__DDRSS1_PHY_914_DATA=0x00000000
LOCAL &__DDRSS1_PHY_915_DATA
&__DDRSS1_PHY_915_DATA=0x00000000
LOCAL &__DDRSS1_PHY_916_DATA
&__DDRSS1_PHY_916_DATA=0x00000000
LOCAL &__DDRSS1_PHY_917_DATA
&__DDRSS1_PHY_917_DATA=0x00000000
LOCAL &__DDRSS1_PHY_918_DATA
&__DDRSS1_PHY_918_DATA=0x00000000
LOCAL &__DDRSS1_PHY_919_DATA
&__DDRSS1_PHY_919_DATA=0x00000000
LOCAL &__DDRSS1_PHY_920_DATA
&__DDRSS1_PHY_920_DATA=0x00000000
LOCAL &__DDRSS1_PHY_921_DATA
&__DDRSS1_PHY_921_DATA=0x00000000
LOCAL &__DDRSS1_PHY_922_DATA
&__DDRSS1_PHY_922_DATA=0x00000000
LOCAL &__DDRSS1_PHY_923_DATA
&__DDRSS1_PHY_923_DATA=0x00000000
LOCAL &__DDRSS1_PHY_924_DATA
&__DDRSS1_PHY_924_DATA=0x00000000
LOCAL &__DDRSS1_PHY_925_DATA
&__DDRSS1_PHY_925_DATA=0x00000000
LOCAL &__DDRSS1_PHY_926_DATA
&__DDRSS1_PHY_926_DATA=0x00000000
LOCAL &__DDRSS1_PHY_927_DATA
&__DDRSS1_PHY_927_DATA=0x00000000
LOCAL &__DDRSS1_PHY_928_DATA
&__DDRSS1_PHY_928_DATA=0x00000000
LOCAL &__DDRSS1_PHY_929_DATA
&__DDRSS1_PHY_929_DATA=0x00000000
LOCAL &__DDRSS1_PHY_930_DATA
&__DDRSS1_PHY_930_DATA=0x00000000
LOCAL &__DDRSS1_PHY_931_DATA
&__DDRSS1_PHY_931_DATA=0x00000000
LOCAL &__DDRSS1_PHY_932_DATA
&__DDRSS1_PHY_932_DATA=0x00000000
LOCAL &__DDRSS1_PHY_933_DATA
&__DDRSS1_PHY_933_DATA=0x00000000
LOCAL &__DDRSS1_PHY_934_DATA
&__DDRSS1_PHY_934_DATA=0x00000000
LOCAL &__DDRSS1_PHY_935_DATA
&__DDRSS1_PHY_935_DATA=0x00000000
LOCAL &__DDRSS1_PHY_936_DATA
&__DDRSS1_PHY_936_DATA=0x00000000
LOCAL &__DDRSS1_PHY_937_DATA
&__DDRSS1_PHY_937_DATA=0x00000000
LOCAL &__DDRSS1_PHY_938_DATA
&__DDRSS1_PHY_938_DATA=0x00000000
LOCAL &__DDRSS1_PHY_939_DATA
&__DDRSS1_PHY_939_DATA=0x00000000
LOCAL &__DDRSS1_PHY_940_DATA
&__DDRSS1_PHY_940_DATA=0x00000000
LOCAL &__DDRSS1_PHY_941_DATA
&__DDRSS1_PHY_941_DATA=0x00000000
LOCAL &__DDRSS1_PHY_942_DATA
&__DDRSS1_PHY_942_DATA=0x00000000
LOCAL &__DDRSS1_PHY_943_DATA
&__DDRSS1_PHY_943_DATA=0x00000000
LOCAL &__DDRSS1_PHY_944_DATA
&__DDRSS1_PHY_944_DATA=0x00000000
LOCAL &__DDRSS1_PHY_945_DATA
&__DDRSS1_PHY_945_DATA=0x00000000
LOCAL &__DDRSS1_PHY_946_DATA
&__DDRSS1_PHY_946_DATA=0x00000000
LOCAL &__DDRSS1_PHY_947_DATA
&__DDRSS1_PHY_947_DATA=0x00000000
LOCAL &__DDRSS1_PHY_948_DATA
&__DDRSS1_PHY_948_DATA=0x00000000
LOCAL &__DDRSS1_PHY_949_DATA
&__DDRSS1_PHY_949_DATA=0x00000000
LOCAL &__DDRSS1_PHY_950_DATA
&__DDRSS1_PHY_950_DATA=0x00000000
LOCAL &__DDRSS1_PHY_951_DATA
&__DDRSS1_PHY_951_DATA=0x00000000
LOCAL &__DDRSS1_PHY_952_DATA
&__DDRSS1_PHY_952_DATA=0x00000000
LOCAL &__DDRSS1_PHY_953_DATA
&__DDRSS1_PHY_953_DATA=0x00000000
LOCAL &__DDRSS1_PHY_954_DATA
&__DDRSS1_PHY_954_DATA=0x00000000
LOCAL &__DDRSS1_PHY_955_DATA
&__DDRSS1_PHY_955_DATA=0x00000000
LOCAL &__DDRSS1_PHY_956_DATA
&__DDRSS1_PHY_956_DATA=0x00000000
LOCAL &__DDRSS1_PHY_957_DATA
&__DDRSS1_PHY_957_DATA=0x00000000
LOCAL &__DDRSS1_PHY_958_DATA
&__DDRSS1_PHY_958_DATA=0x00000000
LOCAL &__DDRSS1_PHY_959_DATA
&__DDRSS1_PHY_959_DATA=0x00000000
LOCAL &__DDRSS1_PHY_960_DATA
&__DDRSS1_PHY_960_DATA=0x00000000
LOCAL &__DDRSS1_PHY_961_DATA
&__DDRSS1_PHY_961_DATA=0x00000000
LOCAL &__DDRSS1_PHY_962_DATA
&__DDRSS1_PHY_962_DATA=0x00000000
LOCAL &__DDRSS1_PHY_963_DATA
&__DDRSS1_PHY_963_DATA=0x00000000
LOCAL &__DDRSS1_PHY_964_DATA
&__DDRSS1_PHY_964_DATA=0x00000000
LOCAL &__DDRSS1_PHY_965_DATA
&__DDRSS1_PHY_965_DATA=0x00000000
LOCAL &__DDRSS1_PHY_966_DATA
&__DDRSS1_PHY_966_DATA=0x00000000
LOCAL &__DDRSS1_PHY_967_DATA
&__DDRSS1_PHY_967_DATA=0x00000000
LOCAL &__DDRSS1_PHY_968_DATA
&__DDRSS1_PHY_968_DATA=0x00000000
LOCAL &__DDRSS1_PHY_969_DATA
&__DDRSS1_PHY_969_DATA=0x00000000
LOCAL &__DDRSS1_PHY_970_DATA
&__DDRSS1_PHY_970_DATA=0x00000000
LOCAL &__DDRSS1_PHY_971_DATA
&__DDRSS1_PHY_971_DATA=0x00000000
LOCAL &__DDRSS1_PHY_972_DATA
&__DDRSS1_PHY_972_DATA=0x00000000
LOCAL &__DDRSS1_PHY_973_DATA
&__DDRSS1_PHY_973_DATA=0x00000000
LOCAL &__DDRSS1_PHY_974_DATA
&__DDRSS1_PHY_974_DATA=0x00000000
LOCAL &__DDRSS1_PHY_975_DATA
&__DDRSS1_PHY_975_DATA=0x00000000
LOCAL &__DDRSS1_PHY_976_DATA
&__DDRSS1_PHY_976_DATA=0x00000000
LOCAL &__DDRSS1_PHY_977_DATA
&__DDRSS1_PHY_977_DATA=0x00000000
LOCAL &__DDRSS1_PHY_978_DATA
&__DDRSS1_PHY_978_DATA=0x00000000
LOCAL &__DDRSS1_PHY_979_DATA
&__DDRSS1_PHY_979_DATA=0x00000000
LOCAL &__DDRSS1_PHY_980_DATA
&__DDRSS1_PHY_980_DATA=0x00000000
LOCAL &__DDRSS1_PHY_981_DATA
&__DDRSS1_PHY_981_DATA=0x00000000
LOCAL &__DDRSS1_PHY_982_DATA
&__DDRSS1_PHY_982_DATA=0x00000000
LOCAL &__DDRSS1_PHY_983_DATA
&__DDRSS1_PHY_983_DATA=0x00000000
LOCAL &__DDRSS1_PHY_984_DATA
&__DDRSS1_PHY_984_DATA=0x00000000
LOCAL &__DDRSS1_PHY_985_DATA
&__DDRSS1_PHY_985_DATA=0x00000000
LOCAL &__DDRSS1_PHY_986_DATA
&__DDRSS1_PHY_986_DATA=0x00000000
LOCAL &__DDRSS1_PHY_987_DATA
&__DDRSS1_PHY_987_DATA=0x00000000
LOCAL &__DDRSS1_PHY_988_DATA
&__DDRSS1_PHY_988_DATA=0x00000000
LOCAL &__DDRSS1_PHY_989_DATA
&__DDRSS1_PHY_989_DATA=0x00000000
LOCAL &__DDRSS1_PHY_990_DATA
&__DDRSS1_PHY_990_DATA=0x00000000
LOCAL &__DDRSS1_PHY_991_DATA
&__DDRSS1_PHY_991_DATA=0x00000000
LOCAL &__DDRSS1_PHY_992_DATA
&__DDRSS1_PHY_992_DATA=0x00000000
LOCAL &__DDRSS1_PHY_993_DATA
&__DDRSS1_PHY_993_DATA=0x00000000
LOCAL &__DDRSS1_PHY_994_DATA
&__DDRSS1_PHY_994_DATA=0x00000000
LOCAL &__DDRSS1_PHY_995_DATA
&__DDRSS1_PHY_995_DATA=0x00000000
LOCAL &__DDRSS1_PHY_996_DATA
&__DDRSS1_PHY_996_DATA=0x00000000
LOCAL &__DDRSS1_PHY_997_DATA
&__DDRSS1_PHY_997_DATA=0x00000000
LOCAL &__DDRSS1_PHY_998_DATA
&__DDRSS1_PHY_998_DATA=0x00000000
LOCAL &__DDRSS1_PHY_999_DATA
&__DDRSS1_PHY_999_DATA=0x00000000
LOCAL &__DDRSS1_PHY_1000_DATA
&__DDRSS1_PHY_1000_DATA=0x00000000
LOCAL &__DDRSS1_PHY_1001_DATA
&__DDRSS1_PHY_1001_DATA=0x00000000
LOCAL &__DDRSS1_PHY_1002_DATA
&__DDRSS1_PHY_1002_DATA=0x00000000
LOCAL &__DDRSS1_PHY_1003_DATA
&__DDRSS1_PHY_1003_DATA=0x00000000
LOCAL &__DDRSS1_PHY_1004_DATA
&__DDRSS1_PHY_1004_DATA=0x00000000
LOCAL &__DDRSS1_PHY_1005_DATA
&__DDRSS1_PHY_1005_DATA=0x00000000
LOCAL &__DDRSS1_PHY_1006_DATA
&__DDRSS1_PHY_1006_DATA=0x00000000
LOCAL &__DDRSS1_PHY_1007_DATA
&__DDRSS1_PHY_1007_DATA=0x00000000
LOCAL &__DDRSS1_PHY_1008_DATA
&__DDRSS1_PHY_1008_DATA=0x00000000
LOCAL &__DDRSS1_PHY_1009_DATA
&__DDRSS1_PHY_1009_DATA=0x00000000
LOCAL &__DDRSS1_PHY_1010_DATA
&__DDRSS1_PHY_1010_DATA=0x00000000
LOCAL &__DDRSS1_PHY_1011_DATA
&__DDRSS1_PHY_1011_DATA=0x00000000
LOCAL &__DDRSS1_PHY_1012_DATA
&__DDRSS1_PHY_1012_DATA=0x00000000
LOCAL &__DDRSS1_PHY_1013_DATA
&__DDRSS1_PHY_1013_DATA=0x00000000
LOCAL &__DDRSS1_PHY_1014_DATA
&__DDRSS1_PHY_1014_DATA=0x00000000
LOCAL &__DDRSS1_PHY_1015_DATA
&__DDRSS1_PHY_1015_DATA=0x00000000
LOCAL &__DDRSS1_PHY_1016_DATA
&__DDRSS1_PHY_1016_DATA=0x00000000
LOCAL &__DDRSS1_PHY_1017_DATA
&__DDRSS1_PHY_1017_DATA=0x00000000
LOCAL &__DDRSS1_PHY_1018_DATA
&__DDRSS1_PHY_1018_DATA=0x00000000
LOCAL &__DDRSS1_PHY_1019_DATA
&__DDRSS1_PHY_1019_DATA=0x00000000
LOCAL &__DDRSS1_PHY_1020_DATA
&__DDRSS1_PHY_1020_DATA=0x00000000
LOCAL &__DDRSS1_PHY_1021_DATA
&__DDRSS1_PHY_1021_DATA=0x00000000
LOCAL &__DDRSS1_PHY_1022_DATA
&__DDRSS1_PHY_1022_DATA=0x00000000
LOCAL &__DDRSS1_PHY_1023_DATA
&__DDRSS1_PHY_1023_DATA=0x00000000
LOCAL &__DDRSS1_PHY_1024_DATA
&__DDRSS1_PHY_1024_DATA=0x00000000
LOCAL &__DDRSS1_PHY_1025_DATA
&__DDRSS1_PHY_1025_DATA=0x00000000
LOCAL &__DDRSS1_PHY_1026_DATA
&__DDRSS1_PHY_1026_DATA=0x00000000
LOCAL &__DDRSS1_PHY_1027_DATA
&__DDRSS1_PHY_1027_DATA=0x00000000
LOCAL &__DDRSS1_PHY_1028_DATA
&__DDRSS1_PHY_1028_DATA=0x00000000
LOCAL &__DDRSS1_PHY_1029_DATA
&__DDRSS1_PHY_1029_DATA=0x00000100
LOCAL &__DDRSS1_PHY_1030_DATA
&__DDRSS1_PHY_1030_DATA=0x00000200
LOCAL &__DDRSS1_PHY_1031_DATA
&__DDRSS1_PHY_1031_DATA=0x00000000
LOCAL &__DDRSS1_PHY_1032_DATA
&__DDRSS1_PHY_1032_DATA=0x00000000
LOCAL &__DDRSS1_PHY_1033_DATA
&__DDRSS1_PHY_1033_DATA=0x00000000
LOCAL &__DDRSS1_PHY_1034_DATA
&__DDRSS1_PHY_1034_DATA=0x00000000
LOCAL &__DDRSS1_PHY_1035_DATA
&__DDRSS1_PHY_1035_DATA=0x00400000
LOCAL &__DDRSS1_PHY_1036_DATA
&__DDRSS1_PHY_1036_DATA=0x00000080
LOCAL &__DDRSS1_PHY_1037_DATA
&__DDRSS1_PHY_1037_DATA=0x00DCBA98
LOCAL &__DDRSS1_PHY_1038_DATA
&__DDRSS1_PHY_1038_DATA=0x03000000
LOCAL &__DDRSS1_PHY_1039_DATA
&__DDRSS1_PHY_1039_DATA=0x00200000
LOCAL &__DDRSS1_PHY_1040_DATA
&__DDRSS1_PHY_1040_DATA=0x00000000
LOCAL &__DDRSS1_PHY_1041_DATA
&__DDRSS1_PHY_1041_DATA=0x00000000
LOCAL &__DDRSS1_PHY_1042_DATA
&__DDRSS1_PHY_1042_DATA=0x00000000
LOCAL &__DDRSS1_PHY_1043_DATA
&__DDRSS1_PHY_1043_DATA=0x00000000
LOCAL &__DDRSS1_PHY_1044_DATA
&__DDRSS1_PHY_1044_DATA=0x00000000
LOCAL &__DDRSS1_PHY_1045_DATA
&__DDRSS1_PHY_1045_DATA=0x0000002A
LOCAL &__DDRSS1_PHY_1046_DATA
&__DDRSS1_PHY_1046_DATA=0x00000015
LOCAL &__DDRSS1_PHY_1047_DATA
&__DDRSS1_PHY_1047_DATA=0x00000015
LOCAL &__DDRSS1_PHY_1048_DATA
&__DDRSS1_PHY_1048_DATA=0x0000002A
LOCAL &__DDRSS1_PHY_1049_DATA
&__DDRSS1_PHY_1049_DATA=0x00000033
LOCAL &__DDRSS1_PHY_1050_DATA
&__DDRSS1_PHY_1050_DATA=0x0000000C
LOCAL &__DDRSS1_PHY_1051_DATA
&__DDRSS1_PHY_1051_DATA=0x0000000C
LOCAL &__DDRSS1_PHY_1052_DATA
&__DDRSS1_PHY_1052_DATA=0x00000033
LOCAL &__DDRSS1_PHY_1053_DATA
&__DDRSS1_PHY_1053_DATA=0x00543210
LOCAL &__DDRSS1_PHY_1054_DATA
&__DDRSS1_PHY_1054_DATA=0x003F0000
LOCAL &__DDRSS1_PHY_1055_DATA
&__DDRSS1_PHY_1055_DATA=0x000F013F
LOCAL &__DDRSS1_PHY_1056_DATA
&__DDRSS1_PHY_1056_DATA=0x20202003
LOCAL &__DDRSS1_PHY_1057_DATA
&__DDRSS1_PHY_1057_DATA=0x00202020
LOCAL &__DDRSS1_PHY_1058_DATA
&__DDRSS1_PHY_1058_DATA=0x20008008
LOCAL &__DDRSS1_PHY_1059_DATA
&__DDRSS1_PHY_1059_DATA=0x00000810
LOCAL &__DDRSS1_PHY_1060_DATA
&__DDRSS1_PHY_1060_DATA=0x00000F00
LOCAL &__DDRSS1_PHY_1061_DATA
&__DDRSS1_PHY_1061_DATA=0x00000000
LOCAL &__DDRSS1_PHY_1062_DATA
&__DDRSS1_PHY_1062_DATA=0x00000000
LOCAL &__DDRSS1_PHY_1063_DATA
&__DDRSS1_PHY_1063_DATA=0x00000000
LOCAL &__DDRSS1_PHY_1064_DATA
&__DDRSS1_PHY_1064_DATA=0x000205CC
LOCAL &__DDRSS1_PHY_1065_DATA
&__DDRSS1_PHY_1065_DATA=0x00030000
LOCAL &__DDRSS1_PHY_1066_DATA
&__DDRSS1_PHY_1066_DATA=0x00000300
LOCAL &__DDRSS1_PHY_1067_DATA
&__DDRSS1_PHY_1067_DATA=0x00000300
LOCAL &__DDRSS1_PHY_1068_DATA
&__DDRSS1_PHY_1068_DATA=0x00000300
LOCAL &__DDRSS1_PHY_1069_DATA
&__DDRSS1_PHY_1069_DATA=0x00000300
LOCAL &__DDRSS1_PHY_1070_DATA
&__DDRSS1_PHY_1070_DATA=0x00000300
LOCAL &__DDRSS1_PHY_1071_DATA
&__DDRSS1_PHY_1071_DATA=0x42080010
LOCAL &__DDRSS1_PHY_1072_DATA
&__DDRSS1_PHY_1072_DATA=0x0000803E
LOCAL &__DDRSS1_PHY_1073_DATA
&__DDRSS1_PHY_1073_DATA=0x00000001
LOCAL &__DDRSS1_PHY_1074_DATA
&__DDRSS1_PHY_1074_DATA=0x01000102
LOCAL &__DDRSS1_PHY_1075_DATA
&__DDRSS1_PHY_1075_DATA=0x00008000
LOCAL &__DDRSS1_PHY_1076_DATA
&__DDRSS1_PHY_1076_DATA=0x00000000
LOCAL &__DDRSS1_PHY_1077_DATA
&__DDRSS1_PHY_1077_DATA=0x00000000
LOCAL &__DDRSS1_PHY_1078_DATA
&__DDRSS1_PHY_1078_DATA=0x00000000
LOCAL &__DDRSS1_PHY_1079_DATA
&__DDRSS1_PHY_1079_DATA=0x00000000
LOCAL &__DDRSS1_PHY_1080_DATA
&__DDRSS1_PHY_1080_DATA=0x00000000
LOCAL &__DDRSS1_PHY_1081_DATA
&__DDRSS1_PHY_1081_DATA=0x00000000
LOCAL &__DDRSS1_PHY_1082_DATA
&__DDRSS1_PHY_1082_DATA=0x00000000
LOCAL &__DDRSS1_PHY_1083_DATA
&__DDRSS1_PHY_1083_DATA=0x00000000
LOCAL &__DDRSS1_PHY_1084_DATA
&__DDRSS1_PHY_1084_DATA=0x00000000
LOCAL &__DDRSS1_PHY_1085_DATA
&__DDRSS1_PHY_1085_DATA=0x00000000
LOCAL &__DDRSS1_PHY_1086_DATA
&__DDRSS1_PHY_1086_DATA=0x00000000
LOCAL &__DDRSS1_PHY_1087_DATA
&__DDRSS1_PHY_1087_DATA=0x00000000
LOCAL &__DDRSS1_PHY_1088_DATA
&__DDRSS1_PHY_1088_DATA=0x00000000
LOCAL &__DDRSS1_PHY_1089_DATA
&__DDRSS1_PHY_1089_DATA=0x00000000
LOCAL &__DDRSS1_PHY_1090_DATA
&__DDRSS1_PHY_1090_DATA=0x00000000
LOCAL &__DDRSS1_PHY_1091_DATA
&__DDRSS1_PHY_1091_DATA=0x00000000
LOCAL &__DDRSS1_PHY_1092_DATA
&__DDRSS1_PHY_1092_DATA=0x00000000
LOCAL &__DDRSS1_PHY_1093_DATA
&__DDRSS1_PHY_1093_DATA=0x00000000
LOCAL &__DDRSS1_PHY_1094_DATA
&__DDRSS1_PHY_1094_DATA=0x00000000
LOCAL &__DDRSS1_PHY_1095_DATA
&__DDRSS1_PHY_1095_DATA=0x00000000
LOCAL &__DDRSS1_PHY_1096_DATA
&__DDRSS1_PHY_1096_DATA=0x00000000
LOCAL &__DDRSS1_PHY_1097_DATA
&__DDRSS1_PHY_1097_DATA=0x00000000
LOCAL &__DDRSS1_PHY_1098_DATA
&__DDRSS1_PHY_1098_DATA=0x00000000
LOCAL &__DDRSS1_PHY_1099_DATA
&__DDRSS1_PHY_1099_DATA=0x00000000
LOCAL &__DDRSS1_PHY_1100_DATA
&__DDRSS1_PHY_1100_DATA=0x00000000
LOCAL &__DDRSS1_PHY_1101_DATA
&__DDRSS1_PHY_1101_DATA=0x00000000
LOCAL &__DDRSS1_PHY_1102_DATA
&__DDRSS1_PHY_1102_DATA=0x00000000
LOCAL &__DDRSS1_PHY_1103_DATA
&__DDRSS1_PHY_1103_DATA=0x00000000
LOCAL &__DDRSS1_PHY_1104_DATA
&__DDRSS1_PHY_1104_DATA=0x00000000
LOCAL &__DDRSS1_PHY_1105_DATA
&__DDRSS1_PHY_1105_DATA=0x00000000
LOCAL &__DDRSS1_PHY_1106_DATA
&__DDRSS1_PHY_1106_DATA=0x00000000
LOCAL &__DDRSS1_PHY_1107_DATA
&__DDRSS1_PHY_1107_DATA=0x00000000
LOCAL &__DDRSS1_PHY_1108_DATA
&__DDRSS1_PHY_1108_DATA=0x00000000
LOCAL &__DDRSS1_PHY_1109_DATA
&__DDRSS1_PHY_1109_DATA=0x00000000
LOCAL &__DDRSS1_PHY_1110_DATA
&__DDRSS1_PHY_1110_DATA=0x00000000
LOCAL &__DDRSS1_PHY_1111_DATA
&__DDRSS1_PHY_1111_DATA=0x00000000
LOCAL &__DDRSS1_PHY_1112_DATA
&__DDRSS1_PHY_1112_DATA=0x00000000
LOCAL &__DDRSS1_PHY_1113_DATA
&__DDRSS1_PHY_1113_DATA=0x00000000
LOCAL &__DDRSS1_PHY_1114_DATA
&__DDRSS1_PHY_1114_DATA=0x00000000
LOCAL &__DDRSS1_PHY_1115_DATA
&__DDRSS1_PHY_1115_DATA=0x00000000
LOCAL &__DDRSS1_PHY_1116_DATA
&__DDRSS1_PHY_1116_DATA=0x00000000
LOCAL &__DDRSS1_PHY_1117_DATA
&__DDRSS1_PHY_1117_DATA=0x00000000
LOCAL &__DDRSS1_PHY_1118_DATA
&__DDRSS1_PHY_1118_DATA=0x00000000
LOCAL &__DDRSS1_PHY_1119_DATA
&__DDRSS1_PHY_1119_DATA=0x00000000
LOCAL &__DDRSS1_PHY_1120_DATA
&__DDRSS1_PHY_1120_DATA=0x00000000
LOCAL &__DDRSS1_PHY_1121_DATA
&__DDRSS1_PHY_1121_DATA=0x00000000
LOCAL &__DDRSS1_PHY_1122_DATA
&__DDRSS1_PHY_1122_DATA=0x00000000
LOCAL &__DDRSS1_PHY_1123_DATA
&__DDRSS1_PHY_1123_DATA=0x00000000
LOCAL &__DDRSS1_PHY_1124_DATA
&__DDRSS1_PHY_1124_DATA=0x00000000
LOCAL &__DDRSS1_PHY_1125_DATA
&__DDRSS1_PHY_1125_DATA=0x00000000
LOCAL &__DDRSS1_PHY_1126_DATA
&__DDRSS1_PHY_1126_DATA=0x00000000
LOCAL &__DDRSS1_PHY_1127_DATA
&__DDRSS1_PHY_1127_DATA=0x00000000
LOCAL &__DDRSS1_PHY_1128_DATA
&__DDRSS1_PHY_1128_DATA=0x00000000
LOCAL &__DDRSS1_PHY_1129_DATA
&__DDRSS1_PHY_1129_DATA=0x00000000
LOCAL &__DDRSS1_PHY_1130_DATA
&__DDRSS1_PHY_1130_DATA=0x00000000
LOCAL &__DDRSS1_PHY_1131_DATA
&__DDRSS1_PHY_1131_DATA=0x00000000
LOCAL &__DDRSS1_PHY_1132_DATA
&__DDRSS1_PHY_1132_DATA=0x00000000
LOCAL &__DDRSS1_PHY_1133_DATA
&__DDRSS1_PHY_1133_DATA=0x00000000
LOCAL &__DDRSS1_PHY_1134_DATA
&__DDRSS1_PHY_1134_DATA=0x00000000
LOCAL &__DDRSS1_PHY_1135_DATA
&__DDRSS1_PHY_1135_DATA=0x00000000
LOCAL &__DDRSS1_PHY_1136_DATA
&__DDRSS1_PHY_1136_DATA=0x00000000
LOCAL &__DDRSS1_PHY_1137_DATA
&__DDRSS1_PHY_1137_DATA=0x00000000
LOCAL &__DDRSS1_PHY_1138_DATA
&__DDRSS1_PHY_1138_DATA=0x00000000
LOCAL &__DDRSS1_PHY_1139_DATA
&__DDRSS1_PHY_1139_DATA=0x00000000
LOCAL &__DDRSS1_PHY_1140_DATA
&__DDRSS1_PHY_1140_DATA=0x00000000
LOCAL &__DDRSS1_PHY_1141_DATA
&__DDRSS1_PHY_1141_DATA=0x00000000
LOCAL &__DDRSS1_PHY_1142_DATA
&__DDRSS1_PHY_1142_DATA=0x00000000
LOCAL &__DDRSS1_PHY_1143_DATA
&__DDRSS1_PHY_1143_DATA=0x00000000
LOCAL &__DDRSS1_PHY_1144_DATA
&__DDRSS1_PHY_1144_DATA=0x00000000
LOCAL &__DDRSS1_PHY_1145_DATA
&__DDRSS1_PHY_1145_DATA=0x00000000
LOCAL &__DDRSS1_PHY_1146_DATA
&__DDRSS1_PHY_1146_DATA=0x00000000
LOCAL &__DDRSS1_PHY_1147_DATA
&__DDRSS1_PHY_1147_DATA=0x00000000
LOCAL &__DDRSS1_PHY_1148_DATA
&__DDRSS1_PHY_1148_DATA=0x00000000
LOCAL &__DDRSS1_PHY_1149_DATA
&__DDRSS1_PHY_1149_DATA=0x00000000
LOCAL &__DDRSS1_PHY_1150_DATA
&__DDRSS1_PHY_1150_DATA=0x00000000
LOCAL &__DDRSS1_PHY_1151_DATA
&__DDRSS1_PHY_1151_DATA=0x00000000
LOCAL &__DDRSS1_PHY_1152_DATA
&__DDRSS1_PHY_1152_DATA=0x00000000
LOCAL &__DDRSS1_PHY_1153_DATA
&__DDRSS1_PHY_1153_DATA=0x00000000
LOCAL &__DDRSS1_PHY_1154_DATA
&__DDRSS1_PHY_1154_DATA=0x00000000
LOCAL &__DDRSS1_PHY_1155_DATA
&__DDRSS1_PHY_1155_DATA=0x00000000
LOCAL &__DDRSS1_PHY_1156_DATA
&__DDRSS1_PHY_1156_DATA=0x00000000
LOCAL &__DDRSS1_PHY_1157_DATA
&__DDRSS1_PHY_1157_DATA=0x00000000
LOCAL &__DDRSS1_PHY_1158_DATA
&__DDRSS1_PHY_1158_DATA=0x00000000
LOCAL &__DDRSS1_PHY_1159_DATA
&__DDRSS1_PHY_1159_DATA=0x00000000
LOCAL &__DDRSS1_PHY_1160_DATA
&__DDRSS1_PHY_1160_DATA=0x00000000
LOCAL &__DDRSS1_PHY_1161_DATA
&__DDRSS1_PHY_1161_DATA=0x00000000
LOCAL &__DDRSS1_PHY_1162_DATA
&__DDRSS1_PHY_1162_DATA=0x00000000
LOCAL &__DDRSS1_PHY_1163_DATA
&__DDRSS1_PHY_1163_DATA=0x00000000
LOCAL &__DDRSS1_PHY_1164_DATA
&__DDRSS1_PHY_1164_DATA=0x00000000
LOCAL &__DDRSS1_PHY_1165_DATA
&__DDRSS1_PHY_1165_DATA=0x00000000
LOCAL &__DDRSS1_PHY_1166_DATA
&__DDRSS1_PHY_1166_DATA=0x00000000
LOCAL &__DDRSS1_PHY_1167_DATA
&__DDRSS1_PHY_1167_DATA=0x00000000
LOCAL &__DDRSS1_PHY_1168_DATA
&__DDRSS1_PHY_1168_DATA=0x00000000
LOCAL &__DDRSS1_PHY_1169_DATA
&__DDRSS1_PHY_1169_DATA=0x00000000
LOCAL &__DDRSS1_PHY_1170_DATA
&__DDRSS1_PHY_1170_DATA=0x00000000
LOCAL &__DDRSS1_PHY_1171_DATA
&__DDRSS1_PHY_1171_DATA=0x00000000
LOCAL &__DDRSS1_PHY_1172_DATA
&__DDRSS1_PHY_1172_DATA=0x00000000
LOCAL &__DDRSS1_PHY_1173_DATA
&__DDRSS1_PHY_1173_DATA=0x00000000
LOCAL &__DDRSS1_PHY_1174_DATA
&__DDRSS1_PHY_1174_DATA=0x00000000
LOCAL &__DDRSS1_PHY_1175_DATA
&__DDRSS1_PHY_1175_DATA=0x00000000
LOCAL &__DDRSS1_PHY_1176_DATA
&__DDRSS1_PHY_1176_DATA=0x00000000
LOCAL &__DDRSS1_PHY_1177_DATA
&__DDRSS1_PHY_1177_DATA=0x00000000
LOCAL &__DDRSS1_PHY_1178_DATA
&__DDRSS1_PHY_1178_DATA=0x00000000
LOCAL &__DDRSS1_PHY_1179_DATA
&__DDRSS1_PHY_1179_DATA=0x00000000
LOCAL &__DDRSS1_PHY_1180_DATA
&__DDRSS1_PHY_1180_DATA=0x00000000
LOCAL &__DDRSS1_PHY_1181_DATA
&__DDRSS1_PHY_1181_DATA=0x00000000
LOCAL &__DDRSS1_PHY_1182_DATA
&__DDRSS1_PHY_1182_DATA=0x00000000
LOCAL &__DDRSS1_PHY_1183_DATA
&__DDRSS1_PHY_1183_DATA=0x00000000
LOCAL &__DDRSS1_PHY_1184_DATA
&__DDRSS1_PHY_1184_DATA=0x00000000
LOCAL &__DDRSS1_PHY_1185_DATA
&__DDRSS1_PHY_1185_DATA=0x00000000
LOCAL &__DDRSS1_PHY_1186_DATA
&__DDRSS1_PHY_1186_DATA=0x00000000
LOCAL &__DDRSS1_PHY_1187_DATA
&__DDRSS1_PHY_1187_DATA=0x00000000
LOCAL &__DDRSS1_PHY_1188_DATA
&__DDRSS1_PHY_1188_DATA=0x00000000
LOCAL &__DDRSS1_PHY_1189_DATA
&__DDRSS1_PHY_1189_DATA=0x00000000
LOCAL &__DDRSS1_PHY_1190_DATA
&__DDRSS1_PHY_1190_DATA=0x00000000
LOCAL &__DDRSS1_PHY_1191_DATA
&__DDRSS1_PHY_1191_DATA=0x00000000
LOCAL &__DDRSS1_PHY_1192_DATA
&__DDRSS1_PHY_1192_DATA=0x00000000
LOCAL &__DDRSS1_PHY_1193_DATA
&__DDRSS1_PHY_1193_DATA=0x00000000
LOCAL &__DDRSS1_PHY_1194_DATA
&__DDRSS1_PHY_1194_DATA=0x00000000
LOCAL &__DDRSS1_PHY_1195_DATA
&__DDRSS1_PHY_1195_DATA=0x00000000
LOCAL &__DDRSS1_PHY_1196_DATA
&__DDRSS1_PHY_1196_DATA=0x00000000
LOCAL &__DDRSS1_PHY_1197_DATA
&__DDRSS1_PHY_1197_DATA=0x00000000
LOCAL &__DDRSS1_PHY_1198_DATA
&__DDRSS1_PHY_1198_DATA=0x00000000
LOCAL &__DDRSS1_PHY_1199_DATA
&__DDRSS1_PHY_1199_DATA=0x00000000
LOCAL &__DDRSS1_PHY_1200_DATA
&__DDRSS1_PHY_1200_DATA=0x00000000
LOCAL &__DDRSS1_PHY_1201_DATA
&__DDRSS1_PHY_1201_DATA=0x00000000
LOCAL &__DDRSS1_PHY_1202_DATA
&__DDRSS1_PHY_1202_DATA=0x00000000
LOCAL &__DDRSS1_PHY_1203_DATA
&__DDRSS1_PHY_1203_DATA=0x00000000
LOCAL &__DDRSS1_PHY_1204_DATA
&__DDRSS1_PHY_1204_DATA=0x00000000
LOCAL &__DDRSS1_PHY_1205_DATA
&__DDRSS1_PHY_1205_DATA=0x00000000
LOCAL &__DDRSS1_PHY_1206_DATA
&__DDRSS1_PHY_1206_DATA=0x00000000
LOCAL &__DDRSS1_PHY_1207_DATA
&__DDRSS1_PHY_1207_DATA=0x00000000
LOCAL &__DDRSS1_PHY_1208_DATA
&__DDRSS1_PHY_1208_DATA=0x00000000
LOCAL &__DDRSS1_PHY_1209_DATA
&__DDRSS1_PHY_1209_DATA=0x00000000
LOCAL &__DDRSS1_PHY_1210_DATA
&__DDRSS1_PHY_1210_DATA=0x00000000
LOCAL &__DDRSS1_PHY_1211_DATA
&__DDRSS1_PHY_1211_DATA=0x00000000
LOCAL &__DDRSS1_PHY_1212_DATA
&__DDRSS1_PHY_1212_DATA=0x00000000
LOCAL &__DDRSS1_PHY_1213_DATA
&__DDRSS1_PHY_1213_DATA=0x00000000
LOCAL &__DDRSS1_PHY_1214_DATA
&__DDRSS1_PHY_1214_DATA=0x00000000
LOCAL &__DDRSS1_PHY_1215_DATA
&__DDRSS1_PHY_1215_DATA=0x00000000
LOCAL &__DDRSS1_PHY_1216_DATA
&__DDRSS1_PHY_1216_DATA=0x00000000
LOCAL &__DDRSS1_PHY_1217_DATA
&__DDRSS1_PHY_1217_DATA=0x00000000
LOCAL &__DDRSS1_PHY_1218_DATA
&__DDRSS1_PHY_1218_DATA=0x00000000
LOCAL &__DDRSS1_PHY_1219_DATA
&__DDRSS1_PHY_1219_DATA=0x00000000
LOCAL &__DDRSS1_PHY_1220_DATA
&__DDRSS1_PHY_1220_DATA=0x00000000
LOCAL &__DDRSS1_PHY_1221_DATA
&__DDRSS1_PHY_1221_DATA=0x00000000
LOCAL &__DDRSS1_PHY_1222_DATA
&__DDRSS1_PHY_1222_DATA=0x00000000
LOCAL &__DDRSS1_PHY_1223_DATA
&__DDRSS1_PHY_1223_DATA=0x00000000
LOCAL &__DDRSS1_PHY_1224_DATA
&__DDRSS1_PHY_1224_DATA=0x00000000
LOCAL &__DDRSS1_PHY_1225_DATA
&__DDRSS1_PHY_1225_DATA=0x00000000
LOCAL &__DDRSS1_PHY_1226_DATA
&__DDRSS1_PHY_1226_DATA=0x00000000
LOCAL &__DDRSS1_PHY_1227_DATA
&__DDRSS1_PHY_1227_DATA=0x00000000
LOCAL &__DDRSS1_PHY_1228_DATA
&__DDRSS1_PHY_1228_DATA=0x00000000
LOCAL &__DDRSS1_PHY_1229_DATA
&__DDRSS1_PHY_1229_DATA=0x00000000
LOCAL &__DDRSS1_PHY_1230_DATA
&__DDRSS1_PHY_1230_DATA=0x00000000
LOCAL &__DDRSS1_PHY_1231_DATA
&__DDRSS1_PHY_1231_DATA=0x00000000
LOCAL &__DDRSS1_PHY_1232_DATA
&__DDRSS1_PHY_1232_DATA=0x00000000
LOCAL &__DDRSS1_PHY_1233_DATA
&__DDRSS1_PHY_1233_DATA=0x00000000
LOCAL &__DDRSS1_PHY_1234_DATA
&__DDRSS1_PHY_1234_DATA=0x00000000
LOCAL &__DDRSS1_PHY_1235_DATA
&__DDRSS1_PHY_1235_DATA=0x00000000
LOCAL &__DDRSS1_PHY_1236_DATA
&__DDRSS1_PHY_1236_DATA=0x00000000
LOCAL &__DDRSS1_PHY_1237_DATA
&__DDRSS1_PHY_1237_DATA=0x00000000
LOCAL &__DDRSS1_PHY_1238_DATA
&__DDRSS1_PHY_1238_DATA=0x00000000
LOCAL &__DDRSS1_PHY_1239_DATA
&__DDRSS1_PHY_1239_DATA=0x00000000
LOCAL &__DDRSS1_PHY_1240_DATA
&__DDRSS1_PHY_1240_DATA=0x00000000
LOCAL &__DDRSS1_PHY_1241_DATA
&__DDRSS1_PHY_1241_DATA=0x00000000
LOCAL &__DDRSS1_PHY_1242_DATA
&__DDRSS1_PHY_1242_DATA=0x00000000
LOCAL &__DDRSS1_PHY_1243_DATA
&__DDRSS1_PHY_1243_DATA=0x00000000
LOCAL &__DDRSS1_PHY_1244_DATA
&__DDRSS1_PHY_1244_DATA=0x00000000
LOCAL &__DDRSS1_PHY_1245_DATA
&__DDRSS1_PHY_1245_DATA=0x00000000
LOCAL &__DDRSS1_PHY_1246_DATA
&__DDRSS1_PHY_1246_DATA=0x00000000
LOCAL &__DDRSS1_PHY_1247_DATA
&__DDRSS1_PHY_1247_DATA=0x00000000
LOCAL &__DDRSS1_PHY_1248_DATA
&__DDRSS1_PHY_1248_DATA=0x00000000
LOCAL &__DDRSS1_PHY_1249_DATA
&__DDRSS1_PHY_1249_DATA=0x00000000
LOCAL &__DDRSS1_PHY_1250_DATA
&__DDRSS1_PHY_1250_DATA=0x00000000
LOCAL &__DDRSS1_PHY_1251_DATA
&__DDRSS1_PHY_1251_DATA=0x00000000
LOCAL &__DDRSS1_PHY_1252_DATA
&__DDRSS1_PHY_1252_DATA=0x00000000
LOCAL &__DDRSS1_PHY_1253_DATA
&__DDRSS1_PHY_1253_DATA=0x00000000
LOCAL &__DDRSS1_PHY_1254_DATA
&__DDRSS1_PHY_1254_DATA=0x00000000
LOCAL &__DDRSS1_PHY_1255_DATA
&__DDRSS1_PHY_1255_DATA=0x00000000
LOCAL &__DDRSS1_PHY_1256_DATA
&__DDRSS1_PHY_1256_DATA=0x00000000
LOCAL &__DDRSS1_PHY_1257_DATA
&__DDRSS1_PHY_1257_DATA=0x00000000
LOCAL &__DDRSS1_PHY_1258_DATA
&__DDRSS1_PHY_1258_DATA=0x00000000
LOCAL &__DDRSS1_PHY_1259_DATA
&__DDRSS1_PHY_1259_DATA=0x00000000
LOCAL &__DDRSS1_PHY_1260_DATA
&__DDRSS1_PHY_1260_DATA=0x00000000
LOCAL &__DDRSS1_PHY_1261_DATA
&__DDRSS1_PHY_1261_DATA=0x00000000
LOCAL &__DDRSS1_PHY_1262_DATA
&__DDRSS1_PHY_1262_DATA=0x00000000
LOCAL &__DDRSS1_PHY_1263_DATA
&__DDRSS1_PHY_1263_DATA=0x00000000
LOCAL &__DDRSS1_PHY_1264_DATA
&__DDRSS1_PHY_1264_DATA=0x00000000
LOCAL &__DDRSS1_PHY_1265_DATA
&__DDRSS1_PHY_1265_DATA=0x00000000
LOCAL &__DDRSS1_PHY_1266_DATA
&__DDRSS1_PHY_1266_DATA=0x00000000
LOCAL &__DDRSS1_PHY_1267_DATA
&__DDRSS1_PHY_1267_DATA=0x00000000
LOCAL &__DDRSS1_PHY_1268_DATA
&__DDRSS1_PHY_1268_DATA=0x00000000
LOCAL &__DDRSS1_PHY_1269_DATA
&__DDRSS1_PHY_1269_DATA=0x00000000
LOCAL &__DDRSS1_PHY_1270_DATA
&__DDRSS1_PHY_1270_DATA=0x00000000
LOCAL &__DDRSS1_PHY_1271_DATA
&__DDRSS1_PHY_1271_DATA=0x00000000
LOCAL &__DDRSS1_PHY_1272_DATA
&__DDRSS1_PHY_1272_DATA=0x00000000
LOCAL &__DDRSS1_PHY_1273_DATA
&__DDRSS1_PHY_1273_DATA=0x00000000
LOCAL &__DDRSS1_PHY_1274_DATA
&__DDRSS1_PHY_1274_DATA=0x00000000
LOCAL &__DDRSS1_PHY_1275_DATA
&__DDRSS1_PHY_1275_DATA=0x00000000
LOCAL &__DDRSS1_PHY_1276_DATA
&__DDRSS1_PHY_1276_DATA=0x00000000
LOCAL &__DDRSS1_PHY_1277_DATA
&__DDRSS1_PHY_1277_DATA=0x00000000
LOCAL &__DDRSS1_PHY_1278_DATA
&__DDRSS1_PHY_1278_DATA=0x00000000
LOCAL &__DDRSS1_PHY_1279_DATA
&__DDRSS1_PHY_1279_DATA=0x00000000
LOCAL &__DDRSS1_PHY_1280_DATA
&__DDRSS1_PHY_1280_DATA=0x00000000
LOCAL &__DDRSS1_PHY_1281_DATA
&__DDRSS1_PHY_1281_DATA=0x00010100
LOCAL &__DDRSS1_PHY_1282_DATA
&__DDRSS1_PHY_1282_DATA=0x00000000
LOCAL &__DDRSS1_PHY_1283_DATA
&__DDRSS1_PHY_1283_DATA=0x00000000
LOCAL &__DDRSS1_PHY_1284_DATA
&__DDRSS1_PHY_1284_DATA=0x00050000
LOCAL &__DDRSS1_PHY_1285_DATA
&__DDRSS1_PHY_1285_DATA=0x04000000
LOCAL &__DDRSS1_PHY_1286_DATA
&__DDRSS1_PHY_1286_DATA=0x00000055
LOCAL &__DDRSS1_PHY_1287_DATA
&__DDRSS1_PHY_1287_DATA=0x00000000
LOCAL &__DDRSS1_PHY_1288_DATA
&__DDRSS1_PHY_1288_DATA=0x00000000
LOCAL &__DDRSS1_PHY_1289_DATA
&__DDRSS1_PHY_1289_DATA=0x00000000
LOCAL &__DDRSS1_PHY_1290_DATA
&__DDRSS1_PHY_1290_DATA=0x00000000
LOCAL &__DDRSS1_PHY_1291_DATA
&__DDRSS1_PHY_1291_DATA=0x00002001
LOCAL &__DDRSS1_PHY_1292_DATA
&__DDRSS1_PHY_1292_DATA=0x0000400F
LOCAL &__DDRSS1_PHY_1293_DATA
&__DDRSS1_PHY_1293_DATA=0x50020028
LOCAL &__DDRSS1_PHY_1294_DATA
&__DDRSS1_PHY_1294_DATA=0x01010000
LOCAL &__DDRSS1_PHY_1295_DATA
&__DDRSS1_PHY_1295_DATA=0x80080001
LOCAL &__DDRSS1_PHY_1296_DATA
&__DDRSS1_PHY_1296_DATA=0x10200000
LOCAL &__DDRSS1_PHY_1297_DATA
&__DDRSS1_PHY_1297_DATA=0x00000008
LOCAL &__DDRSS1_PHY_1298_DATA
&__DDRSS1_PHY_1298_DATA=0x00000000
LOCAL &__DDRSS1_PHY_1299_DATA
&__DDRSS1_PHY_1299_DATA=0x01090E00
LOCAL &__DDRSS1_PHY_1300_DATA
&__DDRSS1_PHY_1300_DATA=0x00040101
LOCAL &__DDRSS1_PHY_1301_DATA
&__DDRSS1_PHY_1301_DATA=0x0000010F
LOCAL &__DDRSS1_PHY_1302_DATA
&__DDRSS1_PHY_1302_DATA=0x00000000
LOCAL &__DDRSS1_PHY_1303_DATA
&__DDRSS1_PHY_1303_DATA=0x0000FFFF
LOCAL &__DDRSS1_PHY_1304_DATA
&__DDRSS1_PHY_1304_DATA=0x00000000
LOCAL &__DDRSS1_PHY_1305_DATA
&__DDRSS1_PHY_1305_DATA=0x01010000
LOCAL &__DDRSS1_PHY_1306_DATA
&__DDRSS1_PHY_1306_DATA=0x01080402
LOCAL &__DDRSS1_PHY_1307_DATA
&__DDRSS1_PHY_1307_DATA=0x01200F02
LOCAL &__DDRSS1_PHY_1308_DATA
&__DDRSS1_PHY_1308_DATA=0x00194280
LOCAL &__DDRSS1_PHY_1309_DATA
&__DDRSS1_PHY_1309_DATA=0x00000004
LOCAL &__DDRSS1_PHY_1310_DATA
&__DDRSS1_PHY_1310_DATA=0x00052000
LOCAL &__DDRSS1_PHY_1311_DATA
&__DDRSS1_PHY_1311_DATA=0x00000000
LOCAL &__DDRSS1_PHY_1312_DATA
&__DDRSS1_PHY_1312_DATA=0x00000000
LOCAL &__DDRSS1_PHY_1313_DATA
&__DDRSS1_PHY_1313_DATA=0x00000000
LOCAL &__DDRSS1_PHY_1314_DATA
&__DDRSS1_PHY_1314_DATA=0x00000000
LOCAL &__DDRSS1_PHY_1315_DATA
&__DDRSS1_PHY_1315_DATA=0x00000000
LOCAL &__DDRSS1_PHY_1316_DATA
&__DDRSS1_PHY_1316_DATA=0x00000000
LOCAL &__DDRSS1_PHY_1317_DATA
&__DDRSS1_PHY_1317_DATA=0x01000000
LOCAL &__DDRSS1_PHY_1318_DATA
&__DDRSS1_PHY_1318_DATA=0x00000705
LOCAL &__DDRSS1_PHY_1319_DATA
&__DDRSS1_PHY_1319_DATA=0x00000054
LOCAL &__DDRSS1_PHY_1320_DATA
&__DDRSS1_PHY_1320_DATA=0x00030820
LOCAL &__DDRSS1_PHY_1321_DATA
&__DDRSS1_PHY_1321_DATA=0x00010820
LOCAL &__DDRSS1_PHY_1322_DATA
&__DDRSS1_PHY_1322_DATA=0x00010820
LOCAL &__DDRSS1_PHY_1323_DATA
&__DDRSS1_PHY_1323_DATA=0x00010820
LOCAL &__DDRSS1_PHY_1324_DATA
&__DDRSS1_PHY_1324_DATA=0x00010820
LOCAL &__DDRSS1_PHY_1325_DATA
&__DDRSS1_PHY_1325_DATA=0x00010820
LOCAL &__DDRSS1_PHY_1326_DATA
&__DDRSS1_PHY_1326_DATA=0x00010820
LOCAL &__DDRSS1_PHY_1327_DATA
&__DDRSS1_PHY_1327_DATA=0x00010820
LOCAL &__DDRSS1_PHY_1328_DATA
&__DDRSS1_PHY_1328_DATA=0x00010820
LOCAL &__DDRSS1_PHY_1329_DATA
&__DDRSS1_PHY_1329_DATA=0x00000000
LOCAL &__DDRSS1_PHY_1330_DATA
&__DDRSS1_PHY_1330_DATA=0x00000074
LOCAL &__DDRSS1_PHY_1331_DATA
&__DDRSS1_PHY_1331_DATA=0x00000400
LOCAL &__DDRSS1_PHY_1332_DATA
&__DDRSS1_PHY_1332_DATA=0x00000108
LOCAL &__DDRSS1_PHY_1333_DATA
&__DDRSS1_PHY_1333_DATA=0x00000000
LOCAL &__DDRSS1_PHY_1334_DATA
&__DDRSS1_PHY_1334_DATA=0x00000000
LOCAL &__DDRSS1_PHY_1335_DATA
&__DDRSS1_PHY_1335_DATA=0x00000000
LOCAL &__DDRSS1_PHY_1336_DATA
&__DDRSS1_PHY_1336_DATA=0x00000000
LOCAL &__DDRSS1_PHY_1337_DATA
&__DDRSS1_PHY_1337_DATA=0x00000000
LOCAL &__DDRSS1_PHY_1338_DATA
&__DDRSS1_PHY_1338_DATA=0x03000000
LOCAL &__DDRSS1_PHY_1339_DATA
&__DDRSS1_PHY_1339_DATA=0x00000000
LOCAL &__DDRSS1_PHY_1340_DATA
&__DDRSS1_PHY_1340_DATA=0x00000000
LOCAL &__DDRSS1_PHY_1341_DATA
&__DDRSS1_PHY_1341_DATA=0x00000000
LOCAL &__DDRSS1_PHY_1342_DATA
&__DDRSS1_PHY_1342_DATA=0x04102006
LOCAL &__DDRSS1_PHY_1343_DATA
&__DDRSS1_PHY_1343_DATA=0x00041020
LOCAL &__DDRSS1_PHY_1344_DATA
&__DDRSS1_PHY_1344_DATA=0x01C98C98
LOCAL &__DDRSS1_PHY_1345_DATA
&__DDRSS1_PHY_1345_DATA=0x3F400000
LOCAL &__DDRSS1_PHY_1346_DATA
&__DDRSS1_PHY_1346_DATA=0x3F3F1F3F
LOCAL &__DDRSS1_PHY_1347_DATA
&__DDRSS1_PHY_1347_DATA=0x0000001F
LOCAL &__DDRSS1_PHY_1348_DATA
&__DDRSS1_PHY_1348_DATA=0x00000000
LOCAL &__DDRSS1_PHY_1349_DATA
&__DDRSS1_PHY_1349_DATA=0x00000000
LOCAL &__DDRSS1_PHY_1350_DATA
&__DDRSS1_PHY_1350_DATA=0x00000000
LOCAL &__DDRSS1_PHY_1351_DATA
&__DDRSS1_PHY_1351_DATA=0x00010000
LOCAL &__DDRSS1_PHY_1352_DATA
&__DDRSS1_PHY_1352_DATA=0x00000000
LOCAL &__DDRSS1_PHY_1353_DATA
&__DDRSS1_PHY_1353_DATA=0x00000000
LOCAL &__DDRSS1_PHY_1354_DATA
&__DDRSS1_PHY_1354_DATA=0x00000000
LOCAL &__DDRSS1_PHY_1355_DATA
&__DDRSS1_PHY_1355_DATA=0x00000000
LOCAL &__DDRSS1_PHY_1356_DATA
&__DDRSS1_PHY_1356_DATA=0x76543210
LOCAL &__DDRSS1_PHY_1357_DATA
&__DDRSS1_PHY_1357_DATA=0x00010198
LOCAL &__DDRSS1_PHY_1358_DATA
&__DDRSS1_PHY_1358_DATA=0x00000000
LOCAL &__DDRSS1_PHY_1359_DATA
&__DDRSS1_PHY_1359_DATA=0x00000000
LOCAL &__DDRSS1_PHY_1360_DATA
&__DDRSS1_PHY_1360_DATA=0x00000000
LOCAL &__DDRSS1_PHY_1361_DATA
&__DDRSS1_PHY_1361_DATA=0x00040700
LOCAL &__DDRSS1_PHY_1362_DATA
&__DDRSS1_PHY_1362_DATA=0x00000000
LOCAL &__DDRSS1_PHY_1363_DATA
&__DDRSS1_PHY_1363_DATA=0x00000000
LOCAL &__DDRSS1_PHY_1364_DATA
&__DDRSS1_PHY_1364_DATA=0x00000000
LOCAL &__DDRSS1_PHY_1365_DATA
&__DDRSS1_PHY_1365_DATA=0x00000000
LOCAL &__DDRSS1_PHY_1366_DATA
&__DDRSS1_PHY_1366_DATA=0x00000000
LOCAL &__DDRSS1_PHY_1367_DATA
&__DDRSS1_PHY_1367_DATA=0x00000002
LOCAL &__DDRSS1_PHY_1368_DATA
&__DDRSS1_PHY_1368_DATA=0x00000000
LOCAL &__DDRSS1_PHY_1369_DATA
&__DDRSS1_PHY_1369_DATA=0x00000000
LOCAL &__DDRSS1_PHY_1370_DATA
&__DDRSS1_PHY_1370_DATA=0x00000000
LOCAL &__DDRSS1_PHY_1371_DATA
&__DDRSS1_PHY_1371_DATA=0x00000000
LOCAL &__DDRSS1_PHY_1372_DATA
&__DDRSS1_PHY_1372_DATA=0x00000000
LOCAL &__DDRSS1_PHY_1373_DATA
&__DDRSS1_PHY_1373_DATA=0x00000000
LOCAL &__DDRSS1_PHY_1374_DATA
&__DDRSS1_PHY_1374_DATA=0x00080000
LOCAL &__DDRSS1_PHY_1375_DATA
&__DDRSS1_PHY_1375_DATA=0x000007FF
LOCAL &__DDRSS1_PHY_1376_DATA
&__DDRSS1_PHY_1376_DATA=0x00000000
LOCAL &__DDRSS1_PHY_1377_DATA
&__DDRSS1_PHY_1377_DATA=0x00000000
LOCAL &__DDRSS1_PHY_1378_DATA
&__DDRSS1_PHY_1378_DATA=0x00000000
LOCAL &__DDRSS1_PHY_1379_DATA
&__DDRSS1_PHY_1379_DATA=0x00000000
LOCAL &__DDRSS1_PHY_1380_DATA
&__DDRSS1_PHY_1380_DATA=0x00000000
LOCAL &__DDRSS1_PHY_1381_DATA
&__DDRSS1_PHY_1381_DATA=0x00000000
LOCAL &__DDRSS1_PHY_1382_DATA
&__DDRSS1_PHY_1382_DATA=0x000FFFFF
LOCAL &__DDRSS1_PHY_1383_DATA
&__DDRSS1_PHY_1383_DATA=0x000FFFFF
LOCAL &__DDRSS1_PHY_1384_DATA
&__DDRSS1_PHY_1384_DATA=0x0000FFFF
LOCAL &__DDRSS1_PHY_1385_DATA
&__DDRSS1_PHY_1385_DATA=0xFFFFFFF0
LOCAL &__DDRSS1_PHY_1386_DATA
&__DDRSS1_PHY_1386_DATA=0x030FFFFF
LOCAL &__DDRSS1_PHY_1387_DATA
&__DDRSS1_PHY_1387_DATA=0x01FFFFFF
LOCAL &__DDRSS1_PHY_1388_DATA
&__DDRSS1_PHY_1388_DATA=0x0000FFFF
LOCAL &__DDRSS1_PHY_1389_DATA
&__DDRSS1_PHY_1389_DATA=0x00000000
LOCAL &__DDRSS1_PHY_1390_DATA
&__DDRSS1_PHY_1390_DATA=0x00000000
LOCAL &__DDRSS1_PHY_1391_DATA
&__DDRSS1_PHY_1391_DATA=0x00000000
LOCAL &__DDRSS1_PHY_1392_DATA
&__DDRSS1_PHY_1392_DATA=0x00000000
LOCAL &__DDRSS1_PHY_1393_DATA
&__DDRSS1_PHY_1393_DATA=0x0001F7C0
LOCAL &__DDRSS1_PHY_1394_DATA
&__DDRSS1_PHY_1394_DATA=0x00000002
LOCAL &__DDRSS1_PHY_1395_DATA
&__DDRSS1_PHY_1395_DATA=0x00000000
LOCAL &__DDRSS1_PHY_1396_DATA
&__DDRSS1_PHY_1396_DATA=0x00001142
LOCAL &__DDRSS1_PHY_1397_DATA
&__DDRSS1_PHY_1397_DATA=0x010207AB
LOCAL &__DDRSS1_PHY_1398_DATA
&__DDRSS1_PHY_1398_DATA=0x01000080
LOCAL &__DDRSS1_PHY_1399_DATA
&__DDRSS1_PHY_1399_DATA=0x03900390
LOCAL &__DDRSS1_PHY_1400_DATA
&__DDRSS1_PHY_1400_DATA=0x03900390
LOCAL &__DDRSS1_PHY_1401_DATA
&__DDRSS1_PHY_1401_DATA=0x00000390
LOCAL &__DDRSS1_PHY_1402_DATA
&__DDRSS1_PHY_1402_DATA=0x00000390
LOCAL &__DDRSS1_PHY_1403_DATA
&__DDRSS1_PHY_1403_DATA=0x00000390
LOCAL &__DDRSS1_PHY_1404_DATA
&__DDRSS1_PHY_1404_DATA=0x00000390
LOCAL &__DDRSS1_PHY_1405_DATA
&__DDRSS1_PHY_1405_DATA=0x00000005
LOCAL &__DDRSS1_PHY_1406_DATA
&__DDRSS1_PHY_1406_DATA=0x01813FCC
LOCAL &__DDRSS1_PHY_1407_DATA
&__DDRSS1_PHY_1407_DATA=0x000000CC
LOCAL &__DDRSS1_PHY_1408_DATA
&__DDRSS1_PHY_1408_DATA=0x0C000DFF
LOCAL &__DDRSS1_PHY_1409_DATA
&__DDRSS1_PHY_1409_DATA=0x30000DFF
LOCAL &__DDRSS1_PHY_1410_DATA
&__DDRSS1_PHY_1410_DATA=0x3F0DFF11
LOCAL &__DDRSS1_PHY_1411_DATA
&__DDRSS1_PHY_1411_DATA=0x000100F0
LOCAL &__DDRSS1_PHY_1412_DATA
&__DDRSS1_PHY_1412_DATA=0x780DFFCC
LOCAL &__DDRSS1_PHY_1413_DATA
&__DDRSS1_PHY_1413_DATA=0x00007E31
LOCAL &__DDRSS1_PHY_1414_DATA
&__DDRSS1_PHY_1414_DATA=0x000CBF11
LOCAL &__DDRSS1_PHY_1415_DATA
&__DDRSS1_PHY_1415_DATA=0x01990010
LOCAL &__DDRSS1_PHY_1416_DATA
&__DDRSS1_PHY_1416_DATA=0x000CBF11
LOCAL &__DDRSS1_PHY_1417_DATA
&__DDRSS1_PHY_1417_DATA=0x01990010
LOCAL &__DDRSS1_PHY_1418_DATA
&__DDRSS1_PHY_1418_DATA=0x3F0DFF11
LOCAL &__DDRSS1_PHY_1419_DATA
&__DDRSS1_PHY_1419_DATA=0x00EF00F0
LOCAL &__DDRSS1_PHY_1420_DATA
&__DDRSS1_PHY_1420_DATA=0x3F0DFF11
LOCAL &__DDRSS1_PHY_1421_DATA
&__DDRSS1_PHY_1421_DATA=0x01FF00F0
LOCAL &__DDRSS1_PHY_1422_DATA
&__DDRSS1_PHY_1422_DATA=0x20040006
// --  Copyright (c) 2019, Texas Instruments Incorporated
// --  *
// --  * Redistribution and use in source and binary forms, with or without
// --  * modification, are permitted provided that the following conditions
// --  * are met:
// --  *
// --  * *  Redistributions of source code must retain the above copyright
// --  *    notice, this list of conditions and the following disclaimer.
// --  *
// --  * *  Redistributions in binary form must reproduce the above copyright
// --  *    notice, this list of conditions and the following disclaimer in the
// --  *    documentation and/or other materials provided with the distribution.
// --  *
// --  * *  Neither the name of Texas Instruments Incorporated nor the names of
// --  *    its contributors may be used to endorse or promote products derived
// --  *    from this software without specific prior written permission.
// --  *
// --  * THIS SOFTWARE IS PROVIDED BY THE COPYRIGHT HOLDERS AND CONTRIBUTORS "AS IS"
// --  * AND ANY EXPRESS OR IMPLIED WARRANTIES, INCLUDING, BUT NOT LIMITED TO,
// --  * THE IMPLIED WARRANTIES OF MERCHANTABILITY AND FITNESS FOR A PARTICULAR
// --  * PURPOSE ARE DISCLAIMED. IN NO EVENT SHALL THE COPYRIGHT OWNER OR
// --  * CONTRIBUTORS BE LIABLE FOR ANY DIRECT, INDIRECT, INCIDENTAL, SPECIAL,
// --  * EXEMPLARY, OR CONSEQUENTIAL DAMAGES (INCLUDING, BUT NOT LIMITED TO,
// --  * PROCUREMENT OF SUBSTITUTE GOODS OR SERVICES; LOSS OF USE, DATA, OR PROFITS;
// --  * OR BUSINESS INTERRUPTION) HOWEVER CAUSED AND ON ANY THEORY OF LIABILITY,
// --  * WHETHER IN CONTRACT, STRICT LIABILITY, OR TORT (INCLUDING NEGLIGENCE OR
// --  * OTHERWISE) ARISING IN ANY WAY OUT OF THE USE OF THIS SOFTWARE,
// --  * EVEN IF ADVISED OF THE POSSIBILITY OF SUCH DAMAGE. 
// -- CONVERTER INFO: static expanded
// -- CONVERTER INFO: void expanded
// -- CONVERTER INFO: uint32_t expanded
// -- CONVERTER INFO: HW_WR_REG32 expanded
// -- CONVERTER INFO: HW_RD_REG32 expanded
LOCAL &__CTRLMMR_LOCK5_KICK0
&__CTRLMMR_LOCK5_KICK0=0x00115008
LOCAL &__CTRLMMR_LOCK5_KICK1
&__CTRLMMR_LOCK5_KICK1=0x0011500C
LOCAL &__CTRLMMR_LOCK5_KICK0_KEY
&__CTRLMMR_LOCK5_KICK0_KEY=0x68EF3490
LOCAL &__CTRLMMR_LOCK5_KICK1_KEY
&__CTRLMMR_LOCK5_KICK1_KEY=0xD172BC5A
// --  *  Use these addresses if running from M4
LOCAL &__M4_RAT_OFFSET
&__M4_RAT_OFFSET=0x80000000
// -- depends on M4 RAT config 
LOCAL &__J7_DDR0_SS_BASE
&__J7_DDR0_SS_BASE=0x82990000
// -- when running from M4
LOCAL &__J7_DDR1_SS_BASE
&__J7_DDR1_SS_BASE=0x829B0000
// -- when running from M4
LOCAL &__CTRLMMR_DDR4_FSP_CLKCHNG_REQ_ADDR0
&__CTRLMMR_DDR4_FSP_CLKCHNG_REQ_ADDR0=0x114080
LOCAL &__CTRLMMR_DDR4_FSP_CLKCHNG_ACK_ADDR0
&__CTRLMMR_DDR4_FSP_CLKCHNG_ACK_ADDR0=0x1140C0
LOCAL &__CTRLMMR_DDR4_FSP_CLKCHNG_REQ_ADDR1
&__CTRLMMR_DDR4_FSP_CLKCHNG_REQ_ADDR1=0x114090
LOCAL &__CTRLMMR_DDR4_FSP_CLKCHNG_ACK_ADDR1
&__CTRLMMR_DDR4_FSP_CLKCHNG_ACK_ADDR1=0x1140D0
LOCAL &__MULTI_DDR_CFG0
&__MULTI_DDR_CFG0=0x114100
LOCAL &__MULTI_DDR_CFG1
&__MULTI_DDR_CFG1=0x114104
LOCAL &__DDR_CFG_LOAD
&__DDR_CFG_LOAD=0x114110
LOCAL &__PRE_SILICON
&__PRE_SILICON=(0.)

GLOBAL &path_J721S2_addr_map_offs_LP4_2132_DDR_config_cmm
&path_J721S2_addr_map_offs_LP4_2132_DDR_config_cmm=OS.PPF()
IF "&function"!=""
(
	GOSUB &function &args
)
ELSE
(
	GOSUB __GeL_MeNu_CrEaTe
)
ENDDO
// --  This is dummy function - GEL does not work real-time.
// --  * If GELs are imported to C code, this function must be implemented a loop of
// --  * "delay" microseconds

us_delay:
(
	PRIVATE &__VF0
	ENTRY &__VF0
	
	&__VF0=&__VF0 // evaluation of passed expression 
	
	Var.NEWLOCAL unsigned int \delay=&__VF0
	Var.NEWLOCAL unsigned int \loop
	Var.Assign \loop=0x0
	WHILE (Var.VALUE(\loop)<(Var.VALUE(\delay)*0x64))
	(
		Var.Assign \loop=\loop
		Var.Assign \loop=\loop+1
	)
	RETURN
)
// --  Wrapper function to simplify importing GEL file to a C code 

printf:
(
	PRIVATE &__VF0
	ENTRY &__VF0
	
	&__VF0=&__VF0 // evaluation of passed expression 
	
	Var.NEWLOCAL char[128] \temp="&__VF0"
	var.print %string \temp
	RETURN
)

DDRSS0_Register_Init:
(
	// -- Program the DDR Controller
	Var.NEWLOCAL char[128] \strtmp = "--->>> DDR0 controller programming in progress.. <<<---\n"
	GOSUB printf Var.String(\strtmp)
	
	Data.Set D:(((Var.VALUE(&__J7_DDR0_SS_BASE)+Var.VALUE(&__DDRSS_CTL_0__SFR_OFFS)))) %Long Var.VALUE(&__DDRSS0_CTL_00_DATA)
	Data.Set D:(((Var.VALUE(&__J7_DDR0_SS_BASE)+Var.VALUE(&__DDRSS_CTL_1__SFR_OFFS)))) %Long Var.VALUE(&__DDRSS0_CTL_01_DATA)
	Data.Set D:(((Var.VALUE(&__J7_DDR0_SS_BASE)+Var.VALUE(&__DDRSS_CTL_2__SFR_OFFS)))) %Long Var.VALUE(&__DDRSS0_CTL_02_DATA)
	Data.Set D:(((Var.VALUE(&__J7_DDR0_SS_BASE)+Var.VALUE(&__DDRSS_CTL_3__SFR_OFFS)))) %Long Var.VALUE(&__DDRSS0_CTL_03_DATA)
	Data.Set D:(((Var.VALUE(&__J7_DDR0_SS_BASE)+Var.VALUE(&__DDRSS_CTL_4__SFR_OFFS)))) %Long Var.VALUE(&__DDRSS0_CTL_04_DATA)
	Data.Set D:(((Var.VALUE(&__J7_DDR0_SS_BASE)+Var.VALUE(&__DDRSS_CTL_5__SFR_OFFS)))) %Long Var.VALUE(&__DDRSS0_CTL_05_DATA)
	Data.Set D:(((Var.VALUE(&__J7_DDR0_SS_BASE)+Var.VALUE(&__DDRSS_CTL_6__SFR_OFFS)))) %Long Var.VALUE(&__DDRSS0_CTL_06_DATA)
	Data.Set D:(((Var.VALUE(&__J7_DDR0_SS_BASE)+Var.VALUE(&__DDRSS_CTL_7__SFR_OFFS)))) %Long Var.VALUE(&__DDRSS0_CTL_07_DATA)
	Data.Set D:(((Var.VALUE(&__J7_DDR0_SS_BASE)+Var.VALUE(&__DDRSS_CTL_8__SFR_OFFS)))) %Long Var.VALUE(&__DDRSS0_CTL_08_DATA)
	Data.Set D:(((Var.VALUE(&__J7_DDR0_SS_BASE)+Var.VALUE(&__DDRSS_CTL_9__SFR_OFFS)))) %Long Var.VALUE(&__DDRSS0_CTL_09_DATA)
	Data.Set D:(((Var.VALUE(&__J7_DDR0_SS_BASE)+Var.VALUE(&__DDRSS_CTL_10__SFR_OFFS)))) %Long Var.VALUE(&__DDRSS0_CTL_10_DATA)
	Data.Set D:(((Var.VALUE(&__J7_DDR0_SS_BASE)+Var.VALUE(&__DDRSS_CTL_11__SFR_OFFS)))) %Long Var.VALUE(&__DDRSS0_CTL_11_DATA)
	Data.Set D:(((Var.VALUE(&__J7_DDR0_SS_BASE)+Var.VALUE(&__DDRSS_CTL_12__SFR_OFFS)))) %Long Var.VALUE(&__DDRSS0_CTL_12_DATA)
	Data.Set D:(((Var.VALUE(&__J7_DDR0_SS_BASE)+Var.VALUE(&__DDRSS_CTL_13__SFR_OFFS)))) %Long Var.VALUE(&__DDRSS0_CTL_13_DATA)
	Data.Set D:(((Var.VALUE(&__J7_DDR0_SS_BASE)+Var.VALUE(&__DDRSS_CTL_14__SFR_OFFS)))) %Long Var.VALUE(&__DDRSS0_CTL_14_DATA)
	Data.Set D:(((Var.VALUE(&__J7_DDR0_SS_BASE)+Var.VALUE(&__DDRSS_CTL_15__SFR_OFFS)))) %Long Var.VALUE(&__DDRSS0_CTL_15_DATA)
	Data.Set D:(((Var.VALUE(&__J7_DDR0_SS_BASE)+Var.VALUE(&__DDRSS_CTL_16__SFR_OFFS)))) %Long Var.VALUE(&__DDRSS0_CTL_16_DATA)
	Data.Set D:(((Var.VALUE(&__J7_DDR0_SS_BASE)+Var.VALUE(&__DDRSS_CTL_17__SFR_OFFS)))) %Long Var.VALUE(&__DDRSS0_CTL_17_DATA)
	Data.Set D:(((Var.VALUE(&__J7_DDR0_SS_BASE)+Var.VALUE(&__DDRSS_CTL_18__SFR_OFFS)))) %Long Var.VALUE(&__DDRSS0_CTL_18_DATA)
	Data.Set D:(((Var.VALUE(&__J7_DDR0_SS_BASE)+Var.VALUE(&__DDRSS_CTL_19__SFR_OFFS)))) %Long Var.VALUE(&__DDRSS0_CTL_19_DATA)
	Data.Set D:(((Var.VALUE(&__J7_DDR0_SS_BASE)+Var.VALUE(&__DDRSS_CTL_20__SFR_OFFS)))) %Long Var.VALUE(&__DDRSS0_CTL_20_DATA)
	Data.Set D:(((Var.VALUE(&__J7_DDR0_SS_BASE)+Var.VALUE(&__DDRSS_CTL_21__SFR_OFFS)))) %Long Var.VALUE(&__DDRSS0_CTL_21_DATA)
	Data.Set D:(((Var.VALUE(&__J7_DDR0_SS_BASE)+Var.VALUE(&__DDRSS_CTL_22__SFR_OFFS)))) %Long Var.VALUE(&__DDRSS0_CTL_22_DATA)
	Data.Set D:(((Var.VALUE(&__J7_DDR0_SS_BASE)+Var.VALUE(&__DDRSS_CTL_23__SFR_OFFS)))) %Long Var.VALUE(&__DDRSS0_CTL_23_DATA)
	Data.Set D:(((Var.VALUE(&__J7_DDR0_SS_BASE)+Var.VALUE(&__DDRSS_CTL_24__SFR_OFFS)))) %Long Var.VALUE(&__DDRSS0_CTL_24_DATA)
	Data.Set D:(((Var.VALUE(&__J7_DDR0_SS_BASE)+Var.VALUE(&__DDRSS_CTL_25__SFR_OFFS)))) %Long Var.VALUE(&__DDRSS0_CTL_25_DATA)
	Data.Set D:(((Var.VALUE(&__J7_DDR0_SS_BASE)+Var.VALUE(&__DDRSS_CTL_26__SFR_OFFS)))) %Long Var.VALUE(&__DDRSS0_CTL_26_DATA)
	Data.Set D:(((Var.VALUE(&__J7_DDR0_SS_BASE)+Var.VALUE(&__DDRSS_CTL_27__SFR_OFFS)))) %Long Var.VALUE(&__DDRSS0_CTL_27_DATA)
	Data.Set D:(((Var.VALUE(&__J7_DDR0_SS_BASE)+Var.VALUE(&__DDRSS_CTL_28__SFR_OFFS)))) %Long Var.VALUE(&__DDRSS0_CTL_28_DATA)
	Data.Set D:(((Var.VALUE(&__J7_DDR0_SS_BASE)+Var.VALUE(&__DDRSS_CTL_29__SFR_OFFS)))) %Long Var.VALUE(&__DDRSS0_CTL_29_DATA)
	Data.Set D:(((Var.VALUE(&__J7_DDR0_SS_BASE)+Var.VALUE(&__DDRSS_CTL_30__SFR_OFFS)))) %Long Var.VALUE(&__DDRSS0_CTL_30_DATA)
	Data.Set D:(((Var.VALUE(&__J7_DDR0_SS_BASE)+Var.VALUE(&__DDRSS_CTL_31__SFR_OFFS)))) %Long Var.VALUE(&__DDRSS0_CTL_31_DATA)
	Data.Set D:(((Var.VALUE(&__J7_DDR0_SS_BASE)+Var.VALUE(&__DDRSS_CTL_32__SFR_OFFS)))) %Long Var.VALUE(&__DDRSS0_CTL_32_DATA)
	Data.Set D:(((Var.VALUE(&__J7_DDR0_SS_BASE)+Var.VALUE(&__DDRSS_CTL_33__SFR_OFFS)))) %Long Var.VALUE(&__DDRSS0_CTL_33_DATA)
	Data.Set D:(((Var.VALUE(&__J7_DDR0_SS_BASE)+Var.VALUE(&__DDRSS_CTL_34__SFR_OFFS)))) %Long Var.VALUE(&__DDRSS0_CTL_34_DATA)
	Data.Set D:(((Var.VALUE(&__J7_DDR0_SS_BASE)+Var.VALUE(&__DDRSS_CTL_35__SFR_OFFS)))) %Long Var.VALUE(&__DDRSS0_CTL_35_DATA)
	Data.Set D:(((Var.VALUE(&__J7_DDR0_SS_BASE)+Var.VALUE(&__DDRSS_CTL_36__SFR_OFFS)))) %Long Var.VALUE(&__DDRSS0_CTL_36_DATA)
	Data.Set D:(((Var.VALUE(&__J7_DDR0_SS_BASE)+Var.VALUE(&__DDRSS_CTL_37__SFR_OFFS)))) %Long Var.VALUE(&__DDRSS0_CTL_37_DATA)
	Data.Set D:(((Var.VALUE(&__J7_DDR0_SS_BASE)+Var.VALUE(&__DDRSS_CTL_38__SFR_OFFS)))) %Long Var.VALUE(&__DDRSS0_CTL_38_DATA)
	Data.Set D:(((Var.VALUE(&__J7_DDR0_SS_BASE)+Var.VALUE(&__DDRSS_CTL_39__SFR_OFFS)))) %Long Var.VALUE(&__DDRSS0_CTL_39_DATA)
	Data.Set D:(((Var.VALUE(&__J7_DDR0_SS_BASE)+Var.VALUE(&__DDRSS_CTL_40__SFR_OFFS)))) %Long Var.VALUE(&__DDRSS0_CTL_40_DATA)
	Data.Set D:(((Var.VALUE(&__J7_DDR0_SS_BASE)+Var.VALUE(&__DDRSS_CTL_41__SFR_OFFS)))) %Long Var.VALUE(&__DDRSS0_CTL_41_DATA)
	Data.Set D:(((Var.VALUE(&__J7_DDR0_SS_BASE)+Var.VALUE(&__DDRSS_CTL_42__SFR_OFFS)))) %Long Var.VALUE(&__DDRSS0_CTL_42_DATA)
	Data.Set D:(((Var.VALUE(&__J7_DDR0_SS_BASE)+Var.VALUE(&__DDRSS_CTL_43__SFR_OFFS)))) %Long Var.VALUE(&__DDRSS0_CTL_43_DATA)
	Data.Set D:(((Var.VALUE(&__J7_DDR0_SS_BASE)+Var.VALUE(&__DDRSS_CTL_44__SFR_OFFS)))) %Long Var.VALUE(&__DDRSS0_CTL_44_DATA)
	Data.Set D:(((Var.VALUE(&__J7_DDR0_SS_BASE)+Var.VALUE(&__DDRSS_CTL_45__SFR_OFFS)))) %Long Var.VALUE(&__DDRSS0_CTL_45_DATA)
	Data.Set D:(((Var.VALUE(&__J7_DDR0_SS_BASE)+Var.VALUE(&__DDRSS_CTL_46__SFR_OFFS)))) %Long Var.VALUE(&__DDRSS0_CTL_46_DATA)
	Data.Set D:(((Var.VALUE(&__J7_DDR0_SS_BASE)+Var.VALUE(&__DDRSS_CTL_47__SFR_OFFS)))) %Long Var.VALUE(&__DDRSS0_CTL_47_DATA)
	Data.Set D:(((Var.VALUE(&__J7_DDR0_SS_BASE)+Var.VALUE(&__DDRSS_CTL_48__SFR_OFFS)))) %Long Var.VALUE(&__DDRSS0_CTL_48_DATA)
	Data.Set D:(((Var.VALUE(&__J7_DDR0_SS_BASE)+Var.VALUE(&__DDRSS_CTL_49__SFR_OFFS)))) %Long Var.VALUE(&__DDRSS0_CTL_49_DATA)
	Data.Set D:(((Var.VALUE(&__J7_DDR0_SS_BASE)+Var.VALUE(&__DDRSS_CTL_50__SFR_OFFS)))) %Long Var.VALUE(&__DDRSS0_CTL_50_DATA)
	Data.Set D:(((Var.VALUE(&__J7_DDR0_SS_BASE)+Var.VALUE(&__DDRSS_CTL_51__SFR_OFFS)))) %Long Var.VALUE(&__DDRSS0_CTL_51_DATA)
	Data.Set D:(((Var.VALUE(&__J7_DDR0_SS_BASE)+Var.VALUE(&__DDRSS_CTL_52__SFR_OFFS)))) %Long Var.VALUE(&__DDRSS0_CTL_52_DATA)
	Data.Set D:(((Var.VALUE(&__J7_DDR0_SS_BASE)+Var.VALUE(&__DDRSS_CTL_53__SFR_OFFS)))) %Long Var.VALUE(&__DDRSS0_CTL_53_DATA)
	Data.Set D:(((Var.VALUE(&__J7_DDR0_SS_BASE)+Var.VALUE(&__DDRSS_CTL_54__SFR_OFFS)))) %Long Var.VALUE(&__DDRSS0_CTL_54_DATA)
	Data.Set D:(((Var.VALUE(&__J7_DDR0_SS_BASE)+Var.VALUE(&__DDRSS_CTL_55__SFR_OFFS)))) %Long Var.VALUE(&__DDRSS0_CTL_55_DATA)
	Data.Set D:(((Var.VALUE(&__J7_DDR0_SS_BASE)+Var.VALUE(&__DDRSS_CTL_56__SFR_OFFS)))) %Long Var.VALUE(&__DDRSS0_CTL_56_DATA)
	Data.Set D:(((Var.VALUE(&__J7_DDR0_SS_BASE)+Var.VALUE(&__DDRSS_CTL_57__SFR_OFFS)))) %Long Var.VALUE(&__DDRSS0_CTL_57_DATA)
	Data.Set D:(((Var.VALUE(&__J7_DDR0_SS_BASE)+Var.VALUE(&__DDRSS_CTL_58__SFR_OFFS)))) %Long Var.VALUE(&__DDRSS0_CTL_58_DATA)
	Data.Set D:(((Var.VALUE(&__J7_DDR0_SS_BASE)+Var.VALUE(&__DDRSS_CTL_59__SFR_OFFS)))) %Long Var.VALUE(&__DDRSS0_CTL_59_DATA)
	Data.Set D:(((Var.VALUE(&__J7_DDR0_SS_BASE)+Var.VALUE(&__DDRSS_CTL_60__SFR_OFFS)))) %Long Var.VALUE(&__DDRSS0_CTL_60_DATA)
	Data.Set D:(((Var.VALUE(&__J7_DDR0_SS_BASE)+Var.VALUE(&__DDRSS_CTL_61__SFR_OFFS)))) %Long Var.VALUE(&__DDRSS0_CTL_61_DATA)
	Data.Set D:(((Var.VALUE(&__J7_DDR0_SS_BASE)+Var.VALUE(&__DDRSS_CTL_62__SFR_OFFS)))) %Long Var.VALUE(&__DDRSS0_CTL_62_DATA)
	Data.Set D:(((Var.VALUE(&__J7_DDR0_SS_BASE)+Var.VALUE(&__DDRSS_CTL_63__SFR_OFFS)))) %Long Var.VALUE(&__DDRSS0_CTL_63_DATA)
	Data.Set D:(((Var.VALUE(&__J7_DDR0_SS_BASE)+Var.VALUE(&__DDRSS_CTL_64__SFR_OFFS)))) %Long Var.VALUE(&__DDRSS0_CTL_64_DATA)
	Data.Set D:(((Var.VALUE(&__J7_DDR0_SS_BASE)+Var.VALUE(&__DDRSS_CTL_65__SFR_OFFS)))) %Long Var.VALUE(&__DDRSS0_CTL_65_DATA)
	Data.Set D:(((Var.VALUE(&__J7_DDR0_SS_BASE)+Var.VALUE(&__DDRSS_CTL_66__SFR_OFFS)))) %Long Var.VALUE(&__DDRSS0_CTL_66_DATA)
	Data.Set D:(((Var.VALUE(&__J7_DDR0_SS_BASE)+Var.VALUE(&__DDRSS_CTL_67__SFR_OFFS)))) %Long Var.VALUE(&__DDRSS0_CTL_67_DATA)
	Data.Set D:(((Var.VALUE(&__J7_DDR0_SS_BASE)+Var.VALUE(&__DDRSS_CTL_68__SFR_OFFS)))) %Long Var.VALUE(&__DDRSS0_CTL_68_DATA)
	Data.Set D:(((Var.VALUE(&__J7_DDR0_SS_BASE)+Var.VALUE(&__DDRSS_CTL_69__SFR_OFFS)))) %Long Var.VALUE(&__DDRSS0_CTL_69_DATA)
	Data.Set D:(((Var.VALUE(&__J7_DDR0_SS_BASE)+Var.VALUE(&__DDRSS_CTL_70__SFR_OFFS)))) %Long Var.VALUE(&__DDRSS0_CTL_70_DATA)
	Data.Set D:(((Var.VALUE(&__J7_DDR0_SS_BASE)+Var.VALUE(&__DDRSS_CTL_71__SFR_OFFS)))) %Long Var.VALUE(&__DDRSS0_CTL_71_DATA)
	Data.Set D:(((Var.VALUE(&__J7_DDR0_SS_BASE)+Var.VALUE(&__DDRSS_CTL_72__SFR_OFFS)))) %Long Var.VALUE(&__DDRSS0_CTL_72_DATA)
	Data.Set D:(((Var.VALUE(&__J7_DDR0_SS_BASE)+Var.VALUE(&__DDRSS_CTL_73__SFR_OFFS)))) %Long Var.VALUE(&__DDRSS0_CTL_73_DATA)
	Data.Set D:(((Var.VALUE(&__J7_DDR0_SS_BASE)+Var.VALUE(&__DDRSS_CTL_74__SFR_OFFS)))) %Long Var.VALUE(&__DDRSS0_CTL_74_DATA)
	Data.Set D:(((Var.VALUE(&__J7_DDR0_SS_BASE)+Var.VALUE(&__DDRSS_CTL_75__SFR_OFFS)))) %Long Var.VALUE(&__DDRSS0_CTL_75_DATA)
	Data.Set D:(((Var.VALUE(&__J7_DDR0_SS_BASE)+Var.VALUE(&__DDRSS_CTL_76__SFR_OFFS)))) %Long Var.VALUE(&__DDRSS0_CTL_76_DATA)
	Data.Set D:(((Var.VALUE(&__J7_DDR0_SS_BASE)+Var.VALUE(&__DDRSS_CTL_77__SFR_OFFS)))) %Long Var.VALUE(&__DDRSS0_CTL_77_DATA)
	Data.Set D:(((Var.VALUE(&__J7_DDR0_SS_BASE)+Var.VALUE(&__DDRSS_CTL_78__SFR_OFFS)))) %Long Var.VALUE(&__DDRSS0_CTL_78_DATA)
	Data.Set D:(((Var.VALUE(&__J7_DDR0_SS_BASE)+Var.VALUE(&__DDRSS_CTL_79__SFR_OFFS)))) %Long Var.VALUE(&__DDRSS0_CTL_79_DATA)
	Data.Set D:(((Var.VALUE(&__J7_DDR0_SS_BASE)+Var.VALUE(&__DDRSS_CTL_80__SFR_OFFS)))) %Long Var.VALUE(&__DDRSS0_CTL_80_DATA)
	Data.Set D:(((Var.VALUE(&__J7_DDR0_SS_BASE)+Var.VALUE(&__DDRSS_CTL_81__SFR_OFFS)))) %Long Var.VALUE(&__DDRSS0_CTL_81_DATA)
	Data.Set D:(((Var.VALUE(&__J7_DDR0_SS_BASE)+Var.VALUE(&__DDRSS_CTL_82__SFR_OFFS)))) %Long Var.VALUE(&__DDRSS0_CTL_82_DATA)
	Data.Set D:(((Var.VALUE(&__J7_DDR0_SS_BASE)+Var.VALUE(&__DDRSS_CTL_83__SFR_OFFS)))) %Long Var.VALUE(&__DDRSS0_CTL_83_DATA)
	Data.Set D:(((Var.VALUE(&__J7_DDR0_SS_BASE)+Var.VALUE(&__DDRSS_CTL_84__SFR_OFFS)))) %Long Var.VALUE(&__DDRSS0_CTL_84_DATA)
	Data.Set D:(((Var.VALUE(&__J7_DDR0_SS_BASE)+Var.VALUE(&__DDRSS_CTL_85__SFR_OFFS)))) %Long Var.VALUE(&__DDRSS0_CTL_85_DATA)
	Data.Set D:(((Var.VALUE(&__J7_DDR0_SS_BASE)+Var.VALUE(&__DDRSS_CTL_86__SFR_OFFS)))) %Long Var.VALUE(&__DDRSS0_CTL_86_DATA)
	Data.Set D:(((Var.VALUE(&__J7_DDR0_SS_BASE)+Var.VALUE(&__DDRSS_CTL_87__SFR_OFFS)))) %Long Var.VALUE(&__DDRSS0_CTL_87_DATA)
	Data.Set D:(((Var.VALUE(&__J7_DDR0_SS_BASE)+Var.VALUE(&__DDRSS_CTL_88__SFR_OFFS)))) %Long Var.VALUE(&__DDRSS0_CTL_88_DATA)
	Data.Set D:(((Var.VALUE(&__J7_DDR0_SS_BASE)+Var.VALUE(&__DDRSS_CTL_89__SFR_OFFS)))) %Long Var.VALUE(&__DDRSS0_CTL_89_DATA)
	Data.Set D:(((Var.VALUE(&__J7_DDR0_SS_BASE)+Var.VALUE(&__DDRSS_CTL_90__SFR_OFFS)))) %Long Var.VALUE(&__DDRSS0_CTL_90_DATA)
	Data.Set D:(((Var.VALUE(&__J7_DDR0_SS_BASE)+Var.VALUE(&__DDRSS_CTL_91__SFR_OFFS)))) %Long Var.VALUE(&__DDRSS0_CTL_91_DATA)
	Data.Set D:(((Var.VALUE(&__J7_DDR0_SS_BASE)+Var.VALUE(&__DDRSS_CTL_92__SFR_OFFS)))) %Long Var.VALUE(&__DDRSS0_CTL_92_DATA)
	Data.Set D:(((Var.VALUE(&__J7_DDR0_SS_BASE)+Var.VALUE(&__DDRSS_CTL_93__SFR_OFFS)))) %Long Var.VALUE(&__DDRSS0_CTL_93_DATA)
	Data.Set D:(((Var.VALUE(&__J7_DDR0_SS_BASE)+Var.VALUE(&__DDRSS_CTL_94__SFR_OFFS)))) %Long Var.VALUE(&__DDRSS0_CTL_94_DATA)
	Data.Set D:(((Var.VALUE(&__J7_DDR0_SS_BASE)+Var.VALUE(&__DDRSS_CTL_95__SFR_OFFS)))) %Long Var.VALUE(&__DDRSS0_CTL_95_DATA)
	Data.Set D:(((Var.VALUE(&__J7_DDR0_SS_BASE)+Var.VALUE(&__DDRSS_CTL_96__SFR_OFFS)))) %Long Var.VALUE(&__DDRSS0_CTL_96_DATA)
	Data.Set D:(((Var.VALUE(&__J7_DDR0_SS_BASE)+Var.VALUE(&__DDRSS_CTL_97__SFR_OFFS)))) %Long Var.VALUE(&__DDRSS0_CTL_97_DATA)
	Data.Set D:(((Var.VALUE(&__J7_DDR0_SS_BASE)+Var.VALUE(&__DDRSS_CTL_98__SFR_OFFS)))) %Long Var.VALUE(&__DDRSS0_CTL_98_DATA)
	Data.Set D:(((Var.VALUE(&__J7_DDR0_SS_BASE)+Var.VALUE(&__DDRSS_CTL_99__SFR_OFFS)))) %Long Var.VALUE(&__DDRSS0_CTL_99_DATA)
	Data.Set D:(((Var.VALUE(&__J7_DDR0_SS_BASE)+Var.VALUE(&__DDRSS_CTL_100__SFR_OFFS)))) %Long Var.VALUE(&__DDRSS0_CTL_100_DATA)
	Data.Set D:(((Var.VALUE(&__J7_DDR0_SS_BASE)+Var.VALUE(&__DDRSS_CTL_101__SFR_OFFS)))) %Long Var.VALUE(&__DDRSS0_CTL_101_DATA)
	Data.Set D:(((Var.VALUE(&__J7_DDR0_SS_BASE)+Var.VALUE(&__DDRSS_CTL_102__SFR_OFFS)))) %Long Var.VALUE(&__DDRSS0_CTL_102_DATA)
	Data.Set D:(((Var.VALUE(&__J7_DDR0_SS_BASE)+Var.VALUE(&__DDRSS_CTL_103__SFR_OFFS)))) %Long Var.VALUE(&__DDRSS0_CTL_103_DATA)
	Data.Set D:(((Var.VALUE(&__J7_DDR0_SS_BASE)+Var.VALUE(&__DDRSS_CTL_104__SFR_OFFS)))) %Long Var.VALUE(&__DDRSS0_CTL_104_DATA)
	Data.Set D:(((Var.VALUE(&__J7_DDR0_SS_BASE)+Var.VALUE(&__DDRSS_CTL_105__SFR_OFFS)))) %Long Var.VALUE(&__DDRSS0_CTL_105_DATA)
	Data.Set D:(((Var.VALUE(&__J7_DDR0_SS_BASE)+Var.VALUE(&__DDRSS_CTL_106__SFR_OFFS)))) %Long Var.VALUE(&__DDRSS0_CTL_106_DATA)
	Data.Set D:(((Var.VALUE(&__J7_DDR0_SS_BASE)+Var.VALUE(&__DDRSS_CTL_107__SFR_OFFS)))) %Long Var.VALUE(&__DDRSS0_CTL_107_DATA)
	Data.Set D:(((Var.VALUE(&__J7_DDR0_SS_BASE)+Var.VALUE(&__DDRSS_CTL_108__SFR_OFFS)))) %Long Var.VALUE(&__DDRSS0_CTL_108_DATA)
	Data.Set D:(((Var.VALUE(&__J7_DDR0_SS_BASE)+Var.VALUE(&__DDRSS_CTL_109__SFR_OFFS)))) %Long Var.VALUE(&__DDRSS0_CTL_109_DATA)
	Data.Set D:(((Var.VALUE(&__J7_DDR0_SS_BASE)+Var.VALUE(&__DDRSS_CTL_110__SFR_OFFS)))) %Long Var.VALUE(&__DDRSS0_CTL_110_DATA)
	Data.Set D:(((Var.VALUE(&__J7_DDR0_SS_BASE)+Var.VALUE(&__DDRSS_CTL_111__SFR_OFFS)))) %Long Var.VALUE(&__DDRSS0_CTL_111_DATA)
	Data.Set D:(((Var.VALUE(&__J7_DDR0_SS_BASE)+Var.VALUE(&__DDRSS_CTL_112__SFR_OFFS)))) %Long Var.VALUE(&__DDRSS0_CTL_112_DATA)
	Data.Set D:(((Var.VALUE(&__J7_DDR0_SS_BASE)+Var.VALUE(&__DDRSS_CTL_113__SFR_OFFS)))) %Long Var.VALUE(&__DDRSS0_CTL_113_DATA)
	Data.Set D:(((Var.VALUE(&__J7_DDR0_SS_BASE)+Var.VALUE(&__DDRSS_CTL_114__SFR_OFFS)))) %Long Var.VALUE(&__DDRSS0_CTL_114_DATA)
	Data.Set D:(((Var.VALUE(&__J7_DDR0_SS_BASE)+Var.VALUE(&__DDRSS_CTL_115__SFR_OFFS)))) %Long Var.VALUE(&__DDRSS0_CTL_115_DATA)
	Data.Set D:(((Var.VALUE(&__J7_DDR0_SS_BASE)+Var.VALUE(&__DDRSS_CTL_116__SFR_OFFS)))) %Long Var.VALUE(&__DDRSS0_CTL_116_DATA)
	Data.Set D:(((Var.VALUE(&__J7_DDR0_SS_BASE)+Var.VALUE(&__DDRSS_CTL_117__SFR_OFFS)))) %Long Var.VALUE(&__DDRSS0_CTL_117_DATA)
	Data.Set D:(((Var.VALUE(&__J7_DDR0_SS_BASE)+Var.VALUE(&__DDRSS_CTL_118__SFR_OFFS)))) %Long Var.VALUE(&__DDRSS0_CTL_118_DATA)
	Data.Set D:(((Var.VALUE(&__J7_DDR0_SS_BASE)+Var.VALUE(&__DDRSS_CTL_119__SFR_OFFS)))) %Long Var.VALUE(&__DDRSS0_CTL_119_DATA)
	Data.Set D:(((Var.VALUE(&__J7_DDR0_SS_BASE)+Var.VALUE(&__DDRSS_CTL_120__SFR_OFFS)))) %Long Var.VALUE(&__DDRSS0_CTL_120_DATA)
	Data.Set D:(((Var.VALUE(&__J7_DDR0_SS_BASE)+Var.VALUE(&__DDRSS_CTL_121__SFR_OFFS)))) %Long Var.VALUE(&__DDRSS0_CTL_121_DATA)
	Data.Set D:(((Var.VALUE(&__J7_DDR0_SS_BASE)+Var.VALUE(&__DDRSS_CTL_122__SFR_OFFS)))) %Long Var.VALUE(&__DDRSS0_CTL_122_DATA)
	Data.Set D:(((Var.VALUE(&__J7_DDR0_SS_BASE)+Var.VALUE(&__DDRSS_CTL_123__SFR_OFFS)))) %Long Var.VALUE(&__DDRSS0_CTL_123_DATA)
	Data.Set D:(((Var.VALUE(&__J7_DDR0_SS_BASE)+Var.VALUE(&__DDRSS_CTL_124__SFR_OFFS)))) %Long Var.VALUE(&__DDRSS0_CTL_124_DATA)
	Data.Set D:(((Var.VALUE(&__J7_DDR0_SS_BASE)+Var.VALUE(&__DDRSS_CTL_125__SFR_OFFS)))) %Long Var.VALUE(&__DDRSS0_CTL_125_DATA)
	Data.Set D:(((Var.VALUE(&__J7_DDR0_SS_BASE)+Var.VALUE(&__DDRSS_CTL_126__SFR_OFFS)))) %Long Var.VALUE(&__DDRSS0_CTL_126_DATA)
	Data.Set D:(((Var.VALUE(&__J7_DDR0_SS_BASE)+Var.VALUE(&__DDRSS_CTL_127__SFR_OFFS)))) %Long Var.VALUE(&__DDRSS0_CTL_127_DATA)
	Data.Set D:(((Var.VALUE(&__J7_DDR0_SS_BASE)+Var.VALUE(&__DDRSS_CTL_128__SFR_OFFS)))) %Long Var.VALUE(&__DDRSS0_CTL_128_DATA)
	Data.Set D:(((Var.VALUE(&__J7_DDR0_SS_BASE)+Var.VALUE(&__DDRSS_CTL_129__SFR_OFFS)))) %Long Var.VALUE(&__DDRSS0_CTL_129_DATA)
	Data.Set D:(((Var.VALUE(&__J7_DDR0_SS_BASE)+Var.VALUE(&__DDRSS_CTL_130__SFR_OFFS)))) %Long Var.VALUE(&__DDRSS0_CTL_130_DATA)
	Data.Set D:(((Var.VALUE(&__J7_DDR0_SS_BASE)+Var.VALUE(&__DDRSS_CTL_131__SFR_OFFS)))) %Long Var.VALUE(&__DDRSS0_CTL_131_DATA)
	Data.Set D:(((Var.VALUE(&__J7_DDR0_SS_BASE)+Var.VALUE(&__DDRSS_CTL_132__SFR_OFFS)))) %Long Var.VALUE(&__DDRSS0_CTL_132_DATA)
	Data.Set D:(((Var.VALUE(&__J7_DDR0_SS_BASE)+Var.VALUE(&__DDRSS_CTL_133__SFR_OFFS)))) %Long Var.VALUE(&__DDRSS0_CTL_133_DATA)
	Data.Set D:(((Var.VALUE(&__J7_DDR0_SS_BASE)+Var.VALUE(&__DDRSS_CTL_134__SFR_OFFS)))) %Long Var.VALUE(&__DDRSS0_CTL_134_DATA)
	Data.Set D:(((Var.VALUE(&__J7_DDR0_SS_BASE)+Var.VALUE(&__DDRSS_CTL_135__SFR_OFFS)))) %Long Var.VALUE(&__DDRSS0_CTL_135_DATA)
	Data.Set D:(((Var.VALUE(&__J7_DDR0_SS_BASE)+Var.VALUE(&__DDRSS_CTL_136__SFR_OFFS)))) %Long Var.VALUE(&__DDRSS0_CTL_136_DATA)
	Data.Set D:(((Var.VALUE(&__J7_DDR0_SS_BASE)+Var.VALUE(&__DDRSS_CTL_137__SFR_OFFS)))) %Long Var.VALUE(&__DDRSS0_CTL_137_DATA)
	Data.Set D:(((Var.VALUE(&__J7_DDR0_SS_BASE)+Var.VALUE(&__DDRSS_CTL_138__SFR_OFFS)))) %Long Var.VALUE(&__DDRSS0_CTL_138_DATA)
	Data.Set D:(((Var.VALUE(&__J7_DDR0_SS_BASE)+Var.VALUE(&__DDRSS_CTL_139__SFR_OFFS)))) %Long Var.VALUE(&__DDRSS0_CTL_139_DATA)
	Data.Set D:(((Var.VALUE(&__J7_DDR0_SS_BASE)+Var.VALUE(&__DDRSS_CTL_140__SFR_OFFS)))) %Long Var.VALUE(&__DDRSS0_CTL_140_DATA)
	Data.Set D:(((Var.VALUE(&__J7_DDR0_SS_BASE)+Var.VALUE(&__DDRSS_CTL_141__SFR_OFFS)))) %Long Var.VALUE(&__DDRSS0_CTL_141_DATA)
	Data.Set D:(((Var.VALUE(&__J7_DDR0_SS_BASE)+Var.VALUE(&__DDRSS_CTL_142__SFR_OFFS)))) %Long Var.VALUE(&__DDRSS0_CTL_142_DATA)
	Data.Set D:(((Var.VALUE(&__J7_DDR0_SS_BASE)+Var.VALUE(&__DDRSS_CTL_143__SFR_OFFS)))) %Long Var.VALUE(&__DDRSS0_CTL_143_DATA)
	Data.Set D:(((Var.VALUE(&__J7_DDR0_SS_BASE)+Var.VALUE(&__DDRSS_CTL_144__SFR_OFFS)))) %Long Var.VALUE(&__DDRSS0_CTL_144_DATA)
	Data.Set D:(((Var.VALUE(&__J7_DDR0_SS_BASE)+Var.VALUE(&__DDRSS_CTL_145__SFR_OFFS)))) %Long Var.VALUE(&__DDRSS0_CTL_145_DATA)
	Data.Set D:(((Var.VALUE(&__J7_DDR0_SS_BASE)+Var.VALUE(&__DDRSS_CTL_146__SFR_OFFS)))) %Long Var.VALUE(&__DDRSS0_CTL_146_DATA)
	Data.Set D:(((Var.VALUE(&__J7_DDR0_SS_BASE)+Var.VALUE(&__DDRSS_CTL_147__SFR_OFFS)))) %Long Var.VALUE(&__DDRSS0_CTL_147_DATA)
	Data.Set D:(((Var.VALUE(&__J7_DDR0_SS_BASE)+Var.VALUE(&__DDRSS_CTL_148__SFR_OFFS)))) %Long Var.VALUE(&__DDRSS0_CTL_148_DATA)
	Data.Set D:(((Var.VALUE(&__J7_DDR0_SS_BASE)+Var.VALUE(&__DDRSS_CTL_149__SFR_OFFS)))) %Long Var.VALUE(&__DDRSS0_CTL_149_DATA)
	Data.Set D:(((Var.VALUE(&__J7_DDR0_SS_BASE)+Var.VALUE(&__DDRSS_CTL_150__SFR_OFFS)))) %Long Var.VALUE(&__DDRSS0_CTL_150_DATA)
	Data.Set D:(((Var.VALUE(&__J7_DDR0_SS_BASE)+Var.VALUE(&__DDRSS_CTL_151__SFR_OFFS)))) %Long Var.VALUE(&__DDRSS0_CTL_151_DATA)
	Data.Set D:(((Var.VALUE(&__J7_DDR0_SS_BASE)+Var.VALUE(&__DDRSS_CTL_152__SFR_OFFS)))) %Long Var.VALUE(&__DDRSS0_CTL_152_DATA)
	Data.Set D:(((Var.VALUE(&__J7_DDR0_SS_BASE)+Var.VALUE(&__DDRSS_CTL_153__SFR_OFFS)))) %Long Var.VALUE(&__DDRSS0_CTL_153_DATA)
	Data.Set D:(((Var.VALUE(&__J7_DDR0_SS_BASE)+Var.VALUE(&__DDRSS_CTL_154__SFR_OFFS)))) %Long Var.VALUE(&__DDRSS0_CTL_154_DATA)
	Data.Set D:(((Var.VALUE(&__J7_DDR0_SS_BASE)+Var.VALUE(&__DDRSS_CTL_155__SFR_OFFS)))) %Long Var.VALUE(&__DDRSS0_CTL_155_DATA)
	Data.Set D:(((Var.VALUE(&__J7_DDR0_SS_BASE)+Var.VALUE(&__DDRSS_CTL_156__SFR_OFFS)))) %Long Var.VALUE(&__DDRSS0_CTL_156_DATA)
	Data.Set D:(((Var.VALUE(&__J7_DDR0_SS_BASE)+Var.VALUE(&__DDRSS_CTL_157__SFR_OFFS)))) %Long Var.VALUE(&__DDRSS0_CTL_157_DATA)
	Data.Set D:(((Var.VALUE(&__J7_DDR0_SS_BASE)+Var.VALUE(&__DDRSS_CTL_158__SFR_OFFS)))) %Long Var.VALUE(&__DDRSS0_CTL_158_DATA)
	Data.Set D:(((Var.VALUE(&__J7_DDR0_SS_BASE)+Var.VALUE(&__DDRSS_CTL_159__SFR_OFFS)))) %Long Var.VALUE(&__DDRSS0_CTL_159_DATA)
	Data.Set D:(((Var.VALUE(&__J7_DDR0_SS_BASE)+Var.VALUE(&__DDRSS_CTL_160__SFR_OFFS)))) %Long Var.VALUE(&__DDRSS0_CTL_160_DATA)
	Data.Set D:(((Var.VALUE(&__J7_DDR0_SS_BASE)+Var.VALUE(&__DDRSS_CTL_161__SFR_OFFS)))) %Long Var.VALUE(&__DDRSS0_CTL_161_DATA)
	Data.Set D:(((Var.VALUE(&__J7_DDR0_SS_BASE)+Var.VALUE(&__DDRSS_CTL_162__SFR_OFFS)))) %Long Var.VALUE(&__DDRSS0_CTL_162_DATA)
	Data.Set D:(((Var.VALUE(&__J7_DDR0_SS_BASE)+Var.VALUE(&__DDRSS_CTL_163__SFR_OFFS)))) %Long Var.VALUE(&__DDRSS0_CTL_163_DATA)
	Data.Set D:(((Var.VALUE(&__J7_DDR0_SS_BASE)+Var.VALUE(&__DDRSS_CTL_164__SFR_OFFS)))) %Long Var.VALUE(&__DDRSS0_CTL_164_DATA)
	Data.Set D:(((Var.VALUE(&__J7_DDR0_SS_BASE)+Var.VALUE(&__DDRSS_CTL_165__SFR_OFFS)))) %Long Var.VALUE(&__DDRSS0_CTL_165_DATA)
	Data.Set D:(((Var.VALUE(&__J7_DDR0_SS_BASE)+Var.VALUE(&__DDRSS_CTL_166__SFR_OFFS)))) %Long Var.VALUE(&__DDRSS0_CTL_166_DATA)
	Data.Set D:(((Var.VALUE(&__J7_DDR0_SS_BASE)+Var.VALUE(&__DDRSS_CTL_167__SFR_OFFS)))) %Long Var.VALUE(&__DDRSS0_CTL_167_DATA)
	Data.Set D:(((Var.VALUE(&__J7_DDR0_SS_BASE)+Var.VALUE(&__DDRSS_CTL_168__SFR_OFFS)))) %Long Var.VALUE(&__DDRSS0_CTL_168_DATA)
	Data.Set D:(((Var.VALUE(&__J7_DDR0_SS_BASE)+Var.VALUE(&__DDRSS_CTL_169__SFR_OFFS)))) %Long Var.VALUE(&__DDRSS0_CTL_169_DATA)
	Data.Set D:(((Var.VALUE(&__J7_DDR0_SS_BASE)+Var.VALUE(&__DDRSS_CTL_170__SFR_OFFS)))) %Long Var.VALUE(&__DDRSS0_CTL_170_DATA)
	Data.Set D:(((Var.VALUE(&__J7_DDR0_SS_BASE)+Var.VALUE(&__DDRSS_CTL_171__SFR_OFFS)))) %Long Var.VALUE(&__DDRSS0_CTL_171_DATA)
	Data.Set D:(((Var.VALUE(&__J7_DDR0_SS_BASE)+Var.VALUE(&__DDRSS_CTL_172__SFR_OFFS)))) %Long Var.VALUE(&__DDRSS0_CTL_172_DATA)
	Data.Set D:(((Var.VALUE(&__J7_DDR0_SS_BASE)+Var.VALUE(&__DDRSS_CTL_173__SFR_OFFS)))) %Long Var.VALUE(&__DDRSS0_CTL_173_DATA)
	Data.Set D:(((Var.VALUE(&__J7_DDR0_SS_BASE)+Var.VALUE(&__DDRSS_CTL_174__SFR_OFFS)))) %Long Var.VALUE(&__DDRSS0_CTL_174_DATA)
	Data.Set D:(((Var.VALUE(&__J7_DDR0_SS_BASE)+Var.VALUE(&__DDRSS_CTL_175__SFR_OFFS)))) %Long Var.VALUE(&__DDRSS0_CTL_175_DATA)
	Data.Set D:(((Var.VALUE(&__J7_DDR0_SS_BASE)+Var.VALUE(&__DDRSS_CTL_176__SFR_OFFS)))) %Long Var.VALUE(&__DDRSS0_CTL_176_DATA)
	Data.Set D:(((Var.VALUE(&__J7_DDR0_SS_BASE)+Var.VALUE(&__DDRSS_CTL_177__SFR_OFFS)))) %Long Var.VALUE(&__DDRSS0_CTL_177_DATA)
	Data.Set D:(((Var.VALUE(&__J7_DDR0_SS_BASE)+Var.VALUE(&__DDRSS_CTL_178__SFR_OFFS)))) %Long Var.VALUE(&__DDRSS0_CTL_178_DATA)
	Data.Set D:(((Var.VALUE(&__J7_DDR0_SS_BASE)+Var.VALUE(&__DDRSS_CTL_179__SFR_OFFS)))) %Long Var.VALUE(&__DDRSS0_CTL_179_DATA)
	Data.Set D:(((Var.VALUE(&__J7_DDR0_SS_BASE)+Var.VALUE(&__DDRSS_CTL_180__SFR_OFFS)))) %Long Var.VALUE(&__DDRSS0_CTL_180_DATA)
	Data.Set D:(((Var.VALUE(&__J7_DDR0_SS_BASE)+Var.VALUE(&__DDRSS_CTL_181__SFR_OFFS)))) %Long Var.VALUE(&__DDRSS0_CTL_181_DATA)
	Data.Set D:(((Var.VALUE(&__J7_DDR0_SS_BASE)+Var.VALUE(&__DDRSS_CTL_182__SFR_OFFS)))) %Long Var.VALUE(&__DDRSS0_CTL_182_DATA)
	Data.Set D:(((Var.VALUE(&__J7_DDR0_SS_BASE)+Var.VALUE(&__DDRSS_CTL_183__SFR_OFFS)))) %Long Var.VALUE(&__DDRSS0_CTL_183_DATA)
	Data.Set D:(((Var.VALUE(&__J7_DDR0_SS_BASE)+Var.VALUE(&__DDRSS_CTL_184__SFR_OFFS)))) %Long Var.VALUE(&__DDRSS0_CTL_184_DATA)
	Data.Set D:(((Var.VALUE(&__J7_DDR0_SS_BASE)+Var.VALUE(&__DDRSS_CTL_185__SFR_OFFS)))) %Long Var.VALUE(&__DDRSS0_CTL_185_DATA)
	Data.Set D:(((Var.VALUE(&__J7_DDR0_SS_BASE)+Var.VALUE(&__DDRSS_CTL_186__SFR_OFFS)))) %Long Var.VALUE(&__DDRSS0_CTL_186_DATA)
	Data.Set D:(((Var.VALUE(&__J7_DDR0_SS_BASE)+Var.VALUE(&__DDRSS_CTL_187__SFR_OFFS)))) %Long Var.VALUE(&__DDRSS0_CTL_187_DATA)
	Data.Set D:(((Var.VALUE(&__J7_DDR0_SS_BASE)+Var.VALUE(&__DDRSS_CTL_188__SFR_OFFS)))) %Long Var.VALUE(&__DDRSS0_CTL_188_DATA)
	Data.Set D:(((Var.VALUE(&__J7_DDR0_SS_BASE)+Var.VALUE(&__DDRSS_CTL_189__SFR_OFFS)))) %Long Var.VALUE(&__DDRSS0_CTL_189_DATA)
	Data.Set D:(((Var.VALUE(&__J7_DDR0_SS_BASE)+Var.VALUE(&__DDRSS_CTL_190__SFR_OFFS)))) %Long Var.VALUE(&__DDRSS0_CTL_190_DATA)
	Data.Set D:(((Var.VALUE(&__J7_DDR0_SS_BASE)+Var.VALUE(&__DDRSS_CTL_191__SFR_OFFS)))) %Long Var.VALUE(&__DDRSS0_CTL_191_DATA)
	Data.Set D:(((Var.VALUE(&__J7_DDR0_SS_BASE)+Var.VALUE(&__DDRSS_CTL_192__SFR_OFFS)))) %Long Var.VALUE(&__DDRSS0_CTL_192_DATA)
	Data.Set D:(((Var.VALUE(&__J7_DDR0_SS_BASE)+Var.VALUE(&__DDRSS_CTL_193__SFR_OFFS)))) %Long Var.VALUE(&__DDRSS0_CTL_193_DATA)
	Data.Set D:(((Var.VALUE(&__J7_DDR0_SS_BASE)+Var.VALUE(&__DDRSS_CTL_194__SFR_OFFS)))) %Long Var.VALUE(&__DDRSS0_CTL_194_DATA)
	Data.Set D:(((Var.VALUE(&__J7_DDR0_SS_BASE)+Var.VALUE(&__DDRSS_CTL_195__SFR_OFFS)))) %Long Var.VALUE(&__DDRSS0_CTL_195_DATA)
	Data.Set D:(((Var.VALUE(&__J7_DDR0_SS_BASE)+Var.VALUE(&__DDRSS_CTL_196__SFR_OFFS)))) %Long Var.VALUE(&__DDRSS0_CTL_196_DATA)
	Data.Set D:(((Var.VALUE(&__J7_DDR0_SS_BASE)+Var.VALUE(&__DDRSS_CTL_197__SFR_OFFS)))) %Long Var.VALUE(&__DDRSS0_CTL_197_DATA)
	Data.Set D:(((Var.VALUE(&__J7_DDR0_SS_BASE)+Var.VALUE(&__DDRSS_CTL_198__SFR_OFFS)))) %Long Var.VALUE(&__DDRSS0_CTL_198_DATA)
	Data.Set D:(((Var.VALUE(&__J7_DDR0_SS_BASE)+Var.VALUE(&__DDRSS_CTL_199__SFR_OFFS)))) %Long Var.VALUE(&__DDRSS0_CTL_199_DATA)
	Data.Set D:(((Var.VALUE(&__J7_DDR0_SS_BASE)+Var.VALUE(&__DDRSS_CTL_200__SFR_OFFS)))) %Long Var.VALUE(&__DDRSS0_CTL_200_DATA)
	Data.Set D:(((Var.VALUE(&__J7_DDR0_SS_BASE)+Var.VALUE(&__DDRSS_CTL_201__SFR_OFFS)))) %Long Var.VALUE(&__DDRSS0_CTL_201_DATA)
	Data.Set D:(((Var.VALUE(&__J7_DDR0_SS_BASE)+Var.VALUE(&__DDRSS_CTL_202__SFR_OFFS)))) %Long Var.VALUE(&__DDRSS0_CTL_202_DATA)
	Data.Set D:(((Var.VALUE(&__J7_DDR0_SS_BASE)+Var.VALUE(&__DDRSS_CTL_203__SFR_OFFS)))) %Long Var.VALUE(&__DDRSS0_CTL_203_DATA)
	Data.Set D:(((Var.VALUE(&__J7_DDR0_SS_BASE)+Var.VALUE(&__DDRSS_CTL_204__SFR_OFFS)))) %Long Var.VALUE(&__DDRSS0_CTL_204_DATA)
	Data.Set D:(((Var.VALUE(&__J7_DDR0_SS_BASE)+Var.VALUE(&__DDRSS_CTL_205__SFR_OFFS)))) %Long Var.VALUE(&__DDRSS0_CTL_205_DATA)
	Data.Set D:(((Var.VALUE(&__J7_DDR0_SS_BASE)+Var.VALUE(&__DDRSS_CTL_206__SFR_OFFS)))) %Long Var.VALUE(&__DDRSS0_CTL_206_DATA)
	Data.Set D:(((Var.VALUE(&__J7_DDR0_SS_BASE)+Var.VALUE(&__DDRSS_CTL_207__SFR_OFFS)))) %Long Var.VALUE(&__DDRSS0_CTL_207_DATA)
	Data.Set D:(((Var.VALUE(&__J7_DDR0_SS_BASE)+Var.VALUE(&__DDRSS_CTL_208__SFR_OFFS)))) %Long Var.VALUE(&__DDRSS0_CTL_208_DATA)
	Data.Set D:(((Var.VALUE(&__J7_DDR0_SS_BASE)+Var.VALUE(&__DDRSS_CTL_209__SFR_OFFS)))) %Long Var.VALUE(&__DDRSS0_CTL_209_DATA)
	Data.Set D:(((Var.VALUE(&__J7_DDR0_SS_BASE)+Var.VALUE(&__DDRSS_CTL_210__SFR_OFFS)))) %Long Var.VALUE(&__DDRSS0_CTL_210_DATA)
	Data.Set D:(((Var.VALUE(&__J7_DDR0_SS_BASE)+Var.VALUE(&__DDRSS_CTL_211__SFR_OFFS)))) %Long Var.VALUE(&__DDRSS0_CTL_211_DATA)
	Data.Set D:(((Var.VALUE(&__J7_DDR0_SS_BASE)+Var.VALUE(&__DDRSS_CTL_212__SFR_OFFS)))) %Long Var.VALUE(&__DDRSS0_CTL_212_DATA)
	Data.Set D:(((Var.VALUE(&__J7_DDR0_SS_BASE)+Var.VALUE(&__DDRSS_CTL_213__SFR_OFFS)))) %Long Var.VALUE(&__DDRSS0_CTL_213_DATA)
	Data.Set D:(((Var.VALUE(&__J7_DDR0_SS_BASE)+Var.VALUE(&__DDRSS_CTL_214__SFR_OFFS)))) %Long Var.VALUE(&__DDRSS0_CTL_214_DATA)
	Data.Set D:(((Var.VALUE(&__J7_DDR0_SS_BASE)+Var.VALUE(&__DDRSS_CTL_215__SFR_OFFS)))) %Long Var.VALUE(&__DDRSS0_CTL_215_DATA)
	Data.Set D:(((Var.VALUE(&__J7_DDR0_SS_BASE)+Var.VALUE(&__DDRSS_CTL_216__SFR_OFFS)))) %Long Var.VALUE(&__DDRSS0_CTL_216_DATA)
	Data.Set D:(((Var.VALUE(&__J7_DDR0_SS_BASE)+Var.VALUE(&__DDRSS_CTL_217__SFR_OFFS)))) %Long Var.VALUE(&__DDRSS0_CTL_217_DATA)
	Data.Set D:(((Var.VALUE(&__J7_DDR0_SS_BASE)+Var.VALUE(&__DDRSS_CTL_218__SFR_OFFS)))) %Long Var.VALUE(&__DDRSS0_CTL_218_DATA)
	Data.Set D:(((Var.VALUE(&__J7_DDR0_SS_BASE)+Var.VALUE(&__DDRSS_CTL_219__SFR_OFFS)))) %Long Var.VALUE(&__DDRSS0_CTL_219_DATA)
	Data.Set D:(((Var.VALUE(&__J7_DDR0_SS_BASE)+Var.VALUE(&__DDRSS_CTL_220__SFR_OFFS)))) %Long Var.VALUE(&__DDRSS0_CTL_220_DATA)
	Data.Set D:(((Var.VALUE(&__J7_DDR0_SS_BASE)+Var.VALUE(&__DDRSS_CTL_221__SFR_OFFS)))) %Long Var.VALUE(&__DDRSS0_CTL_221_DATA)
	Data.Set D:(((Var.VALUE(&__J7_DDR0_SS_BASE)+Var.VALUE(&__DDRSS_CTL_222__SFR_OFFS)))) %Long Var.VALUE(&__DDRSS0_CTL_222_DATA)
	Data.Set D:(((Var.VALUE(&__J7_DDR0_SS_BASE)+Var.VALUE(&__DDRSS_CTL_223__SFR_OFFS)))) %Long Var.VALUE(&__DDRSS0_CTL_223_DATA)
	Data.Set D:(((Var.VALUE(&__J7_DDR0_SS_BASE)+Var.VALUE(&__DDRSS_CTL_224__SFR_OFFS)))) %Long Var.VALUE(&__DDRSS0_CTL_224_DATA)
	Data.Set D:(((Var.VALUE(&__J7_DDR0_SS_BASE)+Var.VALUE(&__DDRSS_CTL_225__SFR_OFFS)))) %Long Var.VALUE(&__DDRSS0_CTL_225_DATA)
	Data.Set D:(((Var.VALUE(&__J7_DDR0_SS_BASE)+Var.VALUE(&__DDRSS_CTL_226__SFR_OFFS)))) %Long Var.VALUE(&__DDRSS0_CTL_226_DATA)
	Data.Set D:(((Var.VALUE(&__J7_DDR0_SS_BASE)+Var.VALUE(&__DDRSS_CTL_227__SFR_OFFS)))) %Long Var.VALUE(&__DDRSS0_CTL_227_DATA)
	Data.Set D:(((Var.VALUE(&__J7_DDR0_SS_BASE)+Var.VALUE(&__DDRSS_CTL_228__SFR_OFFS)))) %Long Var.VALUE(&__DDRSS0_CTL_228_DATA)
	Data.Set D:(((Var.VALUE(&__J7_DDR0_SS_BASE)+Var.VALUE(&__DDRSS_CTL_229__SFR_OFFS)))) %Long Var.VALUE(&__DDRSS0_CTL_229_DATA)
	Data.Set D:(((Var.VALUE(&__J7_DDR0_SS_BASE)+Var.VALUE(&__DDRSS_CTL_230__SFR_OFFS)))) %Long Var.VALUE(&__DDRSS0_CTL_230_DATA)
	Data.Set D:(((Var.VALUE(&__J7_DDR0_SS_BASE)+Var.VALUE(&__DDRSS_CTL_231__SFR_OFFS)))) %Long Var.VALUE(&__DDRSS0_CTL_231_DATA)
	Data.Set D:(((Var.VALUE(&__J7_DDR0_SS_BASE)+Var.VALUE(&__DDRSS_CTL_232__SFR_OFFS)))) %Long Var.VALUE(&__DDRSS0_CTL_232_DATA)
	Data.Set D:(((Var.VALUE(&__J7_DDR0_SS_BASE)+Var.VALUE(&__DDRSS_CTL_233__SFR_OFFS)))) %Long Var.VALUE(&__DDRSS0_CTL_233_DATA)
	Data.Set D:(((Var.VALUE(&__J7_DDR0_SS_BASE)+Var.VALUE(&__DDRSS_CTL_234__SFR_OFFS)))) %Long Var.VALUE(&__DDRSS0_CTL_234_DATA)
	Data.Set D:(((Var.VALUE(&__J7_DDR0_SS_BASE)+Var.VALUE(&__DDRSS_CTL_235__SFR_OFFS)))) %Long Var.VALUE(&__DDRSS0_CTL_235_DATA)
	Data.Set D:(((Var.VALUE(&__J7_DDR0_SS_BASE)+Var.VALUE(&__DDRSS_CTL_236__SFR_OFFS)))) %Long Var.VALUE(&__DDRSS0_CTL_236_DATA)
	Data.Set D:(((Var.VALUE(&__J7_DDR0_SS_BASE)+Var.VALUE(&__DDRSS_CTL_237__SFR_OFFS)))) %Long Var.VALUE(&__DDRSS0_CTL_237_DATA)
	Data.Set D:(((Var.VALUE(&__J7_DDR0_SS_BASE)+Var.VALUE(&__DDRSS_CTL_238__SFR_OFFS)))) %Long Var.VALUE(&__DDRSS0_CTL_238_DATA)
	Data.Set D:(((Var.VALUE(&__J7_DDR0_SS_BASE)+Var.VALUE(&__DDRSS_CTL_239__SFR_OFFS)))) %Long Var.VALUE(&__DDRSS0_CTL_239_DATA)
	Data.Set D:(((Var.VALUE(&__J7_DDR0_SS_BASE)+Var.VALUE(&__DDRSS_CTL_240__SFR_OFFS)))) %Long Var.VALUE(&__DDRSS0_CTL_240_DATA)
	Data.Set D:(((Var.VALUE(&__J7_DDR0_SS_BASE)+Var.VALUE(&__DDRSS_CTL_241__SFR_OFFS)))) %Long Var.VALUE(&__DDRSS0_CTL_241_DATA)
	Data.Set D:(((Var.VALUE(&__J7_DDR0_SS_BASE)+Var.VALUE(&__DDRSS_CTL_242__SFR_OFFS)))) %Long Var.VALUE(&__DDRSS0_CTL_242_DATA)
	Data.Set D:(((Var.VALUE(&__J7_DDR0_SS_BASE)+Var.VALUE(&__DDRSS_CTL_243__SFR_OFFS)))) %Long Var.VALUE(&__DDRSS0_CTL_243_DATA)
	Data.Set D:(((Var.VALUE(&__J7_DDR0_SS_BASE)+Var.VALUE(&__DDRSS_CTL_244__SFR_OFFS)))) %Long Var.VALUE(&__DDRSS0_CTL_244_DATA)
	Data.Set D:(((Var.VALUE(&__J7_DDR0_SS_BASE)+Var.VALUE(&__DDRSS_CTL_245__SFR_OFFS)))) %Long Var.VALUE(&__DDRSS0_CTL_245_DATA)
	Data.Set D:(((Var.VALUE(&__J7_DDR0_SS_BASE)+Var.VALUE(&__DDRSS_CTL_246__SFR_OFFS)))) %Long Var.VALUE(&__DDRSS0_CTL_246_DATA)
	Data.Set D:(((Var.VALUE(&__J7_DDR0_SS_BASE)+Var.VALUE(&__DDRSS_CTL_247__SFR_OFFS)))) %Long Var.VALUE(&__DDRSS0_CTL_247_DATA)
	Data.Set D:(((Var.VALUE(&__J7_DDR0_SS_BASE)+Var.VALUE(&__DDRSS_CTL_248__SFR_OFFS)))) %Long Var.VALUE(&__DDRSS0_CTL_248_DATA)
	Data.Set D:(((Var.VALUE(&__J7_DDR0_SS_BASE)+Var.VALUE(&__DDRSS_CTL_249__SFR_OFFS)))) %Long Var.VALUE(&__DDRSS0_CTL_249_DATA)
	Data.Set D:(((Var.VALUE(&__J7_DDR0_SS_BASE)+Var.VALUE(&__DDRSS_CTL_250__SFR_OFFS)))) %Long Var.VALUE(&__DDRSS0_CTL_250_DATA)
	Data.Set D:(((Var.VALUE(&__J7_DDR0_SS_BASE)+Var.VALUE(&__DDRSS_CTL_251__SFR_OFFS)))) %Long Var.VALUE(&__DDRSS0_CTL_251_DATA)
	Data.Set D:(((Var.VALUE(&__J7_DDR0_SS_BASE)+Var.VALUE(&__DDRSS_CTL_252__SFR_OFFS)))) %Long Var.VALUE(&__DDRSS0_CTL_252_DATA)
	Data.Set D:(((Var.VALUE(&__J7_DDR0_SS_BASE)+Var.VALUE(&__DDRSS_CTL_253__SFR_OFFS)))) %Long Var.VALUE(&__DDRSS0_CTL_253_DATA)
	Data.Set D:(((Var.VALUE(&__J7_DDR0_SS_BASE)+Var.VALUE(&__DDRSS_CTL_254__SFR_OFFS)))) %Long Var.VALUE(&__DDRSS0_CTL_254_DATA)
	Data.Set D:(((Var.VALUE(&__J7_DDR0_SS_BASE)+Var.VALUE(&__DDRSS_CTL_255__SFR_OFFS)))) %Long Var.VALUE(&__DDRSS0_CTL_255_DATA)
	Data.Set D:(((Var.VALUE(&__J7_DDR0_SS_BASE)+Var.VALUE(&__DDRSS_CTL_256__SFR_OFFS)))) %Long Var.VALUE(&__DDRSS0_CTL_256_DATA)
	Data.Set D:(((Var.VALUE(&__J7_DDR0_SS_BASE)+Var.VALUE(&__DDRSS_CTL_257__SFR_OFFS)))) %Long Var.VALUE(&__DDRSS0_CTL_257_DATA)
	Data.Set D:(((Var.VALUE(&__J7_DDR0_SS_BASE)+Var.VALUE(&__DDRSS_CTL_258__SFR_OFFS)))) %Long Var.VALUE(&__DDRSS0_CTL_258_DATA)
	Data.Set D:(((Var.VALUE(&__J7_DDR0_SS_BASE)+Var.VALUE(&__DDRSS_CTL_259__SFR_OFFS)))) %Long Var.VALUE(&__DDRSS0_CTL_259_DATA)
	Data.Set D:(((Var.VALUE(&__J7_DDR0_SS_BASE)+Var.VALUE(&__DDRSS_CTL_260__SFR_OFFS)))) %Long Var.VALUE(&__DDRSS0_CTL_260_DATA)
	Data.Set D:(((Var.VALUE(&__J7_DDR0_SS_BASE)+Var.VALUE(&__DDRSS_CTL_261__SFR_OFFS)))) %Long Var.VALUE(&__DDRSS0_CTL_261_DATA)
	Data.Set D:(((Var.VALUE(&__J7_DDR0_SS_BASE)+Var.VALUE(&__DDRSS_CTL_262__SFR_OFFS)))) %Long Var.VALUE(&__DDRSS0_CTL_262_DATA)
	Data.Set D:(((Var.VALUE(&__J7_DDR0_SS_BASE)+Var.VALUE(&__DDRSS_CTL_263__SFR_OFFS)))) %Long Var.VALUE(&__DDRSS0_CTL_263_DATA)
	Data.Set D:(((Var.VALUE(&__J7_DDR0_SS_BASE)+Var.VALUE(&__DDRSS_CTL_264__SFR_OFFS)))) %Long Var.VALUE(&__DDRSS0_CTL_264_DATA)
	Data.Set D:(((Var.VALUE(&__J7_DDR0_SS_BASE)+Var.VALUE(&__DDRSS_CTL_265__SFR_OFFS)))) %Long Var.VALUE(&__DDRSS0_CTL_265_DATA)
	Data.Set D:(((Var.VALUE(&__J7_DDR0_SS_BASE)+Var.VALUE(&__DDRSS_CTL_266__SFR_OFFS)))) %Long Var.VALUE(&__DDRSS0_CTL_266_DATA)
	Data.Set D:(((Var.VALUE(&__J7_DDR0_SS_BASE)+Var.VALUE(&__DDRSS_CTL_267__SFR_OFFS)))) %Long Var.VALUE(&__DDRSS0_CTL_267_DATA)
	Data.Set D:(((Var.VALUE(&__J7_DDR0_SS_BASE)+Var.VALUE(&__DDRSS_CTL_268__SFR_OFFS)))) %Long Var.VALUE(&__DDRSS0_CTL_268_DATA)
	Data.Set D:(((Var.VALUE(&__J7_DDR0_SS_BASE)+Var.VALUE(&__DDRSS_CTL_269__SFR_OFFS)))) %Long Var.VALUE(&__DDRSS0_CTL_269_DATA)
	Data.Set D:(((Var.VALUE(&__J7_DDR0_SS_BASE)+Var.VALUE(&__DDRSS_CTL_270__SFR_OFFS)))) %Long Var.VALUE(&__DDRSS0_CTL_270_DATA)
	Data.Set D:(((Var.VALUE(&__J7_DDR0_SS_BASE)+Var.VALUE(&__DDRSS_CTL_271__SFR_OFFS)))) %Long Var.VALUE(&__DDRSS0_CTL_271_DATA)
	Data.Set D:(((Var.VALUE(&__J7_DDR0_SS_BASE)+Var.VALUE(&__DDRSS_CTL_272__SFR_OFFS)))) %Long Var.VALUE(&__DDRSS0_CTL_272_DATA)
	Data.Set D:(((Var.VALUE(&__J7_DDR0_SS_BASE)+Var.VALUE(&__DDRSS_CTL_273__SFR_OFFS)))) %Long Var.VALUE(&__DDRSS0_CTL_273_DATA)
	Data.Set D:(((Var.VALUE(&__J7_DDR0_SS_BASE)+Var.VALUE(&__DDRSS_CTL_274__SFR_OFFS)))) %Long Var.VALUE(&__DDRSS0_CTL_274_DATA)
	Data.Set D:(((Var.VALUE(&__J7_DDR0_SS_BASE)+Var.VALUE(&__DDRSS_CTL_275__SFR_OFFS)))) %Long Var.VALUE(&__DDRSS0_CTL_275_DATA)
	Data.Set D:(((Var.VALUE(&__J7_DDR0_SS_BASE)+Var.VALUE(&__DDRSS_CTL_276__SFR_OFFS)))) %Long Var.VALUE(&__DDRSS0_CTL_276_DATA)
	Data.Set D:(((Var.VALUE(&__J7_DDR0_SS_BASE)+Var.VALUE(&__DDRSS_CTL_277__SFR_OFFS)))) %Long Var.VALUE(&__DDRSS0_CTL_277_DATA)
	Data.Set D:(((Var.VALUE(&__J7_DDR0_SS_BASE)+Var.VALUE(&__DDRSS_CTL_278__SFR_OFFS)))) %Long Var.VALUE(&__DDRSS0_CTL_278_DATA)
	Data.Set D:(((Var.VALUE(&__J7_DDR0_SS_BASE)+Var.VALUE(&__DDRSS_CTL_279__SFR_OFFS)))) %Long Var.VALUE(&__DDRSS0_CTL_279_DATA)
	Data.Set D:(((Var.VALUE(&__J7_DDR0_SS_BASE)+Var.VALUE(&__DDRSS_CTL_280__SFR_OFFS)))) %Long Var.VALUE(&__DDRSS0_CTL_280_DATA)
	Data.Set D:(((Var.VALUE(&__J7_DDR0_SS_BASE)+Var.VALUE(&__DDRSS_CTL_281__SFR_OFFS)))) %Long Var.VALUE(&__DDRSS0_CTL_281_DATA)
	Data.Set D:(((Var.VALUE(&__J7_DDR0_SS_BASE)+Var.VALUE(&__DDRSS_CTL_282__SFR_OFFS)))) %Long Var.VALUE(&__DDRSS0_CTL_282_DATA)
	Data.Set D:(((Var.VALUE(&__J7_DDR0_SS_BASE)+Var.VALUE(&__DDRSS_CTL_283__SFR_OFFS)))) %Long Var.VALUE(&__DDRSS0_CTL_283_DATA)
	Data.Set D:(((Var.VALUE(&__J7_DDR0_SS_BASE)+Var.VALUE(&__DDRSS_CTL_284__SFR_OFFS)))) %Long Var.VALUE(&__DDRSS0_CTL_284_DATA)
	Data.Set D:(((Var.VALUE(&__J7_DDR0_SS_BASE)+Var.VALUE(&__DDRSS_CTL_285__SFR_OFFS)))) %Long Var.VALUE(&__DDRSS0_CTL_285_DATA)
	Data.Set D:(((Var.VALUE(&__J7_DDR0_SS_BASE)+Var.VALUE(&__DDRSS_CTL_286__SFR_OFFS)))) %Long Var.VALUE(&__DDRSS0_CTL_286_DATA)
	Data.Set D:(((Var.VALUE(&__J7_DDR0_SS_BASE)+Var.VALUE(&__DDRSS_CTL_287__SFR_OFFS)))) %Long Var.VALUE(&__DDRSS0_CTL_287_DATA)
	Data.Set D:(((Var.VALUE(&__J7_DDR0_SS_BASE)+Var.VALUE(&__DDRSS_CTL_288__SFR_OFFS)))) %Long Var.VALUE(&__DDRSS0_CTL_288_DATA)
	Data.Set D:(((Var.VALUE(&__J7_DDR0_SS_BASE)+Var.VALUE(&__DDRSS_CTL_289__SFR_OFFS)))) %Long Var.VALUE(&__DDRSS0_CTL_289_DATA)
	Data.Set D:(((Var.VALUE(&__J7_DDR0_SS_BASE)+Var.VALUE(&__DDRSS_CTL_290__SFR_OFFS)))) %Long Var.VALUE(&__DDRSS0_CTL_290_DATA)
	Data.Set D:(((Var.VALUE(&__J7_DDR0_SS_BASE)+Var.VALUE(&__DDRSS_CTL_291__SFR_OFFS)))) %Long Var.VALUE(&__DDRSS0_CTL_291_DATA)
	Data.Set D:(((Var.VALUE(&__J7_DDR0_SS_BASE)+Var.VALUE(&__DDRSS_CTL_292__SFR_OFFS)))) %Long Var.VALUE(&__DDRSS0_CTL_292_DATA)
	Data.Set D:(((Var.VALUE(&__J7_DDR0_SS_BASE)+Var.VALUE(&__DDRSS_CTL_293__SFR_OFFS)))) %Long Var.VALUE(&__DDRSS0_CTL_293_DATA)
	Data.Set D:(((Var.VALUE(&__J7_DDR0_SS_BASE)+Var.VALUE(&__DDRSS_CTL_294__SFR_OFFS)))) %Long Var.VALUE(&__DDRSS0_CTL_294_DATA)
	Data.Set D:(((Var.VALUE(&__J7_DDR0_SS_BASE)+Var.VALUE(&__DDRSS_CTL_295__SFR_OFFS)))) %Long Var.VALUE(&__DDRSS0_CTL_295_DATA)
	Data.Set D:(((Var.VALUE(&__J7_DDR0_SS_BASE)+Var.VALUE(&__DDRSS_CTL_296__SFR_OFFS)))) %Long Var.VALUE(&__DDRSS0_CTL_296_DATA)
	Data.Set D:(((Var.VALUE(&__J7_DDR0_SS_BASE)+Var.VALUE(&__DDRSS_CTL_297__SFR_OFFS)))) %Long Var.VALUE(&__DDRSS0_CTL_297_DATA)
	Data.Set D:(((Var.VALUE(&__J7_DDR0_SS_BASE)+Var.VALUE(&__DDRSS_CTL_298__SFR_OFFS)))) %Long Var.VALUE(&__DDRSS0_CTL_298_DATA)
	Data.Set D:(((Var.VALUE(&__J7_DDR0_SS_BASE)+Var.VALUE(&__DDRSS_CTL_299__SFR_OFFS)))) %Long Var.VALUE(&__DDRSS0_CTL_299_DATA)
	Data.Set D:(((Var.VALUE(&__J7_DDR0_SS_BASE)+Var.VALUE(&__DDRSS_CTL_300__SFR_OFFS)))) %Long Var.VALUE(&__DDRSS0_CTL_300_DATA)
	Data.Set D:(((Var.VALUE(&__J7_DDR0_SS_BASE)+Var.VALUE(&__DDRSS_CTL_301__SFR_OFFS)))) %Long Var.VALUE(&__DDRSS0_CTL_301_DATA)
	Data.Set D:(((Var.VALUE(&__J7_DDR0_SS_BASE)+Var.VALUE(&__DDRSS_CTL_302__SFR_OFFS)))) %Long Var.VALUE(&__DDRSS0_CTL_302_DATA)
	Data.Set D:(((Var.VALUE(&__J7_DDR0_SS_BASE)+Var.VALUE(&__DDRSS_CTL_303__SFR_OFFS)))) %Long Var.VALUE(&__DDRSS0_CTL_303_DATA)
	Data.Set D:(((Var.VALUE(&__J7_DDR0_SS_BASE)+Var.VALUE(&__DDRSS_CTL_304__SFR_OFFS)))) %Long Var.VALUE(&__DDRSS0_CTL_304_DATA)
	Data.Set D:(((Var.VALUE(&__J7_DDR0_SS_BASE)+Var.VALUE(&__DDRSS_CTL_305__SFR_OFFS)))) %Long Var.VALUE(&__DDRSS0_CTL_305_DATA)
	Data.Set D:(((Var.VALUE(&__J7_DDR0_SS_BASE)+Var.VALUE(&__DDRSS_CTL_306__SFR_OFFS)))) %Long Var.VALUE(&__DDRSS0_CTL_306_DATA)
	Data.Set D:(((Var.VALUE(&__J7_DDR0_SS_BASE)+Var.VALUE(&__DDRSS_CTL_307__SFR_OFFS)))) %Long Var.VALUE(&__DDRSS0_CTL_307_DATA)
	Data.Set D:(((Var.VALUE(&__J7_DDR0_SS_BASE)+Var.VALUE(&__DDRSS_CTL_308__SFR_OFFS)))) %Long Var.VALUE(&__DDRSS0_CTL_308_DATA)
	Data.Set D:(((Var.VALUE(&__J7_DDR0_SS_BASE)+Var.VALUE(&__DDRSS_CTL_309__SFR_OFFS)))) %Long Var.VALUE(&__DDRSS0_CTL_309_DATA)
	Data.Set D:(((Var.VALUE(&__J7_DDR0_SS_BASE)+Var.VALUE(&__DDRSS_CTL_310__SFR_OFFS)))) %Long Var.VALUE(&__DDRSS0_CTL_310_DATA)
	Data.Set D:(((Var.VALUE(&__J7_DDR0_SS_BASE)+Var.VALUE(&__DDRSS_CTL_311__SFR_OFFS)))) %Long Var.VALUE(&__DDRSS0_CTL_311_DATA)
	Data.Set D:(((Var.VALUE(&__J7_DDR0_SS_BASE)+Var.VALUE(&__DDRSS_CTL_312__SFR_OFFS)))) %Long Var.VALUE(&__DDRSS0_CTL_312_DATA)
	Data.Set D:(((Var.VALUE(&__J7_DDR0_SS_BASE)+Var.VALUE(&__DDRSS_CTL_313__SFR_OFFS)))) %Long Var.VALUE(&__DDRSS0_CTL_313_DATA)
	Data.Set D:(((Var.VALUE(&__J7_DDR0_SS_BASE)+Var.VALUE(&__DDRSS_CTL_314__SFR_OFFS)))) %Long Var.VALUE(&__DDRSS0_CTL_314_DATA)
	Data.Set D:(((Var.VALUE(&__J7_DDR0_SS_BASE)+Var.VALUE(&__DDRSS_CTL_315__SFR_OFFS)))) %Long Var.VALUE(&__DDRSS0_CTL_315_DATA)
	Data.Set D:(((Var.VALUE(&__J7_DDR0_SS_BASE)+Var.VALUE(&__DDRSS_CTL_316__SFR_OFFS)))) %Long Var.VALUE(&__DDRSS0_CTL_316_DATA)
	Data.Set D:(((Var.VALUE(&__J7_DDR0_SS_BASE)+Var.VALUE(&__DDRSS_CTL_317__SFR_OFFS)))) %Long Var.VALUE(&__DDRSS0_CTL_317_DATA)
	Data.Set D:(((Var.VALUE(&__J7_DDR0_SS_BASE)+Var.VALUE(&__DDRSS_CTL_318__SFR_OFFS)))) %Long Var.VALUE(&__DDRSS0_CTL_318_DATA)
	Data.Set D:(((Var.VALUE(&__J7_DDR0_SS_BASE)+Var.VALUE(&__DDRSS_CTL_319__SFR_OFFS)))) %Long Var.VALUE(&__DDRSS0_CTL_319_DATA)
	Data.Set D:(((Var.VALUE(&__J7_DDR0_SS_BASE)+Var.VALUE(&__DDRSS_CTL_320__SFR_OFFS)))) %Long Var.VALUE(&__DDRSS0_CTL_320_DATA)
	Data.Set D:(((Var.VALUE(&__J7_DDR0_SS_BASE)+Var.VALUE(&__DDRSS_CTL_321__SFR_OFFS)))) %Long Var.VALUE(&__DDRSS0_CTL_321_DATA)
	Data.Set D:(((Var.VALUE(&__J7_DDR0_SS_BASE)+Var.VALUE(&__DDRSS_CTL_322__SFR_OFFS)))) %Long Var.VALUE(&__DDRSS0_CTL_322_DATA)
	Data.Set D:(((Var.VALUE(&__J7_DDR0_SS_BASE)+Var.VALUE(&__DDRSS_CTL_323__SFR_OFFS)))) %Long Var.VALUE(&__DDRSS0_CTL_323_DATA)
	Data.Set D:(((Var.VALUE(&__J7_DDR0_SS_BASE)+Var.VALUE(&__DDRSS_CTL_324__SFR_OFFS)))) %Long Var.VALUE(&__DDRSS0_CTL_324_DATA)
	Data.Set D:(((Var.VALUE(&__J7_DDR0_SS_BASE)+Var.VALUE(&__DDRSS_CTL_325__SFR_OFFS)))) %Long Var.VALUE(&__DDRSS0_CTL_325_DATA)
	Data.Set D:(((Var.VALUE(&__J7_DDR0_SS_BASE)+Var.VALUE(&__DDRSS_CTL_326__SFR_OFFS)))) %Long Var.VALUE(&__DDRSS0_CTL_326_DATA)
	Data.Set D:(((Var.VALUE(&__J7_DDR0_SS_BASE)+Var.VALUE(&__DDRSS_CTL_327__SFR_OFFS)))) %Long Var.VALUE(&__DDRSS0_CTL_327_DATA)
	Data.Set D:(((Var.VALUE(&__J7_DDR0_SS_BASE)+Var.VALUE(&__DDRSS_CTL_328__SFR_OFFS)))) %Long Var.VALUE(&__DDRSS0_CTL_328_DATA)
	Data.Set D:(((Var.VALUE(&__J7_DDR0_SS_BASE)+Var.VALUE(&__DDRSS_CTL_329__SFR_OFFS)))) %Long Var.VALUE(&__DDRSS0_CTL_329_DATA)
	Data.Set D:(((Var.VALUE(&__J7_DDR0_SS_BASE)+Var.VALUE(&__DDRSS_CTL_330__SFR_OFFS)))) %Long Var.VALUE(&__DDRSS0_CTL_330_DATA)
	Data.Set D:(((Var.VALUE(&__J7_DDR0_SS_BASE)+Var.VALUE(&__DDRSS_CTL_331__SFR_OFFS)))) %Long Var.VALUE(&__DDRSS0_CTL_331_DATA)
	Data.Set D:(((Var.VALUE(&__J7_DDR0_SS_BASE)+Var.VALUE(&__DDRSS_CTL_332__SFR_OFFS)))) %Long Var.VALUE(&__DDRSS0_CTL_332_DATA)
	Data.Set D:(((Var.VALUE(&__J7_DDR0_SS_BASE)+Var.VALUE(&__DDRSS_CTL_333__SFR_OFFS)))) %Long Var.VALUE(&__DDRSS0_CTL_333_DATA)
	Data.Set D:(((Var.VALUE(&__J7_DDR0_SS_BASE)+Var.VALUE(&__DDRSS_CTL_334__SFR_OFFS)))) %Long Var.VALUE(&__DDRSS0_CTL_334_DATA)
	Data.Set D:(((Var.VALUE(&__J7_DDR0_SS_BASE)+Var.VALUE(&__DDRSS_CTL_335__SFR_OFFS)))) %Long Var.VALUE(&__DDRSS0_CTL_335_DATA)
	Data.Set D:(((Var.VALUE(&__J7_DDR0_SS_BASE)+Var.VALUE(&__DDRSS_CTL_336__SFR_OFFS)))) %Long Var.VALUE(&__DDRSS0_CTL_336_DATA)
	Data.Set D:(((Var.VALUE(&__J7_DDR0_SS_BASE)+Var.VALUE(&__DDRSS_CTL_337__SFR_OFFS)))) %Long Var.VALUE(&__DDRSS0_CTL_337_DATA)
	Data.Set D:(((Var.VALUE(&__J7_DDR0_SS_BASE)+Var.VALUE(&__DDRSS_CTL_338__SFR_OFFS)))) %Long Var.VALUE(&__DDRSS0_CTL_338_DATA)
	Data.Set D:(((Var.VALUE(&__J7_DDR0_SS_BASE)+Var.VALUE(&__DDRSS_CTL_339__SFR_OFFS)))) %Long Var.VALUE(&__DDRSS0_CTL_339_DATA)
	Data.Set D:(((Var.VALUE(&__J7_DDR0_SS_BASE)+Var.VALUE(&__DDRSS_CTL_340__SFR_OFFS)))) %Long Var.VALUE(&__DDRSS0_CTL_340_DATA)
	Data.Set D:(((Var.VALUE(&__J7_DDR0_SS_BASE)+Var.VALUE(&__DDRSS_CTL_341__SFR_OFFS)))) %Long Var.VALUE(&__DDRSS0_CTL_341_DATA)
	Data.Set D:(((Var.VALUE(&__J7_DDR0_SS_BASE)+Var.VALUE(&__DDRSS_CTL_342__SFR_OFFS)))) %Long Var.VALUE(&__DDRSS0_CTL_342_DATA)
	Data.Set D:(((Var.VALUE(&__J7_DDR0_SS_BASE)+Var.VALUE(&__DDRSS_CTL_343__SFR_OFFS)))) %Long Var.VALUE(&__DDRSS0_CTL_343_DATA)
	Data.Set D:(((Var.VALUE(&__J7_DDR0_SS_BASE)+Var.VALUE(&__DDRSS_CTL_344__SFR_OFFS)))) %Long Var.VALUE(&__DDRSS0_CTL_344_DATA)
	Data.Set D:(((Var.VALUE(&__J7_DDR0_SS_BASE)+Var.VALUE(&__DDRSS_CTL_345__SFR_OFFS)))) %Long Var.VALUE(&__DDRSS0_CTL_345_DATA)
	Data.Set D:(((Var.VALUE(&__J7_DDR0_SS_BASE)+Var.VALUE(&__DDRSS_CTL_346__SFR_OFFS)))) %Long Var.VALUE(&__DDRSS0_CTL_346_DATA)
	Data.Set D:(((Var.VALUE(&__J7_DDR0_SS_BASE)+Var.VALUE(&__DDRSS_CTL_347__SFR_OFFS)))) %Long Var.VALUE(&__DDRSS0_CTL_347_DATA)
	Data.Set D:(((Var.VALUE(&__J7_DDR0_SS_BASE)+Var.VALUE(&__DDRSS_CTL_348__SFR_OFFS)))) %Long Var.VALUE(&__DDRSS0_CTL_348_DATA)
	Data.Set D:(((Var.VALUE(&__J7_DDR0_SS_BASE)+Var.VALUE(&__DDRSS_CTL_349__SFR_OFFS)))) %Long Var.VALUE(&__DDRSS0_CTL_349_DATA)
	Data.Set D:(((Var.VALUE(&__J7_DDR0_SS_BASE)+Var.VALUE(&__DDRSS_CTL_350__SFR_OFFS)))) %Long Var.VALUE(&__DDRSS0_CTL_350_DATA)
	Data.Set D:(((Var.VALUE(&__J7_DDR0_SS_BASE)+Var.VALUE(&__DDRSS_CTL_351__SFR_OFFS)))) %Long Var.VALUE(&__DDRSS0_CTL_351_DATA)
	Data.Set D:(((Var.VALUE(&__J7_DDR0_SS_BASE)+Var.VALUE(&__DDRSS_CTL_352__SFR_OFFS)))) %Long Var.VALUE(&__DDRSS0_CTL_352_DATA)
	Data.Set D:(((Var.VALUE(&__J7_DDR0_SS_BASE)+Var.VALUE(&__DDRSS_CTL_353__SFR_OFFS)))) %Long Var.VALUE(&__DDRSS0_CTL_353_DATA)
	Data.Set D:(((Var.VALUE(&__J7_DDR0_SS_BASE)+Var.VALUE(&__DDRSS_CTL_354__SFR_OFFS)))) %Long Var.VALUE(&__DDRSS0_CTL_354_DATA)
	Data.Set D:(((Var.VALUE(&__J7_DDR0_SS_BASE)+Var.VALUE(&__DDRSS_CTL_355__SFR_OFFS)))) %Long Var.VALUE(&__DDRSS0_CTL_355_DATA)
	Data.Set D:(((Var.VALUE(&__J7_DDR0_SS_BASE)+Var.VALUE(&__DDRSS_CTL_356__SFR_OFFS)))) %Long Var.VALUE(&__DDRSS0_CTL_356_DATA)
	Data.Set D:(((Var.VALUE(&__J7_DDR0_SS_BASE)+Var.VALUE(&__DDRSS_CTL_357__SFR_OFFS)))) %Long Var.VALUE(&__DDRSS0_CTL_357_DATA)
	Data.Set D:(((Var.VALUE(&__J7_DDR0_SS_BASE)+Var.VALUE(&__DDRSS_CTL_358__SFR_OFFS)))) %Long Var.VALUE(&__DDRSS0_CTL_358_DATA)
	Data.Set D:(((Var.VALUE(&__J7_DDR0_SS_BASE)+Var.VALUE(&__DDRSS_CTL_359__SFR_OFFS)))) %Long Var.VALUE(&__DDRSS0_CTL_359_DATA)
	Data.Set D:(((Var.VALUE(&__J7_DDR0_SS_BASE)+Var.VALUE(&__DDRSS_CTL_360__SFR_OFFS)))) %Long Var.VALUE(&__DDRSS0_CTL_360_DATA)
	Data.Set D:(((Var.VALUE(&__J7_DDR0_SS_BASE)+Var.VALUE(&__DDRSS_CTL_361__SFR_OFFS)))) %Long Var.VALUE(&__DDRSS0_CTL_361_DATA)
	Data.Set D:(((Var.VALUE(&__J7_DDR0_SS_BASE)+Var.VALUE(&__DDRSS_CTL_362__SFR_OFFS)))) %Long Var.VALUE(&__DDRSS0_CTL_362_DATA)
	Data.Set D:(((Var.VALUE(&__J7_DDR0_SS_BASE)+Var.VALUE(&__DDRSS_CTL_363__SFR_OFFS)))) %Long Var.VALUE(&__DDRSS0_CTL_363_DATA)
	Data.Set D:(((Var.VALUE(&__J7_DDR0_SS_BASE)+Var.VALUE(&__DDRSS_CTL_364__SFR_OFFS)))) %Long Var.VALUE(&__DDRSS0_CTL_364_DATA)
	Data.Set D:(((Var.VALUE(&__J7_DDR0_SS_BASE)+Var.VALUE(&__DDRSS_CTL_365__SFR_OFFS)))) %Long Var.VALUE(&__DDRSS0_CTL_365_DATA)
	Data.Set D:(((Var.VALUE(&__J7_DDR0_SS_BASE)+Var.VALUE(&__DDRSS_CTL_366__SFR_OFFS)))) %Long Var.VALUE(&__DDRSS0_CTL_366_DATA)
	Data.Set D:(((Var.VALUE(&__J7_DDR0_SS_BASE)+Var.VALUE(&__DDRSS_CTL_367__SFR_OFFS)))) %Long Var.VALUE(&__DDRSS0_CTL_367_DATA)
	Data.Set D:(((Var.VALUE(&__J7_DDR0_SS_BASE)+Var.VALUE(&__DDRSS_CTL_368__SFR_OFFS)))) %Long Var.VALUE(&__DDRSS0_CTL_368_DATA)
	Data.Set D:(((Var.VALUE(&__J7_DDR0_SS_BASE)+Var.VALUE(&__DDRSS_CTL_369__SFR_OFFS)))) %Long Var.VALUE(&__DDRSS0_CTL_369_DATA)
	Data.Set D:(((Var.VALUE(&__J7_DDR0_SS_BASE)+Var.VALUE(&__DDRSS_CTL_370__SFR_OFFS)))) %Long Var.VALUE(&__DDRSS0_CTL_370_DATA)
	Data.Set D:(((Var.VALUE(&__J7_DDR0_SS_BASE)+Var.VALUE(&__DDRSS_CTL_371__SFR_OFFS)))) %Long Var.VALUE(&__DDRSS0_CTL_371_DATA)
	Data.Set D:(((Var.VALUE(&__J7_DDR0_SS_BASE)+Var.VALUE(&__DDRSS_CTL_372__SFR_OFFS)))) %Long Var.VALUE(&__DDRSS0_CTL_372_DATA)
	Data.Set D:(((Var.VALUE(&__J7_DDR0_SS_BASE)+Var.VALUE(&__DDRSS_CTL_373__SFR_OFFS)))) %Long Var.VALUE(&__DDRSS0_CTL_373_DATA)
	Data.Set D:(((Var.VALUE(&__J7_DDR0_SS_BASE)+Var.VALUE(&__DDRSS_CTL_374__SFR_OFFS)))) %Long Var.VALUE(&__DDRSS0_CTL_374_DATA)
	Data.Set D:(((Var.VALUE(&__J7_DDR0_SS_BASE)+Var.VALUE(&__DDRSS_CTL_375__SFR_OFFS)))) %Long Var.VALUE(&__DDRSS0_CTL_375_DATA)
	Data.Set D:(((Var.VALUE(&__J7_DDR0_SS_BASE)+Var.VALUE(&__DDRSS_CTL_376__SFR_OFFS)))) %Long Var.VALUE(&__DDRSS0_CTL_376_DATA)
	Data.Set D:(((Var.VALUE(&__J7_DDR0_SS_BASE)+Var.VALUE(&__DDRSS_CTL_377__SFR_OFFS)))) %Long Var.VALUE(&__DDRSS0_CTL_377_DATA)
	Data.Set D:(((Var.VALUE(&__J7_DDR0_SS_BASE)+Var.VALUE(&__DDRSS_CTL_378__SFR_OFFS)))) %Long Var.VALUE(&__DDRSS0_CTL_378_DATA)
	Data.Set D:(((Var.VALUE(&__J7_DDR0_SS_BASE)+Var.VALUE(&__DDRSS_CTL_379__SFR_OFFS)))) %Long Var.VALUE(&__DDRSS0_CTL_379_DATA)
	Data.Set D:(((Var.VALUE(&__J7_DDR0_SS_BASE)+Var.VALUE(&__DDRSS_CTL_380__SFR_OFFS)))) %Long Var.VALUE(&__DDRSS0_CTL_380_DATA)
	Data.Set D:(((Var.VALUE(&__J7_DDR0_SS_BASE)+Var.VALUE(&__DDRSS_CTL_381__SFR_OFFS)))) %Long Var.VALUE(&__DDRSS0_CTL_381_DATA)
	Data.Set D:(((Var.VALUE(&__J7_DDR0_SS_BASE)+Var.VALUE(&__DDRSS_CTL_382__SFR_OFFS)))) %Long Var.VALUE(&__DDRSS0_CTL_382_DATA)
	Data.Set D:(((Var.VALUE(&__J7_DDR0_SS_BASE)+Var.VALUE(&__DDRSS_CTL_383__SFR_OFFS)))) %Long Var.VALUE(&__DDRSS0_CTL_383_DATA)
	Data.Set D:(((Var.VALUE(&__J7_DDR0_SS_BASE)+Var.VALUE(&__DDRSS_CTL_384__SFR_OFFS)))) %Long Var.VALUE(&__DDRSS0_CTL_384_DATA)
	Data.Set D:(((Var.VALUE(&__J7_DDR0_SS_BASE)+Var.VALUE(&__DDRSS_CTL_385__SFR_OFFS)))) %Long Var.VALUE(&__DDRSS0_CTL_385_DATA)
	Data.Set D:(((Var.VALUE(&__J7_DDR0_SS_BASE)+Var.VALUE(&__DDRSS_CTL_386__SFR_OFFS)))) %Long Var.VALUE(&__DDRSS0_CTL_386_DATA)
	Data.Set D:(((Var.VALUE(&__J7_DDR0_SS_BASE)+Var.VALUE(&__DDRSS_CTL_387__SFR_OFFS)))) %Long Var.VALUE(&__DDRSS0_CTL_387_DATA)
	Data.Set D:(((Var.VALUE(&__J7_DDR0_SS_BASE)+Var.VALUE(&__DDRSS_CTL_388__SFR_OFFS)))) %Long Var.VALUE(&__DDRSS0_CTL_388_DATA)
	Data.Set D:(((Var.VALUE(&__J7_DDR0_SS_BASE)+Var.VALUE(&__DDRSS_CTL_389__SFR_OFFS)))) %Long Var.VALUE(&__DDRSS0_CTL_389_DATA)
	Data.Set D:(((Var.VALUE(&__J7_DDR0_SS_BASE)+Var.VALUE(&__DDRSS_CTL_390__SFR_OFFS)))) %Long Var.VALUE(&__DDRSS0_CTL_390_DATA)
	Data.Set D:(((Var.VALUE(&__J7_DDR0_SS_BASE)+Var.VALUE(&__DDRSS_CTL_391__SFR_OFFS)))) %Long Var.VALUE(&__DDRSS0_CTL_391_DATA)
	Data.Set D:(((Var.VALUE(&__J7_DDR0_SS_BASE)+Var.VALUE(&__DDRSS_CTL_392__SFR_OFFS)))) %Long Var.VALUE(&__DDRSS0_CTL_392_DATA)
	Data.Set D:(((Var.VALUE(&__J7_DDR0_SS_BASE)+Var.VALUE(&__DDRSS_CTL_393__SFR_OFFS)))) %Long Var.VALUE(&__DDRSS0_CTL_393_DATA)
	Data.Set D:(((Var.VALUE(&__J7_DDR0_SS_BASE)+Var.VALUE(&__DDRSS_CTL_394__SFR_OFFS)))) %Long Var.VALUE(&__DDRSS0_CTL_394_DATA)
	Data.Set D:(((Var.VALUE(&__J7_DDR0_SS_BASE)+Var.VALUE(&__DDRSS_CTL_395__SFR_OFFS)))) %Long Var.VALUE(&__DDRSS0_CTL_395_DATA)
	Data.Set D:(((Var.VALUE(&__J7_DDR0_SS_BASE)+Var.VALUE(&__DDRSS_CTL_396__SFR_OFFS)))) %Long Var.VALUE(&__DDRSS0_CTL_396_DATA)
	Data.Set D:(((Var.VALUE(&__J7_DDR0_SS_BASE)+Var.VALUE(&__DDRSS_CTL_397__SFR_OFFS)))) %Long Var.VALUE(&__DDRSS0_CTL_397_DATA)
	Data.Set D:(((Var.VALUE(&__J7_DDR0_SS_BASE)+Var.VALUE(&__DDRSS_CTL_398__SFR_OFFS)))) %Long Var.VALUE(&__DDRSS0_CTL_398_DATA)
	Data.Set D:(((Var.VALUE(&__J7_DDR0_SS_BASE)+Var.VALUE(&__DDRSS_CTL_399__SFR_OFFS)))) %Long Var.VALUE(&__DDRSS0_CTL_399_DATA)
	Data.Set D:(((Var.VALUE(&__J7_DDR0_SS_BASE)+Var.VALUE(&__DDRSS_CTL_400__SFR_OFFS)))) %Long Var.VALUE(&__DDRSS0_CTL_400_DATA)
	Data.Set D:(((Var.VALUE(&__J7_DDR0_SS_BASE)+Var.VALUE(&__DDRSS_CTL_401__SFR_OFFS)))) %Long Var.VALUE(&__DDRSS0_CTL_401_DATA)
	Data.Set D:(((Var.VALUE(&__J7_DDR0_SS_BASE)+Var.VALUE(&__DDRSS_CTL_402__SFR_OFFS)))) %Long Var.VALUE(&__DDRSS0_CTL_402_DATA)
	Data.Set D:(((Var.VALUE(&__J7_DDR0_SS_BASE)+Var.VALUE(&__DDRSS_CTL_403__SFR_OFFS)))) %Long Var.VALUE(&__DDRSS0_CTL_403_DATA)
	Data.Set D:(((Var.VALUE(&__J7_DDR0_SS_BASE)+Var.VALUE(&__DDRSS_CTL_404__SFR_OFFS)))) %Long Var.VALUE(&__DDRSS0_CTL_404_DATA)
	Data.Set D:(((Var.VALUE(&__J7_DDR0_SS_BASE)+Var.VALUE(&__DDRSS_CTL_405__SFR_OFFS)))) %Long Var.VALUE(&__DDRSS0_CTL_405_DATA)
	Data.Set D:(((Var.VALUE(&__J7_DDR0_SS_BASE)+Var.VALUE(&__DDRSS_CTL_406__SFR_OFFS)))) %Long Var.VALUE(&__DDRSS0_CTL_406_DATA)
	Data.Set D:(((Var.VALUE(&__J7_DDR0_SS_BASE)+Var.VALUE(&__DDRSS_CTL_407__SFR_OFFS)))) %Long Var.VALUE(&__DDRSS0_CTL_407_DATA)
	Data.Set D:(((Var.VALUE(&__J7_DDR0_SS_BASE)+Var.VALUE(&__DDRSS_CTL_408__SFR_OFFS)))) %Long Var.VALUE(&__DDRSS0_CTL_408_DATA)
	Data.Set D:(((Var.VALUE(&__J7_DDR0_SS_BASE)+Var.VALUE(&__DDRSS_CTL_409__SFR_OFFS)))) %Long Var.VALUE(&__DDRSS0_CTL_409_DATA)
	Data.Set D:(((Var.VALUE(&__J7_DDR0_SS_BASE)+Var.VALUE(&__DDRSS_CTL_410__SFR_OFFS)))) %Long Var.VALUE(&__DDRSS0_CTL_410_DATA)
	Data.Set D:(((Var.VALUE(&__J7_DDR0_SS_BASE)+Var.VALUE(&__DDRSS_CTL_411__SFR_OFFS)))) %Long Var.VALUE(&__DDRSS0_CTL_411_DATA)
	Data.Set D:(((Var.VALUE(&__J7_DDR0_SS_BASE)+Var.VALUE(&__DDRSS_CTL_412__SFR_OFFS)))) %Long Var.VALUE(&__DDRSS0_CTL_412_DATA)
	Data.Set D:(((Var.VALUE(&__J7_DDR0_SS_BASE)+Var.VALUE(&__DDRSS_CTL_413__SFR_OFFS)))) %Long Var.VALUE(&__DDRSS0_CTL_413_DATA)
	Data.Set D:(((Var.VALUE(&__J7_DDR0_SS_BASE)+Var.VALUE(&__DDRSS_CTL_414__SFR_OFFS)))) %Long Var.VALUE(&__DDRSS0_CTL_414_DATA)
	Data.Set D:(((Var.VALUE(&__J7_DDR0_SS_BASE)+Var.VALUE(&__DDRSS_CTL_415__SFR_OFFS)))) %Long Var.VALUE(&__DDRSS0_CTL_415_DATA)
	Data.Set D:(((Var.VALUE(&__J7_DDR0_SS_BASE)+Var.VALUE(&__DDRSS_CTL_416__SFR_OFFS)))) %Long Var.VALUE(&__DDRSS0_CTL_416_DATA)
	Data.Set D:(((Var.VALUE(&__J7_DDR0_SS_BASE)+Var.VALUE(&__DDRSS_CTL_417__SFR_OFFS)))) %Long Var.VALUE(&__DDRSS0_CTL_417_DATA)
	Data.Set D:(((Var.VALUE(&__J7_DDR0_SS_BASE)+Var.VALUE(&__DDRSS_CTL_418__SFR_OFFS)))) %Long Var.VALUE(&__DDRSS0_CTL_418_DATA)
	Data.Set D:(((Var.VALUE(&__J7_DDR0_SS_BASE)+Var.VALUE(&__DDRSS_CTL_419__SFR_OFFS)))) %Long Var.VALUE(&__DDRSS0_CTL_419_DATA)
	Data.Set D:(((Var.VALUE(&__J7_DDR0_SS_BASE)+Var.VALUE(&__DDRSS_CTL_420__SFR_OFFS)))) %Long Var.VALUE(&__DDRSS0_CTL_420_DATA)
	Data.Set D:(((Var.VALUE(&__J7_DDR0_SS_BASE)+Var.VALUE(&__DDRSS_CTL_421__SFR_OFFS)))) %Long Var.VALUE(&__DDRSS0_CTL_421_DATA)
	Data.Set D:(((Var.VALUE(&__J7_DDR0_SS_BASE)+Var.VALUE(&__DDRSS_CTL_422__SFR_OFFS)))) %Long Var.VALUE(&__DDRSS0_CTL_422_DATA)
	Data.Set D:(((Var.VALUE(&__J7_DDR0_SS_BASE)+Var.VALUE(&__DDRSS_CTL_423__SFR_OFFS)))) %Long Var.VALUE(&__DDRSS0_CTL_423_DATA)
	Data.Set D:(((Var.VALUE(&__J7_DDR0_SS_BASE)+Var.VALUE(&__DDRSS_CTL_424__SFR_OFFS)))) %Long Var.VALUE(&__DDRSS0_CTL_424_DATA)
	Data.Set D:(((Var.VALUE(&__J7_DDR0_SS_BASE)+Var.VALUE(&__DDRSS_CTL_425__SFR_OFFS)))) %Long Var.VALUE(&__DDRSS0_CTL_425_DATA)
	Data.Set D:(((Var.VALUE(&__J7_DDR0_SS_BASE)+Var.VALUE(&__DDRSS_CTL_426__SFR_OFFS)))) %Long Var.VALUE(&__DDRSS0_CTL_426_DATA)
	Data.Set D:(((Var.VALUE(&__J7_DDR0_SS_BASE)+Var.VALUE(&__DDRSS_CTL_427__SFR_OFFS)))) %Long Var.VALUE(&__DDRSS0_CTL_427_DATA)
	Data.Set D:(((Var.VALUE(&__J7_DDR0_SS_BASE)+Var.VALUE(&__DDRSS_CTL_428__SFR_OFFS)))) %Long Var.VALUE(&__DDRSS0_CTL_428_DATA)
	Data.Set D:(((Var.VALUE(&__J7_DDR0_SS_BASE)+Var.VALUE(&__DDRSS_CTL_429__SFR_OFFS)))) %Long Var.VALUE(&__DDRSS0_CTL_429_DATA)
	Data.Set D:(((Var.VALUE(&__J7_DDR0_SS_BASE)+Var.VALUE(&__DDRSS_CTL_430__SFR_OFFS)))) %Long Var.VALUE(&__DDRSS0_CTL_430_DATA)
	Data.Set D:(((Var.VALUE(&__J7_DDR0_SS_BASE)+Var.VALUE(&__DDRSS_CTL_431__SFR_OFFS)))) %Long Var.VALUE(&__DDRSS0_CTL_431_DATA)
	Data.Set D:(((Var.VALUE(&__J7_DDR0_SS_BASE)+Var.VALUE(&__DDRSS_CTL_432__SFR_OFFS)))) %Long Var.VALUE(&__DDRSS0_CTL_432_DATA)
	Data.Set D:(((Var.VALUE(&__J7_DDR0_SS_BASE)+Var.VALUE(&__DDRSS_CTL_433__SFR_OFFS)))) %Long Var.VALUE(&__DDRSS0_CTL_433_DATA)
	Data.Set D:(((Var.VALUE(&__J7_DDR0_SS_BASE)+Var.VALUE(&__DDRSS_CTL_434__SFR_OFFS)))) %Long Var.VALUE(&__DDRSS0_CTL_434_DATA)
	Data.Set D:(((Var.VALUE(&__J7_DDR0_SS_BASE)+Var.VALUE(&__DDRSS_CTL_435__SFR_OFFS)))) %Long Var.VALUE(&__DDRSS0_CTL_435_DATA)
	Data.Set D:(((Var.VALUE(&__J7_DDR0_SS_BASE)+Var.VALUE(&__DDRSS_CTL_436__SFR_OFFS)))) %Long Var.VALUE(&__DDRSS0_CTL_436_DATA)
	Data.Set D:(((Var.VALUE(&__J7_DDR0_SS_BASE)+Var.VALUE(&__DDRSS_CTL_437__SFR_OFFS)))) %Long Var.VALUE(&__DDRSS0_CTL_437_DATA)
	Data.Set D:(((Var.VALUE(&__J7_DDR0_SS_BASE)+Var.VALUE(&__DDRSS_CTL_438__SFR_OFFS)))) %Long Var.VALUE(&__DDRSS0_CTL_438_DATA)
	Data.Set D:(((Var.VALUE(&__J7_DDR0_SS_BASE)+Var.VALUE(&__DDRSS_CTL_439__SFR_OFFS)))) %Long Var.VALUE(&__DDRSS0_CTL_439_DATA)
	Data.Set D:(((Var.VALUE(&__J7_DDR0_SS_BASE)+Var.VALUE(&__DDRSS_CTL_440__SFR_OFFS)))) %Long Var.VALUE(&__DDRSS0_CTL_440_DATA)
	Data.Set D:(((Var.VALUE(&__J7_DDR0_SS_BASE)+Var.VALUE(&__DDRSS_CTL_441__SFR_OFFS)))) %Long Var.VALUE(&__DDRSS0_CTL_441_DATA)
	Data.Set D:(((Var.VALUE(&__J7_DDR0_SS_BASE)+Var.VALUE(&__DDRSS_CTL_442__SFR_OFFS)))) %Long Var.VALUE(&__DDRSS0_CTL_442_DATA)
	Data.Set D:(((Var.VALUE(&__J7_DDR0_SS_BASE)+Var.VALUE(&__DDRSS_CTL_443__SFR_OFFS)))) %Long Var.VALUE(&__DDRSS0_CTL_443_DATA)
	Data.Set D:(((Var.VALUE(&__J7_DDR0_SS_BASE)+Var.VALUE(&__DDRSS_CTL_444__SFR_OFFS)))) %Long Var.VALUE(&__DDRSS0_CTL_444_DATA)
	Data.Set D:(((Var.VALUE(&__J7_DDR0_SS_BASE)+Var.VALUE(&__DDRSS_CTL_445__SFR_OFFS)))) %Long Var.VALUE(&__DDRSS0_CTL_445_DATA)
	Data.Set D:(((Var.VALUE(&__J7_DDR0_SS_BASE)+Var.VALUE(&__DDRSS_CTL_446__SFR_OFFS)))) %Long Var.VALUE(&__DDRSS0_CTL_446_DATA)
	Data.Set D:(((Var.VALUE(&__J7_DDR0_SS_BASE)+Var.VALUE(&__DDRSS_CTL_447__SFR_OFFS)))) %Long Var.VALUE(&__DDRSS0_CTL_447_DATA)
	Data.Set D:(((Var.VALUE(&__J7_DDR0_SS_BASE)+Var.VALUE(&__DDRSS_CTL_448__SFR_OFFS)))) %Long Var.VALUE(&__DDRSS0_CTL_448_DATA)
	Data.Set D:(((Var.VALUE(&__J7_DDR0_SS_BASE)+Var.VALUE(&__DDRSS_CTL_449__SFR_OFFS)))) %Long Var.VALUE(&__DDRSS0_CTL_449_DATA)
	Data.Set D:(((Var.VALUE(&__J7_DDR0_SS_BASE)+Var.VALUE(&__DDRSS_CTL_450__SFR_OFFS)))) %Long Var.VALUE(&__DDRSS0_CTL_450_DATA)
	Data.Set D:(((Var.VALUE(&__J7_DDR0_SS_BASE)+Var.VALUE(&__DDRSS_CTL_451__SFR_OFFS)))) %Long Var.VALUE(&__DDRSS0_CTL_451_DATA)
	Data.Set D:(((Var.VALUE(&__J7_DDR0_SS_BASE)+Var.VALUE(&__DDRSS_CTL_452__SFR_OFFS)))) %Long Var.VALUE(&__DDRSS0_CTL_452_DATA)
	Data.Set D:(((Var.VALUE(&__J7_DDR0_SS_BASE)+Var.VALUE(&__DDRSS_CTL_453__SFR_OFFS)))) %Long Var.VALUE(&__DDRSS0_CTL_453_DATA)
	Data.Set D:(((Var.VALUE(&__J7_DDR0_SS_BASE)+Var.VALUE(&__DDRSS_CTL_454__SFR_OFFS)))) %Long Var.VALUE(&__DDRSS0_CTL_454_DATA)
	Data.Set D:(((Var.VALUE(&__J7_DDR0_SS_BASE)+Var.VALUE(&__DDRSS_CTL_455__SFR_OFFS)))) %Long Var.VALUE(&__DDRSS0_CTL_455_DATA)
	Data.Set D:(((Var.VALUE(&__J7_DDR0_SS_BASE)+Var.VALUE(&__DDRSS_CTL_456__SFR_OFFS)))) %Long Var.VALUE(&__DDRSS0_CTL_456_DATA)
	Data.Set D:(((Var.VALUE(&__J7_DDR0_SS_BASE)+Var.VALUE(&__DDRSS_CTL_457__SFR_OFFS)))) %Long Var.VALUE(&__DDRSS0_CTL_457_DATA)
	Data.Set D:(((Var.VALUE(&__J7_DDR0_SS_BASE)+Var.VALUE(&__DDRSS_CTL_458__SFR_OFFS)))) %Long Var.VALUE(&__DDRSS0_CTL_458_DATA)
	Var.NEWLOCAL char[128] \strtmp = "--->>> DDR0 controller programming completed... <<<---\n"
	GOSUB printf Var.String(\strtmp)
	
	Var.NEWLOCAL char[128] \strtmp = "--->>> DDR0 PI programming in progress.. <<<---\n"
	GOSUB printf Var.String(\strtmp)
	
	Data.Set D:((((Var.VALUE(&__J7_DDR0_SS_BASE)+Var.VALUE(&__DDRSS_PI_REGISTER_BLOCK__OFFS))+Var.VALUE(&__DDRSS_PI_0__SFR_OFFS)))) %Long Var.VALUE(&__DDRSS0_PI_00_DATA)
	Data.Set D:((((Var.VALUE(&__J7_DDR0_SS_BASE)+Var.VALUE(&__DDRSS_PI_REGISTER_BLOCK__OFFS))+Var.VALUE(&__DDRSS_PI_1__SFR_OFFS)))) %Long Var.VALUE(&__DDRSS0_PI_01_DATA)
	Data.Set D:((((Var.VALUE(&__J7_DDR0_SS_BASE)+Var.VALUE(&__DDRSS_PI_REGISTER_BLOCK__OFFS))+Var.VALUE(&__DDRSS_PI_2__SFR_OFFS)))) %Long Var.VALUE(&__DDRSS0_PI_02_DATA)
	Data.Set D:((((Var.VALUE(&__J7_DDR0_SS_BASE)+Var.VALUE(&__DDRSS_PI_REGISTER_BLOCK__OFFS))+Var.VALUE(&__DDRSS_PI_3__SFR_OFFS)))) %Long Var.VALUE(&__DDRSS0_PI_03_DATA)
	Data.Set D:((((Var.VALUE(&__J7_DDR0_SS_BASE)+Var.VALUE(&__DDRSS_PI_REGISTER_BLOCK__OFFS))+Var.VALUE(&__DDRSS_PI_4__SFR_OFFS)))) %Long Var.VALUE(&__DDRSS0_PI_04_DATA)
	Data.Set D:((((Var.VALUE(&__J7_DDR0_SS_BASE)+Var.VALUE(&__DDRSS_PI_REGISTER_BLOCK__OFFS))+Var.VALUE(&__DDRSS_PI_5__SFR_OFFS)))) %Long Var.VALUE(&__DDRSS0_PI_05_DATA)
	Data.Set D:((((Var.VALUE(&__J7_DDR0_SS_BASE)+Var.VALUE(&__DDRSS_PI_REGISTER_BLOCK__OFFS))+Var.VALUE(&__DDRSS_PI_6__SFR_OFFS)))) %Long Var.VALUE(&__DDRSS0_PI_06_DATA)
	Data.Set D:((((Var.VALUE(&__J7_DDR0_SS_BASE)+Var.VALUE(&__DDRSS_PI_REGISTER_BLOCK__OFFS))+Var.VALUE(&__DDRSS_PI_7__SFR_OFFS)))) %Long Var.VALUE(&__DDRSS0_PI_07_DATA)
	Data.Set D:((((Var.VALUE(&__J7_DDR0_SS_BASE)+Var.VALUE(&__DDRSS_PI_REGISTER_BLOCK__OFFS))+Var.VALUE(&__DDRSS_PI_8__SFR_OFFS)))) %Long Var.VALUE(&__DDRSS0_PI_08_DATA)
	Data.Set D:((((Var.VALUE(&__J7_DDR0_SS_BASE)+Var.VALUE(&__DDRSS_PI_REGISTER_BLOCK__OFFS))+Var.VALUE(&__DDRSS_PI_9__SFR_OFFS)))) %Long Var.VALUE(&__DDRSS0_PI_09_DATA)
	Data.Set D:((((Var.VALUE(&__J7_DDR0_SS_BASE)+Var.VALUE(&__DDRSS_PI_REGISTER_BLOCK__OFFS))+Var.VALUE(&__DDRSS_PI_10__SFR_OFFS)))) %Long Var.VALUE(&__DDRSS0_PI_10_DATA)
	Data.Set D:((((Var.VALUE(&__J7_DDR0_SS_BASE)+Var.VALUE(&__DDRSS_PI_REGISTER_BLOCK__OFFS))+Var.VALUE(&__DDRSS_PI_11__SFR_OFFS)))) %Long Var.VALUE(&__DDRSS0_PI_11_DATA)
	Data.Set D:((((Var.VALUE(&__J7_DDR0_SS_BASE)+Var.VALUE(&__DDRSS_PI_REGISTER_BLOCK__OFFS))+Var.VALUE(&__DDRSS_PI_12__SFR_OFFS)))) %Long Var.VALUE(&__DDRSS0_PI_12_DATA)
	Data.Set D:((((Var.VALUE(&__J7_DDR0_SS_BASE)+Var.VALUE(&__DDRSS_PI_REGISTER_BLOCK__OFFS))+Var.VALUE(&__DDRSS_PI_13__SFR_OFFS)))) %Long Var.VALUE(&__DDRSS0_PI_13_DATA)
	Data.Set D:((((Var.VALUE(&__J7_DDR0_SS_BASE)+Var.VALUE(&__DDRSS_PI_REGISTER_BLOCK__OFFS))+Var.VALUE(&__DDRSS_PI_14__SFR_OFFS)))) %Long Var.VALUE(&__DDRSS0_PI_14_DATA)
	Data.Set D:((((Var.VALUE(&__J7_DDR0_SS_BASE)+Var.VALUE(&__DDRSS_PI_REGISTER_BLOCK__OFFS))+Var.VALUE(&__DDRSS_PI_15__SFR_OFFS)))) %Long Var.VALUE(&__DDRSS0_PI_15_DATA)
	Data.Set D:((((Var.VALUE(&__J7_DDR0_SS_BASE)+Var.VALUE(&__DDRSS_PI_REGISTER_BLOCK__OFFS))+Var.VALUE(&__DDRSS_PI_16__SFR_OFFS)))) %Long Var.VALUE(&__DDRSS0_PI_16_DATA)
	Data.Set D:((((Var.VALUE(&__J7_DDR0_SS_BASE)+Var.VALUE(&__DDRSS_PI_REGISTER_BLOCK__OFFS))+Var.VALUE(&__DDRSS_PI_17__SFR_OFFS)))) %Long Var.VALUE(&__DDRSS0_PI_17_DATA)
	Data.Set D:((((Var.VALUE(&__J7_DDR0_SS_BASE)+Var.VALUE(&__DDRSS_PI_REGISTER_BLOCK__OFFS))+Var.VALUE(&__DDRSS_PI_18__SFR_OFFS)))) %Long Var.VALUE(&__DDRSS0_PI_18_DATA)
	Data.Set D:((((Var.VALUE(&__J7_DDR0_SS_BASE)+Var.VALUE(&__DDRSS_PI_REGISTER_BLOCK__OFFS))+Var.VALUE(&__DDRSS_PI_19__SFR_OFFS)))) %Long Var.VALUE(&__DDRSS0_PI_19_DATA)
	Data.Set D:((((Var.VALUE(&__J7_DDR0_SS_BASE)+Var.VALUE(&__DDRSS_PI_REGISTER_BLOCK__OFFS))+Var.VALUE(&__DDRSS_PI_20__SFR_OFFS)))) %Long Var.VALUE(&__DDRSS0_PI_20_DATA)
	Data.Set D:((((Var.VALUE(&__J7_DDR0_SS_BASE)+Var.VALUE(&__DDRSS_PI_REGISTER_BLOCK__OFFS))+Var.VALUE(&__DDRSS_PI_21__SFR_OFFS)))) %Long Var.VALUE(&__DDRSS0_PI_21_DATA)
	Data.Set D:((((Var.VALUE(&__J7_DDR0_SS_BASE)+Var.VALUE(&__DDRSS_PI_REGISTER_BLOCK__OFFS))+Var.VALUE(&__DDRSS_PI_22__SFR_OFFS)))) %Long Var.VALUE(&__DDRSS0_PI_22_DATA)
	Data.Set D:((((Var.VALUE(&__J7_DDR0_SS_BASE)+Var.VALUE(&__DDRSS_PI_REGISTER_BLOCK__OFFS))+Var.VALUE(&__DDRSS_PI_23__SFR_OFFS)))) %Long Var.VALUE(&__DDRSS0_PI_23_DATA)
	Data.Set D:((((Var.VALUE(&__J7_DDR0_SS_BASE)+Var.VALUE(&__DDRSS_PI_REGISTER_BLOCK__OFFS))+Var.VALUE(&__DDRSS_PI_24__SFR_OFFS)))) %Long Var.VALUE(&__DDRSS0_PI_24_DATA)
	Data.Set D:((((Var.VALUE(&__J7_DDR0_SS_BASE)+Var.VALUE(&__DDRSS_PI_REGISTER_BLOCK__OFFS))+Var.VALUE(&__DDRSS_PI_25__SFR_OFFS)))) %Long Var.VALUE(&__DDRSS0_PI_25_DATA)
	Data.Set D:((((Var.VALUE(&__J7_DDR0_SS_BASE)+Var.VALUE(&__DDRSS_PI_REGISTER_BLOCK__OFFS))+Var.VALUE(&__DDRSS_PI_26__SFR_OFFS)))) %Long Var.VALUE(&__DDRSS0_PI_26_DATA)
	Data.Set D:((((Var.VALUE(&__J7_DDR0_SS_BASE)+Var.VALUE(&__DDRSS_PI_REGISTER_BLOCK__OFFS))+Var.VALUE(&__DDRSS_PI_27__SFR_OFFS)))) %Long Var.VALUE(&__DDRSS0_PI_27_DATA)
	Data.Set D:((((Var.VALUE(&__J7_DDR0_SS_BASE)+Var.VALUE(&__DDRSS_PI_REGISTER_BLOCK__OFFS))+Var.VALUE(&__DDRSS_PI_28__SFR_OFFS)))) %Long Var.VALUE(&__DDRSS0_PI_28_DATA)
	Data.Set D:((((Var.VALUE(&__J7_DDR0_SS_BASE)+Var.VALUE(&__DDRSS_PI_REGISTER_BLOCK__OFFS))+Var.VALUE(&__DDRSS_PI_29__SFR_OFFS)))) %Long Var.VALUE(&__DDRSS0_PI_29_DATA)
	Data.Set D:((((Var.VALUE(&__J7_DDR0_SS_BASE)+Var.VALUE(&__DDRSS_PI_REGISTER_BLOCK__OFFS))+Var.VALUE(&__DDRSS_PI_30__SFR_OFFS)))) %Long Var.VALUE(&__DDRSS0_PI_30_DATA)
	Data.Set D:((((Var.VALUE(&__J7_DDR0_SS_BASE)+Var.VALUE(&__DDRSS_PI_REGISTER_BLOCK__OFFS))+Var.VALUE(&__DDRSS_PI_31__SFR_OFFS)))) %Long Var.VALUE(&__DDRSS0_PI_31_DATA)
	Data.Set D:((((Var.VALUE(&__J7_DDR0_SS_BASE)+Var.VALUE(&__DDRSS_PI_REGISTER_BLOCK__OFFS))+Var.VALUE(&__DDRSS_PI_32__SFR_OFFS)))) %Long Var.VALUE(&__DDRSS0_PI_32_DATA)
	Data.Set D:((((Var.VALUE(&__J7_DDR0_SS_BASE)+Var.VALUE(&__DDRSS_PI_REGISTER_BLOCK__OFFS))+Var.VALUE(&__DDRSS_PI_33__SFR_OFFS)))) %Long Var.VALUE(&__DDRSS0_PI_33_DATA)
	Data.Set D:((((Var.VALUE(&__J7_DDR0_SS_BASE)+Var.VALUE(&__DDRSS_PI_REGISTER_BLOCK__OFFS))+Var.VALUE(&__DDRSS_PI_34__SFR_OFFS)))) %Long Var.VALUE(&__DDRSS0_PI_34_DATA)
	Data.Set D:((((Var.VALUE(&__J7_DDR0_SS_BASE)+Var.VALUE(&__DDRSS_PI_REGISTER_BLOCK__OFFS))+Var.VALUE(&__DDRSS_PI_35__SFR_OFFS)))) %Long Var.VALUE(&__DDRSS0_PI_35_DATA)
	Data.Set D:((((Var.VALUE(&__J7_DDR0_SS_BASE)+Var.VALUE(&__DDRSS_PI_REGISTER_BLOCK__OFFS))+Var.VALUE(&__DDRSS_PI_36__SFR_OFFS)))) %Long Var.VALUE(&__DDRSS0_PI_36_DATA)
	Data.Set D:((((Var.VALUE(&__J7_DDR0_SS_BASE)+Var.VALUE(&__DDRSS_PI_REGISTER_BLOCK__OFFS))+Var.VALUE(&__DDRSS_PI_37__SFR_OFFS)))) %Long Var.VALUE(&__DDRSS0_PI_37_DATA)
	Data.Set D:((((Var.VALUE(&__J7_DDR0_SS_BASE)+Var.VALUE(&__DDRSS_PI_REGISTER_BLOCK__OFFS))+Var.VALUE(&__DDRSS_PI_38__SFR_OFFS)))) %Long Var.VALUE(&__DDRSS0_PI_38_DATA)
	Data.Set D:((((Var.VALUE(&__J7_DDR0_SS_BASE)+Var.VALUE(&__DDRSS_PI_REGISTER_BLOCK__OFFS))+Var.VALUE(&__DDRSS_PI_39__SFR_OFFS)))) %Long Var.VALUE(&__DDRSS0_PI_39_DATA)
	Data.Set D:((((Var.VALUE(&__J7_DDR0_SS_BASE)+Var.VALUE(&__DDRSS_PI_REGISTER_BLOCK__OFFS))+Var.VALUE(&__DDRSS_PI_40__SFR_OFFS)))) %Long Var.VALUE(&__DDRSS0_PI_40_DATA)
	Data.Set D:((((Var.VALUE(&__J7_DDR0_SS_BASE)+Var.VALUE(&__DDRSS_PI_REGISTER_BLOCK__OFFS))+Var.VALUE(&__DDRSS_PI_41__SFR_OFFS)))) %Long Var.VALUE(&__DDRSS0_PI_41_DATA)
	Data.Set D:((((Var.VALUE(&__J7_DDR0_SS_BASE)+Var.VALUE(&__DDRSS_PI_REGISTER_BLOCK__OFFS))+Var.VALUE(&__DDRSS_PI_42__SFR_OFFS)))) %Long Var.VALUE(&__DDRSS0_PI_42_DATA)
	Data.Set D:((((Var.VALUE(&__J7_DDR0_SS_BASE)+Var.VALUE(&__DDRSS_PI_REGISTER_BLOCK__OFFS))+Var.VALUE(&__DDRSS_PI_43__SFR_OFFS)))) %Long Var.VALUE(&__DDRSS0_PI_43_DATA)
	Data.Set D:((((Var.VALUE(&__J7_DDR0_SS_BASE)+Var.VALUE(&__DDRSS_PI_REGISTER_BLOCK__OFFS))+Var.VALUE(&__DDRSS_PI_44__SFR_OFFS)))) %Long Var.VALUE(&__DDRSS0_PI_44_DATA)
	Data.Set D:((((Var.VALUE(&__J7_DDR0_SS_BASE)+Var.VALUE(&__DDRSS_PI_REGISTER_BLOCK__OFFS))+Var.VALUE(&__DDRSS_PI_45__SFR_OFFS)))) %Long Var.VALUE(&__DDRSS0_PI_45_DATA)
	Data.Set D:((((Var.VALUE(&__J7_DDR0_SS_BASE)+Var.VALUE(&__DDRSS_PI_REGISTER_BLOCK__OFFS))+Var.VALUE(&__DDRSS_PI_46__SFR_OFFS)))) %Long Var.VALUE(&__DDRSS0_PI_46_DATA)
	Data.Set D:((((Var.VALUE(&__J7_DDR0_SS_BASE)+Var.VALUE(&__DDRSS_PI_REGISTER_BLOCK__OFFS))+Var.VALUE(&__DDRSS_PI_47__SFR_OFFS)))) %Long Var.VALUE(&__DDRSS0_PI_47_DATA)
	Data.Set D:((((Var.VALUE(&__J7_DDR0_SS_BASE)+Var.VALUE(&__DDRSS_PI_REGISTER_BLOCK__OFFS))+Var.VALUE(&__DDRSS_PI_48__SFR_OFFS)))) %Long Var.VALUE(&__DDRSS0_PI_48_DATA)
	Data.Set D:((((Var.VALUE(&__J7_DDR0_SS_BASE)+Var.VALUE(&__DDRSS_PI_REGISTER_BLOCK__OFFS))+Var.VALUE(&__DDRSS_PI_49__SFR_OFFS)))) %Long Var.VALUE(&__DDRSS0_PI_49_DATA)
	Data.Set D:((((Var.VALUE(&__J7_DDR0_SS_BASE)+Var.VALUE(&__DDRSS_PI_REGISTER_BLOCK__OFFS))+Var.VALUE(&__DDRSS_PI_50__SFR_OFFS)))) %Long Var.VALUE(&__DDRSS0_PI_50_DATA)
	Data.Set D:((((Var.VALUE(&__J7_DDR0_SS_BASE)+Var.VALUE(&__DDRSS_PI_REGISTER_BLOCK__OFFS))+Var.VALUE(&__DDRSS_PI_51__SFR_OFFS)))) %Long Var.VALUE(&__DDRSS0_PI_51_DATA)
	Data.Set D:((((Var.VALUE(&__J7_DDR0_SS_BASE)+Var.VALUE(&__DDRSS_PI_REGISTER_BLOCK__OFFS))+Var.VALUE(&__DDRSS_PI_52__SFR_OFFS)))) %Long Var.VALUE(&__DDRSS0_PI_52_DATA)
	Data.Set D:((((Var.VALUE(&__J7_DDR0_SS_BASE)+Var.VALUE(&__DDRSS_PI_REGISTER_BLOCK__OFFS))+Var.VALUE(&__DDRSS_PI_53__SFR_OFFS)))) %Long Var.VALUE(&__DDRSS0_PI_53_DATA)
	Data.Set D:((((Var.VALUE(&__J7_DDR0_SS_BASE)+Var.VALUE(&__DDRSS_PI_REGISTER_BLOCK__OFFS))+Var.VALUE(&__DDRSS_PI_54__SFR_OFFS)))) %Long Var.VALUE(&__DDRSS0_PI_54_DATA)
	Data.Set D:((((Var.VALUE(&__J7_DDR0_SS_BASE)+Var.VALUE(&__DDRSS_PI_REGISTER_BLOCK__OFFS))+Var.VALUE(&__DDRSS_PI_55__SFR_OFFS)))) %Long Var.VALUE(&__DDRSS0_PI_55_DATA)
	Data.Set D:((((Var.VALUE(&__J7_DDR0_SS_BASE)+Var.VALUE(&__DDRSS_PI_REGISTER_BLOCK__OFFS))+Var.VALUE(&__DDRSS_PI_56__SFR_OFFS)))) %Long Var.VALUE(&__DDRSS0_PI_56_DATA)
	Data.Set D:((((Var.VALUE(&__J7_DDR0_SS_BASE)+Var.VALUE(&__DDRSS_PI_REGISTER_BLOCK__OFFS))+Var.VALUE(&__DDRSS_PI_57__SFR_OFFS)))) %Long Var.VALUE(&__DDRSS0_PI_57_DATA)
	Data.Set D:((((Var.VALUE(&__J7_DDR0_SS_BASE)+Var.VALUE(&__DDRSS_PI_REGISTER_BLOCK__OFFS))+Var.VALUE(&__DDRSS_PI_58__SFR_OFFS)))) %Long Var.VALUE(&__DDRSS0_PI_58_DATA)
	Data.Set D:((((Var.VALUE(&__J7_DDR0_SS_BASE)+Var.VALUE(&__DDRSS_PI_REGISTER_BLOCK__OFFS))+Var.VALUE(&__DDRSS_PI_59__SFR_OFFS)))) %Long Var.VALUE(&__DDRSS0_PI_59_DATA)
	Data.Set D:((((Var.VALUE(&__J7_DDR0_SS_BASE)+Var.VALUE(&__DDRSS_PI_REGISTER_BLOCK__OFFS))+Var.VALUE(&__DDRSS_PI_60__SFR_OFFS)))) %Long Var.VALUE(&__DDRSS0_PI_60_DATA)
	Data.Set D:((((Var.VALUE(&__J7_DDR0_SS_BASE)+Var.VALUE(&__DDRSS_PI_REGISTER_BLOCK__OFFS))+Var.VALUE(&__DDRSS_PI_61__SFR_OFFS)))) %Long Var.VALUE(&__DDRSS0_PI_61_DATA)
	Data.Set D:((((Var.VALUE(&__J7_DDR0_SS_BASE)+Var.VALUE(&__DDRSS_PI_REGISTER_BLOCK__OFFS))+Var.VALUE(&__DDRSS_PI_62__SFR_OFFS)))) %Long Var.VALUE(&__DDRSS0_PI_62_DATA)
	Data.Set D:((((Var.VALUE(&__J7_DDR0_SS_BASE)+Var.VALUE(&__DDRSS_PI_REGISTER_BLOCK__OFFS))+Var.VALUE(&__DDRSS_PI_63__SFR_OFFS)))) %Long Var.VALUE(&__DDRSS0_PI_63_DATA)
	Data.Set D:((((Var.VALUE(&__J7_DDR0_SS_BASE)+Var.VALUE(&__DDRSS_PI_REGISTER_BLOCK__OFFS))+Var.VALUE(&__DDRSS_PI_64__SFR_OFFS)))) %Long Var.VALUE(&__DDRSS0_PI_64_DATA)
	Data.Set D:((((Var.VALUE(&__J7_DDR0_SS_BASE)+Var.VALUE(&__DDRSS_PI_REGISTER_BLOCK__OFFS))+Var.VALUE(&__DDRSS_PI_65__SFR_OFFS)))) %Long Var.VALUE(&__DDRSS0_PI_65_DATA)
	Data.Set D:((((Var.VALUE(&__J7_DDR0_SS_BASE)+Var.VALUE(&__DDRSS_PI_REGISTER_BLOCK__OFFS))+Var.VALUE(&__DDRSS_PI_66__SFR_OFFS)))) %Long Var.VALUE(&__DDRSS0_PI_66_DATA)
	Data.Set D:((((Var.VALUE(&__J7_DDR0_SS_BASE)+Var.VALUE(&__DDRSS_PI_REGISTER_BLOCK__OFFS))+Var.VALUE(&__DDRSS_PI_67__SFR_OFFS)))) %Long Var.VALUE(&__DDRSS0_PI_67_DATA)
	Data.Set D:((((Var.VALUE(&__J7_DDR0_SS_BASE)+Var.VALUE(&__DDRSS_PI_REGISTER_BLOCK__OFFS))+Var.VALUE(&__DDRSS_PI_68__SFR_OFFS)))) %Long Var.VALUE(&__DDRSS0_PI_68_DATA)
	Data.Set D:((((Var.VALUE(&__J7_DDR0_SS_BASE)+Var.VALUE(&__DDRSS_PI_REGISTER_BLOCK__OFFS))+Var.VALUE(&__DDRSS_PI_69__SFR_OFFS)))) %Long Var.VALUE(&__DDRSS0_PI_69_DATA)
	Data.Set D:((((Var.VALUE(&__J7_DDR0_SS_BASE)+Var.VALUE(&__DDRSS_PI_REGISTER_BLOCK__OFFS))+Var.VALUE(&__DDRSS_PI_70__SFR_OFFS)))) %Long Var.VALUE(&__DDRSS0_PI_70_DATA)
	Data.Set D:((((Var.VALUE(&__J7_DDR0_SS_BASE)+Var.VALUE(&__DDRSS_PI_REGISTER_BLOCK__OFFS))+Var.VALUE(&__DDRSS_PI_71__SFR_OFFS)))) %Long Var.VALUE(&__DDRSS0_PI_71_DATA)
	Data.Set D:((((Var.VALUE(&__J7_DDR0_SS_BASE)+Var.VALUE(&__DDRSS_PI_REGISTER_BLOCK__OFFS))+Var.VALUE(&__DDRSS_PI_72__SFR_OFFS)))) %Long Var.VALUE(&__DDRSS0_PI_72_DATA)
	Data.Set D:((((Var.VALUE(&__J7_DDR0_SS_BASE)+Var.VALUE(&__DDRSS_PI_REGISTER_BLOCK__OFFS))+Var.VALUE(&__DDRSS_PI_73__SFR_OFFS)))) %Long Var.VALUE(&__DDRSS0_PI_73_DATA)
	Data.Set D:((((Var.VALUE(&__J7_DDR0_SS_BASE)+Var.VALUE(&__DDRSS_PI_REGISTER_BLOCK__OFFS))+Var.VALUE(&__DDRSS_PI_74__SFR_OFFS)))) %Long Var.VALUE(&__DDRSS0_PI_74_DATA)
	Data.Set D:((((Var.VALUE(&__J7_DDR0_SS_BASE)+Var.VALUE(&__DDRSS_PI_REGISTER_BLOCK__OFFS))+Var.VALUE(&__DDRSS_PI_75__SFR_OFFS)))) %Long Var.VALUE(&__DDRSS0_PI_75_DATA)
	Data.Set D:((((Var.VALUE(&__J7_DDR0_SS_BASE)+Var.VALUE(&__DDRSS_PI_REGISTER_BLOCK__OFFS))+Var.VALUE(&__DDRSS_PI_76__SFR_OFFS)))) %Long Var.VALUE(&__DDRSS0_PI_76_DATA)
	Data.Set D:((((Var.VALUE(&__J7_DDR0_SS_BASE)+Var.VALUE(&__DDRSS_PI_REGISTER_BLOCK__OFFS))+Var.VALUE(&__DDRSS_PI_77__SFR_OFFS)))) %Long Var.VALUE(&__DDRSS0_PI_77_DATA)
	Data.Set D:((((Var.VALUE(&__J7_DDR0_SS_BASE)+Var.VALUE(&__DDRSS_PI_REGISTER_BLOCK__OFFS))+Var.VALUE(&__DDRSS_PI_78__SFR_OFFS)))) %Long Var.VALUE(&__DDRSS0_PI_78_DATA)
	Data.Set D:((((Var.VALUE(&__J7_DDR0_SS_BASE)+Var.VALUE(&__DDRSS_PI_REGISTER_BLOCK__OFFS))+Var.VALUE(&__DDRSS_PI_79__SFR_OFFS)))) %Long Var.VALUE(&__DDRSS0_PI_79_DATA)
	Data.Set D:((((Var.VALUE(&__J7_DDR0_SS_BASE)+Var.VALUE(&__DDRSS_PI_REGISTER_BLOCK__OFFS))+Var.VALUE(&__DDRSS_PI_80__SFR_OFFS)))) %Long Var.VALUE(&__DDRSS0_PI_80_DATA)
	Data.Set D:((((Var.VALUE(&__J7_DDR0_SS_BASE)+Var.VALUE(&__DDRSS_PI_REGISTER_BLOCK__OFFS))+Var.VALUE(&__DDRSS_PI_81__SFR_OFFS)))) %Long Var.VALUE(&__DDRSS0_PI_81_DATA)
	Data.Set D:((((Var.VALUE(&__J7_DDR0_SS_BASE)+Var.VALUE(&__DDRSS_PI_REGISTER_BLOCK__OFFS))+Var.VALUE(&__DDRSS_PI_82__SFR_OFFS)))) %Long Var.VALUE(&__DDRSS0_PI_82_DATA)
	Data.Set D:((((Var.VALUE(&__J7_DDR0_SS_BASE)+Var.VALUE(&__DDRSS_PI_REGISTER_BLOCK__OFFS))+Var.VALUE(&__DDRSS_PI_83__SFR_OFFS)))) %Long Var.VALUE(&__DDRSS0_PI_83_DATA)
	Data.Set D:((((Var.VALUE(&__J7_DDR0_SS_BASE)+Var.VALUE(&__DDRSS_PI_REGISTER_BLOCK__OFFS))+Var.VALUE(&__DDRSS_PI_84__SFR_OFFS)))) %Long Var.VALUE(&__DDRSS0_PI_84_DATA)
	Data.Set D:((((Var.VALUE(&__J7_DDR0_SS_BASE)+Var.VALUE(&__DDRSS_PI_REGISTER_BLOCK__OFFS))+Var.VALUE(&__DDRSS_PI_85__SFR_OFFS)))) %Long Var.VALUE(&__DDRSS0_PI_85_DATA)
	Data.Set D:((((Var.VALUE(&__J7_DDR0_SS_BASE)+Var.VALUE(&__DDRSS_PI_REGISTER_BLOCK__OFFS))+Var.VALUE(&__DDRSS_PI_86__SFR_OFFS)))) %Long Var.VALUE(&__DDRSS0_PI_86_DATA)
	Data.Set D:((((Var.VALUE(&__J7_DDR0_SS_BASE)+Var.VALUE(&__DDRSS_PI_REGISTER_BLOCK__OFFS))+Var.VALUE(&__DDRSS_PI_87__SFR_OFFS)))) %Long Var.VALUE(&__DDRSS0_PI_87_DATA)
	Data.Set D:((((Var.VALUE(&__J7_DDR0_SS_BASE)+Var.VALUE(&__DDRSS_PI_REGISTER_BLOCK__OFFS))+Var.VALUE(&__DDRSS_PI_88__SFR_OFFS)))) %Long Var.VALUE(&__DDRSS0_PI_88_DATA)
	Data.Set D:((((Var.VALUE(&__J7_DDR0_SS_BASE)+Var.VALUE(&__DDRSS_PI_REGISTER_BLOCK__OFFS))+Var.VALUE(&__DDRSS_PI_89__SFR_OFFS)))) %Long Var.VALUE(&__DDRSS0_PI_89_DATA)
	Data.Set D:((((Var.VALUE(&__J7_DDR0_SS_BASE)+Var.VALUE(&__DDRSS_PI_REGISTER_BLOCK__OFFS))+Var.VALUE(&__DDRSS_PI_90__SFR_OFFS)))) %Long Var.VALUE(&__DDRSS0_PI_90_DATA)
	Data.Set D:((((Var.VALUE(&__J7_DDR0_SS_BASE)+Var.VALUE(&__DDRSS_PI_REGISTER_BLOCK__OFFS))+Var.VALUE(&__DDRSS_PI_91__SFR_OFFS)))) %Long Var.VALUE(&__DDRSS0_PI_91_DATA)
	Data.Set D:((((Var.VALUE(&__J7_DDR0_SS_BASE)+Var.VALUE(&__DDRSS_PI_REGISTER_BLOCK__OFFS))+Var.VALUE(&__DDRSS_PI_92__SFR_OFFS)))) %Long Var.VALUE(&__DDRSS0_PI_92_DATA)
	Data.Set D:((((Var.VALUE(&__J7_DDR0_SS_BASE)+Var.VALUE(&__DDRSS_PI_REGISTER_BLOCK__OFFS))+Var.VALUE(&__DDRSS_PI_93__SFR_OFFS)))) %Long Var.VALUE(&__DDRSS0_PI_93_DATA)
	Data.Set D:((((Var.VALUE(&__J7_DDR0_SS_BASE)+Var.VALUE(&__DDRSS_PI_REGISTER_BLOCK__OFFS))+Var.VALUE(&__DDRSS_PI_94__SFR_OFFS)))) %Long Var.VALUE(&__DDRSS0_PI_94_DATA)
	Data.Set D:((((Var.VALUE(&__J7_DDR0_SS_BASE)+Var.VALUE(&__DDRSS_PI_REGISTER_BLOCK__OFFS))+Var.VALUE(&__DDRSS_PI_95__SFR_OFFS)))) %Long Var.VALUE(&__DDRSS0_PI_95_DATA)
	Data.Set D:((((Var.VALUE(&__J7_DDR0_SS_BASE)+Var.VALUE(&__DDRSS_PI_REGISTER_BLOCK__OFFS))+Var.VALUE(&__DDRSS_PI_96__SFR_OFFS)))) %Long Var.VALUE(&__DDRSS0_PI_96_DATA)
	Data.Set D:((((Var.VALUE(&__J7_DDR0_SS_BASE)+Var.VALUE(&__DDRSS_PI_REGISTER_BLOCK__OFFS))+Var.VALUE(&__DDRSS_PI_97__SFR_OFFS)))) %Long Var.VALUE(&__DDRSS0_PI_97_DATA)
	Data.Set D:((((Var.VALUE(&__J7_DDR0_SS_BASE)+Var.VALUE(&__DDRSS_PI_REGISTER_BLOCK__OFFS))+Var.VALUE(&__DDRSS_PI_98__SFR_OFFS)))) %Long Var.VALUE(&__DDRSS0_PI_98_DATA)
	Data.Set D:((((Var.VALUE(&__J7_DDR0_SS_BASE)+Var.VALUE(&__DDRSS_PI_REGISTER_BLOCK__OFFS))+Var.VALUE(&__DDRSS_PI_99__SFR_OFFS)))) %Long Var.VALUE(&__DDRSS0_PI_99_DATA)
	Data.Set D:((((Var.VALUE(&__J7_DDR0_SS_BASE)+Var.VALUE(&__DDRSS_PI_REGISTER_BLOCK__OFFS))+Var.VALUE(&__DDRSS_PI_100__SFR_OFFS)))) %Long Var.VALUE(&__DDRSS0_PI_100_DATA)
	Data.Set D:((((Var.VALUE(&__J7_DDR0_SS_BASE)+Var.VALUE(&__DDRSS_PI_REGISTER_BLOCK__OFFS))+Var.VALUE(&__DDRSS_PI_101__SFR_OFFS)))) %Long Var.VALUE(&__DDRSS0_PI_101_DATA)
	Data.Set D:((((Var.VALUE(&__J7_DDR0_SS_BASE)+Var.VALUE(&__DDRSS_PI_REGISTER_BLOCK__OFFS))+Var.VALUE(&__DDRSS_PI_102__SFR_OFFS)))) %Long Var.VALUE(&__DDRSS0_PI_102_DATA)
	Data.Set D:((((Var.VALUE(&__J7_DDR0_SS_BASE)+Var.VALUE(&__DDRSS_PI_REGISTER_BLOCK__OFFS))+Var.VALUE(&__DDRSS_PI_103__SFR_OFFS)))) %Long Var.VALUE(&__DDRSS0_PI_103_DATA)
	Data.Set D:((((Var.VALUE(&__J7_DDR0_SS_BASE)+Var.VALUE(&__DDRSS_PI_REGISTER_BLOCK__OFFS))+Var.VALUE(&__DDRSS_PI_104__SFR_OFFS)))) %Long Var.VALUE(&__DDRSS0_PI_104_DATA)
	Data.Set D:((((Var.VALUE(&__J7_DDR0_SS_BASE)+Var.VALUE(&__DDRSS_PI_REGISTER_BLOCK__OFFS))+Var.VALUE(&__DDRSS_PI_105__SFR_OFFS)))) %Long Var.VALUE(&__DDRSS0_PI_105_DATA)
	Data.Set D:((((Var.VALUE(&__J7_DDR0_SS_BASE)+Var.VALUE(&__DDRSS_PI_REGISTER_BLOCK__OFFS))+Var.VALUE(&__DDRSS_PI_106__SFR_OFFS)))) %Long Var.VALUE(&__DDRSS0_PI_106_DATA)
	Data.Set D:((((Var.VALUE(&__J7_DDR0_SS_BASE)+Var.VALUE(&__DDRSS_PI_REGISTER_BLOCK__OFFS))+Var.VALUE(&__DDRSS_PI_107__SFR_OFFS)))) %Long Var.VALUE(&__DDRSS0_PI_107_DATA)
	Data.Set D:((((Var.VALUE(&__J7_DDR0_SS_BASE)+Var.VALUE(&__DDRSS_PI_REGISTER_BLOCK__OFFS))+Var.VALUE(&__DDRSS_PI_108__SFR_OFFS)))) %Long Var.VALUE(&__DDRSS0_PI_108_DATA)
	Data.Set D:((((Var.VALUE(&__J7_DDR0_SS_BASE)+Var.VALUE(&__DDRSS_PI_REGISTER_BLOCK__OFFS))+Var.VALUE(&__DDRSS_PI_109__SFR_OFFS)))) %Long Var.VALUE(&__DDRSS0_PI_109_DATA)
	Data.Set D:((((Var.VALUE(&__J7_DDR0_SS_BASE)+Var.VALUE(&__DDRSS_PI_REGISTER_BLOCK__OFFS))+Var.VALUE(&__DDRSS_PI_110__SFR_OFFS)))) %Long Var.VALUE(&__DDRSS0_PI_110_DATA)
	Data.Set D:((((Var.VALUE(&__J7_DDR0_SS_BASE)+Var.VALUE(&__DDRSS_PI_REGISTER_BLOCK__OFFS))+Var.VALUE(&__DDRSS_PI_111__SFR_OFFS)))) %Long Var.VALUE(&__DDRSS0_PI_111_DATA)
	Data.Set D:((((Var.VALUE(&__J7_DDR0_SS_BASE)+Var.VALUE(&__DDRSS_PI_REGISTER_BLOCK__OFFS))+Var.VALUE(&__DDRSS_PI_112__SFR_OFFS)))) %Long Var.VALUE(&__DDRSS0_PI_112_DATA)
	Data.Set D:((((Var.VALUE(&__J7_DDR0_SS_BASE)+Var.VALUE(&__DDRSS_PI_REGISTER_BLOCK__OFFS))+Var.VALUE(&__DDRSS_PI_113__SFR_OFFS)))) %Long Var.VALUE(&__DDRSS0_PI_113_DATA)
	Data.Set D:((((Var.VALUE(&__J7_DDR0_SS_BASE)+Var.VALUE(&__DDRSS_PI_REGISTER_BLOCK__OFFS))+Var.VALUE(&__DDRSS_PI_114__SFR_OFFS)))) %Long Var.VALUE(&__DDRSS0_PI_114_DATA)
	Data.Set D:((((Var.VALUE(&__J7_DDR0_SS_BASE)+Var.VALUE(&__DDRSS_PI_REGISTER_BLOCK__OFFS))+Var.VALUE(&__DDRSS_PI_115__SFR_OFFS)))) %Long Var.VALUE(&__DDRSS0_PI_115_DATA)
	Data.Set D:((((Var.VALUE(&__J7_DDR0_SS_BASE)+Var.VALUE(&__DDRSS_PI_REGISTER_BLOCK__OFFS))+Var.VALUE(&__DDRSS_PI_116__SFR_OFFS)))) %Long Var.VALUE(&__DDRSS0_PI_116_DATA)
	Data.Set D:((((Var.VALUE(&__J7_DDR0_SS_BASE)+Var.VALUE(&__DDRSS_PI_REGISTER_BLOCK__OFFS))+Var.VALUE(&__DDRSS_PI_117__SFR_OFFS)))) %Long Var.VALUE(&__DDRSS0_PI_117_DATA)
	Data.Set D:((((Var.VALUE(&__J7_DDR0_SS_BASE)+Var.VALUE(&__DDRSS_PI_REGISTER_BLOCK__OFFS))+Var.VALUE(&__DDRSS_PI_118__SFR_OFFS)))) %Long Var.VALUE(&__DDRSS0_PI_118_DATA)
	Data.Set D:((((Var.VALUE(&__J7_DDR0_SS_BASE)+Var.VALUE(&__DDRSS_PI_REGISTER_BLOCK__OFFS))+Var.VALUE(&__DDRSS_PI_119__SFR_OFFS)))) %Long Var.VALUE(&__DDRSS0_PI_119_DATA)
	Data.Set D:((((Var.VALUE(&__J7_DDR0_SS_BASE)+Var.VALUE(&__DDRSS_PI_REGISTER_BLOCK__OFFS))+Var.VALUE(&__DDRSS_PI_120__SFR_OFFS)))) %Long Var.VALUE(&__DDRSS0_PI_120_DATA)
	Data.Set D:((((Var.VALUE(&__J7_DDR0_SS_BASE)+Var.VALUE(&__DDRSS_PI_REGISTER_BLOCK__OFFS))+Var.VALUE(&__DDRSS_PI_121__SFR_OFFS)))) %Long Var.VALUE(&__DDRSS0_PI_121_DATA)
	Data.Set D:((((Var.VALUE(&__J7_DDR0_SS_BASE)+Var.VALUE(&__DDRSS_PI_REGISTER_BLOCK__OFFS))+Var.VALUE(&__DDRSS_PI_122__SFR_OFFS)))) %Long Var.VALUE(&__DDRSS0_PI_122_DATA)
	Data.Set D:((((Var.VALUE(&__J7_DDR0_SS_BASE)+Var.VALUE(&__DDRSS_PI_REGISTER_BLOCK__OFFS))+Var.VALUE(&__DDRSS_PI_123__SFR_OFFS)))) %Long Var.VALUE(&__DDRSS0_PI_123_DATA)
	Data.Set D:((((Var.VALUE(&__J7_DDR0_SS_BASE)+Var.VALUE(&__DDRSS_PI_REGISTER_BLOCK__OFFS))+Var.VALUE(&__DDRSS_PI_124__SFR_OFFS)))) %Long Var.VALUE(&__DDRSS0_PI_124_DATA)
	Data.Set D:((((Var.VALUE(&__J7_DDR0_SS_BASE)+Var.VALUE(&__DDRSS_PI_REGISTER_BLOCK__OFFS))+Var.VALUE(&__DDRSS_PI_125__SFR_OFFS)))) %Long Var.VALUE(&__DDRSS0_PI_125_DATA)
	Data.Set D:((((Var.VALUE(&__J7_DDR0_SS_BASE)+Var.VALUE(&__DDRSS_PI_REGISTER_BLOCK__OFFS))+Var.VALUE(&__DDRSS_PI_126__SFR_OFFS)))) %Long Var.VALUE(&__DDRSS0_PI_126_DATA)
	Data.Set D:((((Var.VALUE(&__J7_DDR0_SS_BASE)+Var.VALUE(&__DDRSS_PI_REGISTER_BLOCK__OFFS))+Var.VALUE(&__DDRSS_PI_127__SFR_OFFS)))) %Long Var.VALUE(&__DDRSS0_PI_127_DATA)
	Data.Set D:((((Var.VALUE(&__J7_DDR0_SS_BASE)+Var.VALUE(&__DDRSS_PI_REGISTER_BLOCK__OFFS))+Var.VALUE(&__DDRSS_PI_128__SFR_OFFS)))) %Long Var.VALUE(&__DDRSS0_PI_128_DATA)
	Data.Set D:((((Var.VALUE(&__J7_DDR0_SS_BASE)+Var.VALUE(&__DDRSS_PI_REGISTER_BLOCK__OFFS))+Var.VALUE(&__DDRSS_PI_129__SFR_OFFS)))) %Long Var.VALUE(&__DDRSS0_PI_129_DATA)
	Data.Set D:((((Var.VALUE(&__J7_DDR0_SS_BASE)+Var.VALUE(&__DDRSS_PI_REGISTER_BLOCK__OFFS))+Var.VALUE(&__DDRSS_PI_130__SFR_OFFS)))) %Long Var.VALUE(&__DDRSS0_PI_130_DATA)
	Data.Set D:((((Var.VALUE(&__J7_DDR0_SS_BASE)+Var.VALUE(&__DDRSS_PI_REGISTER_BLOCK__OFFS))+Var.VALUE(&__DDRSS_PI_131__SFR_OFFS)))) %Long Var.VALUE(&__DDRSS0_PI_131_DATA)
	Data.Set D:((((Var.VALUE(&__J7_DDR0_SS_BASE)+Var.VALUE(&__DDRSS_PI_REGISTER_BLOCK__OFFS))+Var.VALUE(&__DDRSS_PI_132__SFR_OFFS)))) %Long Var.VALUE(&__DDRSS0_PI_132_DATA)
	Data.Set D:((((Var.VALUE(&__J7_DDR0_SS_BASE)+Var.VALUE(&__DDRSS_PI_REGISTER_BLOCK__OFFS))+Var.VALUE(&__DDRSS_PI_133__SFR_OFFS)))) %Long Var.VALUE(&__DDRSS0_PI_133_DATA)
	Data.Set D:((((Var.VALUE(&__J7_DDR0_SS_BASE)+Var.VALUE(&__DDRSS_PI_REGISTER_BLOCK__OFFS))+Var.VALUE(&__DDRSS_PI_134__SFR_OFFS)))) %Long Var.VALUE(&__DDRSS0_PI_134_DATA)
	Data.Set D:((((Var.VALUE(&__J7_DDR0_SS_BASE)+Var.VALUE(&__DDRSS_PI_REGISTER_BLOCK__OFFS))+Var.VALUE(&__DDRSS_PI_135__SFR_OFFS)))) %Long Var.VALUE(&__DDRSS0_PI_135_DATA)
	Data.Set D:((((Var.VALUE(&__J7_DDR0_SS_BASE)+Var.VALUE(&__DDRSS_PI_REGISTER_BLOCK__OFFS))+Var.VALUE(&__DDRSS_PI_136__SFR_OFFS)))) %Long Var.VALUE(&__DDRSS0_PI_136_DATA)
	Data.Set D:((((Var.VALUE(&__J7_DDR0_SS_BASE)+Var.VALUE(&__DDRSS_PI_REGISTER_BLOCK__OFFS))+Var.VALUE(&__DDRSS_PI_137__SFR_OFFS)))) %Long Var.VALUE(&__DDRSS0_PI_137_DATA)
	Data.Set D:((((Var.VALUE(&__J7_DDR0_SS_BASE)+Var.VALUE(&__DDRSS_PI_REGISTER_BLOCK__OFFS))+Var.VALUE(&__DDRSS_PI_138__SFR_OFFS)))) %Long Var.VALUE(&__DDRSS0_PI_138_DATA)
	Data.Set D:((((Var.VALUE(&__J7_DDR0_SS_BASE)+Var.VALUE(&__DDRSS_PI_REGISTER_BLOCK__OFFS))+Var.VALUE(&__DDRSS_PI_139__SFR_OFFS)))) %Long Var.VALUE(&__DDRSS0_PI_139_DATA)
	Data.Set D:((((Var.VALUE(&__J7_DDR0_SS_BASE)+Var.VALUE(&__DDRSS_PI_REGISTER_BLOCK__OFFS))+Var.VALUE(&__DDRSS_PI_140__SFR_OFFS)))) %Long Var.VALUE(&__DDRSS0_PI_140_DATA)
	Data.Set D:((((Var.VALUE(&__J7_DDR0_SS_BASE)+Var.VALUE(&__DDRSS_PI_REGISTER_BLOCK__OFFS))+Var.VALUE(&__DDRSS_PI_141__SFR_OFFS)))) %Long Var.VALUE(&__DDRSS0_PI_141_DATA)
	Data.Set D:((((Var.VALUE(&__J7_DDR0_SS_BASE)+Var.VALUE(&__DDRSS_PI_REGISTER_BLOCK__OFFS))+Var.VALUE(&__DDRSS_PI_142__SFR_OFFS)))) %Long Var.VALUE(&__DDRSS0_PI_142_DATA)
	Data.Set D:((((Var.VALUE(&__J7_DDR0_SS_BASE)+Var.VALUE(&__DDRSS_PI_REGISTER_BLOCK__OFFS))+Var.VALUE(&__DDRSS_PI_143__SFR_OFFS)))) %Long Var.VALUE(&__DDRSS0_PI_143_DATA)
	Data.Set D:((((Var.VALUE(&__J7_DDR0_SS_BASE)+Var.VALUE(&__DDRSS_PI_REGISTER_BLOCK__OFFS))+Var.VALUE(&__DDRSS_PI_144__SFR_OFFS)))) %Long Var.VALUE(&__DDRSS0_PI_144_DATA)
	Data.Set D:((((Var.VALUE(&__J7_DDR0_SS_BASE)+Var.VALUE(&__DDRSS_PI_REGISTER_BLOCK__OFFS))+Var.VALUE(&__DDRSS_PI_145__SFR_OFFS)))) %Long Var.VALUE(&__DDRSS0_PI_145_DATA)
	Data.Set D:((((Var.VALUE(&__J7_DDR0_SS_BASE)+Var.VALUE(&__DDRSS_PI_REGISTER_BLOCK__OFFS))+Var.VALUE(&__DDRSS_PI_146__SFR_OFFS)))) %Long Var.VALUE(&__DDRSS0_PI_146_DATA)
	Data.Set D:((((Var.VALUE(&__J7_DDR0_SS_BASE)+Var.VALUE(&__DDRSS_PI_REGISTER_BLOCK__OFFS))+Var.VALUE(&__DDRSS_PI_147__SFR_OFFS)))) %Long Var.VALUE(&__DDRSS0_PI_147_DATA)
	Data.Set D:((((Var.VALUE(&__J7_DDR0_SS_BASE)+Var.VALUE(&__DDRSS_PI_REGISTER_BLOCK__OFFS))+Var.VALUE(&__DDRSS_PI_148__SFR_OFFS)))) %Long Var.VALUE(&__DDRSS0_PI_148_DATA)
	Data.Set D:((((Var.VALUE(&__J7_DDR0_SS_BASE)+Var.VALUE(&__DDRSS_PI_REGISTER_BLOCK__OFFS))+Var.VALUE(&__DDRSS_PI_149__SFR_OFFS)))) %Long Var.VALUE(&__DDRSS0_PI_149_DATA)
	Data.Set D:((((Var.VALUE(&__J7_DDR0_SS_BASE)+Var.VALUE(&__DDRSS_PI_REGISTER_BLOCK__OFFS))+Var.VALUE(&__DDRSS_PI_150__SFR_OFFS)))) %Long Var.VALUE(&__DDRSS0_PI_150_DATA)
	Data.Set D:((((Var.VALUE(&__J7_DDR0_SS_BASE)+Var.VALUE(&__DDRSS_PI_REGISTER_BLOCK__OFFS))+Var.VALUE(&__DDRSS_PI_151__SFR_OFFS)))) %Long Var.VALUE(&__DDRSS0_PI_151_DATA)
	Data.Set D:((((Var.VALUE(&__J7_DDR0_SS_BASE)+Var.VALUE(&__DDRSS_PI_REGISTER_BLOCK__OFFS))+Var.VALUE(&__DDRSS_PI_152__SFR_OFFS)))) %Long Var.VALUE(&__DDRSS0_PI_152_DATA)
	Data.Set D:((((Var.VALUE(&__J7_DDR0_SS_BASE)+Var.VALUE(&__DDRSS_PI_REGISTER_BLOCK__OFFS))+Var.VALUE(&__DDRSS_PI_153__SFR_OFFS)))) %Long Var.VALUE(&__DDRSS0_PI_153_DATA)
	Data.Set D:((((Var.VALUE(&__J7_DDR0_SS_BASE)+Var.VALUE(&__DDRSS_PI_REGISTER_BLOCK__OFFS))+Var.VALUE(&__DDRSS_PI_154__SFR_OFFS)))) %Long Var.VALUE(&__DDRSS0_PI_154_DATA)
	Data.Set D:((((Var.VALUE(&__J7_DDR0_SS_BASE)+Var.VALUE(&__DDRSS_PI_REGISTER_BLOCK__OFFS))+Var.VALUE(&__DDRSS_PI_155__SFR_OFFS)))) %Long Var.VALUE(&__DDRSS0_PI_155_DATA)
	Data.Set D:((((Var.VALUE(&__J7_DDR0_SS_BASE)+Var.VALUE(&__DDRSS_PI_REGISTER_BLOCK__OFFS))+Var.VALUE(&__DDRSS_PI_156__SFR_OFFS)))) %Long Var.VALUE(&__DDRSS0_PI_156_DATA)
	Data.Set D:((((Var.VALUE(&__J7_DDR0_SS_BASE)+Var.VALUE(&__DDRSS_PI_REGISTER_BLOCK__OFFS))+Var.VALUE(&__DDRSS_PI_157__SFR_OFFS)))) %Long Var.VALUE(&__DDRSS0_PI_157_DATA)
	Data.Set D:((((Var.VALUE(&__J7_DDR0_SS_BASE)+Var.VALUE(&__DDRSS_PI_REGISTER_BLOCK__OFFS))+Var.VALUE(&__DDRSS_PI_158__SFR_OFFS)))) %Long Var.VALUE(&__DDRSS0_PI_158_DATA)
	Data.Set D:((((Var.VALUE(&__J7_DDR0_SS_BASE)+Var.VALUE(&__DDRSS_PI_REGISTER_BLOCK__OFFS))+Var.VALUE(&__DDRSS_PI_159__SFR_OFFS)))) %Long Var.VALUE(&__DDRSS0_PI_159_DATA)
	Data.Set D:((((Var.VALUE(&__J7_DDR0_SS_BASE)+Var.VALUE(&__DDRSS_PI_REGISTER_BLOCK__OFFS))+Var.VALUE(&__DDRSS_PI_160__SFR_OFFS)))) %Long Var.VALUE(&__DDRSS0_PI_160_DATA)
	Data.Set D:((((Var.VALUE(&__J7_DDR0_SS_BASE)+Var.VALUE(&__DDRSS_PI_REGISTER_BLOCK__OFFS))+Var.VALUE(&__DDRSS_PI_161__SFR_OFFS)))) %Long Var.VALUE(&__DDRSS0_PI_161_DATA)
	Data.Set D:((((Var.VALUE(&__J7_DDR0_SS_BASE)+Var.VALUE(&__DDRSS_PI_REGISTER_BLOCK__OFFS))+Var.VALUE(&__DDRSS_PI_162__SFR_OFFS)))) %Long Var.VALUE(&__DDRSS0_PI_162_DATA)
	Data.Set D:((((Var.VALUE(&__J7_DDR0_SS_BASE)+Var.VALUE(&__DDRSS_PI_REGISTER_BLOCK__OFFS))+Var.VALUE(&__DDRSS_PI_163__SFR_OFFS)))) %Long Var.VALUE(&__DDRSS0_PI_163_DATA)
	Data.Set D:((((Var.VALUE(&__J7_DDR0_SS_BASE)+Var.VALUE(&__DDRSS_PI_REGISTER_BLOCK__OFFS))+Var.VALUE(&__DDRSS_PI_164__SFR_OFFS)))) %Long Var.VALUE(&__DDRSS0_PI_164_DATA)
	Data.Set D:((((Var.VALUE(&__J7_DDR0_SS_BASE)+Var.VALUE(&__DDRSS_PI_REGISTER_BLOCK__OFFS))+Var.VALUE(&__DDRSS_PI_165__SFR_OFFS)))) %Long Var.VALUE(&__DDRSS0_PI_165_DATA)
	Data.Set D:((((Var.VALUE(&__J7_DDR0_SS_BASE)+Var.VALUE(&__DDRSS_PI_REGISTER_BLOCK__OFFS))+Var.VALUE(&__DDRSS_PI_166__SFR_OFFS)))) %Long Var.VALUE(&__DDRSS0_PI_166_DATA)
	Data.Set D:((((Var.VALUE(&__J7_DDR0_SS_BASE)+Var.VALUE(&__DDRSS_PI_REGISTER_BLOCK__OFFS))+Var.VALUE(&__DDRSS_PI_167__SFR_OFFS)))) %Long Var.VALUE(&__DDRSS0_PI_167_DATA)
	Data.Set D:((((Var.VALUE(&__J7_DDR0_SS_BASE)+Var.VALUE(&__DDRSS_PI_REGISTER_BLOCK__OFFS))+Var.VALUE(&__DDRSS_PI_168__SFR_OFFS)))) %Long Var.VALUE(&__DDRSS0_PI_168_DATA)
	Data.Set D:((((Var.VALUE(&__J7_DDR0_SS_BASE)+Var.VALUE(&__DDRSS_PI_REGISTER_BLOCK__OFFS))+Var.VALUE(&__DDRSS_PI_169__SFR_OFFS)))) %Long Var.VALUE(&__DDRSS0_PI_169_DATA)
	Data.Set D:((((Var.VALUE(&__J7_DDR0_SS_BASE)+Var.VALUE(&__DDRSS_PI_REGISTER_BLOCK__OFFS))+Var.VALUE(&__DDRSS_PI_170__SFR_OFFS)))) %Long Var.VALUE(&__DDRSS0_PI_170_DATA)
	Data.Set D:((((Var.VALUE(&__J7_DDR0_SS_BASE)+Var.VALUE(&__DDRSS_PI_REGISTER_BLOCK__OFFS))+Var.VALUE(&__DDRSS_PI_171__SFR_OFFS)))) %Long Var.VALUE(&__DDRSS0_PI_171_DATA)
	Data.Set D:((((Var.VALUE(&__J7_DDR0_SS_BASE)+Var.VALUE(&__DDRSS_PI_REGISTER_BLOCK__OFFS))+Var.VALUE(&__DDRSS_PI_172__SFR_OFFS)))) %Long Var.VALUE(&__DDRSS0_PI_172_DATA)
	Data.Set D:((((Var.VALUE(&__J7_DDR0_SS_BASE)+Var.VALUE(&__DDRSS_PI_REGISTER_BLOCK__OFFS))+Var.VALUE(&__DDRSS_PI_173__SFR_OFFS)))) %Long Var.VALUE(&__DDRSS0_PI_173_DATA)
	Data.Set D:((((Var.VALUE(&__J7_DDR0_SS_BASE)+Var.VALUE(&__DDRSS_PI_REGISTER_BLOCK__OFFS))+Var.VALUE(&__DDRSS_PI_174__SFR_OFFS)))) %Long Var.VALUE(&__DDRSS0_PI_174_DATA)
	Data.Set D:((((Var.VALUE(&__J7_DDR0_SS_BASE)+Var.VALUE(&__DDRSS_PI_REGISTER_BLOCK__OFFS))+Var.VALUE(&__DDRSS_PI_175__SFR_OFFS)))) %Long Var.VALUE(&__DDRSS0_PI_175_DATA)
	Data.Set D:((((Var.VALUE(&__J7_DDR0_SS_BASE)+Var.VALUE(&__DDRSS_PI_REGISTER_BLOCK__OFFS))+Var.VALUE(&__DDRSS_PI_176__SFR_OFFS)))) %Long Var.VALUE(&__DDRSS0_PI_176_DATA)
	Data.Set D:((((Var.VALUE(&__J7_DDR0_SS_BASE)+Var.VALUE(&__DDRSS_PI_REGISTER_BLOCK__OFFS))+Var.VALUE(&__DDRSS_PI_177__SFR_OFFS)))) %Long Var.VALUE(&__DDRSS0_PI_177_DATA)
	Data.Set D:((((Var.VALUE(&__J7_DDR0_SS_BASE)+Var.VALUE(&__DDRSS_PI_REGISTER_BLOCK__OFFS))+Var.VALUE(&__DDRSS_PI_178__SFR_OFFS)))) %Long Var.VALUE(&__DDRSS0_PI_178_DATA)
	Data.Set D:((((Var.VALUE(&__J7_DDR0_SS_BASE)+Var.VALUE(&__DDRSS_PI_REGISTER_BLOCK__OFFS))+Var.VALUE(&__DDRSS_PI_179__SFR_OFFS)))) %Long Var.VALUE(&__DDRSS0_PI_179_DATA)
	Data.Set D:((((Var.VALUE(&__J7_DDR0_SS_BASE)+Var.VALUE(&__DDRSS_PI_REGISTER_BLOCK__OFFS))+Var.VALUE(&__DDRSS_PI_180__SFR_OFFS)))) %Long Var.VALUE(&__DDRSS0_PI_180_DATA)
	Data.Set D:((((Var.VALUE(&__J7_DDR0_SS_BASE)+Var.VALUE(&__DDRSS_PI_REGISTER_BLOCK__OFFS))+Var.VALUE(&__DDRSS_PI_181__SFR_OFFS)))) %Long Var.VALUE(&__DDRSS0_PI_181_DATA)
	Data.Set D:((((Var.VALUE(&__J7_DDR0_SS_BASE)+Var.VALUE(&__DDRSS_PI_REGISTER_BLOCK__OFFS))+Var.VALUE(&__DDRSS_PI_182__SFR_OFFS)))) %Long Var.VALUE(&__DDRSS0_PI_182_DATA)
	Data.Set D:((((Var.VALUE(&__J7_DDR0_SS_BASE)+Var.VALUE(&__DDRSS_PI_REGISTER_BLOCK__OFFS))+Var.VALUE(&__DDRSS_PI_183__SFR_OFFS)))) %Long Var.VALUE(&__DDRSS0_PI_183_DATA)
	Data.Set D:((((Var.VALUE(&__J7_DDR0_SS_BASE)+Var.VALUE(&__DDRSS_PI_REGISTER_BLOCK__OFFS))+Var.VALUE(&__DDRSS_PI_184__SFR_OFFS)))) %Long Var.VALUE(&__DDRSS0_PI_184_DATA)
	Data.Set D:((((Var.VALUE(&__J7_DDR0_SS_BASE)+Var.VALUE(&__DDRSS_PI_REGISTER_BLOCK__OFFS))+Var.VALUE(&__DDRSS_PI_185__SFR_OFFS)))) %Long Var.VALUE(&__DDRSS0_PI_185_DATA)
	Data.Set D:((((Var.VALUE(&__J7_DDR0_SS_BASE)+Var.VALUE(&__DDRSS_PI_REGISTER_BLOCK__OFFS))+Var.VALUE(&__DDRSS_PI_186__SFR_OFFS)))) %Long Var.VALUE(&__DDRSS0_PI_186_DATA)
	Data.Set D:((((Var.VALUE(&__J7_DDR0_SS_BASE)+Var.VALUE(&__DDRSS_PI_REGISTER_BLOCK__OFFS))+Var.VALUE(&__DDRSS_PI_187__SFR_OFFS)))) %Long Var.VALUE(&__DDRSS0_PI_187_DATA)
	Data.Set D:((((Var.VALUE(&__J7_DDR0_SS_BASE)+Var.VALUE(&__DDRSS_PI_REGISTER_BLOCK__OFFS))+Var.VALUE(&__DDRSS_PI_188__SFR_OFFS)))) %Long Var.VALUE(&__DDRSS0_PI_188_DATA)
	Data.Set D:((((Var.VALUE(&__J7_DDR0_SS_BASE)+Var.VALUE(&__DDRSS_PI_REGISTER_BLOCK__OFFS))+Var.VALUE(&__DDRSS_PI_189__SFR_OFFS)))) %Long Var.VALUE(&__DDRSS0_PI_189_DATA)
	Data.Set D:((((Var.VALUE(&__J7_DDR0_SS_BASE)+Var.VALUE(&__DDRSS_PI_REGISTER_BLOCK__OFFS))+Var.VALUE(&__DDRSS_PI_190__SFR_OFFS)))) %Long Var.VALUE(&__DDRSS0_PI_190_DATA)
	Data.Set D:((((Var.VALUE(&__J7_DDR0_SS_BASE)+Var.VALUE(&__DDRSS_PI_REGISTER_BLOCK__OFFS))+Var.VALUE(&__DDRSS_PI_191__SFR_OFFS)))) %Long Var.VALUE(&__DDRSS0_PI_191_DATA)
	Data.Set D:((((Var.VALUE(&__J7_DDR0_SS_BASE)+Var.VALUE(&__DDRSS_PI_REGISTER_BLOCK__OFFS))+Var.VALUE(&__DDRSS_PI_192__SFR_OFFS)))) %Long Var.VALUE(&__DDRSS0_PI_192_DATA)
	Data.Set D:((((Var.VALUE(&__J7_DDR0_SS_BASE)+Var.VALUE(&__DDRSS_PI_REGISTER_BLOCK__OFFS))+Var.VALUE(&__DDRSS_PI_193__SFR_OFFS)))) %Long Var.VALUE(&__DDRSS0_PI_193_DATA)
	Data.Set D:((((Var.VALUE(&__J7_DDR0_SS_BASE)+Var.VALUE(&__DDRSS_PI_REGISTER_BLOCK__OFFS))+Var.VALUE(&__DDRSS_PI_194__SFR_OFFS)))) %Long Var.VALUE(&__DDRSS0_PI_194_DATA)
	Data.Set D:((((Var.VALUE(&__J7_DDR0_SS_BASE)+Var.VALUE(&__DDRSS_PI_REGISTER_BLOCK__OFFS))+Var.VALUE(&__DDRSS_PI_195__SFR_OFFS)))) %Long Var.VALUE(&__DDRSS0_PI_195_DATA)
	Data.Set D:((((Var.VALUE(&__J7_DDR0_SS_BASE)+Var.VALUE(&__DDRSS_PI_REGISTER_BLOCK__OFFS))+Var.VALUE(&__DDRSS_PI_196__SFR_OFFS)))) %Long Var.VALUE(&__DDRSS0_PI_196_DATA)
	Data.Set D:((((Var.VALUE(&__J7_DDR0_SS_BASE)+Var.VALUE(&__DDRSS_PI_REGISTER_BLOCK__OFFS))+Var.VALUE(&__DDRSS_PI_197__SFR_OFFS)))) %Long Var.VALUE(&__DDRSS0_PI_197_DATA)
	Data.Set D:((((Var.VALUE(&__J7_DDR0_SS_BASE)+Var.VALUE(&__DDRSS_PI_REGISTER_BLOCK__OFFS))+Var.VALUE(&__DDRSS_PI_198__SFR_OFFS)))) %Long Var.VALUE(&__DDRSS0_PI_198_DATA)
	Data.Set D:((((Var.VALUE(&__J7_DDR0_SS_BASE)+Var.VALUE(&__DDRSS_PI_REGISTER_BLOCK__OFFS))+Var.VALUE(&__DDRSS_PI_199__SFR_OFFS)))) %Long Var.VALUE(&__DDRSS0_PI_199_DATA)
	Data.Set D:((((Var.VALUE(&__J7_DDR0_SS_BASE)+Var.VALUE(&__DDRSS_PI_REGISTER_BLOCK__OFFS))+Var.VALUE(&__DDRSS_PI_200__SFR_OFFS)))) %Long Var.VALUE(&__DDRSS0_PI_200_DATA)
	Data.Set D:((((Var.VALUE(&__J7_DDR0_SS_BASE)+Var.VALUE(&__DDRSS_PI_REGISTER_BLOCK__OFFS))+Var.VALUE(&__DDRSS_PI_201__SFR_OFFS)))) %Long Var.VALUE(&__DDRSS0_PI_201_DATA)
	Data.Set D:((((Var.VALUE(&__J7_DDR0_SS_BASE)+Var.VALUE(&__DDRSS_PI_REGISTER_BLOCK__OFFS))+Var.VALUE(&__DDRSS_PI_202__SFR_OFFS)))) %Long Var.VALUE(&__DDRSS0_PI_202_DATA)
	Data.Set D:((((Var.VALUE(&__J7_DDR0_SS_BASE)+Var.VALUE(&__DDRSS_PI_REGISTER_BLOCK__OFFS))+Var.VALUE(&__DDRSS_PI_203__SFR_OFFS)))) %Long Var.VALUE(&__DDRSS0_PI_203_DATA)
	Data.Set D:((((Var.VALUE(&__J7_DDR0_SS_BASE)+Var.VALUE(&__DDRSS_PI_REGISTER_BLOCK__OFFS))+Var.VALUE(&__DDRSS_PI_204__SFR_OFFS)))) %Long Var.VALUE(&__DDRSS0_PI_204_DATA)
	Data.Set D:((((Var.VALUE(&__J7_DDR0_SS_BASE)+Var.VALUE(&__DDRSS_PI_REGISTER_BLOCK__OFFS))+Var.VALUE(&__DDRSS_PI_205__SFR_OFFS)))) %Long Var.VALUE(&__DDRSS0_PI_205_DATA)
	Data.Set D:((((Var.VALUE(&__J7_DDR0_SS_BASE)+Var.VALUE(&__DDRSS_PI_REGISTER_BLOCK__OFFS))+Var.VALUE(&__DDRSS_PI_206__SFR_OFFS)))) %Long Var.VALUE(&__DDRSS0_PI_206_DATA)
	Data.Set D:((((Var.VALUE(&__J7_DDR0_SS_BASE)+Var.VALUE(&__DDRSS_PI_REGISTER_BLOCK__OFFS))+Var.VALUE(&__DDRSS_PI_207__SFR_OFFS)))) %Long Var.VALUE(&__DDRSS0_PI_207_DATA)
	Data.Set D:((((Var.VALUE(&__J7_DDR0_SS_BASE)+Var.VALUE(&__DDRSS_PI_REGISTER_BLOCK__OFFS))+Var.VALUE(&__DDRSS_PI_208__SFR_OFFS)))) %Long Var.VALUE(&__DDRSS0_PI_208_DATA)
	Data.Set D:((((Var.VALUE(&__J7_DDR0_SS_BASE)+Var.VALUE(&__DDRSS_PI_REGISTER_BLOCK__OFFS))+Var.VALUE(&__DDRSS_PI_209__SFR_OFFS)))) %Long Var.VALUE(&__DDRSS0_PI_209_DATA)
	Data.Set D:((((Var.VALUE(&__J7_DDR0_SS_BASE)+Var.VALUE(&__DDRSS_PI_REGISTER_BLOCK__OFFS))+Var.VALUE(&__DDRSS_PI_210__SFR_OFFS)))) %Long Var.VALUE(&__DDRSS0_PI_210_DATA)
	Data.Set D:((((Var.VALUE(&__J7_DDR0_SS_BASE)+Var.VALUE(&__DDRSS_PI_REGISTER_BLOCK__OFFS))+Var.VALUE(&__DDRSS_PI_211__SFR_OFFS)))) %Long Var.VALUE(&__DDRSS0_PI_211_DATA)
	Data.Set D:((((Var.VALUE(&__J7_DDR0_SS_BASE)+Var.VALUE(&__DDRSS_PI_REGISTER_BLOCK__OFFS))+Var.VALUE(&__DDRSS_PI_212__SFR_OFFS)))) %Long Var.VALUE(&__DDRSS0_PI_212_DATA)
	Data.Set D:((((Var.VALUE(&__J7_DDR0_SS_BASE)+Var.VALUE(&__DDRSS_PI_REGISTER_BLOCK__OFFS))+Var.VALUE(&__DDRSS_PI_213__SFR_OFFS)))) %Long Var.VALUE(&__DDRSS0_PI_213_DATA)
	Data.Set D:((((Var.VALUE(&__J7_DDR0_SS_BASE)+Var.VALUE(&__DDRSS_PI_REGISTER_BLOCK__OFFS))+Var.VALUE(&__DDRSS_PI_214__SFR_OFFS)))) %Long Var.VALUE(&__DDRSS0_PI_214_DATA)
	Data.Set D:((((Var.VALUE(&__J7_DDR0_SS_BASE)+Var.VALUE(&__DDRSS_PI_REGISTER_BLOCK__OFFS))+Var.VALUE(&__DDRSS_PI_215__SFR_OFFS)))) %Long Var.VALUE(&__DDRSS0_PI_215_DATA)
	Data.Set D:((((Var.VALUE(&__J7_DDR0_SS_BASE)+Var.VALUE(&__DDRSS_PI_REGISTER_BLOCK__OFFS))+Var.VALUE(&__DDRSS_PI_216__SFR_OFFS)))) %Long Var.VALUE(&__DDRSS0_PI_216_DATA)
	Data.Set D:((((Var.VALUE(&__J7_DDR0_SS_BASE)+Var.VALUE(&__DDRSS_PI_REGISTER_BLOCK__OFFS))+Var.VALUE(&__DDRSS_PI_217__SFR_OFFS)))) %Long Var.VALUE(&__DDRSS0_PI_217_DATA)
	Data.Set D:((((Var.VALUE(&__J7_DDR0_SS_BASE)+Var.VALUE(&__DDRSS_PI_REGISTER_BLOCK__OFFS))+Var.VALUE(&__DDRSS_PI_218__SFR_OFFS)))) %Long Var.VALUE(&__DDRSS0_PI_218_DATA)
	Data.Set D:((((Var.VALUE(&__J7_DDR0_SS_BASE)+Var.VALUE(&__DDRSS_PI_REGISTER_BLOCK__OFFS))+Var.VALUE(&__DDRSS_PI_219__SFR_OFFS)))) %Long Var.VALUE(&__DDRSS0_PI_219_DATA)
	Data.Set D:((((Var.VALUE(&__J7_DDR0_SS_BASE)+Var.VALUE(&__DDRSS_PI_REGISTER_BLOCK__OFFS))+Var.VALUE(&__DDRSS_PI_220__SFR_OFFS)))) %Long Var.VALUE(&__DDRSS0_PI_220_DATA)
	Data.Set D:((((Var.VALUE(&__J7_DDR0_SS_BASE)+Var.VALUE(&__DDRSS_PI_REGISTER_BLOCK__OFFS))+Var.VALUE(&__DDRSS_PI_221__SFR_OFFS)))) %Long Var.VALUE(&__DDRSS0_PI_221_DATA)
	Data.Set D:((((Var.VALUE(&__J7_DDR0_SS_BASE)+Var.VALUE(&__DDRSS_PI_REGISTER_BLOCK__OFFS))+Var.VALUE(&__DDRSS_PI_222__SFR_OFFS)))) %Long Var.VALUE(&__DDRSS0_PI_222_DATA)
	Data.Set D:((((Var.VALUE(&__J7_DDR0_SS_BASE)+Var.VALUE(&__DDRSS_PI_REGISTER_BLOCK__OFFS))+Var.VALUE(&__DDRSS_PI_223__SFR_OFFS)))) %Long Var.VALUE(&__DDRSS0_PI_223_DATA)
	Data.Set D:((((Var.VALUE(&__J7_DDR0_SS_BASE)+Var.VALUE(&__DDRSS_PI_REGISTER_BLOCK__OFFS))+Var.VALUE(&__DDRSS_PI_224__SFR_OFFS)))) %Long Var.VALUE(&__DDRSS0_PI_224_DATA)
	Data.Set D:((((Var.VALUE(&__J7_DDR0_SS_BASE)+Var.VALUE(&__DDRSS_PI_REGISTER_BLOCK__OFFS))+Var.VALUE(&__DDRSS_PI_225__SFR_OFFS)))) %Long Var.VALUE(&__DDRSS0_PI_225_DATA)
	Data.Set D:((((Var.VALUE(&__J7_DDR0_SS_BASE)+Var.VALUE(&__DDRSS_PI_REGISTER_BLOCK__OFFS))+Var.VALUE(&__DDRSS_PI_226__SFR_OFFS)))) %Long Var.VALUE(&__DDRSS0_PI_226_DATA)
	Data.Set D:((((Var.VALUE(&__J7_DDR0_SS_BASE)+Var.VALUE(&__DDRSS_PI_REGISTER_BLOCK__OFFS))+Var.VALUE(&__DDRSS_PI_227__SFR_OFFS)))) %Long Var.VALUE(&__DDRSS0_PI_227_DATA)
	Data.Set D:((((Var.VALUE(&__J7_DDR0_SS_BASE)+Var.VALUE(&__DDRSS_PI_REGISTER_BLOCK__OFFS))+Var.VALUE(&__DDRSS_PI_228__SFR_OFFS)))) %Long Var.VALUE(&__DDRSS0_PI_228_DATA)
	Data.Set D:((((Var.VALUE(&__J7_DDR0_SS_BASE)+Var.VALUE(&__DDRSS_PI_REGISTER_BLOCK__OFFS))+Var.VALUE(&__DDRSS_PI_229__SFR_OFFS)))) %Long Var.VALUE(&__DDRSS0_PI_229_DATA)
	Data.Set D:((((Var.VALUE(&__J7_DDR0_SS_BASE)+Var.VALUE(&__DDRSS_PI_REGISTER_BLOCK__OFFS))+Var.VALUE(&__DDRSS_PI_230__SFR_OFFS)))) %Long Var.VALUE(&__DDRSS0_PI_230_DATA)
	Data.Set D:((((Var.VALUE(&__J7_DDR0_SS_BASE)+Var.VALUE(&__DDRSS_PI_REGISTER_BLOCK__OFFS))+Var.VALUE(&__DDRSS_PI_231__SFR_OFFS)))) %Long Var.VALUE(&__DDRSS0_PI_231_DATA)
	Data.Set D:((((Var.VALUE(&__J7_DDR0_SS_BASE)+Var.VALUE(&__DDRSS_PI_REGISTER_BLOCK__OFFS))+Var.VALUE(&__DDRSS_PI_232__SFR_OFFS)))) %Long Var.VALUE(&__DDRSS0_PI_232_DATA)
	Data.Set D:((((Var.VALUE(&__J7_DDR0_SS_BASE)+Var.VALUE(&__DDRSS_PI_REGISTER_BLOCK__OFFS))+Var.VALUE(&__DDRSS_PI_233__SFR_OFFS)))) %Long Var.VALUE(&__DDRSS0_PI_233_DATA)
	Data.Set D:((((Var.VALUE(&__J7_DDR0_SS_BASE)+Var.VALUE(&__DDRSS_PI_REGISTER_BLOCK__OFFS))+Var.VALUE(&__DDRSS_PI_234__SFR_OFFS)))) %Long Var.VALUE(&__DDRSS0_PI_234_DATA)
	Data.Set D:((((Var.VALUE(&__J7_DDR0_SS_BASE)+Var.VALUE(&__DDRSS_PI_REGISTER_BLOCK__OFFS))+Var.VALUE(&__DDRSS_PI_235__SFR_OFFS)))) %Long Var.VALUE(&__DDRSS0_PI_235_DATA)
	Data.Set D:((((Var.VALUE(&__J7_DDR0_SS_BASE)+Var.VALUE(&__DDRSS_PI_REGISTER_BLOCK__OFFS))+Var.VALUE(&__DDRSS_PI_236__SFR_OFFS)))) %Long Var.VALUE(&__DDRSS0_PI_236_DATA)
	Data.Set D:((((Var.VALUE(&__J7_DDR0_SS_BASE)+Var.VALUE(&__DDRSS_PI_REGISTER_BLOCK__OFFS))+Var.VALUE(&__DDRSS_PI_237__SFR_OFFS)))) %Long Var.VALUE(&__DDRSS0_PI_237_DATA)
	Data.Set D:((((Var.VALUE(&__J7_DDR0_SS_BASE)+Var.VALUE(&__DDRSS_PI_REGISTER_BLOCK__OFFS))+Var.VALUE(&__DDRSS_PI_238__SFR_OFFS)))) %Long Var.VALUE(&__DDRSS0_PI_238_DATA)
	Data.Set D:((((Var.VALUE(&__J7_DDR0_SS_BASE)+Var.VALUE(&__DDRSS_PI_REGISTER_BLOCK__OFFS))+Var.VALUE(&__DDRSS_PI_239__SFR_OFFS)))) %Long Var.VALUE(&__DDRSS0_PI_239_DATA)
	Data.Set D:((((Var.VALUE(&__J7_DDR0_SS_BASE)+Var.VALUE(&__DDRSS_PI_REGISTER_BLOCK__OFFS))+Var.VALUE(&__DDRSS_PI_240__SFR_OFFS)))) %Long Var.VALUE(&__DDRSS0_PI_240_DATA)
	Data.Set D:((((Var.VALUE(&__J7_DDR0_SS_BASE)+Var.VALUE(&__DDRSS_PI_REGISTER_BLOCK__OFFS))+Var.VALUE(&__DDRSS_PI_241__SFR_OFFS)))) %Long Var.VALUE(&__DDRSS0_PI_241_DATA)
	Data.Set D:((((Var.VALUE(&__J7_DDR0_SS_BASE)+Var.VALUE(&__DDRSS_PI_REGISTER_BLOCK__OFFS))+Var.VALUE(&__DDRSS_PI_242__SFR_OFFS)))) %Long Var.VALUE(&__DDRSS0_PI_242_DATA)
	Data.Set D:((((Var.VALUE(&__J7_DDR0_SS_BASE)+Var.VALUE(&__DDRSS_PI_REGISTER_BLOCK__OFFS))+Var.VALUE(&__DDRSS_PI_243__SFR_OFFS)))) %Long Var.VALUE(&__DDRSS0_PI_243_DATA)
	Data.Set D:((((Var.VALUE(&__J7_DDR0_SS_BASE)+Var.VALUE(&__DDRSS_PI_REGISTER_BLOCK__OFFS))+Var.VALUE(&__DDRSS_PI_244__SFR_OFFS)))) %Long Var.VALUE(&__DDRSS0_PI_244_DATA)
	Data.Set D:((((Var.VALUE(&__J7_DDR0_SS_BASE)+Var.VALUE(&__DDRSS_PI_REGISTER_BLOCK__OFFS))+Var.VALUE(&__DDRSS_PI_245__SFR_OFFS)))) %Long Var.VALUE(&__DDRSS0_PI_245_DATA)
	Data.Set D:((((Var.VALUE(&__J7_DDR0_SS_BASE)+Var.VALUE(&__DDRSS_PI_REGISTER_BLOCK__OFFS))+Var.VALUE(&__DDRSS_PI_246__SFR_OFFS)))) %Long Var.VALUE(&__DDRSS0_PI_246_DATA)
	Data.Set D:((((Var.VALUE(&__J7_DDR0_SS_BASE)+Var.VALUE(&__DDRSS_PI_REGISTER_BLOCK__OFFS))+Var.VALUE(&__DDRSS_PI_247__SFR_OFFS)))) %Long Var.VALUE(&__DDRSS0_PI_247_DATA)
	Data.Set D:((((Var.VALUE(&__J7_DDR0_SS_BASE)+Var.VALUE(&__DDRSS_PI_REGISTER_BLOCK__OFFS))+Var.VALUE(&__DDRSS_PI_248__SFR_OFFS)))) %Long Var.VALUE(&__DDRSS0_PI_248_DATA)
	Data.Set D:((((Var.VALUE(&__J7_DDR0_SS_BASE)+Var.VALUE(&__DDRSS_PI_REGISTER_BLOCK__OFFS))+Var.VALUE(&__DDRSS_PI_249__SFR_OFFS)))) %Long Var.VALUE(&__DDRSS0_PI_249_DATA)
	Data.Set D:((((Var.VALUE(&__J7_DDR0_SS_BASE)+Var.VALUE(&__DDRSS_PI_REGISTER_BLOCK__OFFS))+Var.VALUE(&__DDRSS_PI_250__SFR_OFFS)))) %Long Var.VALUE(&__DDRSS0_PI_250_DATA)
	Data.Set D:((((Var.VALUE(&__J7_DDR0_SS_BASE)+Var.VALUE(&__DDRSS_PI_REGISTER_BLOCK__OFFS))+Var.VALUE(&__DDRSS_PI_251__SFR_OFFS)))) %Long Var.VALUE(&__DDRSS0_PI_251_DATA)
	Data.Set D:((((Var.VALUE(&__J7_DDR0_SS_BASE)+Var.VALUE(&__DDRSS_PI_REGISTER_BLOCK__OFFS))+Var.VALUE(&__DDRSS_PI_252__SFR_OFFS)))) %Long Var.VALUE(&__DDRSS0_PI_252_DATA)
	Data.Set D:((((Var.VALUE(&__J7_DDR0_SS_BASE)+Var.VALUE(&__DDRSS_PI_REGISTER_BLOCK__OFFS))+Var.VALUE(&__DDRSS_PI_253__SFR_OFFS)))) %Long Var.VALUE(&__DDRSS0_PI_253_DATA)
	Data.Set D:((((Var.VALUE(&__J7_DDR0_SS_BASE)+Var.VALUE(&__DDRSS_PI_REGISTER_BLOCK__OFFS))+Var.VALUE(&__DDRSS_PI_254__SFR_OFFS)))) %Long Var.VALUE(&__DDRSS0_PI_254_DATA)
	Data.Set D:((((Var.VALUE(&__J7_DDR0_SS_BASE)+Var.VALUE(&__DDRSS_PI_REGISTER_BLOCK__OFFS))+Var.VALUE(&__DDRSS_PI_255__SFR_OFFS)))) %Long Var.VALUE(&__DDRSS0_PI_255_DATA)
	Data.Set D:((((Var.VALUE(&__J7_DDR0_SS_BASE)+Var.VALUE(&__DDRSS_PI_REGISTER_BLOCK__OFFS))+Var.VALUE(&__DDRSS_PI_256__SFR_OFFS)))) %Long Var.VALUE(&__DDRSS0_PI_256_DATA)
	Data.Set D:((((Var.VALUE(&__J7_DDR0_SS_BASE)+Var.VALUE(&__DDRSS_PI_REGISTER_BLOCK__OFFS))+Var.VALUE(&__DDRSS_PI_257__SFR_OFFS)))) %Long Var.VALUE(&__DDRSS0_PI_257_DATA)
	Data.Set D:((((Var.VALUE(&__J7_DDR0_SS_BASE)+Var.VALUE(&__DDRSS_PI_REGISTER_BLOCK__OFFS))+Var.VALUE(&__DDRSS_PI_258__SFR_OFFS)))) %Long Var.VALUE(&__DDRSS0_PI_258_DATA)
	Data.Set D:((((Var.VALUE(&__J7_DDR0_SS_BASE)+Var.VALUE(&__DDRSS_PI_REGISTER_BLOCK__OFFS))+Var.VALUE(&__DDRSS_PI_259__SFR_OFFS)))) %Long Var.VALUE(&__DDRSS0_PI_259_DATA)
	Data.Set D:((((Var.VALUE(&__J7_DDR0_SS_BASE)+Var.VALUE(&__DDRSS_PI_REGISTER_BLOCK__OFFS))+Var.VALUE(&__DDRSS_PI_260__SFR_OFFS)))) %Long Var.VALUE(&__DDRSS0_PI_260_DATA)
	Data.Set D:((((Var.VALUE(&__J7_DDR0_SS_BASE)+Var.VALUE(&__DDRSS_PI_REGISTER_BLOCK__OFFS))+Var.VALUE(&__DDRSS_PI_261__SFR_OFFS)))) %Long Var.VALUE(&__DDRSS0_PI_261_DATA)
	Data.Set D:((((Var.VALUE(&__J7_DDR0_SS_BASE)+Var.VALUE(&__DDRSS_PI_REGISTER_BLOCK__OFFS))+Var.VALUE(&__DDRSS_PI_262__SFR_OFFS)))) %Long Var.VALUE(&__DDRSS0_PI_262_DATA)
	Data.Set D:((((Var.VALUE(&__J7_DDR0_SS_BASE)+Var.VALUE(&__DDRSS_PI_REGISTER_BLOCK__OFFS))+Var.VALUE(&__DDRSS_PI_263__SFR_OFFS)))) %Long Var.VALUE(&__DDRSS0_PI_263_DATA)
	Data.Set D:((((Var.VALUE(&__J7_DDR0_SS_BASE)+Var.VALUE(&__DDRSS_PI_REGISTER_BLOCK__OFFS))+Var.VALUE(&__DDRSS_PI_264__SFR_OFFS)))) %Long Var.VALUE(&__DDRSS0_PI_264_DATA)
	Data.Set D:((((Var.VALUE(&__J7_DDR0_SS_BASE)+Var.VALUE(&__DDRSS_PI_REGISTER_BLOCK__OFFS))+Var.VALUE(&__DDRSS_PI_265__SFR_OFFS)))) %Long Var.VALUE(&__DDRSS0_PI_265_DATA)
	Data.Set D:((((Var.VALUE(&__J7_DDR0_SS_BASE)+Var.VALUE(&__DDRSS_PI_REGISTER_BLOCK__OFFS))+Var.VALUE(&__DDRSS_PI_266__SFR_OFFS)))) %Long Var.VALUE(&__DDRSS0_PI_266_DATA)
	Data.Set D:((((Var.VALUE(&__J7_DDR0_SS_BASE)+Var.VALUE(&__DDRSS_PI_REGISTER_BLOCK__OFFS))+Var.VALUE(&__DDRSS_PI_267__SFR_OFFS)))) %Long Var.VALUE(&__DDRSS0_PI_267_DATA)
	Data.Set D:((((Var.VALUE(&__J7_DDR0_SS_BASE)+Var.VALUE(&__DDRSS_PI_REGISTER_BLOCK__OFFS))+Var.VALUE(&__DDRSS_PI_268__SFR_OFFS)))) %Long Var.VALUE(&__DDRSS0_PI_268_DATA)
	Data.Set D:((((Var.VALUE(&__J7_DDR0_SS_BASE)+Var.VALUE(&__DDRSS_PI_REGISTER_BLOCK__OFFS))+Var.VALUE(&__DDRSS_PI_269__SFR_OFFS)))) %Long Var.VALUE(&__DDRSS0_PI_269_DATA)
	Data.Set D:((((Var.VALUE(&__J7_DDR0_SS_BASE)+Var.VALUE(&__DDRSS_PI_REGISTER_BLOCK__OFFS))+Var.VALUE(&__DDRSS_PI_270__SFR_OFFS)))) %Long Var.VALUE(&__DDRSS0_PI_270_DATA)
	Data.Set D:((((Var.VALUE(&__J7_DDR0_SS_BASE)+Var.VALUE(&__DDRSS_PI_REGISTER_BLOCK__OFFS))+Var.VALUE(&__DDRSS_PI_271__SFR_OFFS)))) %Long Var.VALUE(&__DDRSS0_PI_271_DATA)
	Data.Set D:((((Var.VALUE(&__J7_DDR0_SS_BASE)+Var.VALUE(&__DDRSS_PI_REGISTER_BLOCK__OFFS))+Var.VALUE(&__DDRSS_PI_272__SFR_OFFS)))) %Long Var.VALUE(&__DDRSS0_PI_272_DATA)
	Data.Set D:((((Var.VALUE(&__J7_DDR0_SS_BASE)+Var.VALUE(&__DDRSS_PI_REGISTER_BLOCK__OFFS))+Var.VALUE(&__DDRSS_PI_273__SFR_OFFS)))) %Long Var.VALUE(&__DDRSS0_PI_273_DATA)
	Data.Set D:((((Var.VALUE(&__J7_DDR0_SS_BASE)+Var.VALUE(&__DDRSS_PI_REGISTER_BLOCK__OFFS))+Var.VALUE(&__DDRSS_PI_274__SFR_OFFS)))) %Long Var.VALUE(&__DDRSS0_PI_274_DATA)
	Data.Set D:((((Var.VALUE(&__J7_DDR0_SS_BASE)+Var.VALUE(&__DDRSS_PI_REGISTER_BLOCK__OFFS))+Var.VALUE(&__DDRSS_PI_275__SFR_OFFS)))) %Long Var.VALUE(&__DDRSS0_PI_275_DATA)
	Data.Set D:((((Var.VALUE(&__J7_DDR0_SS_BASE)+Var.VALUE(&__DDRSS_PI_REGISTER_BLOCK__OFFS))+Var.VALUE(&__DDRSS_PI_276__SFR_OFFS)))) %Long Var.VALUE(&__DDRSS0_PI_276_DATA)
	Data.Set D:((((Var.VALUE(&__J7_DDR0_SS_BASE)+Var.VALUE(&__DDRSS_PI_REGISTER_BLOCK__OFFS))+Var.VALUE(&__DDRSS_PI_277__SFR_OFFS)))) %Long Var.VALUE(&__DDRSS0_PI_277_DATA)
	Data.Set D:((((Var.VALUE(&__J7_DDR0_SS_BASE)+Var.VALUE(&__DDRSS_PI_REGISTER_BLOCK__OFFS))+Var.VALUE(&__DDRSS_PI_278__SFR_OFFS)))) %Long Var.VALUE(&__DDRSS0_PI_278_DATA)
	Data.Set D:((((Var.VALUE(&__J7_DDR0_SS_BASE)+Var.VALUE(&__DDRSS_PI_REGISTER_BLOCK__OFFS))+Var.VALUE(&__DDRSS_PI_279__SFR_OFFS)))) %Long Var.VALUE(&__DDRSS0_PI_279_DATA)
	Data.Set D:((((Var.VALUE(&__J7_DDR0_SS_BASE)+Var.VALUE(&__DDRSS_PI_REGISTER_BLOCK__OFFS))+Var.VALUE(&__DDRSS_PI_280__SFR_OFFS)))) %Long Var.VALUE(&__DDRSS0_PI_280_DATA)
	Data.Set D:((((Var.VALUE(&__J7_DDR0_SS_BASE)+Var.VALUE(&__DDRSS_PI_REGISTER_BLOCK__OFFS))+Var.VALUE(&__DDRSS_PI_281__SFR_OFFS)))) %Long Var.VALUE(&__DDRSS0_PI_281_DATA)
	Data.Set D:((((Var.VALUE(&__J7_DDR0_SS_BASE)+Var.VALUE(&__DDRSS_PI_REGISTER_BLOCK__OFFS))+Var.VALUE(&__DDRSS_PI_282__SFR_OFFS)))) %Long Var.VALUE(&__DDRSS0_PI_282_DATA)
	Data.Set D:((((Var.VALUE(&__J7_DDR0_SS_BASE)+Var.VALUE(&__DDRSS_PI_REGISTER_BLOCK__OFFS))+Var.VALUE(&__DDRSS_PI_283__SFR_OFFS)))) %Long Var.VALUE(&__DDRSS0_PI_283_DATA)
	Data.Set D:((((Var.VALUE(&__J7_DDR0_SS_BASE)+Var.VALUE(&__DDRSS_PI_REGISTER_BLOCK__OFFS))+Var.VALUE(&__DDRSS_PI_284__SFR_OFFS)))) %Long Var.VALUE(&__DDRSS0_PI_284_DATA)
	Data.Set D:((((Var.VALUE(&__J7_DDR0_SS_BASE)+Var.VALUE(&__DDRSS_PI_REGISTER_BLOCK__OFFS))+Var.VALUE(&__DDRSS_PI_285__SFR_OFFS)))) %Long Var.VALUE(&__DDRSS0_PI_285_DATA)
	Data.Set D:((((Var.VALUE(&__J7_DDR0_SS_BASE)+Var.VALUE(&__DDRSS_PI_REGISTER_BLOCK__OFFS))+Var.VALUE(&__DDRSS_PI_286__SFR_OFFS)))) %Long Var.VALUE(&__DDRSS0_PI_286_DATA)
	Data.Set D:((((Var.VALUE(&__J7_DDR0_SS_BASE)+Var.VALUE(&__DDRSS_PI_REGISTER_BLOCK__OFFS))+Var.VALUE(&__DDRSS_PI_287__SFR_OFFS)))) %Long Var.VALUE(&__DDRSS0_PI_287_DATA)
	Data.Set D:((((Var.VALUE(&__J7_DDR0_SS_BASE)+Var.VALUE(&__DDRSS_PI_REGISTER_BLOCK__OFFS))+Var.VALUE(&__DDRSS_PI_288__SFR_OFFS)))) %Long Var.VALUE(&__DDRSS0_PI_288_DATA)
	Data.Set D:((((Var.VALUE(&__J7_DDR0_SS_BASE)+Var.VALUE(&__DDRSS_PI_REGISTER_BLOCK__OFFS))+Var.VALUE(&__DDRSS_PI_289__SFR_OFFS)))) %Long Var.VALUE(&__DDRSS0_PI_289_DATA)
	Data.Set D:((((Var.VALUE(&__J7_DDR0_SS_BASE)+Var.VALUE(&__DDRSS_PI_REGISTER_BLOCK__OFFS))+Var.VALUE(&__DDRSS_PI_290__SFR_OFFS)))) %Long Var.VALUE(&__DDRSS0_PI_290_DATA)
	Data.Set D:((((Var.VALUE(&__J7_DDR0_SS_BASE)+Var.VALUE(&__DDRSS_PI_REGISTER_BLOCK__OFFS))+Var.VALUE(&__DDRSS_PI_291__SFR_OFFS)))) %Long Var.VALUE(&__DDRSS0_PI_291_DATA)
	Data.Set D:((((Var.VALUE(&__J7_DDR0_SS_BASE)+Var.VALUE(&__DDRSS_PI_REGISTER_BLOCK__OFFS))+Var.VALUE(&__DDRSS_PI_292__SFR_OFFS)))) %Long Var.VALUE(&__DDRSS0_PI_292_DATA)
	Data.Set D:((((Var.VALUE(&__J7_DDR0_SS_BASE)+Var.VALUE(&__DDRSS_PI_REGISTER_BLOCK__OFFS))+Var.VALUE(&__DDRSS_PI_293__SFR_OFFS)))) %Long Var.VALUE(&__DDRSS0_PI_293_DATA)
	Data.Set D:((((Var.VALUE(&__J7_DDR0_SS_BASE)+Var.VALUE(&__DDRSS_PI_REGISTER_BLOCK__OFFS))+Var.VALUE(&__DDRSS_PI_294__SFR_OFFS)))) %Long Var.VALUE(&__DDRSS0_PI_294_DATA)
	Data.Set D:((((Var.VALUE(&__J7_DDR0_SS_BASE)+Var.VALUE(&__DDRSS_PI_REGISTER_BLOCK__OFFS))+Var.VALUE(&__DDRSS_PI_295__SFR_OFFS)))) %Long Var.VALUE(&__DDRSS0_PI_295_DATA)
	Data.Set D:((((Var.VALUE(&__J7_DDR0_SS_BASE)+Var.VALUE(&__DDRSS_PI_REGISTER_BLOCK__OFFS))+Var.VALUE(&__DDRSS_PI_296__SFR_OFFS)))) %Long Var.VALUE(&__DDRSS0_PI_296_DATA)
	Data.Set D:((((Var.VALUE(&__J7_DDR0_SS_BASE)+Var.VALUE(&__DDRSS_PI_REGISTER_BLOCK__OFFS))+Var.VALUE(&__DDRSS_PI_297__SFR_OFFS)))) %Long Var.VALUE(&__DDRSS0_PI_297_DATA)
	Data.Set D:((((Var.VALUE(&__J7_DDR0_SS_BASE)+Var.VALUE(&__DDRSS_PI_REGISTER_BLOCK__OFFS))+Var.VALUE(&__DDRSS_PI_298__SFR_OFFS)))) %Long Var.VALUE(&__DDRSS0_PI_298_DATA)
	Data.Set D:((((Var.VALUE(&__J7_DDR0_SS_BASE)+Var.VALUE(&__DDRSS_PI_REGISTER_BLOCK__OFFS))+Var.VALUE(&__DDRSS_PI_299__SFR_OFFS)))) %Long Var.VALUE(&__DDRSS0_PI_299_DATA)
	Var.NEWLOCAL char[128] \strtmp = "--->>> DDR0 PI programming completed... <<<---\n"
	GOSUB printf Var.String(\strtmp)
	
	Var.NEWLOCAL char[128] \strtmp = "--->>> DDR0 PHY Data Slice 0 programming in progress.. <<<---\n"
	GOSUB printf Var.String(\strtmp)
	
	Data.Set D:((((Var.VALUE(&__J7_DDR0_SS_BASE)+Var.VALUE(&__DDRSS_Data_Slice_0_REGISTER_BLOCK__OFFS))+Var.VALUE(&__DDRSS_PHY_0__SFR_OFFS)))) %Long Var.VALUE(&__DDRSS0_PHY_00_DATA)
	Data.Set D:((((Var.VALUE(&__J7_DDR0_SS_BASE)+Var.VALUE(&__DDRSS_Data_Slice_0_REGISTER_BLOCK__OFFS))+Var.VALUE(&__DDRSS_PHY_1__SFR_OFFS)))) %Long Var.VALUE(&__DDRSS0_PHY_01_DATA)
	Data.Set D:((((Var.VALUE(&__J7_DDR0_SS_BASE)+Var.VALUE(&__DDRSS_Data_Slice_0_REGISTER_BLOCK__OFFS))+Var.VALUE(&__DDRSS_PHY_2__SFR_OFFS)))) %Long Var.VALUE(&__DDRSS0_PHY_02_DATA)
	Data.Set D:((((Var.VALUE(&__J7_DDR0_SS_BASE)+Var.VALUE(&__DDRSS_Data_Slice_0_REGISTER_BLOCK__OFFS))+Var.VALUE(&__DDRSS_PHY_3__SFR_OFFS)))) %Long Var.VALUE(&__DDRSS0_PHY_03_DATA)
	Data.Set D:((((Var.VALUE(&__J7_DDR0_SS_BASE)+Var.VALUE(&__DDRSS_Data_Slice_0_REGISTER_BLOCK__OFFS))+Var.VALUE(&__DDRSS_PHY_4__SFR_OFFS)))) %Long Var.VALUE(&__DDRSS0_PHY_04_DATA)
	Data.Set D:((((Var.VALUE(&__J7_DDR0_SS_BASE)+Var.VALUE(&__DDRSS_Data_Slice_0_REGISTER_BLOCK__OFFS))+Var.VALUE(&__DDRSS_PHY_5__SFR_OFFS)))) %Long Var.VALUE(&__DDRSS0_PHY_05_DATA)
	Data.Set D:((((Var.VALUE(&__J7_DDR0_SS_BASE)+Var.VALUE(&__DDRSS_Data_Slice_0_REGISTER_BLOCK__OFFS))+Var.VALUE(&__DDRSS_PHY_6__SFR_OFFS)))) %Long Var.VALUE(&__DDRSS0_PHY_06_DATA)
	Data.Set D:((((Var.VALUE(&__J7_DDR0_SS_BASE)+Var.VALUE(&__DDRSS_Data_Slice_0_REGISTER_BLOCK__OFFS))+Var.VALUE(&__DDRSS_PHY_7__SFR_OFFS)))) %Long Var.VALUE(&__DDRSS0_PHY_07_DATA)
	Data.Set D:((((Var.VALUE(&__J7_DDR0_SS_BASE)+Var.VALUE(&__DDRSS_Data_Slice_0_REGISTER_BLOCK__OFFS))+Var.VALUE(&__DDRSS_PHY_8__SFR_OFFS)))) %Long Var.VALUE(&__DDRSS0_PHY_08_DATA)
	Data.Set D:((((Var.VALUE(&__J7_DDR0_SS_BASE)+Var.VALUE(&__DDRSS_Data_Slice_0_REGISTER_BLOCK__OFFS))+Var.VALUE(&__DDRSS_PHY_9__SFR_OFFS)))) %Long Var.VALUE(&__DDRSS0_PHY_09_DATA)
	Data.Set D:((((Var.VALUE(&__J7_DDR0_SS_BASE)+Var.VALUE(&__DDRSS_Data_Slice_0_REGISTER_BLOCK__OFFS))+Var.VALUE(&__DDRSS_PHY_10__SFR_OFFS)))) %Long Var.VALUE(&__DDRSS0_PHY_10_DATA)
	Data.Set D:((((Var.VALUE(&__J7_DDR0_SS_BASE)+Var.VALUE(&__DDRSS_Data_Slice_0_REGISTER_BLOCK__OFFS))+Var.VALUE(&__DDRSS_PHY_11__SFR_OFFS)))) %Long Var.VALUE(&__DDRSS0_PHY_11_DATA)
	Data.Set D:((((Var.VALUE(&__J7_DDR0_SS_BASE)+Var.VALUE(&__DDRSS_Data_Slice_0_REGISTER_BLOCK__OFFS))+Var.VALUE(&__DDRSS_PHY_12__SFR_OFFS)))) %Long Var.VALUE(&__DDRSS0_PHY_12_DATA)
	Data.Set D:((((Var.VALUE(&__J7_DDR0_SS_BASE)+Var.VALUE(&__DDRSS_Data_Slice_0_REGISTER_BLOCK__OFFS))+Var.VALUE(&__DDRSS_PHY_13__SFR_OFFS)))) %Long Var.VALUE(&__DDRSS0_PHY_13_DATA)
	Data.Set D:((((Var.VALUE(&__J7_DDR0_SS_BASE)+Var.VALUE(&__DDRSS_Data_Slice_0_REGISTER_BLOCK__OFFS))+Var.VALUE(&__DDRSS_PHY_14__SFR_OFFS)))) %Long Var.VALUE(&__DDRSS0_PHY_14_DATA)
	Data.Set D:((((Var.VALUE(&__J7_DDR0_SS_BASE)+Var.VALUE(&__DDRSS_Data_Slice_0_REGISTER_BLOCK__OFFS))+Var.VALUE(&__DDRSS_PHY_15__SFR_OFFS)))) %Long Var.VALUE(&__DDRSS0_PHY_15_DATA)
	Data.Set D:((((Var.VALUE(&__J7_DDR0_SS_BASE)+Var.VALUE(&__DDRSS_Data_Slice_0_REGISTER_BLOCK__OFFS))+Var.VALUE(&__DDRSS_PHY_16__SFR_OFFS)))) %Long Var.VALUE(&__DDRSS0_PHY_16_DATA)
	Data.Set D:((((Var.VALUE(&__J7_DDR0_SS_BASE)+Var.VALUE(&__DDRSS_Data_Slice_0_REGISTER_BLOCK__OFFS))+Var.VALUE(&__DDRSS_PHY_17__SFR_OFFS)))) %Long Var.VALUE(&__DDRSS0_PHY_17_DATA)
	Data.Set D:((((Var.VALUE(&__J7_DDR0_SS_BASE)+Var.VALUE(&__DDRSS_Data_Slice_0_REGISTER_BLOCK__OFFS))+Var.VALUE(&__DDRSS_PHY_18__SFR_OFFS)))) %Long Var.VALUE(&__DDRSS0_PHY_18_DATA)
	Data.Set D:((((Var.VALUE(&__J7_DDR0_SS_BASE)+Var.VALUE(&__DDRSS_Data_Slice_0_REGISTER_BLOCK__OFFS))+Var.VALUE(&__DDRSS_PHY_19__SFR_OFFS)))) %Long Var.VALUE(&__DDRSS0_PHY_19_DATA)
	Data.Set D:((((Var.VALUE(&__J7_DDR0_SS_BASE)+Var.VALUE(&__DDRSS_Data_Slice_0_REGISTER_BLOCK__OFFS))+Var.VALUE(&__DDRSS_PHY_20__SFR_OFFS)))) %Long Var.VALUE(&__DDRSS0_PHY_20_DATA)
	Data.Set D:((((Var.VALUE(&__J7_DDR0_SS_BASE)+Var.VALUE(&__DDRSS_Data_Slice_0_REGISTER_BLOCK__OFFS))+Var.VALUE(&__DDRSS_PHY_21__SFR_OFFS)))) %Long Var.VALUE(&__DDRSS0_PHY_21_DATA)
	Data.Set D:((((Var.VALUE(&__J7_DDR0_SS_BASE)+Var.VALUE(&__DDRSS_Data_Slice_0_REGISTER_BLOCK__OFFS))+Var.VALUE(&__DDRSS_PHY_22__SFR_OFFS)))) %Long Var.VALUE(&__DDRSS0_PHY_22_DATA)
	Data.Set D:((((Var.VALUE(&__J7_DDR0_SS_BASE)+Var.VALUE(&__DDRSS_Data_Slice_0_REGISTER_BLOCK__OFFS))+Var.VALUE(&__DDRSS_PHY_23__SFR_OFFS)))) %Long Var.VALUE(&__DDRSS0_PHY_23_DATA)
	Data.Set D:((((Var.VALUE(&__J7_DDR0_SS_BASE)+Var.VALUE(&__DDRSS_Data_Slice_0_REGISTER_BLOCK__OFFS))+Var.VALUE(&__DDRSS_PHY_24__SFR_OFFS)))) %Long Var.VALUE(&__DDRSS0_PHY_24_DATA)
	Data.Set D:((((Var.VALUE(&__J7_DDR0_SS_BASE)+Var.VALUE(&__DDRSS_Data_Slice_0_REGISTER_BLOCK__OFFS))+Var.VALUE(&__DDRSS_PHY_25__SFR_OFFS)))) %Long Var.VALUE(&__DDRSS0_PHY_25_DATA)
	Data.Set D:((((Var.VALUE(&__J7_DDR0_SS_BASE)+Var.VALUE(&__DDRSS_Data_Slice_0_REGISTER_BLOCK__OFFS))+Var.VALUE(&__DDRSS_PHY_26__SFR_OFFS)))) %Long Var.VALUE(&__DDRSS0_PHY_26_DATA)
	Data.Set D:((((Var.VALUE(&__J7_DDR0_SS_BASE)+Var.VALUE(&__DDRSS_Data_Slice_0_REGISTER_BLOCK__OFFS))+Var.VALUE(&__DDRSS_PHY_27__SFR_OFFS)))) %Long Var.VALUE(&__DDRSS0_PHY_27_DATA)
	Data.Set D:((((Var.VALUE(&__J7_DDR0_SS_BASE)+Var.VALUE(&__DDRSS_Data_Slice_0_REGISTER_BLOCK__OFFS))+Var.VALUE(&__DDRSS_PHY_28__SFR_OFFS)))) %Long Var.VALUE(&__DDRSS0_PHY_28_DATA)
	Data.Set D:((((Var.VALUE(&__J7_DDR0_SS_BASE)+Var.VALUE(&__DDRSS_Data_Slice_0_REGISTER_BLOCK__OFFS))+Var.VALUE(&__DDRSS_PHY_29__SFR_OFFS)))) %Long Var.VALUE(&__DDRSS0_PHY_29_DATA)
	Data.Set D:((((Var.VALUE(&__J7_DDR0_SS_BASE)+Var.VALUE(&__DDRSS_Data_Slice_0_REGISTER_BLOCK__OFFS))+Var.VALUE(&__DDRSS_PHY_30__SFR_OFFS)))) %Long Var.VALUE(&__DDRSS0_PHY_30_DATA)
	Data.Set D:((((Var.VALUE(&__J7_DDR0_SS_BASE)+Var.VALUE(&__DDRSS_Data_Slice_0_REGISTER_BLOCK__OFFS))+Var.VALUE(&__DDRSS_PHY_31__SFR_OFFS)))) %Long Var.VALUE(&__DDRSS0_PHY_31_DATA)
	Data.Set D:((((Var.VALUE(&__J7_DDR0_SS_BASE)+Var.VALUE(&__DDRSS_Data_Slice_0_REGISTER_BLOCK__OFFS))+Var.VALUE(&__DDRSS_PHY_32__SFR_OFFS)))) %Long Var.VALUE(&__DDRSS0_PHY_32_DATA)
	Data.Set D:((((Var.VALUE(&__J7_DDR0_SS_BASE)+Var.VALUE(&__DDRSS_Data_Slice_0_REGISTER_BLOCK__OFFS))+Var.VALUE(&__DDRSS_PHY_33__SFR_OFFS)))) %Long Var.VALUE(&__DDRSS0_PHY_33_DATA)
	Data.Set D:((((Var.VALUE(&__J7_DDR0_SS_BASE)+Var.VALUE(&__DDRSS_Data_Slice_0_REGISTER_BLOCK__OFFS))+Var.VALUE(&__DDRSS_PHY_34__SFR_OFFS)))) %Long Var.VALUE(&__DDRSS0_PHY_34_DATA)
	Data.Set D:((((Var.VALUE(&__J7_DDR0_SS_BASE)+Var.VALUE(&__DDRSS_Data_Slice_0_REGISTER_BLOCK__OFFS))+Var.VALUE(&__DDRSS_PHY_35__SFR_OFFS)))) %Long Var.VALUE(&__DDRSS0_PHY_35_DATA)
	Data.Set D:((((Var.VALUE(&__J7_DDR0_SS_BASE)+Var.VALUE(&__DDRSS_Data_Slice_0_REGISTER_BLOCK__OFFS))+Var.VALUE(&__DDRSS_PHY_36__SFR_OFFS)))) %Long Var.VALUE(&__DDRSS0_PHY_36_DATA)
	Data.Set D:((((Var.VALUE(&__J7_DDR0_SS_BASE)+Var.VALUE(&__DDRSS_Data_Slice_0_REGISTER_BLOCK__OFFS))+Var.VALUE(&__DDRSS_PHY_37__SFR_OFFS)))) %Long Var.VALUE(&__DDRSS0_PHY_37_DATA)
	Data.Set D:((((Var.VALUE(&__J7_DDR0_SS_BASE)+Var.VALUE(&__DDRSS_Data_Slice_0_REGISTER_BLOCK__OFFS))+Var.VALUE(&__DDRSS_PHY_38__SFR_OFFS)))) %Long Var.VALUE(&__DDRSS0_PHY_38_DATA)
	Data.Set D:((((Var.VALUE(&__J7_DDR0_SS_BASE)+Var.VALUE(&__DDRSS_Data_Slice_0_REGISTER_BLOCK__OFFS))+Var.VALUE(&__DDRSS_PHY_39__SFR_OFFS)))) %Long Var.VALUE(&__DDRSS0_PHY_39_DATA)
	Data.Set D:((((Var.VALUE(&__J7_DDR0_SS_BASE)+Var.VALUE(&__DDRSS_Data_Slice_0_REGISTER_BLOCK__OFFS))+Var.VALUE(&__DDRSS_PHY_40__SFR_OFFS)))) %Long Var.VALUE(&__DDRSS0_PHY_40_DATA)
	Data.Set D:((((Var.VALUE(&__J7_DDR0_SS_BASE)+Var.VALUE(&__DDRSS_Data_Slice_0_REGISTER_BLOCK__OFFS))+Var.VALUE(&__DDRSS_PHY_41__SFR_OFFS)))) %Long Var.VALUE(&__DDRSS0_PHY_41_DATA)
	Data.Set D:((((Var.VALUE(&__J7_DDR0_SS_BASE)+Var.VALUE(&__DDRSS_Data_Slice_0_REGISTER_BLOCK__OFFS))+Var.VALUE(&__DDRSS_PHY_42__SFR_OFFS)))) %Long Var.VALUE(&__DDRSS0_PHY_42_DATA)
	Data.Set D:((((Var.VALUE(&__J7_DDR0_SS_BASE)+Var.VALUE(&__DDRSS_Data_Slice_0_REGISTER_BLOCK__OFFS))+Var.VALUE(&__DDRSS_PHY_43__SFR_OFFS)))) %Long Var.VALUE(&__DDRSS0_PHY_43_DATA)
	Data.Set D:((((Var.VALUE(&__J7_DDR0_SS_BASE)+Var.VALUE(&__DDRSS_Data_Slice_0_REGISTER_BLOCK__OFFS))+Var.VALUE(&__DDRSS_PHY_44__SFR_OFFS)))) %Long Var.VALUE(&__DDRSS0_PHY_44_DATA)
	Data.Set D:((((Var.VALUE(&__J7_DDR0_SS_BASE)+Var.VALUE(&__DDRSS_Data_Slice_0_REGISTER_BLOCK__OFFS))+Var.VALUE(&__DDRSS_PHY_45__SFR_OFFS)))) %Long Var.VALUE(&__DDRSS0_PHY_45_DATA)
	Data.Set D:((((Var.VALUE(&__J7_DDR0_SS_BASE)+Var.VALUE(&__DDRSS_Data_Slice_0_REGISTER_BLOCK__OFFS))+Var.VALUE(&__DDRSS_PHY_46__SFR_OFFS)))) %Long Var.VALUE(&__DDRSS0_PHY_46_DATA)
	Data.Set D:((((Var.VALUE(&__J7_DDR0_SS_BASE)+Var.VALUE(&__DDRSS_Data_Slice_0_REGISTER_BLOCK__OFFS))+Var.VALUE(&__DDRSS_PHY_47__SFR_OFFS)))) %Long Var.VALUE(&__DDRSS0_PHY_47_DATA)
	Data.Set D:((((Var.VALUE(&__J7_DDR0_SS_BASE)+Var.VALUE(&__DDRSS_Data_Slice_0_REGISTER_BLOCK__OFFS))+Var.VALUE(&__DDRSS_PHY_48__SFR_OFFS)))) %Long Var.VALUE(&__DDRSS0_PHY_48_DATA)
	Data.Set D:((((Var.VALUE(&__J7_DDR0_SS_BASE)+Var.VALUE(&__DDRSS_Data_Slice_0_REGISTER_BLOCK__OFFS))+Var.VALUE(&__DDRSS_PHY_49__SFR_OFFS)))) %Long Var.VALUE(&__DDRSS0_PHY_49_DATA)
	Data.Set D:((((Var.VALUE(&__J7_DDR0_SS_BASE)+Var.VALUE(&__DDRSS_Data_Slice_0_REGISTER_BLOCK__OFFS))+Var.VALUE(&__DDRSS_PHY_50__SFR_OFFS)))) %Long Var.VALUE(&__DDRSS0_PHY_50_DATA)
	Data.Set D:((((Var.VALUE(&__J7_DDR0_SS_BASE)+Var.VALUE(&__DDRSS_Data_Slice_0_REGISTER_BLOCK__OFFS))+Var.VALUE(&__DDRSS_PHY_51__SFR_OFFS)))) %Long Var.VALUE(&__DDRSS0_PHY_51_DATA)
	Data.Set D:((((Var.VALUE(&__J7_DDR0_SS_BASE)+Var.VALUE(&__DDRSS_Data_Slice_0_REGISTER_BLOCK__OFFS))+Var.VALUE(&__DDRSS_PHY_52__SFR_OFFS)))) %Long Var.VALUE(&__DDRSS0_PHY_52_DATA)
	Data.Set D:((((Var.VALUE(&__J7_DDR0_SS_BASE)+Var.VALUE(&__DDRSS_Data_Slice_0_REGISTER_BLOCK__OFFS))+Var.VALUE(&__DDRSS_PHY_53__SFR_OFFS)))) %Long Var.VALUE(&__DDRSS0_PHY_53_DATA)
	Data.Set D:((((Var.VALUE(&__J7_DDR0_SS_BASE)+Var.VALUE(&__DDRSS_Data_Slice_0_REGISTER_BLOCK__OFFS))+Var.VALUE(&__DDRSS_PHY_54__SFR_OFFS)))) %Long Var.VALUE(&__DDRSS0_PHY_54_DATA)
	Data.Set D:((((Var.VALUE(&__J7_DDR0_SS_BASE)+Var.VALUE(&__DDRSS_Data_Slice_0_REGISTER_BLOCK__OFFS))+Var.VALUE(&__DDRSS_PHY_55__SFR_OFFS)))) %Long Var.VALUE(&__DDRSS0_PHY_55_DATA)
	Data.Set D:((((Var.VALUE(&__J7_DDR0_SS_BASE)+Var.VALUE(&__DDRSS_Data_Slice_0_REGISTER_BLOCK__OFFS))+Var.VALUE(&__DDRSS_PHY_56__SFR_OFFS)))) %Long Var.VALUE(&__DDRSS0_PHY_56_DATA)
	Data.Set D:((((Var.VALUE(&__J7_DDR0_SS_BASE)+Var.VALUE(&__DDRSS_Data_Slice_0_REGISTER_BLOCK__OFFS))+Var.VALUE(&__DDRSS_PHY_57__SFR_OFFS)))) %Long Var.VALUE(&__DDRSS0_PHY_57_DATA)
	Data.Set D:((((Var.VALUE(&__J7_DDR0_SS_BASE)+Var.VALUE(&__DDRSS_Data_Slice_0_REGISTER_BLOCK__OFFS))+Var.VALUE(&__DDRSS_PHY_58__SFR_OFFS)))) %Long Var.VALUE(&__DDRSS0_PHY_58_DATA)
	Data.Set D:((((Var.VALUE(&__J7_DDR0_SS_BASE)+Var.VALUE(&__DDRSS_Data_Slice_0_REGISTER_BLOCK__OFFS))+Var.VALUE(&__DDRSS_PHY_59__SFR_OFFS)))) %Long Var.VALUE(&__DDRSS0_PHY_59_DATA)
	Data.Set D:((((Var.VALUE(&__J7_DDR0_SS_BASE)+Var.VALUE(&__DDRSS_Data_Slice_0_REGISTER_BLOCK__OFFS))+Var.VALUE(&__DDRSS_PHY_60__SFR_OFFS)))) %Long Var.VALUE(&__DDRSS0_PHY_60_DATA)
	Data.Set D:((((Var.VALUE(&__J7_DDR0_SS_BASE)+Var.VALUE(&__DDRSS_Data_Slice_0_REGISTER_BLOCK__OFFS))+Var.VALUE(&__DDRSS_PHY_61__SFR_OFFS)))) %Long Var.VALUE(&__DDRSS0_PHY_61_DATA)
	Data.Set D:((((Var.VALUE(&__J7_DDR0_SS_BASE)+Var.VALUE(&__DDRSS_Data_Slice_0_REGISTER_BLOCK__OFFS))+Var.VALUE(&__DDRSS_PHY_62__SFR_OFFS)))) %Long Var.VALUE(&__DDRSS0_PHY_62_DATA)
	Data.Set D:((((Var.VALUE(&__J7_DDR0_SS_BASE)+Var.VALUE(&__DDRSS_Data_Slice_0_REGISTER_BLOCK__OFFS))+Var.VALUE(&__DDRSS_PHY_63__SFR_OFFS)))) %Long Var.VALUE(&__DDRSS0_PHY_63_DATA)
	Data.Set D:((((Var.VALUE(&__J7_DDR0_SS_BASE)+Var.VALUE(&__DDRSS_Data_Slice_0_REGISTER_BLOCK__OFFS))+Var.VALUE(&__DDRSS_PHY_64__SFR_OFFS)))) %Long Var.VALUE(&__DDRSS0_PHY_64_DATA)
	Data.Set D:((((Var.VALUE(&__J7_DDR0_SS_BASE)+Var.VALUE(&__DDRSS_Data_Slice_0_REGISTER_BLOCK__OFFS))+Var.VALUE(&__DDRSS_PHY_65__SFR_OFFS)))) %Long Var.VALUE(&__DDRSS0_PHY_65_DATA)
	Data.Set D:((((Var.VALUE(&__J7_DDR0_SS_BASE)+Var.VALUE(&__DDRSS_Data_Slice_0_REGISTER_BLOCK__OFFS))+Var.VALUE(&__DDRSS_PHY_66__SFR_OFFS)))) %Long Var.VALUE(&__DDRSS0_PHY_66_DATA)
	Data.Set D:((((Var.VALUE(&__J7_DDR0_SS_BASE)+Var.VALUE(&__DDRSS_Data_Slice_0_REGISTER_BLOCK__OFFS))+Var.VALUE(&__DDRSS_PHY_67__SFR_OFFS)))) %Long Var.VALUE(&__DDRSS0_PHY_67_DATA)
	Data.Set D:((((Var.VALUE(&__J7_DDR0_SS_BASE)+Var.VALUE(&__DDRSS_Data_Slice_0_REGISTER_BLOCK__OFFS))+Var.VALUE(&__DDRSS_PHY_68__SFR_OFFS)))) %Long Var.VALUE(&__DDRSS0_PHY_68_DATA)
	Data.Set D:((((Var.VALUE(&__J7_DDR0_SS_BASE)+Var.VALUE(&__DDRSS_Data_Slice_0_REGISTER_BLOCK__OFFS))+Var.VALUE(&__DDRSS_PHY_69__SFR_OFFS)))) %Long Var.VALUE(&__DDRSS0_PHY_69_DATA)
	Data.Set D:((((Var.VALUE(&__J7_DDR0_SS_BASE)+Var.VALUE(&__DDRSS_Data_Slice_0_REGISTER_BLOCK__OFFS))+Var.VALUE(&__DDRSS_PHY_70__SFR_OFFS)))) %Long Var.VALUE(&__DDRSS0_PHY_70_DATA)
	Data.Set D:((((Var.VALUE(&__J7_DDR0_SS_BASE)+Var.VALUE(&__DDRSS_Data_Slice_0_REGISTER_BLOCK__OFFS))+Var.VALUE(&__DDRSS_PHY_71__SFR_OFFS)))) %Long Var.VALUE(&__DDRSS0_PHY_71_DATA)
	Data.Set D:((((Var.VALUE(&__J7_DDR0_SS_BASE)+Var.VALUE(&__DDRSS_Data_Slice_0_REGISTER_BLOCK__OFFS))+Var.VALUE(&__DDRSS_PHY_72__SFR_OFFS)))) %Long Var.VALUE(&__DDRSS0_PHY_72_DATA)
	Data.Set D:((((Var.VALUE(&__J7_DDR0_SS_BASE)+Var.VALUE(&__DDRSS_Data_Slice_0_REGISTER_BLOCK__OFFS))+Var.VALUE(&__DDRSS_PHY_73__SFR_OFFS)))) %Long Var.VALUE(&__DDRSS0_PHY_73_DATA)
	Data.Set D:((((Var.VALUE(&__J7_DDR0_SS_BASE)+Var.VALUE(&__DDRSS_Data_Slice_0_REGISTER_BLOCK__OFFS))+Var.VALUE(&__DDRSS_PHY_74__SFR_OFFS)))) %Long Var.VALUE(&__DDRSS0_PHY_74_DATA)
	Data.Set D:((((Var.VALUE(&__J7_DDR0_SS_BASE)+Var.VALUE(&__DDRSS_Data_Slice_0_REGISTER_BLOCK__OFFS))+Var.VALUE(&__DDRSS_PHY_75__SFR_OFFS)))) %Long Var.VALUE(&__DDRSS0_PHY_75_DATA)
	Data.Set D:((((Var.VALUE(&__J7_DDR0_SS_BASE)+Var.VALUE(&__DDRSS_Data_Slice_0_REGISTER_BLOCK__OFFS))+Var.VALUE(&__DDRSS_PHY_76__SFR_OFFS)))) %Long Var.VALUE(&__DDRSS0_PHY_76_DATA)
	Data.Set D:((((Var.VALUE(&__J7_DDR0_SS_BASE)+Var.VALUE(&__DDRSS_Data_Slice_0_REGISTER_BLOCK__OFFS))+Var.VALUE(&__DDRSS_PHY_77__SFR_OFFS)))) %Long Var.VALUE(&__DDRSS0_PHY_77_DATA)
	Data.Set D:((((Var.VALUE(&__J7_DDR0_SS_BASE)+Var.VALUE(&__DDRSS_Data_Slice_0_REGISTER_BLOCK__OFFS))+Var.VALUE(&__DDRSS_PHY_78__SFR_OFFS)))) %Long Var.VALUE(&__DDRSS0_PHY_78_DATA)
	Data.Set D:((((Var.VALUE(&__J7_DDR0_SS_BASE)+Var.VALUE(&__DDRSS_Data_Slice_0_REGISTER_BLOCK__OFFS))+Var.VALUE(&__DDRSS_PHY_79__SFR_OFFS)))) %Long Var.VALUE(&__DDRSS0_PHY_79_DATA)
	Data.Set D:((((Var.VALUE(&__J7_DDR0_SS_BASE)+Var.VALUE(&__DDRSS_Data_Slice_0_REGISTER_BLOCK__OFFS))+Var.VALUE(&__DDRSS_PHY_80__SFR_OFFS)))) %Long Var.VALUE(&__DDRSS0_PHY_80_DATA)
	Data.Set D:((((Var.VALUE(&__J7_DDR0_SS_BASE)+Var.VALUE(&__DDRSS_Data_Slice_0_REGISTER_BLOCK__OFFS))+Var.VALUE(&__DDRSS_PHY_81__SFR_OFFS)))) %Long Var.VALUE(&__DDRSS0_PHY_81_DATA)
	Data.Set D:((((Var.VALUE(&__J7_DDR0_SS_BASE)+Var.VALUE(&__DDRSS_Data_Slice_0_REGISTER_BLOCK__OFFS))+Var.VALUE(&__DDRSS_PHY_82__SFR_OFFS)))) %Long Var.VALUE(&__DDRSS0_PHY_82_DATA)
	Data.Set D:((((Var.VALUE(&__J7_DDR0_SS_BASE)+Var.VALUE(&__DDRSS_Data_Slice_0_REGISTER_BLOCK__OFFS))+Var.VALUE(&__DDRSS_PHY_83__SFR_OFFS)))) %Long Var.VALUE(&__DDRSS0_PHY_83_DATA)
	Data.Set D:((((Var.VALUE(&__J7_DDR0_SS_BASE)+Var.VALUE(&__DDRSS_Data_Slice_0_REGISTER_BLOCK__OFFS))+Var.VALUE(&__DDRSS_PHY_84__SFR_OFFS)))) %Long Var.VALUE(&__DDRSS0_PHY_84_DATA)
	Data.Set D:((((Var.VALUE(&__J7_DDR0_SS_BASE)+Var.VALUE(&__DDRSS_Data_Slice_0_REGISTER_BLOCK__OFFS))+Var.VALUE(&__DDRSS_PHY_85__SFR_OFFS)))) %Long Var.VALUE(&__DDRSS0_PHY_85_DATA)
	Data.Set D:((((Var.VALUE(&__J7_DDR0_SS_BASE)+Var.VALUE(&__DDRSS_Data_Slice_0_REGISTER_BLOCK__OFFS))+Var.VALUE(&__DDRSS_PHY_86__SFR_OFFS)))) %Long Var.VALUE(&__DDRSS0_PHY_86_DATA)
	Data.Set D:((((Var.VALUE(&__J7_DDR0_SS_BASE)+Var.VALUE(&__DDRSS_Data_Slice_0_REGISTER_BLOCK__OFFS))+Var.VALUE(&__DDRSS_PHY_87__SFR_OFFS)))) %Long Var.VALUE(&__DDRSS0_PHY_87_DATA)
	Data.Set D:((((Var.VALUE(&__J7_DDR0_SS_BASE)+Var.VALUE(&__DDRSS_Data_Slice_0_REGISTER_BLOCK__OFFS))+Var.VALUE(&__DDRSS_PHY_88__SFR_OFFS)))) %Long Var.VALUE(&__DDRSS0_PHY_88_DATA)
	Data.Set D:((((Var.VALUE(&__J7_DDR0_SS_BASE)+Var.VALUE(&__DDRSS_Data_Slice_0_REGISTER_BLOCK__OFFS))+Var.VALUE(&__DDRSS_PHY_89__SFR_OFFS)))) %Long Var.VALUE(&__DDRSS0_PHY_89_DATA)
	Data.Set D:((((Var.VALUE(&__J7_DDR0_SS_BASE)+Var.VALUE(&__DDRSS_Data_Slice_0_REGISTER_BLOCK__OFFS))+Var.VALUE(&__DDRSS_PHY_90__SFR_OFFS)))) %Long Var.VALUE(&__DDRSS0_PHY_90_DATA)
	Data.Set D:((((Var.VALUE(&__J7_DDR0_SS_BASE)+Var.VALUE(&__DDRSS_Data_Slice_0_REGISTER_BLOCK__OFFS))+Var.VALUE(&__DDRSS_PHY_91__SFR_OFFS)))) %Long Var.VALUE(&__DDRSS0_PHY_91_DATA)
	Data.Set D:((((Var.VALUE(&__J7_DDR0_SS_BASE)+Var.VALUE(&__DDRSS_Data_Slice_0_REGISTER_BLOCK__OFFS))+Var.VALUE(&__DDRSS_PHY_92__SFR_OFFS)))) %Long Var.VALUE(&__DDRSS0_PHY_92_DATA)
	Data.Set D:((((Var.VALUE(&__J7_DDR0_SS_BASE)+Var.VALUE(&__DDRSS_Data_Slice_0_REGISTER_BLOCK__OFFS))+Var.VALUE(&__DDRSS_PHY_93__SFR_OFFS)))) %Long Var.VALUE(&__DDRSS0_PHY_93_DATA)
	Data.Set D:((((Var.VALUE(&__J7_DDR0_SS_BASE)+Var.VALUE(&__DDRSS_Data_Slice_0_REGISTER_BLOCK__OFFS))+Var.VALUE(&__DDRSS_PHY_94__SFR_OFFS)))) %Long Var.VALUE(&__DDRSS0_PHY_94_DATA)
	Data.Set D:((((Var.VALUE(&__J7_DDR0_SS_BASE)+Var.VALUE(&__DDRSS_Data_Slice_0_REGISTER_BLOCK__OFFS))+Var.VALUE(&__DDRSS_PHY_95__SFR_OFFS)))) %Long Var.VALUE(&__DDRSS0_PHY_95_DATA)
	Data.Set D:((((Var.VALUE(&__J7_DDR0_SS_BASE)+Var.VALUE(&__DDRSS_Data_Slice_0_REGISTER_BLOCK__OFFS))+Var.VALUE(&__DDRSS_PHY_96__SFR_OFFS)))) %Long Var.VALUE(&__DDRSS0_PHY_96_DATA)
	Data.Set D:((((Var.VALUE(&__J7_DDR0_SS_BASE)+Var.VALUE(&__DDRSS_Data_Slice_0_REGISTER_BLOCK__OFFS))+Var.VALUE(&__DDRSS_PHY_97__SFR_OFFS)))) %Long Var.VALUE(&__DDRSS0_PHY_97_DATA)
	Data.Set D:((((Var.VALUE(&__J7_DDR0_SS_BASE)+Var.VALUE(&__DDRSS_Data_Slice_0_REGISTER_BLOCK__OFFS))+Var.VALUE(&__DDRSS_PHY_98__SFR_OFFS)))) %Long Var.VALUE(&__DDRSS0_PHY_98_DATA)
	Data.Set D:((((Var.VALUE(&__J7_DDR0_SS_BASE)+Var.VALUE(&__DDRSS_Data_Slice_0_REGISTER_BLOCK__OFFS))+Var.VALUE(&__DDRSS_PHY_99__SFR_OFFS)))) %Long Var.VALUE(&__DDRSS0_PHY_99_DATA)
	Data.Set D:((((Var.VALUE(&__J7_DDR0_SS_BASE)+Var.VALUE(&__DDRSS_Data_Slice_0_REGISTER_BLOCK__OFFS))+Var.VALUE(&__DDRSS_PHY_100__SFR_OFFS)))) %Long Var.VALUE(&__DDRSS0_PHY_100_DATA)
	Data.Set D:((((Var.VALUE(&__J7_DDR0_SS_BASE)+Var.VALUE(&__DDRSS_Data_Slice_0_REGISTER_BLOCK__OFFS))+Var.VALUE(&__DDRSS_PHY_101__SFR_OFFS)))) %Long Var.VALUE(&__DDRSS0_PHY_101_DATA)
	Data.Set D:((((Var.VALUE(&__J7_DDR0_SS_BASE)+Var.VALUE(&__DDRSS_Data_Slice_0_REGISTER_BLOCK__OFFS))+Var.VALUE(&__DDRSS_PHY_102__SFR_OFFS)))) %Long Var.VALUE(&__DDRSS0_PHY_102_DATA)
	Data.Set D:((((Var.VALUE(&__J7_DDR0_SS_BASE)+Var.VALUE(&__DDRSS_Data_Slice_0_REGISTER_BLOCK__OFFS))+Var.VALUE(&__DDRSS_PHY_103__SFR_OFFS)))) %Long Var.VALUE(&__DDRSS0_PHY_103_DATA)
	Data.Set D:((((Var.VALUE(&__J7_DDR0_SS_BASE)+Var.VALUE(&__DDRSS_Data_Slice_0_REGISTER_BLOCK__OFFS))+Var.VALUE(&__DDRSS_PHY_104__SFR_OFFS)))) %Long Var.VALUE(&__DDRSS0_PHY_104_DATA)
	Data.Set D:((((Var.VALUE(&__J7_DDR0_SS_BASE)+Var.VALUE(&__DDRSS_Data_Slice_0_REGISTER_BLOCK__OFFS))+Var.VALUE(&__DDRSS_PHY_105__SFR_OFFS)))) %Long Var.VALUE(&__DDRSS0_PHY_105_DATA)
	Data.Set D:((((Var.VALUE(&__J7_DDR0_SS_BASE)+Var.VALUE(&__DDRSS_Data_Slice_0_REGISTER_BLOCK__OFFS))+Var.VALUE(&__DDRSS_PHY_106__SFR_OFFS)))) %Long Var.VALUE(&__DDRSS0_PHY_106_DATA)
	Data.Set D:((((Var.VALUE(&__J7_DDR0_SS_BASE)+Var.VALUE(&__DDRSS_Data_Slice_0_REGISTER_BLOCK__OFFS))+Var.VALUE(&__DDRSS_PHY_107__SFR_OFFS)))) %Long Var.VALUE(&__DDRSS0_PHY_107_DATA)
	Data.Set D:((((Var.VALUE(&__J7_DDR0_SS_BASE)+Var.VALUE(&__DDRSS_Data_Slice_0_REGISTER_BLOCK__OFFS))+Var.VALUE(&__DDRSS_PHY_108__SFR_OFFS)))) %Long Var.VALUE(&__DDRSS0_PHY_108_DATA)
	Data.Set D:((((Var.VALUE(&__J7_DDR0_SS_BASE)+Var.VALUE(&__DDRSS_Data_Slice_0_REGISTER_BLOCK__OFFS))+Var.VALUE(&__DDRSS_PHY_109__SFR_OFFS)))) %Long Var.VALUE(&__DDRSS0_PHY_109_DATA)
	Data.Set D:((((Var.VALUE(&__J7_DDR0_SS_BASE)+Var.VALUE(&__DDRSS_Data_Slice_0_REGISTER_BLOCK__OFFS))+Var.VALUE(&__DDRSS_PHY_110__SFR_OFFS)))) %Long Var.VALUE(&__DDRSS0_PHY_110_DATA)
	Data.Set D:((((Var.VALUE(&__J7_DDR0_SS_BASE)+Var.VALUE(&__DDRSS_Data_Slice_0_REGISTER_BLOCK__OFFS))+Var.VALUE(&__DDRSS_PHY_111__SFR_OFFS)))) %Long Var.VALUE(&__DDRSS0_PHY_111_DATA)
	Data.Set D:((((Var.VALUE(&__J7_DDR0_SS_BASE)+Var.VALUE(&__DDRSS_Data_Slice_0_REGISTER_BLOCK__OFFS))+Var.VALUE(&__DDRSS_PHY_112__SFR_OFFS)))) %Long Var.VALUE(&__DDRSS0_PHY_112_DATA)
	Data.Set D:((((Var.VALUE(&__J7_DDR0_SS_BASE)+Var.VALUE(&__DDRSS_Data_Slice_0_REGISTER_BLOCK__OFFS))+Var.VALUE(&__DDRSS_PHY_113__SFR_OFFS)))) %Long Var.VALUE(&__DDRSS0_PHY_113_DATA)
	Data.Set D:((((Var.VALUE(&__J7_DDR0_SS_BASE)+Var.VALUE(&__DDRSS_Data_Slice_0_REGISTER_BLOCK__OFFS))+Var.VALUE(&__DDRSS_PHY_114__SFR_OFFS)))) %Long Var.VALUE(&__DDRSS0_PHY_114_DATA)
	Data.Set D:((((Var.VALUE(&__J7_DDR0_SS_BASE)+Var.VALUE(&__DDRSS_Data_Slice_0_REGISTER_BLOCK__OFFS))+Var.VALUE(&__DDRSS_PHY_115__SFR_OFFS)))) %Long Var.VALUE(&__DDRSS0_PHY_115_DATA)
	Data.Set D:((((Var.VALUE(&__J7_DDR0_SS_BASE)+Var.VALUE(&__DDRSS_Data_Slice_0_REGISTER_BLOCK__OFFS))+Var.VALUE(&__DDRSS_PHY_116__SFR_OFFS)))) %Long Var.VALUE(&__DDRSS0_PHY_116_DATA)
	Data.Set D:((((Var.VALUE(&__J7_DDR0_SS_BASE)+Var.VALUE(&__DDRSS_Data_Slice_0_REGISTER_BLOCK__OFFS))+Var.VALUE(&__DDRSS_PHY_117__SFR_OFFS)))) %Long Var.VALUE(&__DDRSS0_PHY_117_DATA)
	Data.Set D:((((Var.VALUE(&__J7_DDR0_SS_BASE)+Var.VALUE(&__DDRSS_Data_Slice_0_REGISTER_BLOCK__OFFS))+Var.VALUE(&__DDRSS_PHY_118__SFR_OFFS)))) %Long Var.VALUE(&__DDRSS0_PHY_118_DATA)
	Data.Set D:((((Var.VALUE(&__J7_DDR0_SS_BASE)+Var.VALUE(&__DDRSS_Data_Slice_0_REGISTER_BLOCK__OFFS))+Var.VALUE(&__DDRSS_PHY_119__SFR_OFFS)))) %Long Var.VALUE(&__DDRSS0_PHY_119_DATA)
	Data.Set D:((((Var.VALUE(&__J7_DDR0_SS_BASE)+Var.VALUE(&__DDRSS_Data_Slice_0_REGISTER_BLOCK__OFFS))+Var.VALUE(&__DDRSS_PHY_120__SFR_OFFS)))) %Long Var.VALUE(&__DDRSS0_PHY_120_DATA)
	Data.Set D:((((Var.VALUE(&__J7_DDR0_SS_BASE)+Var.VALUE(&__DDRSS_Data_Slice_0_REGISTER_BLOCK__OFFS))+Var.VALUE(&__DDRSS_PHY_121__SFR_OFFS)))) %Long Var.VALUE(&__DDRSS0_PHY_121_DATA)
	Data.Set D:((((Var.VALUE(&__J7_DDR0_SS_BASE)+Var.VALUE(&__DDRSS_Data_Slice_0_REGISTER_BLOCK__OFFS))+Var.VALUE(&__DDRSS_PHY_122__SFR_OFFS)))) %Long Var.VALUE(&__DDRSS0_PHY_122_DATA)
	Data.Set D:((((Var.VALUE(&__J7_DDR0_SS_BASE)+Var.VALUE(&__DDRSS_Data_Slice_0_REGISTER_BLOCK__OFFS))+Var.VALUE(&__DDRSS_PHY_123__SFR_OFFS)))) %Long Var.VALUE(&__DDRSS0_PHY_123_DATA)
	Data.Set D:((((Var.VALUE(&__J7_DDR0_SS_BASE)+Var.VALUE(&__DDRSS_Data_Slice_0_REGISTER_BLOCK__OFFS))+Var.VALUE(&__DDRSS_PHY_124__SFR_OFFS)))) %Long Var.VALUE(&__DDRSS0_PHY_124_DATA)
	Data.Set D:((((Var.VALUE(&__J7_DDR0_SS_BASE)+Var.VALUE(&__DDRSS_Data_Slice_0_REGISTER_BLOCK__OFFS))+Var.VALUE(&__DDRSS_PHY_125__SFR_OFFS)))) %Long Var.VALUE(&__DDRSS0_PHY_125_DATA)
	Data.Set D:((((Var.VALUE(&__J7_DDR0_SS_BASE)+Var.VALUE(&__DDRSS_Data_Slice_0_REGISTER_BLOCK__OFFS))+Var.VALUE(&__DDRSS_PHY_126__SFR_OFFS)))) %Long Var.VALUE(&__DDRSS0_PHY_126_DATA)
	Data.Set D:((((Var.VALUE(&__J7_DDR0_SS_BASE)+Var.VALUE(&__DDRSS_Data_Slice_0_REGISTER_BLOCK__OFFS))+Var.VALUE(&__DDRSS_PHY_127__SFR_OFFS)))) %Long Var.VALUE(&__DDRSS0_PHY_127_DATA)
	Data.Set D:((((Var.VALUE(&__J7_DDR0_SS_BASE)+Var.VALUE(&__DDRSS_Data_Slice_0_REGISTER_BLOCK__OFFS))+Var.VALUE(&__DDRSS_PHY_128__SFR_OFFS)))) %Long Var.VALUE(&__DDRSS0_PHY_128_DATA)
	Data.Set D:((((Var.VALUE(&__J7_DDR0_SS_BASE)+Var.VALUE(&__DDRSS_Data_Slice_0_REGISTER_BLOCK__OFFS))+Var.VALUE(&__DDRSS_PHY_129__SFR_OFFS)))) %Long Var.VALUE(&__DDRSS0_PHY_129_DATA)
	Data.Set D:((((Var.VALUE(&__J7_DDR0_SS_BASE)+Var.VALUE(&__DDRSS_Data_Slice_0_REGISTER_BLOCK__OFFS))+Var.VALUE(&__DDRSS_PHY_130__SFR_OFFS)))) %Long Var.VALUE(&__DDRSS0_PHY_130_DATA)
	Data.Set D:((((Var.VALUE(&__J7_DDR0_SS_BASE)+Var.VALUE(&__DDRSS_Data_Slice_0_REGISTER_BLOCK__OFFS))+Var.VALUE(&__DDRSS_PHY_131__SFR_OFFS)))) %Long Var.VALUE(&__DDRSS0_PHY_131_DATA)
	Data.Set D:((((Var.VALUE(&__J7_DDR0_SS_BASE)+Var.VALUE(&__DDRSS_Data_Slice_0_REGISTER_BLOCK__OFFS))+Var.VALUE(&__DDRSS_PHY_132__SFR_OFFS)))) %Long Var.VALUE(&__DDRSS0_PHY_132_DATA)
	Data.Set D:((((Var.VALUE(&__J7_DDR0_SS_BASE)+Var.VALUE(&__DDRSS_Data_Slice_0_REGISTER_BLOCK__OFFS))+Var.VALUE(&__DDRSS_PHY_133__SFR_OFFS)))) %Long Var.VALUE(&__DDRSS0_PHY_133_DATA)
	Data.Set D:((((Var.VALUE(&__J7_DDR0_SS_BASE)+Var.VALUE(&__DDRSS_Data_Slice_0_REGISTER_BLOCK__OFFS))+Var.VALUE(&__DDRSS_PHY_134__SFR_OFFS)))) %Long Var.VALUE(&__DDRSS0_PHY_134_DATA)
	Data.Set D:((((Var.VALUE(&__J7_DDR0_SS_BASE)+Var.VALUE(&__DDRSS_Data_Slice_0_REGISTER_BLOCK__OFFS))+Var.VALUE(&__DDRSS_PHY_135__SFR_OFFS)))) %Long Var.VALUE(&__DDRSS0_PHY_135_DATA)
	Data.Set D:((((Var.VALUE(&__J7_DDR0_SS_BASE)+Var.VALUE(&__DDRSS_Data_Slice_0_REGISTER_BLOCK__OFFS))+Var.VALUE(&__DDRSS_PHY_136__SFR_OFFS)))) %Long Var.VALUE(&__DDRSS0_PHY_136_DATA)
	Data.Set D:((((Var.VALUE(&__J7_DDR0_SS_BASE)+Var.VALUE(&__DDRSS_Data_Slice_0_REGISTER_BLOCK__OFFS))+Var.VALUE(&__DDRSS_PHY_137__SFR_OFFS)))) %Long Var.VALUE(&__DDRSS0_PHY_137_DATA)
	Data.Set D:((((Var.VALUE(&__J7_DDR0_SS_BASE)+Var.VALUE(&__DDRSS_Data_Slice_0_REGISTER_BLOCK__OFFS))+Var.VALUE(&__DDRSS_PHY_138__SFR_OFFS)))) %Long Var.VALUE(&__DDRSS0_PHY_138_DATA)
	Data.Set D:((((Var.VALUE(&__J7_DDR0_SS_BASE)+Var.VALUE(&__DDRSS_Data_Slice_0_REGISTER_BLOCK__OFFS))+Var.VALUE(&__DDRSS_PHY_139__SFR_OFFS)))) %Long Var.VALUE(&__DDRSS0_PHY_139_DATA)
	Var.NEWLOCAL char[128] \strtmp = "--->>> DDR0 PHY Data Slice 0 programming completed... <<<---\n"
	GOSUB printf Var.String(\strtmp)
	
	Var.NEWLOCAL char[128] \strtmp = "--->>> DDR0 PHY Data Slice 1 programming in progress.. <<<---\n"
	GOSUB printf Var.String(\strtmp)
	
	Data.Set D:((((Var.VALUE(&__J7_DDR0_SS_BASE)+Var.VALUE(&__DDRSS_Data_Slice_1_REGISTER_BLOCK__OFFS))+Var.VALUE(&__DDRSS_PHY_256__SFR_OFFS)))) %Long Var.VALUE(&__DDRSS0_PHY_256_DATA)
	Data.Set D:((((Var.VALUE(&__J7_DDR0_SS_BASE)+Var.VALUE(&__DDRSS_Data_Slice_1_REGISTER_BLOCK__OFFS))+Var.VALUE(&__DDRSS_PHY_257__SFR_OFFS)))) %Long Var.VALUE(&__DDRSS0_PHY_257_DATA)
	Data.Set D:((((Var.VALUE(&__J7_DDR0_SS_BASE)+Var.VALUE(&__DDRSS_Data_Slice_1_REGISTER_BLOCK__OFFS))+Var.VALUE(&__DDRSS_PHY_258__SFR_OFFS)))) %Long Var.VALUE(&__DDRSS0_PHY_258_DATA)
	Data.Set D:((((Var.VALUE(&__J7_DDR0_SS_BASE)+Var.VALUE(&__DDRSS_Data_Slice_1_REGISTER_BLOCK__OFFS))+Var.VALUE(&__DDRSS_PHY_259__SFR_OFFS)))) %Long Var.VALUE(&__DDRSS0_PHY_259_DATA)
	Data.Set D:((((Var.VALUE(&__J7_DDR0_SS_BASE)+Var.VALUE(&__DDRSS_Data_Slice_1_REGISTER_BLOCK__OFFS))+Var.VALUE(&__DDRSS_PHY_260__SFR_OFFS)))) %Long Var.VALUE(&__DDRSS0_PHY_260_DATA)
	Data.Set D:((((Var.VALUE(&__J7_DDR0_SS_BASE)+Var.VALUE(&__DDRSS_Data_Slice_1_REGISTER_BLOCK__OFFS))+Var.VALUE(&__DDRSS_PHY_261__SFR_OFFS)))) %Long Var.VALUE(&__DDRSS0_PHY_261_DATA)
	Data.Set D:((((Var.VALUE(&__J7_DDR0_SS_BASE)+Var.VALUE(&__DDRSS_Data_Slice_1_REGISTER_BLOCK__OFFS))+Var.VALUE(&__DDRSS_PHY_262__SFR_OFFS)))) %Long Var.VALUE(&__DDRSS0_PHY_262_DATA)
	Data.Set D:((((Var.VALUE(&__J7_DDR0_SS_BASE)+Var.VALUE(&__DDRSS_Data_Slice_1_REGISTER_BLOCK__OFFS))+Var.VALUE(&__DDRSS_PHY_263__SFR_OFFS)))) %Long Var.VALUE(&__DDRSS0_PHY_263_DATA)
	Data.Set D:((((Var.VALUE(&__J7_DDR0_SS_BASE)+Var.VALUE(&__DDRSS_Data_Slice_1_REGISTER_BLOCK__OFFS))+Var.VALUE(&__DDRSS_PHY_264__SFR_OFFS)))) %Long Var.VALUE(&__DDRSS0_PHY_264_DATA)
	Data.Set D:((((Var.VALUE(&__J7_DDR0_SS_BASE)+Var.VALUE(&__DDRSS_Data_Slice_1_REGISTER_BLOCK__OFFS))+Var.VALUE(&__DDRSS_PHY_265__SFR_OFFS)))) %Long Var.VALUE(&__DDRSS0_PHY_265_DATA)
	Data.Set D:((((Var.VALUE(&__J7_DDR0_SS_BASE)+Var.VALUE(&__DDRSS_Data_Slice_1_REGISTER_BLOCK__OFFS))+Var.VALUE(&__DDRSS_PHY_266__SFR_OFFS)))) %Long Var.VALUE(&__DDRSS0_PHY_266_DATA)
	Data.Set D:((((Var.VALUE(&__J7_DDR0_SS_BASE)+Var.VALUE(&__DDRSS_Data_Slice_1_REGISTER_BLOCK__OFFS))+Var.VALUE(&__DDRSS_PHY_267__SFR_OFFS)))) %Long Var.VALUE(&__DDRSS0_PHY_267_DATA)
	Data.Set D:((((Var.VALUE(&__J7_DDR0_SS_BASE)+Var.VALUE(&__DDRSS_Data_Slice_1_REGISTER_BLOCK__OFFS))+Var.VALUE(&__DDRSS_PHY_268__SFR_OFFS)))) %Long Var.VALUE(&__DDRSS0_PHY_268_DATA)
	Data.Set D:((((Var.VALUE(&__J7_DDR0_SS_BASE)+Var.VALUE(&__DDRSS_Data_Slice_1_REGISTER_BLOCK__OFFS))+Var.VALUE(&__DDRSS_PHY_269__SFR_OFFS)))) %Long Var.VALUE(&__DDRSS0_PHY_269_DATA)
	Data.Set D:((((Var.VALUE(&__J7_DDR0_SS_BASE)+Var.VALUE(&__DDRSS_Data_Slice_1_REGISTER_BLOCK__OFFS))+Var.VALUE(&__DDRSS_PHY_270__SFR_OFFS)))) %Long Var.VALUE(&__DDRSS0_PHY_270_DATA)
	Data.Set D:((((Var.VALUE(&__J7_DDR0_SS_BASE)+Var.VALUE(&__DDRSS_Data_Slice_1_REGISTER_BLOCK__OFFS))+Var.VALUE(&__DDRSS_PHY_271__SFR_OFFS)))) %Long Var.VALUE(&__DDRSS0_PHY_271_DATA)
	Data.Set D:((((Var.VALUE(&__J7_DDR0_SS_BASE)+Var.VALUE(&__DDRSS_Data_Slice_1_REGISTER_BLOCK__OFFS))+Var.VALUE(&__DDRSS_PHY_272__SFR_OFFS)))) %Long Var.VALUE(&__DDRSS0_PHY_272_DATA)
	Data.Set D:((((Var.VALUE(&__J7_DDR0_SS_BASE)+Var.VALUE(&__DDRSS_Data_Slice_1_REGISTER_BLOCK__OFFS))+Var.VALUE(&__DDRSS_PHY_273__SFR_OFFS)))) %Long Var.VALUE(&__DDRSS0_PHY_273_DATA)
	Data.Set D:((((Var.VALUE(&__J7_DDR0_SS_BASE)+Var.VALUE(&__DDRSS_Data_Slice_1_REGISTER_BLOCK__OFFS))+Var.VALUE(&__DDRSS_PHY_274__SFR_OFFS)))) %Long Var.VALUE(&__DDRSS0_PHY_274_DATA)
	Data.Set D:((((Var.VALUE(&__J7_DDR0_SS_BASE)+Var.VALUE(&__DDRSS_Data_Slice_1_REGISTER_BLOCK__OFFS))+Var.VALUE(&__DDRSS_PHY_275__SFR_OFFS)))) %Long Var.VALUE(&__DDRSS0_PHY_275_DATA)
	Data.Set D:((((Var.VALUE(&__J7_DDR0_SS_BASE)+Var.VALUE(&__DDRSS_Data_Slice_1_REGISTER_BLOCK__OFFS))+Var.VALUE(&__DDRSS_PHY_276__SFR_OFFS)))) %Long Var.VALUE(&__DDRSS0_PHY_276_DATA)
	Data.Set D:((((Var.VALUE(&__J7_DDR0_SS_BASE)+Var.VALUE(&__DDRSS_Data_Slice_1_REGISTER_BLOCK__OFFS))+Var.VALUE(&__DDRSS_PHY_277__SFR_OFFS)))) %Long Var.VALUE(&__DDRSS0_PHY_277_DATA)
	Data.Set D:((((Var.VALUE(&__J7_DDR0_SS_BASE)+Var.VALUE(&__DDRSS_Data_Slice_1_REGISTER_BLOCK__OFFS))+Var.VALUE(&__DDRSS_PHY_278__SFR_OFFS)))) %Long Var.VALUE(&__DDRSS0_PHY_278_DATA)
	Data.Set D:((((Var.VALUE(&__J7_DDR0_SS_BASE)+Var.VALUE(&__DDRSS_Data_Slice_1_REGISTER_BLOCK__OFFS))+Var.VALUE(&__DDRSS_PHY_279__SFR_OFFS)))) %Long Var.VALUE(&__DDRSS0_PHY_279_DATA)
	Data.Set D:((((Var.VALUE(&__J7_DDR0_SS_BASE)+Var.VALUE(&__DDRSS_Data_Slice_1_REGISTER_BLOCK__OFFS))+Var.VALUE(&__DDRSS_PHY_280__SFR_OFFS)))) %Long Var.VALUE(&__DDRSS0_PHY_280_DATA)
	Data.Set D:((((Var.VALUE(&__J7_DDR0_SS_BASE)+Var.VALUE(&__DDRSS_Data_Slice_1_REGISTER_BLOCK__OFFS))+Var.VALUE(&__DDRSS_PHY_281__SFR_OFFS)))) %Long Var.VALUE(&__DDRSS0_PHY_281_DATA)
	Data.Set D:((((Var.VALUE(&__J7_DDR0_SS_BASE)+Var.VALUE(&__DDRSS_Data_Slice_1_REGISTER_BLOCK__OFFS))+Var.VALUE(&__DDRSS_PHY_282__SFR_OFFS)))) %Long Var.VALUE(&__DDRSS0_PHY_282_DATA)
	Data.Set D:((((Var.VALUE(&__J7_DDR0_SS_BASE)+Var.VALUE(&__DDRSS_Data_Slice_1_REGISTER_BLOCK__OFFS))+Var.VALUE(&__DDRSS_PHY_283__SFR_OFFS)))) %Long Var.VALUE(&__DDRSS0_PHY_283_DATA)
	Data.Set D:((((Var.VALUE(&__J7_DDR0_SS_BASE)+Var.VALUE(&__DDRSS_Data_Slice_1_REGISTER_BLOCK__OFFS))+Var.VALUE(&__DDRSS_PHY_284__SFR_OFFS)))) %Long Var.VALUE(&__DDRSS0_PHY_284_DATA)
	Data.Set D:((((Var.VALUE(&__J7_DDR0_SS_BASE)+Var.VALUE(&__DDRSS_Data_Slice_1_REGISTER_BLOCK__OFFS))+Var.VALUE(&__DDRSS_PHY_285__SFR_OFFS)))) %Long Var.VALUE(&__DDRSS0_PHY_285_DATA)
	Data.Set D:((((Var.VALUE(&__J7_DDR0_SS_BASE)+Var.VALUE(&__DDRSS_Data_Slice_1_REGISTER_BLOCK__OFFS))+Var.VALUE(&__DDRSS_PHY_286__SFR_OFFS)))) %Long Var.VALUE(&__DDRSS0_PHY_286_DATA)
	Data.Set D:((((Var.VALUE(&__J7_DDR0_SS_BASE)+Var.VALUE(&__DDRSS_Data_Slice_1_REGISTER_BLOCK__OFFS))+Var.VALUE(&__DDRSS_PHY_287__SFR_OFFS)))) %Long Var.VALUE(&__DDRSS0_PHY_287_DATA)
	Data.Set D:((((Var.VALUE(&__J7_DDR0_SS_BASE)+Var.VALUE(&__DDRSS_Data_Slice_1_REGISTER_BLOCK__OFFS))+Var.VALUE(&__DDRSS_PHY_288__SFR_OFFS)))) %Long Var.VALUE(&__DDRSS0_PHY_288_DATA)
	Data.Set D:((((Var.VALUE(&__J7_DDR0_SS_BASE)+Var.VALUE(&__DDRSS_Data_Slice_1_REGISTER_BLOCK__OFFS))+Var.VALUE(&__DDRSS_PHY_289__SFR_OFFS)))) %Long Var.VALUE(&__DDRSS0_PHY_289_DATA)
	Data.Set D:((((Var.VALUE(&__J7_DDR0_SS_BASE)+Var.VALUE(&__DDRSS_Data_Slice_1_REGISTER_BLOCK__OFFS))+Var.VALUE(&__DDRSS_PHY_290__SFR_OFFS)))) %Long Var.VALUE(&__DDRSS0_PHY_290_DATA)
	Data.Set D:((((Var.VALUE(&__J7_DDR0_SS_BASE)+Var.VALUE(&__DDRSS_Data_Slice_1_REGISTER_BLOCK__OFFS))+Var.VALUE(&__DDRSS_PHY_291__SFR_OFFS)))) %Long Var.VALUE(&__DDRSS0_PHY_291_DATA)
	Data.Set D:((((Var.VALUE(&__J7_DDR0_SS_BASE)+Var.VALUE(&__DDRSS_Data_Slice_1_REGISTER_BLOCK__OFFS))+Var.VALUE(&__DDRSS_PHY_292__SFR_OFFS)))) %Long Var.VALUE(&__DDRSS0_PHY_292_DATA)
	Data.Set D:((((Var.VALUE(&__J7_DDR0_SS_BASE)+Var.VALUE(&__DDRSS_Data_Slice_1_REGISTER_BLOCK__OFFS))+Var.VALUE(&__DDRSS_PHY_293__SFR_OFFS)))) %Long Var.VALUE(&__DDRSS0_PHY_293_DATA)
	Data.Set D:((((Var.VALUE(&__J7_DDR0_SS_BASE)+Var.VALUE(&__DDRSS_Data_Slice_1_REGISTER_BLOCK__OFFS))+Var.VALUE(&__DDRSS_PHY_294__SFR_OFFS)))) %Long Var.VALUE(&__DDRSS0_PHY_294_DATA)
	Data.Set D:((((Var.VALUE(&__J7_DDR0_SS_BASE)+Var.VALUE(&__DDRSS_Data_Slice_1_REGISTER_BLOCK__OFFS))+Var.VALUE(&__DDRSS_PHY_295__SFR_OFFS)))) %Long Var.VALUE(&__DDRSS0_PHY_295_DATA)
	Data.Set D:((((Var.VALUE(&__J7_DDR0_SS_BASE)+Var.VALUE(&__DDRSS_Data_Slice_1_REGISTER_BLOCK__OFFS))+Var.VALUE(&__DDRSS_PHY_296__SFR_OFFS)))) %Long Var.VALUE(&__DDRSS0_PHY_296_DATA)
	Data.Set D:((((Var.VALUE(&__J7_DDR0_SS_BASE)+Var.VALUE(&__DDRSS_Data_Slice_1_REGISTER_BLOCK__OFFS))+Var.VALUE(&__DDRSS_PHY_297__SFR_OFFS)))) %Long Var.VALUE(&__DDRSS0_PHY_297_DATA)
	Data.Set D:((((Var.VALUE(&__J7_DDR0_SS_BASE)+Var.VALUE(&__DDRSS_Data_Slice_1_REGISTER_BLOCK__OFFS))+Var.VALUE(&__DDRSS_PHY_298__SFR_OFFS)))) %Long Var.VALUE(&__DDRSS0_PHY_298_DATA)
	Data.Set D:((((Var.VALUE(&__J7_DDR0_SS_BASE)+Var.VALUE(&__DDRSS_Data_Slice_1_REGISTER_BLOCK__OFFS))+Var.VALUE(&__DDRSS_PHY_299__SFR_OFFS)))) %Long Var.VALUE(&__DDRSS0_PHY_299_DATA)
	Data.Set D:((((Var.VALUE(&__J7_DDR0_SS_BASE)+Var.VALUE(&__DDRSS_Data_Slice_1_REGISTER_BLOCK__OFFS))+Var.VALUE(&__DDRSS_PHY_300__SFR_OFFS)))) %Long Var.VALUE(&__DDRSS0_PHY_300_DATA)
	Data.Set D:((((Var.VALUE(&__J7_DDR0_SS_BASE)+Var.VALUE(&__DDRSS_Data_Slice_1_REGISTER_BLOCK__OFFS))+Var.VALUE(&__DDRSS_PHY_301__SFR_OFFS)))) %Long Var.VALUE(&__DDRSS0_PHY_301_DATA)
	Data.Set D:((((Var.VALUE(&__J7_DDR0_SS_BASE)+Var.VALUE(&__DDRSS_Data_Slice_1_REGISTER_BLOCK__OFFS))+Var.VALUE(&__DDRSS_PHY_302__SFR_OFFS)))) %Long Var.VALUE(&__DDRSS0_PHY_302_DATA)
	Data.Set D:((((Var.VALUE(&__J7_DDR0_SS_BASE)+Var.VALUE(&__DDRSS_Data_Slice_1_REGISTER_BLOCK__OFFS))+Var.VALUE(&__DDRSS_PHY_303__SFR_OFFS)))) %Long Var.VALUE(&__DDRSS0_PHY_303_DATA)
	Data.Set D:((((Var.VALUE(&__J7_DDR0_SS_BASE)+Var.VALUE(&__DDRSS_Data_Slice_1_REGISTER_BLOCK__OFFS))+Var.VALUE(&__DDRSS_PHY_304__SFR_OFFS)))) %Long Var.VALUE(&__DDRSS0_PHY_304_DATA)
	Data.Set D:((((Var.VALUE(&__J7_DDR0_SS_BASE)+Var.VALUE(&__DDRSS_Data_Slice_1_REGISTER_BLOCK__OFFS))+Var.VALUE(&__DDRSS_PHY_305__SFR_OFFS)))) %Long Var.VALUE(&__DDRSS0_PHY_305_DATA)
	Data.Set D:((((Var.VALUE(&__J7_DDR0_SS_BASE)+Var.VALUE(&__DDRSS_Data_Slice_1_REGISTER_BLOCK__OFFS))+Var.VALUE(&__DDRSS_PHY_306__SFR_OFFS)))) %Long Var.VALUE(&__DDRSS0_PHY_306_DATA)
	Data.Set D:((((Var.VALUE(&__J7_DDR0_SS_BASE)+Var.VALUE(&__DDRSS_Data_Slice_1_REGISTER_BLOCK__OFFS))+Var.VALUE(&__DDRSS_PHY_307__SFR_OFFS)))) %Long Var.VALUE(&__DDRSS0_PHY_307_DATA)
	Data.Set D:((((Var.VALUE(&__J7_DDR0_SS_BASE)+Var.VALUE(&__DDRSS_Data_Slice_1_REGISTER_BLOCK__OFFS))+Var.VALUE(&__DDRSS_PHY_308__SFR_OFFS)))) %Long Var.VALUE(&__DDRSS0_PHY_308_DATA)
	Data.Set D:((((Var.VALUE(&__J7_DDR0_SS_BASE)+Var.VALUE(&__DDRSS_Data_Slice_1_REGISTER_BLOCK__OFFS))+Var.VALUE(&__DDRSS_PHY_309__SFR_OFFS)))) %Long Var.VALUE(&__DDRSS0_PHY_309_DATA)
	Data.Set D:((((Var.VALUE(&__J7_DDR0_SS_BASE)+Var.VALUE(&__DDRSS_Data_Slice_1_REGISTER_BLOCK__OFFS))+Var.VALUE(&__DDRSS_PHY_310__SFR_OFFS)))) %Long Var.VALUE(&__DDRSS0_PHY_310_DATA)
	Data.Set D:((((Var.VALUE(&__J7_DDR0_SS_BASE)+Var.VALUE(&__DDRSS_Data_Slice_1_REGISTER_BLOCK__OFFS))+Var.VALUE(&__DDRSS_PHY_311__SFR_OFFS)))) %Long Var.VALUE(&__DDRSS0_PHY_311_DATA)
	Data.Set D:((((Var.VALUE(&__J7_DDR0_SS_BASE)+Var.VALUE(&__DDRSS_Data_Slice_1_REGISTER_BLOCK__OFFS))+Var.VALUE(&__DDRSS_PHY_312__SFR_OFFS)))) %Long Var.VALUE(&__DDRSS0_PHY_312_DATA)
	Data.Set D:((((Var.VALUE(&__J7_DDR0_SS_BASE)+Var.VALUE(&__DDRSS_Data_Slice_1_REGISTER_BLOCK__OFFS))+Var.VALUE(&__DDRSS_PHY_313__SFR_OFFS)))) %Long Var.VALUE(&__DDRSS0_PHY_313_DATA)
	Data.Set D:((((Var.VALUE(&__J7_DDR0_SS_BASE)+Var.VALUE(&__DDRSS_Data_Slice_1_REGISTER_BLOCK__OFFS))+Var.VALUE(&__DDRSS_PHY_314__SFR_OFFS)))) %Long Var.VALUE(&__DDRSS0_PHY_314_DATA)
	Data.Set D:((((Var.VALUE(&__J7_DDR0_SS_BASE)+Var.VALUE(&__DDRSS_Data_Slice_1_REGISTER_BLOCK__OFFS))+Var.VALUE(&__DDRSS_PHY_315__SFR_OFFS)))) %Long Var.VALUE(&__DDRSS0_PHY_315_DATA)
	Data.Set D:((((Var.VALUE(&__J7_DDR0_SS_BASE)+Var.VALUE(&__DDRSS_Data_Slice_1_REGISTER_BLOCK__OFFS))+Var.VALUE(&__DDRSS_PHY_316__SFR_OFFS)))) %Long Var.VALUE(&__DDRSS0_PHY_316_DATA)
	Data.Set D:((((Var.VALUE(&__J7_DDR0_SS_BASE)+Var.VALUE(&__DDRSS_Data_Slice_1_REGISTER_BLOCK__OFFS))+Var.VALUE(&__DDRSS_PHY_317__SFR_OFFS)))) %Long Var.VALUE(&__DDRSS0_PHY_317_DATA)
	Data.Set D:((((Var.VALUE(&__J7_DDR0_SS_BASE)+Var.VALUE(&__DDRSS_Data_Slice_1_REGISTER_BLOCK__OFFS))+Var.VALUE(&__DDRSS_PHY_318__SFR_OFFS)))) %Long Var.VALUE(&__DDRSS0_PHY_318_DATA)
	Data.Set D:((((Var.VALUE(&__J7_DDR0_SS_BASE)+Var.VALUE(&__DDRSS_Data_Slice_1_REGISTER_BLOCK__OFFS))+Var.VALUE(&__DDRSS_PHY_319__SFR_OFFS)))) %Long Var.VALUE(&__DDRSS0_PHY_319_DATA)
	Data.Set D:((((Var.VALUE(&__J7_DDR0_SS_BASE)+Var.VALUE(&__DDRSS_Data_Slice_1_REGISTER_BLOCK__OFFS))+Var.VALUE(&__DDRSS_PHY_320__SFR_OFFS)))) %Long Var.VALUE(&__DDRSS0_PHY_320_DATA)
	Data.Set D:((((Var.VALUE(&__J7_DDR0_SS_BASE)+Var.VALUE(&__DDRSS_Data_Slice_1_REGISTER_BLOCK__OFFS))+Var.VALUE(&__DDRSS_PHY_321__SFR_OFFS)))) %Long Var.VALUE(&__DDRSS0_PHY_321_DATA)
	Data.Set D:((((Var.VALUE(&__J7_DDR0_SS_BASE)+Var.VALUE(&__DDRSS_Data_Slice_1_REGISTER_BLOCK__OFFS))+Var.VALUE(&__DDRSS_PHY_322__SFR_OFFS)))) %Long Var.VALUE(&__DDRSS0_PHY_322_DATA)
	Data.Set D:((((Var.VALUE(&__J7_DDR0_SS_BASE)+Var.VALUE(&__DDRSS_Data_Slice_1_REGISTER_BLOCK__OFFS))+Var.VALUE(&__DDRSS_PHY_323__SFR_OFFS)))) %Long Var.VALUE(&__DDRSS0_PHY_323_DATA)
	Data.Set D:((((Var.VALUE(&__J7_DDR0_SS_BASE)+Var.VALUE(&__DDRSS_Data_Slice_1_REGISTER_BLOCK__OFFS))+Var.VALUE(&__DDRSS_PHY_324__SFR_OFFS)))) %Long Var.VALUE(&__DDRSS0_PHY_324_DATA)
	Data.Set D:((((Var.VALUE(&__J7_DDR0_SS_BASE)+Var.VALUE(&__DDRSS_Data_Slice_1_REGISTER_BLOCK__OFFS))+Var.VALUE(&__DDRSS_PHY_325__SFR_OFFS)))) %Long Var.VALUE(&__DDRSS0_PHY_325_DATA)
	Data.Set D:((((Var.VALUE(&__J7_DDR0_SS_BASE)+Var.VALUE(&__DDRSS_Data_Slice_1_REGISTER_BLOCK__OFFS))+Var.VALUE(&__DDRSS_PHY_326__SFR_OFFS)))) %Long Var.VALUE(&__DDRSS0_PHY_326_DATA)
	Data.Set D:((((Var.VALUE(&__J7_DDR0_SS_BASE)+Var.VALUE(&__DDRSS_Data_Slice_1_REGISTER_BLOCK__OFFS))+Var.VALUE(&__DDRSS_PHY_327__SFR_OFFS)))) %Long Var.VALUE(&__DDRSS0_PHY_327_DATA)
	Data.Set D:((((Var.VALUE(&__J7_DDR0_SS_BASE)+Var.VALUE(&__DDRSS_Data_Slice_1_REGISTER_BLOCK__OFFS))+Var.VALUE(&__DDRSS_PHY_328__SFR_OFFS)))) %Long Var.VALUE(&__DDRSS0_PHY_328_DATA)
	Data.Set D:((((Var.VALUE(&__J7_DDR0_SS_BASE)+Var.VALUE(&__DDRSS_Data_Slice_1_REGISTER_BLOCK__OFFS))+Var.VALUE(&__DDRSS_PHY_329__SFR_OFFS)))) %Long Var.VALUE(&__DDRSS0_PHY_329_DATA)
	Data.Set D:((((Var.VALUE(&__J7_DDR0_SS_BASE)+Var.VALUE(&__DDRSS_Data_Slice_1_REGISTER_BLOCK__OFFS))+Var.VALUE(&__DDRSS_PHY_330__SFR_OFFS)))) %Long Var.VALUE(&__DDRSS0_PHY_330_DATA)
	Data.Set D:((((Var.VALUE(&__J7_DDR0_SS_BASE)+Var.VALUE(&__DDRSS_Data_Slice_1_REGISTER_BLOCK__OFFS))+Var.VALUE(&__DDRSS_PHY_331__SFR_OFFS)))) %Long Var.VALUE(&__DDRSS0_PHY_331_DATA)
	Data.Set D:((((Var.VALUE(&__J7_DDR0_SS_BASE)+Var.VALUE(&__DDRSS_Data_Slice_1_REGISTER_BLOCK__OFFS))+Var.VALUE(&__DDRSS_PHY_332__SFR_OFFS)))) %Long Var.VALUE(&__DDRSS0_PHY_332_DATA)
	Data.Set D:((((Var.VALUE(&__J7_DDR0_SS_BASE)+Var.VALUE(&__DDRSS_Data_Slice_1_REGISTER_BLOCK__OFFS))+Var.VALUE(&__DDRSS_PHY_333__SFR_OFFS)))) %Long Var.VALUE(&__DDRSS0_PHY_333_DATA)
	Data.Set D:((((Var.VALUE(&__J7_DDR0_SS_BASE)+Var.VALUE(&__DDRSS_Data_Slice_1_REGISTER_BLOCK__OFFS))+Var.VALUE(&__DDRSS_PHY_334__SFR_OFFS)))) %Long Var.VALUE(&__DDRSS0_PHY_334_DATA)
	Data.Set D:((((Var.VALUE(&__J7_DDR0_SS_BASE)+Var.VALUE(&__DDRSS_Data_Slice_1_REGISTER_BLOCK__OFFS))+Var.VALUE(&__DDRSS_PHY_335__SFR_OFFS)))) %Long Var.VALUE(&__DDRSS0_PHY_335_DATA)
	Data.Set D:((((Var.VALUE(&__J7_DDR0_SS_BASE)+Var.VALUE(&__DDRSS_Data_Slice_1_REGISTER_BLOCK__OFFS))+Var.VALUE(&__DDRSS_PHY_336__SFR_OFFS)))) %Long Var.VALUE(&__DDRSS0_PHY_336_DATA)
	Data.Set D:((((Var.VALUE(&__J7_DDR0_SS_BASE)+Var.VALUE(&__DDRSS_Data_Slice_1_REGISTER_BLOCK__OFFS))+Var.VALUE(&__DDRSS_PHY_337__SFR_OFFS)))) %Long Var.VALUE(&__DDRSS0_PHY_337_DATA)
	Data.Set D:((((Var.VALUE(&__J7_DDR0_SS_BASE)+Var.VALUE(&__DDRSS_Data_Slice_1_REGISTER_BLOCK__OFFS))+Var.VALUE(&__DDRSS_PHY_338__SFR_OFFS)))) %Long Var.VALUE(&__DDRSS0_PHY_338_DATA)
	Data.Set D:((((Var.VALUE(&__J7_DDR0_SS_BASE)+Var.VALUE(&__DDRSS_Data_Slice_1_REGISTER_BLOCK__OFFS))+Var.VALUE(&__DDRSS_PHY_339__SFR_OFFS)))) %Long Var.VALUE(&__DDRSS0_PHY_339_DATA)
	Data.Set D:((((Var.VALUE(&__J7_DDR0_SS_BASE)+Var.VALUE(&__DDRSS_Data_Slice_1_REGISTER_BLOCK__OFFS))+Var.VALUE(&__DDRSS_PHY_340__SFR_OFFS)))) %Long Var.VALUE(&__DDRSS0_PHY_340_DATA)
	Data.Set D:((((Var.VALUE(&__J7_DDR0_SS_BASE)+Var.VALUE(&__DDRSS_Data_Slice_1_REGISTER_BLOCK__OFFS))+Var.VALUE(&__DDRSS_PHY_341__SFR_OFFS)))) %Long Var.VALUE(&__DDRSS0_PHY_341_DATA)
	Data.Set D:((((Var.VALUE(&__J7_DDR0_SS_BASE)+Var.VALUE(&__DDRSS_Data_Slice_1_REGISTER_BLOCK__OFFS))+Var.VALUE(&__DDRSS_PHY_342__SFR_OFFS)))) %Long Var.VALUE(&__DDRSS0_PHY_342_DATA)
	Data.Set D:((((Var.VALUE(&__J7_DDR0_SS_BASE)+Var.VALUE(&__DDRSS_Data_Slice_1_REGISTER_BLOCK__OFFS))+Var.VALUE(&__DDRSS_PHY_343__SFR_OFFS)))) %Long Var.VALUE(&__DDRSS0_PHY_343_DATA)
	Data.Set D:((((Var.VALUE(&__J7_DDR0_SS_BASE)+Var.VALUE(&__DDRSS_Data_Slice_1_REGISTER_BLOCK__OFFS))+Var.VALUE(&__DDRSS_PHY_344__SFR_OFFS)))) %Long Var.VALUE(&__DDRSS0_PHY_344_DATA)
	Data.Set D:((((Var.VALUE(&__J7_DDR0_SS_BASE)+Var.VALUE(&__DDRSS_Data_Slice_1_REGISTER_BLOCK__OFFS))+Var.VALUE(&__DDRSS_PHY_345__SFR_OFFS)))) %Long Var.VALUE(&__DDRSS0_PHY_345_DATA)
	Data.Set D:((((Var.VALUE(&__J7_DDR0_SS_BASE)+Var.VALUE(&__DDRSS_Data_Slice_1_REGISTER_BLOCK__OFFS))+Var.VALUE(&__DDRSS_PHY_346__SFR_OFFS)))) %Long Var.VALUE(&__DDRSS0_PHY_346_DATA)
	Data.Set D:((((Var.VALUE(&__J7_DDR0_SS_BASE)+Var.VALUE(&__DDRSS_Data_Slice_1_REGISTER_BLOCK__OFFS))+Var.VALUE(&__DDRSS_PHY_347__SFR_OFFS)))) %Long Var.VALUE(&__DDRSS0_PHY_347_DATA)
	Data.Set D:((((Var.VALUE(&__J7_DDR0_SS_BASE)+Var.VALUE(&__DDRSS_Data_Slice_1_REGISTER_BLOCK__OFFS))+Var.VALUE(&__DDRSS_PHY_348__SFR_OFFS)))) %Long Var.VALUE(&__DDRSS0_PHY_348_DATA)
	Data.Set D:((((Var.VALUE(&__J7_DDR0_SS_BASE)+Var.VALUE(&__DDRSS_Data_Slice_1_REGISTER_BLOCK__OFFS))+Var.VALUE(&__DDRSS_PHY_349__SFR_OFFS)))) %Long Var.VALUE(&__DDRSS0_PHY_349_DATA)
	Data.Set D:((((Var.VALUE(&__J7_DDR0_SS_BASE)+Var.VALUE(&__DDRSS_Data_Slice_1_REGISTER_BLOCK__OFFS))+Var.VALUE(&__DDRSS_PHY_350__SFR_OFFS)))) %Long Var.VALUE(&__DDRSS0_PHY_350_DATA)
	Data.Set D:((((Var.VALUE(&__J7_DDR0_SS_BASE)+Var.VALUE(&__DDRSS_Data_Slice_1_REGISTER_BLOCK__OFFS))+Var.VALUE(&__DDRSS_PHY_351__SFR_OFFS)))) %Long Var.VALUE(&__DDRSS0_PHY_351_DATA)
	Data.Set D:((((Var.VALUE(&__J7_DDR0_SS_BASE)+Var.VALUE(&__DDRSS_Data_Slice_1_REGISTER_BLOCK__OFFS))+Var.VALUE(&__DDRSS_PHY_352__SFR_OFFS)))) %Long Var.VALUE(&__DDRSS0_PHY_352_DATA)
	Data.Set D:((((Var.VALUE(&__J7_DDR0_SS_BASE)+Var.VALUE(&__DDRSS_Data_Slice_1_REGISTER_BLOCK__OFFS))+Var.VALUE(&__DDRSS_PHY_353__SFR_OFFS)))) %Long Var.VALUE(&__DDRSS0_PHY_353_DATA)
	Data.Set D:((((Var.VALUE(&__J7_DDR0_SS_BASE)+Var.VALUE(&__DDRSS_Data_Slice_1_REGISTER_BLOCK__OFFS))+Var.VALUE(&__DDRSS_PHY_354__SFR_OFFS)))) %Long Var.VALUE(&__DDRSS0_PHY_354_DATA)
	Data.Set D:((((Var.VALUE(&__J7_DDR0_SS_BASE)+Var.VALUE(&__DDRSS_Data_Slice_1_REGISTER_BLOCK__OFFS))+Var.VALUE(&__DDRSS_PHY_355__SFR_OFFS)))) %Long Var.VALUE(&__DDRSS0_PHY_355_DATA)
	Data.Set D:((((Var.VALUE(&__J7_DDR0_SS_BASE)+Var.VALUE(&__DDRSS_Data_Slice_1_REGISTER_BLOCK__OFFS))+Var.VALUE(&__DDRSS_PHY_356__SFR_OFFS)))) %Long Var.VALUE(&__DDRSS0_PHY_356_DATA)
	Data.Set D:((((Var.VALUE(&__J7_DDR0_SS_BASE)+Var.VALUE(&__DDRSS_Data_Slice_1_REGISTER_BLOCK__OFFS))+Var.VALUE(&__DDRSS_PHY_357__SFR_OFFS)))) %Long Var.VALUE(&__DDRSS0_PHY_357_DATA)
	Data.Set D:((((Var.VALUE(&__J7_DDR0_SS_BASE)+Var.VALUE(&__DDRSS_Data_Slice_1_REGISTER_BLOCK__OFFS))+Var.VALUE(&__DDRSS_PHY_358__SFR_OFFS)))) %Long Var.VALUE(&__DDRSS0_PHY_358_DATA)
	Data.Set D:((((Var.VALUE(&__J7_DDR0_SS_BASE)+Var.VALUE(&__DDRSS_Data_Slice_1_REGISTER_BLOCK__OFFS))+Var.VALUE(&__DDRSS_PHY_359__SFR_OFFS)))) %Long Var.VALUE(&__DDRSS0_PHY_359_DATA)
	Data.Set D:((((Var.VALUE(&__J7_DDR0_SS_BASE)+Var.VALUE(&__DDRSS_Data_Slice_1_REGISTER_BLOCK__OFFS))+Var.VALUE(&__DDRSS_PHY_360__SFR_OFFS)))) %Long Var.VALUE(&__DDRSS0_PHY_360_DATA)
	Data.Set D:((((Var.VALUE(&__J7_DDR0_SS_BASE)+Var.VALUE(&__DDRSS_Data_Slice_1_REGISTER_BLOCK__OFFS))+Var.VALUE(&__DDRSS_PHY_361__SFR_OFFS)))) %Long Var.VALUE(&__DDRSS0_PHY_361_DATA)
	Data.Set D:((((Var.VALUE(&__J7_DDR0_SS_BASE)+Var.VALUE(&__DDRSS_Data_Slice_1_REGISTER_BLOCK__OFFS))+Var.VALUE(&__DDRSS_PHY_362__SFR_OFFS)))) %Long Var.VALUE(&__DDRSS0_PHY_362_DATA)
	Data.Set D:((((Var.VALUE(&__J7_DDR0_SS_BASE)+Var.VALUE(&__DDRSS_Data_Slice_1_REGISTER_BLOCK__OFFS))+Var.VALUE(&__DDRSS_PHY_363__SFR_OFFS)))) %Long Var.VALUE(&__DDRSS0_PHY_363_DATA)
	Data.Set D:((((Var.VALUE(&__J7_DDR0_SS_BASE)+Var.VALUE(&__DDRSS_Data_Slice_1_REGISTER_BLOCK__OFFS))+Var.VALUE(&__DDRSS_PHY_364__SFR_OFFS)))) %Long Var.VALUE(&__DDRSS0_PHY_364_DATA)
	Data.Set D:((((Var.VALUE(&__J7_DDR0_SS_BASE)+Var.VALUE(&__DDRSS_Data_Slice_1_REGISTER_BLOCK__OFFS))+Var.VALUE(&__DDRSS_PHY_365__SFR_OFFS)))) %Long Var.VALUE(&__DDRSS0_PHY_365_DATA)
	Data.Set D:((((Var.VALUE(&__J7_DDR0_SS_BASE)+Var.VALUE(&__DDRSS_Data_Slice_1_REGISTER_BLOCK__OFFS))+Var.VALUE(&__DDRSS_PHY_366__SFR_OFFS)))) %Long Var.VALUE(&__DDRSS0_PHY_366_DATA)
	Data.Set D:((((Var.VALUE(&__J7_DDR0_SS_BASE)+Var.VALUE(&__DDRSS_Data_Slice_1_REGISTER_BLOCK__OFFS))+Var.VALUE(&__DDRSS_PHY_367__SFR_OFFS)))) %Long Var.VALUE(&__DDRSS0_PHY_367_DATA)
	Data.Set D:((((Var.VALUE(&__J7_DDR0_SS_BASE)+Var.VALUE(&__DDRSS_Data_Slice_1_REGISTER_BLOCK__OFFS))+Var.VALUE(&__DDRSS_PHY_368__SFR_OFFS)))) %Long Var.VALUE(&__DDRSS0_PHY_368_DATA)
	Data.Set D:((((Var.VALUE(&__J7_DDR0_SS_BASE)+Var.VALUE(&__DDRSS_Data_Slice_1_REGISTER_BLOCK__OFFS))+Var.VALUE(&__DDRSS_PHY_369__SFR_OFFS)))) %Long Var.VALUE(&__DDRSS0_PHY_369_DATA)
	Data.Set D:((((Var.VALUE(&__J7_DDR0_SS_BASE)+Var.VALUE(&__DDRSS_Data_Slice_1_REGISTER_BLOCK__OFFS))+Var.VALUE(&__DDRSS_PHY_370__SFR_OFFS)))) %Long Var.VALUE(&__DDRSS0_PHY_370_DATA)
	Data.Set D:((((Var.VALUE(&__J7_DDR0_SS_BASE)+Var.VALUE(&__DDRSS_Data_Slice_1_REGISTER_BLOCK__OFFS))+Var.VALUE(&__DDRSS_PHY_371__SFR_OFFS)))) %Long Var.VALUE(&__DDRSS0_PHY_371_DATA)
	Data.Set D:((((Var.VALUE(&__J7_DDR0_SS_BASE)+Var.VALUE(&__DDRSS_Data_Slice_1_REGISTER_BLOCK__OFFS))+Var.VALUE(&__DDRSS_PHY_372__SFR_OFFS)))) %Long Var.VALUE(&__DDRSS0_PHY_372_DATA)
	Data.Set D:((((Var.VALUE(&__J7_DDR0_SS_BASE)+Var.VALUE(&__DDRSS_Data_Slice_1_REGISTER_BLOCK__OFFS))+Var.VALUE(&__DDRSS_PHY_373__SFR_OFFS)))) %Long Var.VALUE(&__DDRSS0_PHY_373_DATA)
	Data.Set D:((((Var.VALUE(&__J7_DDR0_SS_BASE)+Var.VALUE(&__DDRSS_Data_Slice_1_REGISTER_BLOCK__OFFS))+Var.VALUE(&__DDRSS_PHY_374__SFR_OFFS)))) %Long Var.VALUE(&__DDRSS0_PHY_374_DATA)
	Data.Set D:((((Var.VALUE(&__J7_DDR0_SS_BASE)+Var.VALUE(&__DDRSS_Data_Slice_1_REGISTER_BLOCK__OFFS))+Var.VALUE(&__DDRSS_PHY_375__SFR_OFFS)))) %Long Var.VALUE(&__DDRSS0_PHY_375_DATA)
	Data.Set D:((((Var.VALUE(&__J7_DDR0_SS_BASE)+Var.VALUE(&__DDRSS_Data_Slice_1_REGISTER_BLOCK__OFFS))+Var.VALUE(&__DDRSS_PHY_376__SFR_OFFS)))) %Long Var.VALUE(&__DDRSS0_PHY_376_DATA)
	Data.Set D:((((Var.VALUE(&__J7_DDR0_SS_BASE)+Var.VALUE(&__DDRSS_Data_Slice_1_REGISTER_BLOCK__OFFS))+Var.VALUE(&__DDRSS_PHY_377__SFR_OFFS)))) %Long Var.VALUE(&__DDRSS0_PHY_377_DATA)
	Data.Set D:((((Var.VALUE(&__J7_DDR0_SS_BASE)+Var.VALUE(&__DDRSS_Data_Slice_1_REGISTER_BLOCK__OFFS))+Var.VALUE(&__DDRSS_PHY_378__SFR_OFFS)))) %Long Var.VALUE(&__DDRSS0_PHY_378_DATA)
	Data.Set D:((((Var.VALUE(&__J7_DDR0_SS_BASE)+Var.VALUE(&__DDRSS_Data_Slice_1_REGISTER_BLOCK__OFFS))+Var.VALUE(&__DDRSS_PHY_379__SFR_OFFS)))) %Long Var.VALUE(&__DDRSS0_PHY_379_DATA)
	Data.Set D:((((Var.VALUE(&__J7_DDR0_SS_BASE)+Var.VALUE(&__DDRSS_Data_Slice_1_REGISTER_BLOCK__OFFS))+Var.VALUE(&__DDRSS_PHY_380__SFR_OFFS)))) %Long Var.VALUE(&__DDRSS0_PHY_380_DATA)
	Data.Set D:((((Var.VALUE(&__J7_DDR0_SS_BASE)+Var.VALUE(&__DDRSS_Data_Slice_1_REGISTER_BLOCK__OFFS))+Var.VALUE(&__DDRSS_PHY_381__SFR_OFFS)))) %Long Var.VALUE(&__DDRSS0_PHY_381_DATA)
	Data.Set D:((((Var.VALUE(&__J7_DDR0_SS_BASE)+Var.VALUE(&__DDRSS_Data_Slice_1_REGISTER_BLOCK__OFFS))+Var.VALUE(&__DDRSS_PHY_382__SFR_OFFS)))) %Long Var.VALUE(&__DDRSS0_PHY_382_DATA)
	Data.Set D:((((Var.VALUE(&__J7_DDR0_SS_BASE)+Var.VALUE(&__DDRSS_Data_Slice_1_REGISTER_BLOCK__OFFS))+Var.VALUE(&__DDRSS_PHY_383__SFR_OFFS)))) %Long Var.VALUE(&__DDRSS0_PHY_383_DATA)
	Data.Set D:((((Var.VALUE(&__J7_DDR0_SS_BASE)+Var.VALUE(&__DDRSS_Data_Slice_1_REGISTER_BLOCK__OFFS))+Var.VALUE(&__DDRSS_PHY_384__SFR_OFFS)))) %Long Var.VALUE(&__DDRSS0_PHY_384_DATA)
	Data.Set D:((((Var.VALUE(&__J7_DDR0_SS_BASE)+Var.VALUE(&__DDRSS_Data_Slice_1_REGISTER_BLOCK__OFFS))+Var.VALUE(&__DDRSS_PHY_385__SFR_OFFS)))) %Long Var.VALUE(&__DDRSS0_PHY_385_DATA)
	Data.Set D:((((Var.VALUE(&__J7_DDR0_SS_BASE)+Var.VALUE(&__DDRSS_Data_Slice_1_REGISTER_BLOCK__OFFS))+Var.VALUE(&__DDRSS_PHY_386__SFR_OFFS)))) %Long Var.VALUE(&__DDRSS0_PHY_386_DATA)
	Data.Set D:((((Var.VALUE(&__J7_DDR0_SS_BASE)+Var.VALUE(&__DDRSS_Data_Slice_1_REGISTER_BLOCK__OFFS))+Var.VALUE(&__DDRSS_PHY_387__SFR_OFFS)))) %Long Var.VALUE(&__DDRSS0_PHY_387_DATA)
	Data.Set D:((((Var.VALUE(&__J7_DDR0_SS_BASE)+Var.VALUE(&__DDRSS_Data_Slice_1_REGISTER_BLOCK__OFFS))+Var.VALUE(&__DDRSS_PHY_388__SFR_OFFS)))) %Long Var.VALUE(&__DDRSS0_PHY_388_DATA)
	Data.Set D:((((Var.VALUE(&__J7_DDR0_SS_BASE)+Var.VALUE(&__DDRSS_Data_Slice_1_REGISTER_BLOCK__OFFS))+Var.VALUE(&__DDRSS_PHY_389__SFR_OFFS)))) %Long Var.VALUE(&__DDRSS0_PHY_389_DATA)
	Data.Set D:((((Var.VALUE(&__J7_DDR0_SS_BASE)+Var.VALUE(&__DDRSS_Data_Slice_1_REGISTER_BLOCK__OFFS))+Var.VALUE(&__DDRSS_PHY_390__SFR_OFFS)))) %Long Var.VALUE(&__DDRSS0_PHY_390_DATA)
	Data.Set D:((((Var.VALUE(&__J7_DDR0_SS_BASE)+Var.VALUE(&__DDRSS_Data_Slice_1_REGISTER_BLOCK__OFFS))+Var.VALUE(&__DDRSS_PHY_391__SFR_OFFS)))) %Long Var.VALUE(&__DDRSS0_PHY_391_DATA)
	Data.Set D:((((Var.VALUE(&__J7_DDR0_SS_BASE)+Var.VALUE(&__DDRSS_Data_Slice_1_REGISTER_BLOCK__OFFS))+Var.VALUE(&__DDRSS_PHY_392__SFR_OFFS)))) %Long Var.VALUE(&__DDRSS0_PHY_392_DATA)
	Data.Set D:((((Var.VALUE(&__J7_DDR0_SS_BASE)+Var.VALUE(&__DDRSS_Data_Slice_1_REGISTER_BLOCK__OFFS))+Var.VALUE(&__DDRSS_PHY_393__SFR_OFFS)))) %Long Var.VALUE(&__DDRSS0_PHY_393_DATA)
	Data.Set D:((((Var.VALUE(&__J7_DDR0_SS_BASE)+Var.VALUE(&__DDRSS_Data_Slice_1_REGISTER_BLOCK__OFFS))+Var.VALUE(&__DDRSS_PHY_394__SFR_OFFS)))) %Long Var.VALUE(&__DDRSS0_PHY_394_DATA)
	Data.Set D:((((Var.VALUE(&__J7_DDR0_SS_BASE)+Var.VALUE(&__DDRSS_Data_Slice_1_REGISTER_BLOCK__OFFS))+Var.VALUE(&__DDRSS_PHY_395__SFR_OFFS)))) %Long Var.VALUE(&__DDRSS0_PHY_395_DATA)
	Var.NEWLOCAL char[128] \strtmp = "--->>> DDR0 PHY Data Slice 1 programming completed... <<<---\n"
	GOSUB printf Var.String(\strtmp)
	
	Var.NEWLOCAL char[128] \strtmp = "--->>> DDR0 PHY Data Slice 2 programming in progress.. <<<---\n"
	GOSUB printf Var.String(\strtmp)
	
	Data.Set D:((((Var.VALUE(&__J7_DDR0_SS_BASE)+Var.VALUE(&__DDRSS_Data_Slice_2_REGISTER_BLOCK__OFFS))+Var.VALUE(&__DDRSS_PHY_512__SFR_OFFS)))) %Long Var.VALUE(&__DDRSS0_PHY_512_DATA)
	Data.Set D:((((Var.VALUE(&__J7_DDR0_SS_BASE)+Var.VALUE(&__DDRSS_Data_Slice_2_REGISTER_BLOCK__OFFS))+Var.VALUE(&__DDRSS_PHY_513__SFR_OFFS)))) %Long Var.VALUE(&__DDRSS0_PHY_513_DATA)
	Data.Set D:((((Var.VALUE(&__J7_DDR0_SS_BASE)+Var.VALUE(&__DDRSS_Data_Slice_2_REGISTER_BLOCK__OFFS))+Var.VALUE(&__DDRSS_PHY_514__SFR_OFFS)))) %Long Var.VALUE(&__DDRSS0_PHY_514_DATA)
	Data.Set D:((((Var.VALUE(&__J7_DDR0_SS_BASE)+Var.VALUE(&__DDRSS_Data_Slice_2_REGISTER_BLOCK__OFFS))+Var.VALUE(&__DDRSS_PHY_515__SFR_OFFS)))) %Long Var.VALUE(&__DDRSS0_PHY_515_DATA)
	Data.Set D:((((Var.VALUE(&__J7_DDR0_SS_BASE)+Var.VALUE(&__DDRSS_Data_Slice_2_REGISTER_BLOCK__OFFS))+Var.VALUE(&__DDRSS_PHY_516__SFR_OFFS)))) %Long Var.VALUE(&__DDRSS0_PHY_516_DATA)
	Data.Set D:((((Var.VALUE(&__J7_DDR0_SS_BASE)+Var.VALUE(&__DDRSS_Data_Slice_2_REGISTER_BLOCK__OFFS))+Var.VALUE(&__DDRSS_PHY_517__SFR_OFFS)))) %Long Var.VALUE(&__DDRSS0_PHY_517_DATA)
	Data.Set D:((((Var.VALUE(&__J7_DDR0_SS_BASE)+Var.VALUE(&__DDRSS_Data_Slice_2_REGISTER_BLOCK__OFFS))+Var.VALUE(&__DDRSS_PHY_518__SFR_OFFS)))) %Long Var.VALUE(&__DDRSS0_PHY_518_DATA)
	Data.Set D:((((Var.VALUE(&__J7_DDR0_SS_BASE)+Var.VALUE(&__DDRSS_Data_Slice_2_REGISTER_BLOCK__OFFS))+Var.VALUE(&__DDRSS_PHY_519__SFR_OFFS)))) %Long Var.VALUE(&__DDRSS0_PHY_519_DATA)
	Data.Set D:((((Var.VALUE(&__J7_DDR0_SS_BASE)+Var.VALUE(&__DDRSS_Data_Slice_2_REGISTER_BLOCK__OFFS))+Var.VALUE(&__DDRSS_PHY_520__SFR_OFFS)))) %Long Var.VALUE(&__DDRSS0_PHY_520_DATA)
	Data.Set D:((((Var.VALUE(&__J7_DDR0_SS_BASE)+Var.VALUE(&__DDRSS_Data_Slice_2_REGISTER_BLOCK__OFFS))+Var.VALUE(&__DDRSS_PHY_521__SFR_OFFS)))) %Long Var.VALUE(&__DDRSS0_PHY_521_DATA)
	Data.Set D:((((Var.VALUE(&__J7_DDR0_SS_BASE)+Var.VALUE(&__DDRSS_Data_Slice_2_REGISTER_BLOCK__OFFS))+Var.VALUE(&__DDRSS_PHY_522__SFR_OFFS)))) %Long Var.VALUE(&__DDRSS0_PHY_522_DATA)
	Data.Set D:((((Var.VALUE(&__J7_DDR0_SS_BASE)+Var.VALUE(&__DDRSS_Data_Slice_2_REGISTER_BLOCK__OFFS))+Var.VALUE(&__DDRSS_PHY_523__SFR_OFFS)))) %Long Var.VALUE(&__DDRSS0_PHY_523_DATA)
	Data.Set D:((((Var.VALUE(&__J7_DDR0_SS_BASE)+Var.VALUE(&__DDRSS_Data_Slice_2_REGISTER_BLOCK__OFFS))+Var.VALUE(&__DDRSS_PHY_524__SFR_OFFS)))) %Long Var.VALUE(&__DDRSS0_PHY_524_DATA)
	Data.Set D:((((Var.VALUE(&__J7_DDR0_SS_BASE)+Var.VALUE(&__DDRSS_Data_Slice_2_REGISTER_BLOCK__OFFS))+Var.VALUE(&__DDRSS_PHY_525__SFR_OFFS)))) %Long Var.VALUE(&__DDRSS0_PHY_525_DATA)
	Data.Set D:((((Var.VALUE(&__J7_DDR0_SS_BASE)+Var.VALUE(&__DDRSS_Data_Slice_2_REGISTER_BLOCK__OFFS))+Var.VALUE(&__DDRSS_PHY_526__SFR_OFFS)))) %Long Var.VALUE(&__DDRSS0_PHY_526_DATA)
	Data.Set D:((((Var.VALUE(&__J7_DDR0_SS_BASE)+Var.VALUE(&__DDRSS_Data_Slice_2_REGISTER_BLOCK__OFFS))+Var.VALUE(&__DDRSS_PHY_527__SFR_OFFS)))) %Long Var.VALUE(&__DDRSS0_PHY_527_DATA)
	Data.Set D:((((Var.VALUE(&__J7_DDR0_SS_BASE)+Var.VALUE(&__DDRSS_Data_Slice_2_REGISTER_BLOCK__OFFS))+Var.VALUE(&__DDRSS_PHY_528__SFR_OFFS)))) %Long Var.VALUE(&__DDRSS0_PHY_528_DATA)
	Data.Set D:((((Var.VALUE(&__J7_DDR0_SS_BASE)+Var.VALUE(&__DDRSS_Data_Slice_2_REGISTER_BLOCK__OFFS))+Var.VALUE(&__DDRSS_PHY_529__SFR_OFFS)))) %Long Var.VALUE(&__DDRSS0_PHY_529_DATA)
	Data.Set D:((((Var.VALUE(&__J7_DDR0_SS_BASE)+Var.VALUE(&__DDRSS_Data_Slice_2_REGISTER_BLOCK__OFFS))+Var.VALUE(&__DDRSS_PHY_530__SFR_OFFS)))) %Long Var.VALUE(&__DDRSS0_PHY_530_DATA)
	Data.Set D:((((Var.VALUE(&__J7_DDR0_SS_BASE)+Var.VALUE(&__DDRSS_Data_Slice_2_REGISTER_BLOCK__OFFS))+Var.VALUE(&__DDRSS_PHY_531__SFR_OFFS)))) %Long Var.VALUE(&__DDRSS0_PHY_531_DATA)
	Data.Set D:((((Var.VALUE(&__J7_DDR0_SS_BASE)+Var.VALUE(&__DDRSS_Data_Slice_2_REGISTER_BLOCK__OFFS))+Var.VALUE(&__DDRSS_PHY_532__SFR_OFFS)))) %Long Var.VALUE(&__DDRSS0_PHY_532_DATA)
	Data.Set D:((((Var.VALUE(&__J7_DDR0_SS_BASE)+Var.VALUE(&__DDRSS_Data_Slice_2_REGISTER_BLOCK__OFFS))+Var.VALUE(&__DDRSS_PHY_533__SFR_OFFS)))) %Long Var.VALUE(&__DDRSS0_PHY_533_DATA)
	Data.Set D:((((Var.VALUE(&__J7_DDR0_SS_BASE)+Var.VALUE(&__DDRSS_Data_Slice_2_REGISTER_BLOCK__OFFS))+Var.VALUE(&__DDRSS_PHY_534__SFR_OFFS)))) %Long Var.VALUE(&__DDRSS0_PHY_534_DATA)
	Data.Set D:((((Var.VALUE(&__J7_DDR0_SS_BASE)+Var.VALUE(&__DDRSS_Data_Slice_2_REGISTER_BLOCK__OFFS))+Var.VALUE(&__DDRSS_PHY_535__SFR_OFFS)))) %Long Var.VALUE(&__DDRSS0_PHY_535_DATA)
	Data.Set D:((((Var.VALUE(&__J7_DDR0_SS_BASE)+Var.VALUE(&__DDRSS_Data_Slice_2_REGISTER_BLOCK__OFFS))+Var.VALUE(&__DDRSS_PHY_536__SFR_OFFS)))) %Long Var.VALUE(&__DDRSS0_PHY_536_DATA)
	Data.Set D:((((Var.VALUE(&__J7_DDR0_SS_BASE)+Var.VALUE(&__DDRSS_Data_Slice_2_REGISTER_BLOCK__OFFS))+Var.VALUE(&__DDRSS_PHY_537__SFR_OFFS)))) %Long Var.VALUE(&__DDRSS0_PHY_537_DATA)
	Data.Set D:((((Var.VALUE(&__J7_DDR0_SS_BASE)+Var.VALUE(&__DDRSS_Data_Slice_2_REGISTER_BLOCK__OFFS))+Var.VALUE(&__DDRSS_PHY_538__SFR_OFFS)))) %Long Var.VALUE(&__DDRSS0_PHY_538_DATA)
	Data.Set D:((((Var.VALUE(&__J7_DDR0_SS_BASE)+Var.VALUE(&__DDRSS_Data_Slice_2_REGISTER_BLOCK__OFFS))+Var.VALUE(&__DDRSS_PHY_539__SFR_OFFS)))) %Long Var.VALUE(&__DDRSS0_PHY_539_DATA)
	Data.Set D:((((Var.VALUE(&__J7_DDR0_SS_BASE)+Var.VALUE(&__DDRSS_Data_Slice_2_REGISTER_BLOCK__OFFS))+Var.VALUE(&__DDRSS_PHY_540__SFR_OFFS)))) %Long Var.VALUE(&__DDRSS0_PHY_540_DATA)
	Data.Set D:((((Var.VALUE(&__J7_DDR0_SS_BASE)+Var.VALUE(&__DDRSS_Data_Slice_2_REGISTER_BLOCK__OFFS))+Var.VALUE(&__DDRSS_PHY_541__SFR_OFFS)))) %Long Var.VALUE(&__DDRSS0_PHY_541_DATA)
	Data.Set D:((((Var.VALUE(&__J7_DDR0_SS_BASE)+Var.VALUE(&__DDRSS_Data_Slice_2_REGISTER_BLOCK__OFFS))+Var.VALUE(&__DDRSS_PHY_542__SFR_OFFS)))) %Long Var.VALUE(&__DDRSS0_PHY_542_DATA)
	Data.Set D:((((Var.VALUE(&__J7_DDR0_SS_BASE)+Var.VALUE(&__DDRSS_Data_Slice_2_REGISTER_BLOCK__OFFS))+Var.VALUE(&__DDRSS_PHY_543__SFR_OFFS)))) %Long Var.VALUE(&__DDRSS0_PHY_543_DATA)
	Data.Set D:((((Var.VALUE(&__J7_DDR0_SS_BASE)+Var.VALUE(&__DDRSS_Data_Slice_2_REGISTER_BLOCK__OFFS))+Var.VALUE(&__DDRSS_PHY_544__SFR_OFFS)))) %Long Var.VALUE(&__DDRSS0_PHY_544_DATA)
	Data.Set D:((((Var.VALUE(&__J7_DDR0_SS_BASE)+Var.VALUE(&__DDRSS_Data_Slice_2_REGISTER_BLOCK__OFFS))+Var.VALUE(&__DDRSS_PHY_545__SFR_OFFS)))) %Long Var.VALUE(&__DDRSS0_PHY_545_DATA)
	Data.Set D:((((Var.VALUE(&__J7_DDR0_SS_BASE)+Var.VALUE(&__DDRSS_Data_Slice_2_REGISTER_BLOCK__OFFS))+Var.VALUE(&__DDRSS_PHY_546__SFR_OFFS)))) %Long Var.VALUE(&__DDRSS0_PHY_546_DATA)
	Data.Set D:((((Var.VALUE(&__J7_DDR0_SS_BASE)+Var.VALUE(&__DDRSS_Data_Slice_2_REGISTER_BLOCK__OFFS))+Var.VALUE(&__DDRSS_PHY_547__SFR_OFFS)))) %Long Var.VALUE(&__DDRSS0_PHY_547_DATA)
	Data.Set D:((((Var.VALUE(&__J7_DDR0_SS_BASE)+Var.VALUE(&__DDRSS_Data_Slice_2_REGISTER_BLOCK__OFFS))+Var.VALUE(&__DDRSS_PHY_548__SFR_OFFS)))) %Long Var.VALUE(&__DDRSS0_PHY_548_DATA)
	Data.Set D:((((Var.VALUE(&__J7_DDR0_SS_BASE)+Var.VALUE(&__DDRSS_Data_Slice_2_REGISTER_BLOCK__OFFS))+Var.VALUE(&__DDRSS_PHY_549__SFR_OFFS)))) %Long Var.VALUE(&__DDRSS0_PHY_549_DATA)
	Data.Set D:((((Var.VALUE(&__J7_DDR0_SS_BASE)+Var.VALUE(&__DDRSS_Data_Slice_2_REGISTER_BLOCK__OFFS))+Var.VALUE(&__DDRSS_PHY_550__SFR_OFFS)))) %Long Var.VALUE(&__DDRSS0_PHY_550_DATA)
	Data.Set D:((((Var.VALUE(&__J7_DDR0_SS_BASE)+Var.VALUE(&__DDRSS_Data_Slice_2_REGISTER_BLOCK__OFFS))+Var.VALUE(&__DDRSS_PHY_551__SFR_OFFS)))) %Long Var.VALUE(&__DDRSS0_PHY_551_DATA)
	Data.Set D:((((Var.VALUE(&__J7_DDR0_SS_BASE)+Var.VALUE(&__DDRSS_Data_Slice_2_REGISTER_BLOCK__OFFS))+Var.VALUE(&__DDRSS_PHY_552__SFR_OFFS)))) %Long Var.VALUE(&__DDRSS0_PHY_552_DATA)
	Data.Set D:((((Var.VALUE(&__J7_DDR0_SS_BASE)+Var.VALUE(&__DDRSS_Data_Slice_2_REGISTER_BLOCK__OFFS))+Var.VALUE(&__DDRSS_PHY_553__SFR_OFFS)))) %Long Var.VALUE(&__DDRSS0_PHY_553_DATA)
	Data.Set D:((((Var.VALUE(&__J7_DDR0_SS_BASE)+Var.VALUE(&__DDRSS_Data_Slice_2_REGISTER_BLOCK__OFFS))+Var.VALUE(&__DDRSS_PHY_554__SFR_OFFS)))) %Long Var.VALUE(&__DDRSS0_PHY_554_DATA)
	Data.Set D:((((Var.VALUE(&__J7_DDR0_SS_BASE)+Var.VALUE(&__DDRSS_Data_Slice_2_REGISTER_BLOCK__OFFS))+Var.VALUE(&__DDRSS_PHY_555__SFR_OFFS)))) %Long Var.VALUE(&__DDRSS0_PHY_555_DATA)
	Data.Set D:((((Var.VALUE(&__J7_DDR0_SS_BASE)+Var.VALUE(&__DDRSS_Data_Slice_2_REGISTER_BLOCK__OFFS))+Var.VALUE(&__DDRSS_PHY_556__SFR_OFFS)))) %Long Var.VALUE(&__DDRSS0_PHY_556_DATA)
	Data.Set D:((((Var.VALUE(&__J7_DDR0_SS_BASE)+Var.VALUE(&__DDRSS_Data_Slice_2_REGISTER_BLOCK__OFFS))+Var.VALUE(&__DDRSS_PHY_557__SFR_OFFS)))) %Long Var.VALUE(&__DDRSS0_PHY_557_DATA)
	Data.Set D:((((Var.VALUE(&__J7_DDR0_SS_BASE)+Var.VALUE(&__DDRSS_Data_Slice_2_REGISTER_BLOCK__OFFS))+Var.VALUE(&__DDRSS_PHY_558__SFR_OFFS)))) %Long Var.VALUE(&__DDRSS0_PHY_558_DATA)
	Data.Set D:((((Var.VALUE(&__J7_DDR0_SS_BASE)+Var.VALUE(&__DDRSS_Data_Slice_2_REGISTER_BLOCK__OFFS))+Var.VALUE(&__DDRSS_PHY_559__SFR_OFFS)))) %Long Var.VALUE(&__DDRSS0_PHY_559_DATA)
	Data.Set D:((((Var.VALUE(&__J7_DDR0_SS_BASE)+Var.VALUE(&__DDRSS_Data_Slice_2_REGISTER_BLOCK__OFFS))+Var.VALUE(&__DDRSS_PHY_560__SFR_OFFS)))) %Long Var.VALUE(&__DDRSS0_PHY_560_DATA)
	Data.Set D:((((Var.VALUE(&__J7_DDR0_SS_BASE)+Var.VALUE(&__DDRSS_Data_Slice_2_REGISTER_BLOCK__OFFS))+Var.VALUE(&__DDRSS_PHY_561__SFR_OFFS)))) %Long Var.VALUE(&__DDRSS0_PHY_561_DATA)
	Data.Set D:((((Var.VALUE(&__J7_DDR0_SS_BASE)+Var.VALUE(&__DDRSS_Data_Slice_2_REGISTER_BLOCK__OFFS))+Var.VALUE(&__DDRSS_PHY_562__SFR_OFFS)))) %Long Var.VALUE(&__DDRSS0_PHY_562_DATA)
	Data.Set D:((((Var.VALUE(&__J7_DDR0_SS_BASE)+Var.VALUE(&__DDRSS_Data_Slice_2_REGISTER_BLOCK__OFFS))+Var.VALUE(&__DDRSS_PHY_563__SFR_OFFS)))) %Long Var.VALUE(&__DDRSS0_PHY_563_DATA)
	Data.Set D:((((Var.VALUE(&__J7_DDR0_SS_BASE)+Var.VALUE(&__DDRSS_Data_Slice_2_REGISTER_BLOCK__OFFS))+Var.VALUE(&__DDRSS_PHY_564__SFR_OFFS)))) %Long Var.VALUE(&__DDRSS0_PHY_564_DATA)
	Data.Set D:((((Var.VALUE(&__J7_DDR0_SS_BASE)+Var.VALUE(&__DDRSS_Data_Slice_2_REGISTER_BLOCK__OFFS))+Var.VALUE(&__DDRSS_PHY_565__SFR_OFFS)))) %Long Var.VALUE(&__DDRSS0_PHY_565_DATA)
	Data.Set D:((((Var.VALUE(&__J7_DDR0_SS_BASE)+Var.VALUE(&__DDRSS_Data_Slice_2_REGISTER_BLOCK__OFFS))+Var.VALUE(&__DDRSS_PHY_566__SFR_OFFS)))) %Long Var.VALUE(&__DDRSS0_PHY_566_DATA)
	Data.Set D:((((Var.VALUE(&__J7_DDR0_SS_BASE)+Var.VALUE(&__DDRSS_Data_Slice_2_REGISTER_BLOCK__OFFS))+Var.VALUE(&__DDRSS_PHY_567__SFR_OFFS)))) %Long Var.VALUE(&__DDRSS0_PHY_567_DATA)
	Data.Set D:((((Var.VALUE(&__J7_DDR0_SS_BASE)+Var.VALUE(&__DDRSS_Data_Slice_2_REGISTER_BLOCK__OFFS))+Var.VALUE(&__DDRSS_PHY_568__SFR_OFFS)))) %Long Var.VALUE(&__DDRSS0_PHY_568_DATA)
	Data.Set D:((((Var.VALUE(&__J7_DDR0_SS_BASE)+Var.VALUE(&__DDRSS_Data_Slice_2_REGISTER_BLOCK__OFFS))+Var.VALUE(&__DDRSS_PHY_569__SFR_OFFS)))) %Long Var.VALUE(&__DDRSS0_PHY_569_DATA)
	Data.Set D:((((Var.VALUE(&__J7_DDR0_SS_BASE)+Var.VALUE(&__DDRSS_Data_Slice_2_REGISTER_BLOCK__OFFS))+Var.VALUE(&__DDRSS_PHY_570__SFR_OFFS)))) %Long Var.VALUE(&__DDRSS0_PHY_570_DATA)
	Data.Set D:((((Var.VALUE(&__J7_DDR0_SS_BASE)+Var.VALUE(&__DDRSS_Data_Slice_2_REGISTER_BLOCK__OFFS))+Var.VALUE(&__DDRSS_PHY_571__SFR_OFFS)))) %Long Var.VALUE(&__DDRSS0_PHY_571_DATA)
	Data.Set D:((((Var.VALUE(&__J7_DDR0_SS_BASE)+Var.VALUE(&__DDRSS_Data_Slice_2_REGISTER_BLOCK__OFFS))+Var.VALUE(&__DDRSS_PHY_572__SFR_OFFS)))) %Long Var.VALUE(&__DDRSS0_PHY_572_DATA)
	Data.Set D:((((Var.VALUE(&__J7_DDR0_SS_BASE)+Var.VALUE(&__DDRSS_Data_Slice_2_REGISTER_BLOCK__OFFS))+Var.VALUE(&__DDRSS_PHY_573__SFR_OFFS)))) %Long Var.VALUE(&__DDRSS0_PHY_573_DATA)
	Data.Set D:((((Var.VALUE(&__J7_DDR0_SS_BASE)+Var.VALUE(&__DDRSS_Data_Slice_2_REGISTER_BLOCK__OFFS))+Var.VALUE(&__DDRSS_PHY_574__SFR_OFFS)))) %Long Var.VALUE(&__DDRSS0_PHY_574_DATA)
	Data.Set D:((((Var.VALUE(&__J7_DDR0_SS_BASE)+Var.VALUE(&__DDRSS_Data_Slice_2_REGISTER_BLOCK__OFFS))+Var.VALUE(&__DDRSS_PHY_575__SFR_OFFS)))) %Long Var.VALUE(&__DDRSS0_PHY_575_DATA)
	Data.Set D:((((Var.VALUE(&__J7_DDR0_SS_BASE)+Var.VALUE(&__DDRSS_Data_Slice_2_REGISTER_BLOCK__OFFS))+Var.VALUE(&__DDRSS_PHY_576__SFR_OFFS)))) %Long Var.VALUE(&__DDRSS0_PHY_576_DATA)
	Data.Set D:((((Var.VALUE(&__J7_DDR0_SS_BASE)+Var.VALUE(&__DDRSS_Data_Slice_2_REGISTER_BLOCK__OFFS))+Var.VALUE(&__DDRSS_PHY_577__SFR_OFFS)))) %Long Var.VALUE(&__DDRSS0_PHY_577_DATA)
	Data.Set D:((((Var.VALUE(&__J7_DDR0_SS_BASE)+Var.VALUE(&__DDRSS_Data_Slice_2_REGISTER_BLOCK__OFFS))+Var.VALUE(&__DDRSS_PHY_578__SFR_OFFS)))) %Long Var.VALUE(&__DDRSS0_PHY_578_DATA)
	Data.Set D:((((Var.VALUE(&__J7_DDR0_SS_BASE)+Var.VALUE(&__DDRSS_Data_Slice_2_REGISTER_BLOCK__OFFS))+Var.VALUE(&__DDRSS_PHY_579__SFR_OFFS)))) %Long Var.VALUE(&__DDRSS0_PHY_579_DATA)
	Data.Set D:((((Var.VALUE(&__J7_DDR0_SS_BASE)+Var.VALUE(&__DDRSS_Data_Slice_2_REGISTER_BLOCK__OFFS))+Var.VALUE(&__DDRSS_PHY_580__SFR_OFFS)))) %Long Var.VALUE(&__DDRSS0_PHY_580_DATA)
	Data.Set D:((((Var.VALUE(&__J7_DDR0_SS_BASE)+Var.VALUE(&__DDRSS_Data_Slice_2_REGISTER_BLOCK__OFFS))+Var.VALUE(&__DDRSS_PHY_581__SFR_OFFS)))) %Long Var.VALUE(&__DDRSS0_PHY_581_DATA)
	Data.Set D:((((Var.VALUE(&__J7_DDR0_SS_BASE)+Var.VALUE(&__DDRSS_Data_Slice_2_REGISTER_BLOCK__OFFS))+Var.VALUE(&__DDRSS_PHY_582__SFR_OFFS)))) %Long Var.VALUE(&__DDRSS0_PHY_582_DATA)
	Data.Set D:((((Var.VALUE(&__J7_DDR0_SS_BASE)+Var.VALUE(&__DDRSS_Data_Slice_2_REGISTER_BLOCK__OFFS))+Var.VALUE(&__DDRSS_PHY_583__SFR_OFFS)))) %Long Var.VALUE(&__DDRSS0_PHY_583_DATA)
	Data.Set D:((((Var.VALUE(&__J7_DDR0_SS_BASE)+Var.VALUE(&__DDRSS_Data_Slice_2_REGISTER_BLOCK__OFFS))+Var.VALUE(&__DDRSS_PHY_584__SFR_OFFS)))) %Long Var.VALUE(&__DDRSS0_PHY_584_DATA)
	Data.Set D:((((Var.VALUE(&__J7_DDR0_SS_BASE)+Var.VALUE(&__DDRSS_Data_Slice_2_REGISTER_BLOCK__OFFS))+Var.VALUE(&__DDRSS_PHY_585__SFR_OFFS)))) %Long Var.VALUE(&__DDRSS0_PHY_585_DATA)
	Data.Set D:((((Var.VALUE(&__J7_DDR0_SS_BASE)+Var.VALUE(&__DDRSS_Data_Slice_2_REGISTER_BLOCK__OFFS))+Var.VALUE(&__DDRSS_PHY_586__SFR_OFFS)))) %Long Var.VALUE(&__DDRSS0_PHY_586_DATA)
	Data.Set D:((((Var.VALUE(&__J7_DDR0_SS_BASE)+Var.VALUE(&__DDRSS_Data_Slice_2_REGISTER_BLOCK__OFFS))+Var.VALUE(&__DDRSS_PHY_587__SFR_OFFS)))) %Long Var.VALUE(&__DDRSS0_PHY_587_DATA)
	Data.Set D:((((Var.VALUE(&__J7_DDR0_SS_BASE)+Var.VALUE(&__DDRSS_Data_Slice_2_REGISTER_BLOCK__OFFS))+Var.VALUE(&__DDRSS_PHY_588__SFR_OFFS)))) %Long Var.VALUE(&__DDRSS0_PHY_588_DATA)
	Data.Set D:((((Var.VALUE(&__J7_DDR0_SS_BASE)+Var.VALUE(&__DDRSS_Data_Slice_2_REGISTER_BLOCK__OFFS))+Var.VALUE(&__DDRSS_PHY_589__SFR_OFFS)))) %Long Var.VALUE(&__DDRSS0_PHY_589_DATA)
	Data.Set D:((((Var.VALUE(&__J7_DDR0_SS_BASE)+Var.VALUE(&__DDRSS_Data_Slice_2_REGISTER_BLOCK__OFFS))+Var.VALUE(&__DDRSS_PHY_590__SFR_OFFS)))) %Long Var.VALUE(&__DDRSS0_PHY_590_DATA)
	Data.Set D:((((Var.VALUE(&__J7_DDR0_SS_BASE)+Var.VALUE(&__DDRSS_Data_Slice_2_REGISTER_BLOCK__OFFS))+Var.VALUE(&__DDRSS_PHY_591__SFR_OFFS)))) %Long Var.VALUE(&__DDRSS0_PHY_591_DATA)
	Data.Set D:((((Var.VALUE(&__J7_DDR0_SS_BASE)+Var.VALUE(&__DDRSS_Data_Slice_2_REGISTER_BLOCK__OFFS))+Var.VALUE(&__DDRSS_PHY_592__SFR_OFFS)))) %Long Var.VALUE(&__DDRSS0_PHY_592_DATA)
	Data.Set D:((((Var.VALUE(&__J7_DDR0_SS_BASE)+Var.VALUE(&__DDRSS_Data_Slice_2_REGISTER_BLOCK__OFFS))+Var.VALUE(&__DDRSS_PHY_593__SFR_OFFS)))) %Long Var.VALUE(&__DDRSS0_PHY_593_DATA)
	Data.Set D:((((Var.VALUE(&__J7_DDR0_SS_BASE)+Var.VALUE(&__DDRSS_Data_Slice_2_REGISTER_BLOCK__OFFS))+Var.VALUE(&__DDRSS_PHY_594__SFR_OFFS)))) %Long Var.VALUE(&__DDRSS0_PHY_594_DATA)
	Data.Set D:((((Var.VALUE(&__J7_DDR0_SS_BASE)+Var.VALUE(&__DDRSS_Data_Slice_2_REGISTER_BLOCK__OFFS))+Var.VALUE(&__DDRSS_PHY_595__SFR_OFFS)))) %Long Var.VALUE(&__DDRSS0_PHY_595_DATA)
	Data.Set D:((((Var.VALUE(&__J7_DDR0_SS_BASE)+Var.VALUE(&__DDRSS_Data_Slice_2_REGISTER_BLOCK__OFFS))+Var.VALUE(&__DDRSS_PHY_596__SFR_OFFS)))) %Long Var.VALUE(&__DDRSS0_PHY_596_DATA)
	Data.Set D:((((Var.VALUE(&__J7_DDR0_SS_BASE)+Var.VALUE(&__DDRSS_Data_Slice_2_REGISTER_BLOCK__OFFS))+Var.VALUE(&__DDRSS_PHY_597__SFR_OFFS)))) %Long Var.VALUE(&__DDRSS0_PHY_597_DATA)
	Data.Set D:((((Var.VALUE(&__J7_DDR0_SS_BASE)+Var.VALUE(&__DDRSS_Data_Slice_2_REGISTER_BLOCK__OFFS))+Var.VALUE(&__DDRSS_PHY_598__SFR_OFFS)))) %Long Var.VALUE(&__DDRSS0_PHY_598_DATA)
	Data.Set D:((((Var.VALUE(&__J7_DDR0_SS_BASE)+Var.VALUE(&__DDRSS_Data_Slice_2_REGISTER_BLOCK__OFFS))+Var.VALUE(&__DDRSS_PHY_599__SFR_OFFS)))) %Long Var.VALUE(&__DDRSS0_PHY_599_DATA)
	Data.Set D:((((Var.VALUE(&__J7_DDR0_SS_BASE)+Var.VALUE(&__DDRSS_Data_Slice_2_REGISTER_BLOCK__OFFS))+Var.VALUE(&__DDRSS_PHY_600__SFR_OFFS)))) %Long Var.VALUE(&__DDRSS0_PHY_600_DATA)
	Data.Set D:((((Var.VALUE(&__J7_DDR0_SS_BASE)+Var.VALUE(&__DDRSS_Data_Slice_2_REGISTER_BLOCK__OFFS))+Var.VALUE(&__DDRSS_PHY_601__SFR_OFFS)))) %Long Var.VALUE(&__DDRSS0_PHY_601_DATA)
	Data.Set D:((((Var.VALUE(&__J7_DDR0_SS_BASE)+Var.VALUE(&__DDRSS_Data_Slice_2_REGISTER_BLOCK__OFFS))+Var.VALUE(&__DDRSS_PHY_602__SFR_OFFS)))) %Long Var.VALUE(&__DDRSS0_PHY_602_DATA)
	Data.Set D:((((Var.VALUE(&__J7_DDR0_SS_BASE)+Var.VALUE(&__DDRSS_Data_Slice_2_REGISTER_BLOCK__OFFS))+Var.VALUE(&__DDRSS_PHY_603__SFR_OFFS)))) %Long Var.VALUE(&__DDRSS0_PHY_603_DATA)
	Data.Set D:((((Var.VALUE(&__J7_DDR0_SS_BASE)+Var.VALUE(&__DDRSS_Data_Slice_2_REGISTER_BLOCK__OFFS))+Var.VALUE(&__DDRSS_PHY_604__SFR_OFFS)))) %Long Var.VALUE(&__DDRSS0_PHY_604_DATA)
	Data.Set D:((((Var.VALUE(&__J7_DDR0_SS_BASE)+Var.VALUE(&__DDRSS_Data_Slice_2_REGISTER_BLOCK__OFFS))+Var.VALUE(&__DDRSS_PHY_605__SFR_OFFS)))) %Long Var.VALUE(&__DDRSS0_PHY_605_DATA)
	Data.Set D:((((Var.VALUE(&__J7_DDR0_SS_BASE)+Var.VALUE(&__DDRSS_Data_Slice_2_REGISTER_BLOCK__OFFS))+Var.VALUE(&__DDRSS_PHY_606__SFR_OFFS)))) %Long Var.VALUE(&__DDRSS0_PHY_606_DATA)
	Data.Set D:((((Var.VALUE(&__J7_DDR0_SS_BASE)+Var.VALUE(&__DDRSS_Data_Slice_2_REGISTER_BLOCK__OFFS))+Var.VALUE(&__DDRSS_PHY_607__SFR_OFFS)))) %Long Var.VALUE(&__DDRSS0_PHY_607_DATA)
	Data.Set D:((((Var.VALUE(&__J7_DDR0_SS_BASE)+Var.VALUE(&__DDRSS_Data_Slice_2_REGISTER_BLOCK__OFFS))+Var.VALUE(&__DDRSS_PHY_608__SFR_OFFS)))) %Long Var.VALUE(&__DDRSS0_PHY_608_DATA)
	Data.Set D:((((Var.VALUE(&__J7_DDR0_SS_BASE)+Var.VALUE(&__DDRSS_Data_Slice_2_REGISTER_BLOCK__OFFS))+Var.VALUE(&__DDRSS_PHY_609__SFR_OFFS)))) %Long Var.VALUE(&__DDRSS0_PHY_609_DATA)
	Data.Set D:((((Var.VALUE(&__J7_DDR0_SS_BASE)+Var.VALUE(&__DDRSS_Data_Slice_2_REGISTER_BLOCK__OFFS))+Var.VALUE(&__DDRSS_PHY_610__SFR_OFFS)))) %Long Var.VALUE(&__DDRSS0_PHY_610_DATA)
	Data.Set D:((((Var.VALUE(&__J7_DDR0_SS_BASE)+Var.VALUE(&__DDRSS_Data_Slice_2_REGISTER_BLOCK__OFFS))+Var.VALUE(&__DDRSS_PHY_611__SFR_OFFS)))) %Long Var.VALUE(&__DDRSS0_PHY_611_DATA)
	Data.Set D:((((Var.VALUE(&__J7_DDR0_SS_BASE)+Var.VALUE(&__DDRSS_Data_Slice_2_REGISTER_BLOCK__OFFS))+Var.VALUE(&__DDRSS_PHY_612__SFR_OFFS)))) %Long Var.VALUE(&__DDRSS0_PHY_612_DATA)
	Data.Set D:((((Var.VALUE(&__J7_DDR0_SS_BASE)+Var.VALUE(&__DDRSS_Data_Slice_2_REGISTER_BLOCK__OFFS))+Var.VALUE(&__DDRSS_PHY_613__SFR_OFFS)))) %Long Var.VALUE(&__DDRSS0_PHY_613_DATA)
	Data.Set D:((((Var.VALUE(&__J7_DDR0_SS_BASE)+Var.VALUE(&__DDRSS_Data_Slice_2_REGISTER_BLOCK__OFFS))+Var.VALUE(&__DDRSS_PHY_614__SFR_OFFS)))) %Long Var.VALUE(&__DDRSS0_PHY_614_DATA)
	Data.Set D:((((Var.VALUE(&__J7_DDR0_SS_BASE)+Var.VALUE(&__DDRSS_Data_Slice_2_REGISTER_BLOCK__OFFS))+Var.VALUE(&__DDRSS_PHY_615__SFR_OFFS)))) %Long Var.VALUE(&__DDRSS0_PHY_615_DATA)
	Data.Set D:((((Var.VALUE(&__J7_DDR0_SS_BASE)+Var.VALUE(&__DDRSS_Data_Slice_2_REGISTER_BLOCK__OFFS))+Var.VALUE(&__DDRSS_PHY_616__SFR_OFFS)))) %Long Var.VALUE(&__DDRSS0_PHY_616_DATA)
	Data.Set D:((((Var.VALUE(&__J7_DDR0_SS_BASE)+Var.VALUE(&__DDRSS_Data_Slice_2_REGISTER_BLOCK__OFFS))+Var.VALUE(&__DDRSS_PHY_617__SFR_OFFS)))) %Long Var.VALUE(&__DDRSS0_PHY_617_DATA)
	Data.Set D:((((Var.VALUE(&__J7_DDR0_SS_BASE)+Var.VALUE(&__DDRSS_Data_Slice_2_REGISTER_BLOCK__OFFS))+Var.VALUE(&__DDRSS_PHY_618__SFR_OFFS)))) %Long Var.VALUE(&__DDRSS0_PHY_618_DATA)
	Data.Set D:((((Var.VALUE(&__J7_DDR0_SS_BASE)+Var.VALUE(&__DDRSS_Data_Slice_2_REGISTER_BLOCK__OFFS))+Var.VALUE(&__DDRSS_PHY_619__SFR_OFFS)))) %Long Var.VALUE(&__DDRSS0_PHY_619_DATA)
	Data.Set D:((((Var.VALUE(&__J7_DDR0_SS_BASE)+Var.VALUE(&__DDRSS_Data_Slice_2_REGISTER_BLOCK__OFFS))+Var.VALUE(&__DDRSS_PHY_620__SFR_OFFS)))) %Long Var.VALUE(&__DDRSS0_PHY_620_DATA)
	Data.Set D:((((Var.VALUE(&__J7_DDR0_SS_BASE)+Var.VALUE(&__DDRSS_Data_Slice_2_REGISTER_BLOCK__OFFS))+Var.VALUE(&__DDRSS_PHY_621__SFR_OFFS)))) %Long Var.VALUE(&__DDRSS0_PHY_621_DATA)
	Data.Set D:((((Var.VALUE(&__J7_DDR0_SS_BASE)+Var.VALUE(&__DDRSS_Data_Slice_2_REGISTER_BLOCK__OFFS))+Var.VALUE(&__DDRSS_PHY_622__SFR_OFFS)))) %Long Var.VALUE(&__DDRSS0_PHY_622_DATA)
	Data.Set D:((((Var.VALUE(&__J7_DDR0_SS_BASE)+Var.VALUE(&__DDRSS_Data_Slice_2_REGISTER_BLOCK__OFFS))+Var.VALUE(&__DDRSS_PHY_623__SFR_OFFS)))) %Long Var.VALUE(&__DDRSS0_PHY_623_DATA)
	Data.Set D:((((Var.VALUE(&__J7_DDR0_SS_BASE)+Var.VALUE(&__DDRSS_Data_Slice_2_REGISTER_BLOCK__OFFS))+Var.VALUE(&__DDRSS_PHY_624__SFR_OFFS)))) %Long Var.VALUE(&__DDRSS0_PHY_624_DATA)
	Data.Set D:((((Var.VALUE(&__J7_DDR0_SS_BASE)+Var.VALUE(&__DDRSS_Data_Slice_2_REGISTER_BLOCK__OFFS))+Var.VALUE(&__DDRSS_PHY_625__SFR_OFFS)))) %Long Var.VALUE(&__DDRSS0_PHY_625_DATA)
	Data.Set D:((((Var.VALUE(&__J7_DDR0_SS_BASE)+Var.VALUE(&__DDRSS_Data_Slice_2_REGISTER_BLOCK__OFFS))+Var.VALUE(&__DDRSS_PHY_626__SFR_OFFS)))) %Long Var.VALUE(&__DDRSS0_PHY_626_DATA)
	Data.Set D:((((Var.VALUE(&__J7_DDR0_SS_BASE)+Var.VALUE(&__DDRSS_Data_Slice_2_REGISTER_BLOCK__OFFS))+Var.VALUE(&__DDRSS_PHY_627__SFR_OFFS)))) %Long Var.VALUE(&__DDRSS0_PHY_627_DATA)
	Data.Set D:((((Var.VALUE(&__J7_DDR0_SS_BASE)+Var.VALUE(&__DDRSS_Data_Slice_2_REGISTER_BLOCK__OFFS))+Var.VALUE(&__DDRSS_PHY_628__SFR_OFFS)))) %Long Var.VALUE(&__DDRSS0_PHY_628_DATA)
	Data.Set D:((((Var.VALUE(&__J7_DDR0_SS_BASE)+Var.VALUE(&__DDRSS_Data_Slice_2_REGISTER_BLOCK__OFFS))+Var.VALUE(&__DDRSS_PHY_629__SFR_OFFS)))) %Long Var.VALUE(&__DDRSS0_PHY_629_DATA)
	Data.Set D:((((Var.VALUE(&__J7_DDR0_SS_BASE)+Var.VALUE(&__DDRSS_Data_Slice_2_REGISTER_BLOCK__OFFS))+Var.VALUE(&__DDRSS_PHY_630__SFR_OFFS)))) %Long Var.VALUE(&__DDRSS0_PHY_630_DATA)
	Data.Set D:((((Var.VALUE(&__J7_DDR0_SS_BASE)+Var.VALUE(&__DDRSS_Data_Slice_2_REGISTER_BLOCK__OFFS))+Var.VALUE(&__DDRSS_PHY_631__SFR_OFFS)))) %Long Var.VALUE(&__DDRSS0_PHY_631_DATA)
	Data.Set D:((((Var.VALUE(&__J7_DDR0_SS_BASE)+Var.VALUE(&__DDRSS_Data_Slice_2_REGISTER_BLOCK__OFFS))+Var.VALUE(&__DDRSS_PHY_632__SFR_OFFS)))) %Long Var.VALUE(&__DDRSS0_PHY_632_DATA)
	Data.Set D:((((Var.VALUE(&__J7_DDR0_SS_BASE)+Var.VALUE(&__DDRSS_Data_Slice_2_REGISTER_BLOCK__OFFS))+Var.VALUE(&__DDRSS_PHY_633__SFR_OFFS)))) %Long Var.VALUE(&__DDRSS0_PHY_633_DATA)
	Data.Set D:((((Var.VALUE(&__J7_DDR0_SS_BASE)+Var.VALUE(&__DDRSS_Data_Slice_2_REGISTER_BLOCK__OFFS))+Var.VALUE(&__DDRSS_PHY_634__SFR_OFFS)))) %Long Var.VALUE(&__DDRSS0_PHY_634_DATA)
	Data.Set D:((((Var.VALUE(&__J7_DDR0_SS_BASE)+Var.VALUE(&__DDRSS_Data_Slice_2_REGISTER_BLOCK__OFFS))+Var.VALUE(&__DDRSS_PHY_635__SFR_OFFS)))) %Long Var.VALUE(&__DDRSS0_PHY_635_DATA)
	Data.Set D:((((Var.VALUE(&__J7_DDR0_SS_BASE)+Var.VALUE(&__DDRSS_Data_Slice_2_REGISTER_BLOCK__OFFS))+Var.VALUE(&__DDRSS_PHY_636__SFR_OFFS)))) %Long Var.VALUE(&__DDRSS0_PHY_636_DATA)
	Data.Set D:((((Var.VALUE(&__J7_DDR0_SS_BASE)+Var.VALUE(&__DDRSS_Data_Slice_2_REGISTER_BLOCK__OFFS))+Var.VALUE(&__DDRSS_PHY_637__SFR_OFFS)))) %Long Var.VALUE(&__DDRSS0_PHY_637_DATA)
	Data.Set D:((((Var.VALUE(&__J7_DDR0_SS_BASE)+Var.VALUE(&__DDRSS_Data_Slice_2_REGISTER_BLOCK__OFFS))+Var.VALUE(&__DDRSS_PHY_638__SFR_OFFS)))) %Long Var.VALUE(&__DDRSS0_PHY_638_DATA)
	Data.Set D:((((Var.VALUE(&__J7_DDR0_SS_BASE)+Var.VALUE(&__DDRSS_Data_Slice_2_REGISTER_BLOCK__OFFS))+Var.VALUE(&__DDRSS_PHY_639__SFR_OFFS)))) %Long Var.VALUE(&__DDRSS0_PHY_639_DATA)
	Data.Set D:((((Var.VALUE(&__J7_DDR0_SS_BASE)+Var.VALUE(&__DDRSS_Data_Slice_2_REGISTER_BLOCK__OFFS))+Var.VALUE(&__DDRSS_PHY_640__SFR_OFFS)))) %Long Var.VALUE(&__DDRSS0_PHY_640_DATA)
	Data.Set D:((((Var.VALUE(&__J7_DDR0_SS_BASE)+Var.VALUE(&__DDRSS_Data_Slice_2_REGISTER_BLOCK__OFFS))+Var.VALUE(&__DDRSS_PHY_641__SFR_OFFS)))) %Long Var.VALUE(&__DDRSS0_PHY_641_DATA)
	Data.Set D:((((Var.VALUE(&__J7_DDR0_SS_BASE)+Var.VALUE(&__DDRSS_Data_Slice_2_REGISTER_BLOCK__OFFS))+Var.VALUE(&__DDRSS_PHY_642__SFR_OFFS)))) %Long Var.VALUE(&__DDRSS0_PHY_642_DATA)
	Data.Set D:((((Var.VALUE(&__J7_DDR0_SS_BASE)+Var.VALUE(&__DDRSS_Data_Slice_2_REGISTER_BLOCK__OFFS))+Var.VALUE(&__DDRSS_PHY_643__SFR_OFFS)))) %Long Var.VALUE(&__DDRSS0_PHY_643_DATA)
	Data.Set D:((((Var.VALUE(&__J7_DDR0_SS_BASE)+Var.VALUE(&__DDRSS_Data_Slice_2_REGISTER_BLOCK__OFFS))+Var.VALUE(&__DDRSS_PHY_644__SFR_OFFS)))) %Long Var.VALUE(&__DDRSS0_PHY_644_DATA)
	Data.Set D:((((Var.VALUE(&__J7_DDR0_SS_BASE)+Var.VALUE(&__DDRSS_Data_Slice_2_REGISTER_BLOCK__OFFS))+Var.VALUE(&__DDRSS_PHY_645__SFR_OFFS)))) %Long Var.VALUE(&__DDRSS0_PHY_645_DATA)
	Data.Set D:((((Var.VALUE(&__J7_DDR0_SS_BASE)+Var.VALUE(&__DDRSS_Data_Slice_2_REGISTER_BLOCK__OFFS))+Var.VALUE(&__DDRSS_PHY_646__SFR_OFFS)))) %Long Var.VALUE(&__DDRSS0_PHY_646_DATA)
	Data.Set D:((((Var.VALUE(&__J7_DDR0_SS_BASE)+Var.VALUE(&__DDRSS_Data_Slice_2_REGISTER_BLOCK__OFFS))+Var.VALUE(&__DDRSS_PHY_647__SFR_OFFS)))) %Long Var.VALUE(&__DDRSS0_PHY_647_DATA)
	Data.Set D:((((Var.VALUE(&__J7_DDR0_SS_BASE)+Var.VALUE(&__DDRSS_Data_Slice_2_REGISTER_BLOCK__OFFS))+Var.VALUE(&__DDRSS_PHY_648__SFR_OFFS)))) %Long Var.VALUE(&__DDRSS0_PHY_648_DATA)
	Data.Set D:((((Var.VALUE(&__J7_DDR0_SS_BASE)+Var.VALUE(&__DDRSS_Data_Slice_2_REGISTER_BLOCK__OFFS))+Var.VALUE(&__DDRSS_PHY_649__SFR_OFFS)))) %Long Var.VALUE(&__DDRSS0_PHY_649_DATA)
	Data.Set D:((((Var.VALUE(&__J7_DDR0_SS_BASE)+Var.VALUE(&__DDRSS_Data_Slice_2_REGISTER_BLOCK__OFFS))+Var.VALUE(&__DDRSS_PHY_650__SFR_OFFS)))) %Long Var.VALUE(&__DDRSS0_PHY_650_DATA)
	Data.Set D:((((Var.VALUE(&__J7_DDR0_SS_BASE)+Var.VALUE(&__DDRSS_Data_Slice_2_REGISTER_BLOCK__OFFS))+Var.VALUE(&__DDRSS_PHY_651__SFR_OFFS)))) %Long Var.VALUE(&__DDRSS0_PHY_651_DATA)
	Var.NEWLOCAL char[128] \strtmp = "--->>> DDR0 PHY Data Slice 2 programming completed... <<<---\n"
	GOSUB printf Var.String(\strtmp)
	
	Var.NEWLOCAL char[128] \strtmp = "--->>> DDR0 PHY Data Slice 3 programming in progress.. <<<---\n"
	GOSUB printf Var.String(\strtmp)
	
	Data.Set D:((((Var.VALUE(&__J7_DDR0_SS_BASE)+Var.VALUE(&__DDRSS_Data_Slice_3_REGISTER_BLOCK__OFFS))+Var.VALUE(&__DDRSS_PHY_768__SFR_OFFS)))) %Long Var.VALUE(&__DDRSS0_PHY_768_DATA)
	Data.Set D:((((Var.VALUE(&__J7_DDR0_SS_BASE)+Var.VALUE(&__DDRSS_Data_Slice_3_REGISTER_BLOCK__OFFS))+Var.VALUE(&__DDRSS_PHY_769__SFR_OFFS)))) %Long Var.VALUE(&__DDRSS0_PHY_769_DATA)
	Data.Set D:((((Var.VALUE(&__J7_DDR0_SS_BASE)+Var.VALUE(&__DDRSS_Data_Slice_3_REGISTER_BLOCK__OFFS))+Var.VALUE(&__DDRSS_PHY_770__SFR_OFFS)))) %Long Var.VALUE(&__DDRSS0_PHY_770_DATA)
	Data.Set D:((((Var.VALUE(&__J7_DDR0_SS_BASE)+Var.VALUE(&__DDRSS_Data_Slice_3_REGISTER_BLOCK__OFFS))+Var.VALUE(&__DDRSS_PHY_771__SFR_OFFS)))) %Long Var.VALUE(&__DDRSS0_PHY_771_DATA)
	Data.Set D:((((Var.VALUE(&__J7_DDR0_SS_BASE)+Var.VALUE(&__DDRSS_Data_Slice_3_REGISTER_BLOCK__OFFS))+Var.VALUE(&__DDRSS_PHY_772__SFR_OFFS)))) %Long Var.VALUE(&__DDRSS0_PHY_772_DATA)
	Data.Set D:((((Var.VALUE(&__J7_DDR0_SS_BASE)+Var.VALUE(&__DDRSS_Data_Slice_3_REGISTER_BLOCK__OFFS))+Var.VALUE(&__DDRSS_PHY_773__SFR_OFFS)))) %Long Var.VALUE(&__DDRSS0_PHY_773_DATA)
	Data.Set D:((((Var.VALUE(&__J7_DDR0_SS_BASE)+Var.VALUE(&__DDRSS_Data_Slice_3_REGISTER_BLOCK__OFFS))+Var.VALUE(&__DDRSS_PHY_774__SFR_OFFS)))) %Long Var.VALUE(&__DDRSS0_PHY_774_DATA)
	Data.Set D:((((Var.VALUE(&__J7_DDR0_SS_BASE)+Var.VALUE(&__DDRSS_Data_Slice_3_REGISTER_BLOCK__OFFS))+Var.VALUE(&__DDRSS_PHY_775__SFR_OFFS)))) %Long Var.VALUE(&__DDRSS0_PHY_775_DATA)
	Data.Set D:((((Var.VALUE(&__J7_DDR0_SS_BASE)+Var.VALUE(&__DDRSS_Data_Slice_3_REGISTER_BLOCK__OFFS))+Var.VALUE(&__DDRSS_PHY_776__SFR_OFFS)))) %Long Var.VALUE(&__DDRSS0_PHY_776_DATA)
	Data.Set D:((((Var.VALUE(&__J7_DDR0_SS_BASE)+Var.VALUE(&__DDRSS_Data_Slice_3_REGISTER_BLOCK__OFFS))+Var.VALUE(&__DDRSS_PHY_777__SFR_OFFS)))) %Long Var.VALUE(&__DDRSS0_PHY_777_DATA)
	Data.Set D:((((Var.VALUE(&__J7_DDR0_SS_BASE)+Var.VALUE(&__DDRSS_Data_Slice_3_REGISTER_BLOCK__OFFS))+Var.VALUE(&__DDRSS_PHY_778__SFR_OFFS)))) %Long Var.VALUE(&__DDRSS0_PHY_778_DATA)
	Data.Set D:((((Var.VALUE(&__J7_DDR0_SS_BASE)+Var.VALUE(&__DDRSS_Data_Slice_3_REGISTER_BLOCK__OFFS))+Var.VALUE(&__DDRSS_PHY_779__SFR_OFFS)))) %Long Var.VALUE(&__DDRSS0_PHY_779_DATA)
	Data.Set D:((((Var.VALUE(&__J7_DDR0_SS_BASE)+Var.VALUE(&__DDRSS_Data_Slice_3_REGISTER_BLOCK__OFFS))+Var.VALUE(&__DDRSS_PHY_780__SFR_OFFS)))) %Long Var.VALUE(&__DDRSS0_PHY_780_DATA)
	Data.Set D:((((Var.VALUE(&__J7_DDR0_SS_BASE)+Var.VALUE(&__DDRSS_Data_Slice_3_REGISTER_BLOCK__OFFS))+Var.VALUE(&__DDRSS_PHY_781__SFR_OFFS)))) %Long Var.VALUE(&__DDRSS0_PHY_781_DATA)
	Data.Set D:((((Var.VALUE(&__J7_DDR0_SS_BASE)+Var.VALUE(&__DDRSS_Data_Slice_3_REGISTER_BLOCK__OFFS))+Var.VALUE(&__DDRSS_PHY_782__SFR_OFFS)))) %Long Var.VALUE(&__DDRSS0_PHY_782_DATA)
	Data.Set D:((((Var.VALUE(&__J7_DDR0_SS_BASE)+Var.VALUE(&__DDRSS_Data_Slice_3_REGISTER_BLOCK__OFFS))+Var.VALUE(&__DDRSS_PHY_783__SFR_OFFS)))) %Long Var.VALUE(&__DDRSS0_PHY_783_DATA)
	Data.Set D:((((Var.VALUE(&__J7_DDR0_SS_BASE)+Var.VALUE(&__DDRSS_Data_Slice_3_REGISTER_BLOCK__OFFS))+Var.VALUE(&__DDRSS_PHY_784__SFR_OFFS)))) %Long Var.VALUE(&__DDRSS0_PHY_784_DATA)
	Data.Set D:((((Var.VALUE(&__J7_DDR0_SS_BASE)+Var.VALUE(&__DDRSS_Data_Slice_3_REGISTER_BLOCK__OFFS))+Var.VALUE(&__DDRSS_PHY_785__SFR_OFFS)))) %Long Var.VALUE(&__DDRSS0_PHY_785_DATA)
	Data.Set D:((((Var.VALUE(&__J7_DDR0_SS_BASE)+Var.VALUE(&__DDRSS_Data_Slice_3_REGISTER_BLOCK__OFFS))+Var.VALUE(&__DDRSS_PHY_786__SFR_OFFS)))) %Long Var.VALUE(&__DDRSS0_PHY_786_DATA)
	Data.Set D:((((Var.VALUE(&__J7_DDR0_SS_BASE)+Var.VALUE(&__DDRSS_Data_Slice_3_REGISTER_BLOCK__OFFS))+Var.VALUE(&__DDRSS_PHY_787__SFR_OFFS)))) %Long Var.VALUE(&__DDRSS0_PHY_787_DATA)
	Data.Set D:((((Var.VALUE(&__J7_DDR0_SS_BASE)+Var.VALUE(&__DDRSS_Data_Slice_3_REGISTER_BLOCK__OFFS))+Var.VALUE(&__DDRSS_PHY_788__SFR_OFFS)))) %Long Var.VALUE(&__DDRSS0_PHY_788_DATA)
	Data.Set D:((((Var.VALUE(&__J7_DDR0_SS_BASE)+Var.VALUE(&__DDRSS_Data_Slice_3_REGISTER_BLOCK__OFFS))+Var.VALUE(&__DDRSS_PHY_789__SFR_OFFS)))) %Long Var.VALUE(&__DDRSS0_PHY_789_DATA)
	Data.Set D:((((Var.VALUE(&__J7_DDR0_SS_BASE)+Var.VALUE(&__DDRSS_Data_Slice_3_REGISTER_BLOCK__OFFS))+Var.VALUE(&__DDRSS_PHY_790__SFR_OFFS)))) %Long Var.VALUE(&__DDRSS0_PHY_790_DATA)
	Data.Set D:((((Var.VALUE(&__J7_DDR0_SS_BASE)+Var.VALUE(&__DDRSS_Data_Slice_3_REGISTER_BLOCK__OFFS))+Var.VALUE(&__DDRSS_PHY_791__SFR_OFFS)))) %Long Var.VALUE(&__DDRSS0_PHY_791_DATA)
	Data.Set D:((((Var.VALUE(&__J7_DDR0_SS_BASE)+Var.VALUE(&__DDRSS_Data_Slice_3_REGISTER_BLOCK__OFFS))+Var.VALUE(&__DDRSS_PHY_792__SFR_OFFS)))) %Long Var.VALUE(&__DDRSS0_PHY_792_DATA)
	Data.Set D:((((Var.VALUE(&__J7_DDR0_SS_BASE)+Var.VALUE(&__DDRSS_Data_Slice_3_REGISTER_BLOCK__OFFS))+Var.VALUE(&__DDRSS_PHY_793__SFR_OFFS)))) %Long Var.VALUE(&__DDRSS0_PHY_793_DATA)
	Data.Set D:((((Var.VALUE(&__J7_DDR0_SS_BASE)+Var.VALUE(&__DDRSS_Data_Slice_3_REGISTER_BLOCK__OFFS))+Var.VALUE(&__DDRSS_PHY_794__SFR_OFFS)))) %Long Var.VALUE(&__DDRSS0_PHY_794_DATA)
	Data.Set D:((((Var.VALUE(&__J7_DDR0_SS_BASE)+Var.VALUE(&__DDRSS_Data_Slice_3_REGISTER_BLOCK__OFFS))+Var.VALUE(&__DDRSS_PHY_795__SFR_OFFS)))) %Long Var.VALUE(&__DDRSS0_PHY_795_DATA)
	Data.Set D:((((Var.VALUE(&__J7_DDR0_SS_BASE)+Var.VALUE(&__DDRSS_Data_Slice_3_REGISTER_BLOCK__OFFS))+Var.VALUE(&__DDRSS_PHY_796__SFR_OFFS)))) %Long Var.VALUE(&__DDRSS0_PHY_796_DATA)
	Data.Set D:((((Var.VALUE(&__J7_DDR0_SS_BASE)+Var.VALUE(&__DDRSS_Data_Slice_3_REGISTER_BLOCK__OFFS))+Var.VALUE(&__DDRSS_PHY_797__SFR_OFFS)))) %Long Var.VALUE(&__DDRSS0_PHY_797_DATA)
	Data.Set D:((((Var.VALUE(&__J7_DDR0_SS_BASE)+Var.VALUE(&__DDRSS_Data_Slice_3_REGISTER_BLOCK__OFFS))+Var.VALUE(&__DDRSS_PHY_798__SFR_OFFS)))) %Long Var.VALUE(&__DDRSS0_PHY_798_DATA)
	Data.Set D:((((Var.VALUE(&__J7_DDR0_SS_BASE)+Var.VALUE(&__DDRSS_Data_Slice_3_REGISTER_BLOCK__OFFS))+Var.VALUE(&__DDRSS_PHY_799__SFR_OFFS)))) %Long Var.VALUE(&__DDRSS0_PHY_799_DATA)
	Data.Set D:((((Var.VALUE(&__J7_DDR0_SS_BASE)+Var.VALUE(&__DDRSS_Data_Slice_3_REGISTER_BLOCK__OFFS))+Var.VALUE(&__DDRSS_PHY_800__SFR_OFFS)))) %Long Var.VALUE(&__DDRSS0_PHY_800_DATA)
	Data.Set D:((((Var.VALUE(&__J7_DDR0_SS_BASE)+Var.VALUE(&__DDRSS_Data_Slice_3_REGISTER_BLOCK__OFFS))+Var.VALUE(&__DDRSS_PHY_801__SFR_OFFS)))) %Long Var.VALUE(&__DDRSS0_PHY_801_DATA)
	Data.Set D:((((Var.VALUE(&__J7_DDR0_SS_BASE)+Var.VALUE(&__DDRSS_Data_Slice_3_REGISTER_BLOCK__OFFS))+Var.VALUE(&__DDRSS_PHY_802__SFR_OFFS)))) %Long Var.VALUE(&__DDRSS0_PHY_802_DATA)
	Data.Set D:((((Var.VALUE(&__J7_DDR0_SS_BASE)+Var.VALUE(&__DDRSS_Data_Slice_3_REGISTER_BLOCK__OFFS))+Var.VALUE(&__DDRSS_PHY_803__SFR_OFFS)))) %Long Var.VALUE(&__DDRSS0_PHY_803_DATA)
	Data.Set D:((((Var.VALUE(&__J7_DDR0_SS_BASE)+Var.VALUE(&__DDRSS_Data_Slice_3_REGISTER_BLOCK__OFFS))+Var.VALUE(&__DDRSS_PHY_804__SFR_OFFS)))) %Long Var.VALUE(&__DDRSS0_PHY_804_DATA)
	Data.Set D:((((Var.VALUE(&__J7_DDR0_SS_BASE)+Var.VALUE(&__DDRSS_Data_Slice_3_REGISTER_BLOCK__OFFS))+Var.VALUE(&__DDRSS_PHY_805__SFR_OFFS)))) %Long Var.VALUE(&__DDRSS0_PHY_805_DATA)
	Data.Set D:((((Var.VALUE(&__J7_DDR0_SS_BASE)+Var.VALUE(&__DDRSS_Data_Slice_3_REGISTER_BLOCK__OFFS))+Var.VALUE(&__DDRSS_PHY_806__SFR_OFFS)))) %Long Var.VALUE(&__DDRSS0_PHY_806_DATA)
	Data.Set D:((((Var.VALUE(&__J7_DDR0_SS_BASE)+Var.VALUE(&__DDRSS_Data_Slice_3_REGISTER_BLOCK__OFFS))+Var.VALUE(&__DDRSS_PHY_807__SFR_OFFS)))) %Long Var.VALUE(&__DDRSS0_PHY_807_DATA)
	Data.Set D:((((Var.VALUE(&__J7_DDR0_SS_BASE)+Var.VALUE(&__DDRSS_Data_Slice_3_REGISTER_BLOCK__OFFS))+Var.VALUE(&__DDRSS_PHY_808__SFR_OFFS)))) %Long Var.VALUE(&__DDRSS0_PHY_808_DATA)
	Data.Set D:((((Var.VALUE(&__J7_DDR0_SS_BASE)+Var.VALUE(&__DDRSS_Data_Slice_3_REGISTER_BLOCK__OFFS))+Var.VALUE(&__DDRSS_PHY_809__SFR_OFFS)))) %Long Var.VALUE(&__DDRSS0_PHY_809_DATA)
	Data.Set D:((((Var.VALUE(&__J7_DDR0_SS_BASE)+Var.VALUE(&__DDRSS_Data_Slice_3_REGISTER_BLOCK__OFFS))+Var.VALUE(&__DDRSS_PHY_810__SFR_OFFS)))) %Long Var.VALUE(&__DDRSS0_PHY_810_DATA)
	Data.Set D:((((Var.VALUE(&__J7_DDR0_SS_BASE)+Var.VALUE(&__DDRSS_Data_Slice_3_REGISTER_BLOCK__OFFS))+Var.VALUE(&__DDRSS_PHY_811__SFR_OFFS)))) %Long Var.VALUE(&__DDRSS0_PHY_811_DATA)
	Data.Set D:((((Var.VALUE(&__J7_DDR0_SS_BASE)+Var.VALUE(&__DDRSS_Data_Slice_3_REGISTER_BLOCK__OFFS))+Var.VALUE(&__DDRSS_PHY_812__SFR_OFFS)))) %Long Var.VALUE(&__DDRSS0_PHY_812_DATA)
	Data.Set D:((((Var.VALUE(&__J7_DDR0_SS_BASE)+Var.VALUE(&__DDRSS_Data_Slice_3_REGISTER_BLOCK__OFFS))+Var.VALUE(&__DDRSS_PHY_813__SFR_OFFS)))) %Long Var.VALUE(&__DDRSS0_PHY_813_DATA)
	Data.Set D:((((Var.VALUE(&__J7_DDR0_SS_BASE)+Var.VALUE(&__DDRSS_Data_Slice_3_REGISTER_BLOCK__OFFS))+Var.VALUE(&__DDRSS_PHY_814__SFR_OFFS)))) %Long Var.VALUE(&__DDRSS0_PHY_814_DATA)
	Data.Set D:((((Var.VALUE(&__J7_DDR0_SS_BASE)+Var.VALUE(&__DDRSS_Data_Slice_3_REGISTER_BLOCK__OFFS))+Var.VALUE(&__DDRSS_PHY_815__SFR_OFFS)))) %Long Var.VALUE(&__DDRSS0_PHY_815_DATA)
	Data.Set D:((((Var.VALUE(&__J7_DDR0_SS_BASE)+Var.VALUE(&__DDRSS_Data_Slice_3_REGISTER_BLOCK__OFFS))+Var.VALUE(&__DDRSS_PHY_816__SFR_OFFS)))) %Long Var.VALUE(&__DDRSS0_PHY_816_DATA)
	Data.Set D:((((Var.VALUE(&__J7_DDR0_SS_BASE)+Var.VALUE(&__DDRSS_Data_Slice_3_REGISTER_BLOCK__OFFS))+Var.VALUE(&__DDRSS_PHY_817__SFR_OFFS)))) %Long Var.VALUE(&__DDRSS0_PHY_817_DATA)
	Data.Set D:((((Var.VALUE(&__J7_DDR0_SS_BASE)+Var.VALUE(&__DDRSS_Data_Slice_3_REGISTER_BLOCK__OFFS))+Var.VALUE(&__DDRSS_PHY_818__SFR_OFFS)))) %Long Var.VALUE(&__DDRSS0_PHY_818_DATA)
	Data.Set D:((((Var.VALUE(&__J7_DDR0_SS_BASE)+Var.VALUE(&__DDRSS_Data_Slice_3_REGISTER_BLOCK__OFFS))+Var.VALUE(&__DDRSS_PHY_819__SFR_OFFS)))) %Long Var.VALUE(&__DDRSS0_PHY_819_DATA)
	Data.Set D:((((Var.VALUE(&__J7_DDR0_SS_BASE)+Var.VALUE(&__DDRSS_Data_Slice_3_REGISTER_BLOCK__OFFS))+Var.VALUE(&__DDRSS_PHY_820__SFR_OFFS)))) %Long Var.VALUE(&__DDRSS0_PHY_820_DATA)
	Data.Set D:((((Var.VALUE(&__J7_DDR0_SS_BASE)+Var.VALUE(&__DDRSS_Data_Slice_3_REGISTER_BLOCK__OFFS))+Var.VALUE(&__DDRSS_PHY_821__SFR_OFFS)))) %Long Var.VALUE(&__DDRSS0_PHY_821_DATA)
	Data.Set D:((((Var.VALUE(&__J7_DDR0_SS_BASE)+Var.VALUE(&__DDRSS_Data_Slice_3_REGISTER_BLOCK__OFFS))+Var.VALUE(&__DDRSS_PHY_822__SFR_OFFS)))) %Long Var.VALUE(&__DDRSS0_PHY_822_DATA)
	Data.Set D:((((Var.VALUE(&__J7_DDR0_SS_BASE)+Var.VALUE(&__DDRSS_Data_Slice_3_REGISTER_BLOCK__OFFS))+Var.VALUE(&__DDRSS_PHY_823__SFR_OFFS)))) %Long Var.VALUE(&__DDRSS0_PHY_823_DATA)
	Data.Set D:((((Var.VALUE(&__J7_DDR0_SS_BASE)+Var.VALUE(&__DDRSS_Data_Slice_3_REGISTER_BLOCK__OFFS))+Var.VALUE(&__DDRSS_PHY_824__SFR_OFFS)))) %Long Var.VALUE(&__DDRSS0_PHY_824_DATA)
	Data.Set D:((((Var.VALUE(&__J7_DDR0_SS_BASE)+Var.VALUE(&__DDRSS_Data_Slice_3_REGISTER_BLOCK__OFFS))+Var.VALUE(&__DDRSS_PHY_825__SFR_OFFS)))) %Long Var.VALUE(&__DDRSS0_PHY_825_DATA)
	Data.Set D:((((Var.VALUE(&__J7_DDR0_SS_BASE)+Var.VALUE(&__DDRSS_Data_Slice_3_REGISTER_BLOCK__OFFS))+Var.VALUE(&__DDRSS_PHY_826__SFR_OFFS)))) %Long Var.VALUE(&__DDRSS0_PHY_826_DATA)
	Data.Set D:((((Var.VALUE(&__J7_DDR0_SS_BASE)+Var.VALUE(&__DDRSS_Data_Slice_3_REGISTER_BLOCK__OFFS))+Var.VALUE(&__DDRSS_PHY_827__SFR_OFFS)))) %Long Var.VALUE(&__DDRSS0_PHY_827_DATA)
	Data.Set D:((((Var.VALUE(&__J7_DDR0_SS_BASE)+Var.VALUE(&__DDRSS_Data_Slice_3_REGISTER_BLOCK__OFFS))+Var.VALUE(&__DDRSS_PHY_828__SFR_OFFS)))) %Long Var.VALUE(&__DDRSS0_PHY_828_DATA)
	Data.Set D:((((Var.VALUE(&__J7_DDR0_SS_BASE)+Var.VALUE(&__DDRSS_Data_Slice_3_REGISTER_BLOCK__OFFS))+Var.VALUE(&__DDRSS_PHY_829__SFR_OFFS)))) %Long Var.VALUE(&__DDRSS0_PHY_829_DATA)
	Data.Set D:((((Var.VALUE(&__J7_DDR0_SS_BASE)+Var.VALUE(&__DDRSS_Data_Slice_3_REGISTER_BLOCK__OFFS))+Var.VALUE(&__DDRSS_PHY_830__SFR_OFFS)))) %Long Var.VALUE(&__DDRSS0_PHY_830_DATA)
	Data.Set D:((((Var.VALUE(&__J7_DDR0_SS_BASE)+Var.VALUE(&__DDRSS_Data_Slice_3_REGISTER_BLOCK__OFFS))+Var.VALUE(&__DDRSS_PHY_831__SFR_OFFS)))) %Long Var.VALUE(&__DDRSS0_PHY_831_DATA)
	Data.Set D:((((Var.VALUE(&__J7_DDR0_SS_BASE)+Var.VALUE(&__DDRSS_Data_Slice_3_REGISTER_BLOCK__OFFS))+Var.VALUE(&__DDRSS_PHY_832__SFR_OFFS)))) %Long Var.VALUE(&__DDRSS0_PHY_832_DATA)
	Data.Set D:((((Var.VALUE(&__J7_DDR0_SS_BASE)+Var.VALUE(&__DDRSS_Data_Slice_3_REGISTER_BLOCK__OFFS))+Var.VALUE(&__DDRSS_PHY_833__SFR_OFFS)))) %Long Var.VALUE(&__DDRSS0_PHY_833_DATA)
	Data.Set D:((((Var.VALUE(&__J7_DDR0_SS_BASE)+Var.VALUE(&__DDRSS_Data_Slice_3_REGISTER_BLOCK__OFFS))+Var.VALUE(&__DDRSS_PHY_834__SFR_OFFS)))) %Long Var.VALUE(&__DDRSS0_PHY_834_DATA)
	Data.Set D:((((Var.VALUE(&__J7_DDR0_SS_BASE)+Var.VALUE(&__DDRSS_Data_Slice_3_REGISTER_BLOCK__OFFS))+Var.VALUE(&__DDRSS_PHY_835__SFR_OFFS)))) %Long Var.VALUE(&__DDRSS0_PHY_835_DATA)
	Data.Set D:((((Var.VALUE(&__J7_DDR0_SS_BASE)+Var.VALUE(&__DDRSS_Data_Slice_3_REGISTER_BLOCK__OFFS))+Var.VALUE(&__DDRSS_PHY_836__SFR_OFFS)))) %Long Var.VALUE(&__DDRSS0_PHY_836_DATA)
	Data.Set D:((((Var.VALUE(&__J7_DDR0_SS_BASE)+Var.VALUE(&__DDRSS_Data_Slice_3_REGISTER_BLOCK__OFFS))+Var.VALUE(&__DDRSS_PHY_837__SFR_OFFS)))) %Long Var.VALUE(&__DDRSS0_PHY_837_DATA)
	Data.Set D:((((Var.VALUE(&__J7_DDR0_SS_BASE)+Var.VALUE(&__DDRSS_Data_Slice_3_REGISTER_BLOCK__OFFS))+Var.VALUE(&__DDRSS_PHY_838__SFR_OFFS)))) %Long Var.VALUE(&__DDRSS0_PHY_838_DATA)
	Data.Set D:((((Var.VALUE(&__J7_DDR0_SS_BASE)+Var.VALUE(&__DDRSS_Data_Slice_3_REGISTER_BLOCK__OFFS))+Var.VALUE(&__DDRSS_PHY_839__SFR_OFFS)))) %Long Var.VALUE(&__DDRSS0_PHY_839_DATA)
	Data.Set D:((((Var.VALUE(&__J7_DDR0_SS_BASE)+Var.VALUE(&__DDRSS_Data_Slice_3_REGISTER_BLOCK__OFFS))+Var.VALUE(&__DDRSS_PHY_840__SFR_OFFS)))) %Long Var.VALUE(&__DDRSS0_PHY_840_DATA)
	Data.Set D:((((Var.VALUE(&__J7_DDR0_SS_BASE)+Var.VALUE(&__DDRSS_Data_Slice_3_REGISTER_BLOCK__OFFS))+Var.VALUE(&__DDRSS_PHY_841__SFR_OFFS)))) %Long Var.VALUE(&__DDRSS0_PHY_841_DATA)
	Data.Set D:((((Var.VALUE(&__J7_DDR0_SS_BASE)+Var.VALUE(&__DDRSS_Data_Slice_3_REGISTER_BLOCK__OFFS))+Var.VALUE(&__DDRSS_PHY_842__SFR_OFFS)))) %Long Var.VALUE(&__DDRSS0_PHY_842_DATA)
	Data.Set D:((((Var.VALUE(&__J7_DDR0_SS_BASE)+Var.VALUE(&__DDRSS_Data_Slice_3_REGISTER_BLOCK__OFFS))+Var.VALUE(&__DDRSS_PHY_843__SFR_OFFS)))) %Long Var.VALUE(&__DDRSS0_PHY_843_DATA)
	Data.Set D:((((Var.VALUE(&__J7_DDR0_SS_BASE)+Var.VALUE(&__DDRSS_Data_Slice_3_REGISTER_BLOCK__OFFS))+Var.VALUE(&__DDRSS_PHY_844__SFR_OFFS)))) %Long Var.VALUE(&__DDRSS0_PHY_844_DATA)
	Data.Set D:((((Var.VALUE(&__J7_DDR0_SS_BASE)+Var.VALUE(&__DDRSS_Data_Slice_3_REGISTER_BLOCK__OFFS))+Var.VALUE(&__DDRSS_PHY_845__SFR_OFFS)))) %Long Var.VALUE(&__DDRSS0_PHY_845_DATA)
	Data.Set D:((((Var.VALUE(&__J7_DDR0_SS_BASE)+Var.VALUE(&__DDRSS_Data_Slice_3_REGISTER_BLOCK__OFFS))+Var.VALUE(&__DDRSS_PHY_846__SFR_OFFS)))) %Long Var.VALUE(&__DDRSS0_PHY_846_DATA)
	Data.Set D:((((Var.VALUE(&__J7_DDR0_SS_BASE)+Var.VALUE(&__DDRSS_Data_Slice_3_REGISTER_BLOCK__OFFS))+Var.VALUE(&__DDRSS_PHY_847__SFR_OFFS)))) %Long Var.VALUE(&__DDRSS0_PHY_847_DATA)
	Data.Set D:((((Var.VALUE(&__J7_DDR0_SS_BASE)+Var.VALUE(&__DDRSS_Data_Slice_3_REGISTER_BLOCK__OFFS))+Var.VALUE(&__DDRSS_PHY_848__SFR_OFFS)))) %Long Var.VALUE(&__DDRSS0_PHY_848_DATA)
	Data.Set D:((((Var.VALUE(&__J7_DDR0_SS_BASE)+Var.VALUE(&__DDRSS_Data_Slice_3_REGISTER_BLOCK__OFFS))+Var.VALUE(&__DDRSS_PHY_849__SFR_OFFS)))) %Long Var.VALUE(&__DDRSS0_PHY_849_DATA)
	Data.Set D:((((Var.VALUE(&__J7_DDR0_SS_BASE)+Var.VALUE(&__DDRSS_Data_Slice_3_REGISTER_BLOCK__OFFS))+Var.VALUE(&__DDRSS_PHY_850__SFR_OFFS)))) %Long Var.VALUE(&__DDRSS0_PHY_850_DATA)
	Data.Set D:((((Var.VALUE(&__J7_DDR0_SS_BASE)+Var.VALUE(&__DDRSS_Data_Slice_3_REGISTER_BLOCK__OFFS))+Var.VALUE(&__DDRSS_PHY_851__SFR_OFFS)))) %Long Var.VALUE(&__DDRSS0_PHY_851_DATA)
	Data.Set D:((((Var.VALUE(&__J7_DDR0_SS_BASE)+Var.VALUE(&__DDRSS_Data_Slice_3_REGISTER_BLOCK__OFFS))+Var.VALUE(&__DDRSS_PHY_852__SFR_OFFS)))) %Long Var.VALUE(&__DDRSS0_PHY_852_DATA)
	Data.Set D:((((Var.VALUE(&__J7_DDR0_SS_BASE)+Var.VALUE(&__DDRSS_Data_Slice_3_REGISTER_BLOCK__OFFS))+Var.VALUE(&__DDRSS_PHY_853__SFR_OFFS)))) %Long Var.VALUE(&__DDRSS0_PHY_853_DATA)
	Data.Set D:((((Var.VALUE(&__J7_DDR0_SS_BASE)+Var.VALUE(&__DDRSS_Data_Slice_3_REGISTER_BLOCK__OFFS))+Var.VALUE(&__DDRSS_PHY_854__SFR_OFFS)))) %Long Var.VALUE(&__DDRSS0_PHY_854_DATA)
	Data.Set D:((((Var.VALUE(&__J7_DDR0_SS_BASE)+Var.VALUE(&__DDRSS_Data_Slice_3_REGISTER_BLOCK__OFFS))+Var.VALUE(&__DDRSS_PHY_855__SFR_OFFS)))) %Long Var.VALUE(&__DDRSS0_PHY_855_DATA)
	Data.Set D:((((Var.VALUE(&__J7_DDR0_SS_BASE)+Var.VALUE(&__DDRSS_Data_Slice_3_REGISTER_BLOCK__OFFS))+Var.VALUE(&__DDRSS_PHY_856__SFR_OFFS)))) %Long Var.VALUE(&__DDRSS0_PHY_856_DATA)
	Data.Set D:((((Var.VALUE(&__J7_DDR0_SS_BASE)+Var.VALUE(&__DDRSS_Data_Slice_3_REGISTER_BLOCK__OFFS))+Var.VALUE(&__DDRSS_PHY_857__SFR_OFFS)))) %Long Var.VALUE(&__DDRSS0_PHY_857_DATA)
	Data.Set D:((((Var.VALUE(&__J7_DDR0_SS_BASE)+Var.VALUE(&__DDRSS_Data_Slice_3_REGISTER_BLOCK__OFFS))+Var.VALUE(&__DDRSS_PHY_858__SFR_OFFS)))) %Long Var.VALUE(&__DDRSS0_PHY_858_DATA)
	Data.Set D:((((Var.VALUE(&__J7_DDR0_SS_BASE)+Var.VALUE(&__DDRSS_Data_Slice_3_REGISTER_BLOCK__OFFS))+Var.VALUE(&__DDRSS_PHY_859__SFR_OFFS)))) %Long Var.VALUE(&__DDRSS0_PHY_859_DATA)
	Data.Set D:((((Var.VALUE(&__J7_DDR0_SS_BASE)+Var.VALUE(&__DDRSS_Data_Slice_3_REGISTER_BLOCK__OFFS))+Var.VALUE(&__DDRSS_PHY_860__SFR_OFFS)))) %Long Var.VALUE(&__DDRSS0_PHY_860_DATA)
	Data.Set D:((((Var.VALUE(&__J7_DDR0_SS_BASE)+Var.VALUE(&__DDRSS_Data_Slice_3_REGISTER_BLOCK__OFFS))+Var.VALUE(&__DDRSS_PHY_861__SFR_OFFS)))) %Long Var.VALUE(&__DDRSS0_PHY_861_DATA)
	Data.Set D:((((Var.VALUE(&__J7_DDR0_SS_BASE)+Var.VALUE(&__DDRSS_Data_Slice_3_REGISTER_BLOCK__OFFS))+Var.VALUE(&__DDRSS_PHY_862__SFR_OFFS)))) %Long Var.VALUE(&__DDRSS0_PHY_862_DATA)
	Data.Set D:((((Var.VALUE(&__J7_DDR0_SS_BASE)+Var.VALUE(&__DDRSS_Data_Slice_3_REGISTER_BLOCK__OFFS))+Var.VALUE(&__DDRSS_PHY_863__SFR_OFFS)))) %Long Var.VALUE(&__DDRSS0_PHY_863_DATA)
	Data.Set D:((((Var.VALUE(&__J7_DDR0_SS_BASE)+Var.VALUE(&__DDRSS_Data_Slice_3_REGISTER_BLOCK__OFFS))+Var.VALUE(&__DDRSS_PHY_864__SFR_OFFS)))) %Long Var.VALUE(&__DDRSS0_PHY_864_DATA)
	Data.Set D:((((Var.VALUE(&__J7_DDR0_SS_BASE)+Var.VALUE(&__DDRSS_Data_Slice_3_REGISTER_BLOCK__OFFS))+Var.VALUE(&__DDRSS_PHY_865__SFR_OFFS)))) %Long Var.VALUE(&__DDRSS0_PHY_865_DATA)
	Data.Set D:((((Var.VALUE(&__J7_DDR0_SS_BASE)+Var.VALUE(&__DDRSS_Data_Slice_3_REGISTER_BLOCK__OFFS))+Var.VALUE(&__DDRSS_PHY_866__SFR_OFFS)))) %Long Var.VALUE(&__DDRSS0_PHY_866_DATA)
	Data.Set D:((((Var.VALUE(&__J7_DDR0_SS_BASE)+Var.VALUE(&__DDRSS_Data_Slice_3_REGISTER_BLOCK__OFFS))+Var.VALUE(&__DDRSS_PHY_867__SFR_OFFS)))) %Long Var.VALUE(&__DDRSS0_PHY_867_DATA)
	Data.Set D:((((Var.VALUE(&__J7_DDR0_SS_BASE)+Var.VALUE(&__DDRSS_Data_Slice_3_REGISTER_BLOCK__OFFS))+Var.VALUE(&__DDRSS_PHY_868__SFR_OFFS)))) %Long Var.VALUE(&__DDRSS0_PHY_868_DATA)
	Data.Set D:((((Var.VALUE(&__J7_DDR0_SS_BASE)+Var.VALUE(&__DDRSS_Data_Slice_3_REGISTER_BLOCK__OFFS))+Var.VALUE(&__DDRSS_PHY_869__SFR_OFFS)))) %Long Var.VALUE(&__DDRSS0_PHY_869_DATA)
	Data.Set D:((((Var.VALUE(&__J7_DDR0_SS_BASE)+Var.VALUE(&__DDRSS_Data_Slice_3_REGISTER_BLOCK__OFFS))+Var.VALUE(&__DDRSS_PHY_870__SFR_OFFS)))) %Long Var.VALUE(&__DDRSS0_PHY_870_DATA)
	Data.Set D:((((Var.VALUE(&__J7_DDR0_SS_BASE)+Var.VALUE(&__DDRSS_Data_Slice_3_REGISTER_BLOCK__OFFS))+Var.VALUE(&__DDRSS_PHY_871__SFR_OFFS)))) %Long Var.VALUE(&__DDRSS0_PHY_871_DATA)
	Data.Set D:((((Var.VALUE(&__J7_DDR0_SS_BASE)+Var.VALUE(&__DDRSS_Data_Slice_3_REGISTER_BLOCK__OFFS))+Var.VALUE(&__DDRSS_PHY_872__SFR_OFFS)))) %Long Var.VALUE(&__DDRSS0_PHY_872_DATA)
	Data.Set D:((((Var.VALUE(&__J7_DDR0_SS_BASE)+Var.VALUE(&__DDRSS_Data_Slice_3_REGISTER_BLOCK__OFFS))+Var.VALUE(&__DDRSS_PHY_873__SFR_OFFS)))) %Long Var.VALUE(&__DDRSS0_PHY_873_DATA)
	Data.Set D:((((Var.VALUE(&__J7_DDR0_SS_BASE)+Var.VALUE(&__DDRSS_Data_Slice_3_REGISTER_BLOCK__OFFS))+Var.VALUE(&__DDRSS_PHY_874__SFR_OFFS)))) %Long Var.VALUE(&__DDRSS0_PHY_874_DATA)
	Data.Set D:((((Var.VALUE(&__J7_DDR0_SS_BASE)+Var.VALUE(&__DDRSS_Data_Slice_3_REGISTER_BLOCK__OFFS))+Var.VALUE(&__DDRSS_PHY_875__SFR_OFFS)))) %Long Var.VALUE(&__DDRSS0_PHY_875_DATA)
	Data.Set D:((((Var.VALUE(&__J7_DDR0_SS_BASE)+Var.VALUE(&__DDRSS_Data_Slice_3_REGISTER_BLOCK__OFFS))+Var.VALUE(&__DDRSS_PHY_876__SFR_OFFS)))) %Long Var.VALUE(&__DDRSS0_PHY_876_DATA)
	Data.Set D:((((Var.VALUE(&__J7_DDR0_SS_BASE)+Var.VALUE(&__DDRSS_Data_Slice_3_REGISTER_BLOCK__OFFS))+Var.VALUE(&__DDRSS_PHY_877__SFR_OFFS)))) %Long Var.VALUE(&__DDRSS0_PHY_877_DATA)
	Data.Set D:((((Var.VALUE(&__J7_DDR0_SS_BASE)+Var.VALUE(&__DDRSS_Data_Slice_3_REGISTER_BLOCK__OFFS))+Var.VALUE(&__DDRSS_PHY_878__SFR_OFFS)))) %Long Var.VALUE(&__DDRSS0_PHY_878_DATA)
	Data.Set D:((((Var.VALUE(&__J7_DDR0_SS_BASE)+Var.VALUE(&__DDRSS_Data_Slice_3_REGISTER_BLOCK__OFFS))+Var.VALUE(&__DDRSS_PHY_879__SFR_OFFS)))) %Long Var.VALUE(&__DDRSS0_PHY_879_DATA)
	Data.Set D:((((Var.VALUE(&__J7_DDR0_SS_BASE)+Var.VALUE(&__DDRSS_Data_Slice_3_REGISTER_BLOCK__OFFS))+Var.VALUE(&__DDRSS_PHY_880__SFR_OFFS)))) %Long Var.VALUE(&__DDRSS0_PHY_880_DATA)
	Data.Set D:((((Var.VALUE(&__J7_DDR0_SS_BASE)+Var.VALUE(&__DDRSS_Data_Slice_3_REGISTER_BLOCK__OFFS))+Var.VALUE(&__DDRSS_PHY_881__SFR_OFFS)))) %Long Var.VALUE(&__DDRSS0_PHY_881_DATA)
	Data.Set D:((((Var.VALUE(&__J7_DDR0_SS_BASE)+Var.VALUE(&__DDRSS_Data_Slice_3_REGISTER_BLOCK__OFFS))+Var.VALUE(&__DDRSS_PHY_882__SFR_OFFS)))) %Long Var.VALUE(&__DDRSS0_PHY_882_DATA)
	Data.Set D:((((Var.VALUE(&__J7_DDR0_SS_BASE)+Var.VALUE(&__DDRSS_Data_Slice_3_REGISTER_BLOCK__OFFS))+Var.VALUE(&__DDRSS_PHY_883__SFR_OFFS)))) %Long Var.VALUE(&__DDRSS0_PHY_883_DATA)
	Data.Set D:((((Var.VALUE(&__J7_DDR0_SS_BASE)+Var.VALUE(&__DDRSS_Data_Slice_3_REGISTER_BLOCK__OFFS))+Var.VALUE(&__DDRSS_PHY_884__SFR_OFFS)))) %Long Var.VALUE(&__DDRSS0_PHY_884_DATA)
	Data.Set D:((((Var.VALUE(&__J7_DDR0_SS_BASE)+Var.VALUE(&__DDRSS_Data_Slice_3_REGISTER_BLOCK__OFFS))+Var.VALUE(&__DDRSS_PHY_885__SFR_OFFS)))) %Long Var.VALUE(&__DDRSS0_PHY_885_DATA)
	Data.Set D:((((Var.VALUE(&__J7_DDR0_SS_BASE)+Var.VALUE(&__DDRSS_Data_Slice_3_REGISTER_BLOCK__OFFS))+Var.VALUE(&__DDRSS_PHY_886__SFR_OFFS)))) %Long Var.VALUE(&__DDRSS0_PHY_886_DATA)
	Data.Set D:((((Var.VALUE(&__J7_DDR0_SS_BASE)+Var.VALUE(&__DDRSS_Data_Slice_3_REGISTER_BLOCK__OFFS))+Var.VALUE(&__DDRSS_PHY_887__SFR_OFFS)))) %Long Var.VALUE(&__DDRSS0_PHY_887_DATA)
	Data.Set D:((((Var.VALUE(&__J7_DDR0_SS_BASE)+Var.VALUE(&__DDRSS_Data_Slice_3_REGISTER_BLOCK__OFFS))+Var.VALUE(&__DDRSS_PHY_888__SFR_OFFS)))) %Long Var.VALUE(&__DDRSS0_PHY_888_DATA)
	Data.Set D:((((Var.VALUE(&__J7_DDR0_SS_BASE)+Var.VALUE(&__DDRSS_Data_Slice_3_REGISTER_BLOCK__OFFS))+Var.VALUE(&__DDRSS_PHY_889__SFR_OFFS)))) %Long Var.VALUE(&__DDRSS0_PHY_889_DATA)
	Data.Set D:((((Var.VALUE(&__J7_DDR0_SS_BASE)+Var.VALUE(&__DDRSS_Data_Slice_3_REGISTER_BLOCK__OFFS))+Var.VALUE(&__DDRSS_PHY_890__SFR_OFFS)))) %Long Var.VALUE(&__DDRSS0_PHY_890_DATA)
	Data.Set D:((((Var.VALUE(&__J7_DDR0_SS_BASE)+Var.VALUE(&__DDRSS_Data_Slice_3_REGISTER_BLOCK__OFFS))+Var.VALUE(&__DDRSS_PHY_891__SFR_OFFS)))) %Long Var.VALUE(&__DDRSS0_PHY_891_DATA)
	Data.Set D:((((Var.VALUE(&__J7_DDR0_SS_BASE)+Var.VALUE(&__DDRSS_Data_Slice_3_REGISTER_BLOCK__OFFS))+Var.VALUE(&__DDRSS_PHY_892__SFR_OFFS)))) %Long Var.VALUE(&__DDRSS0_PHY_892_DATA)
	Data.Set D:((((Var.VALUE(&__J7_DDR0_SS_BASE)+Var.VALUE(&__DDRSS_Data_Slice_3_REGISTER_BLOCK__OFFS))+Var.VALUE(&__DDRSS_PHY_893__SFR_OFFS)))) %Long Var.VALUE(&__DDRSS0_PHY_893_DATA)
	Data.Set D:((((Var.VALUE(&__J7_DDR0_SS_BASE)+Var.VALUE(&__DDRSS_Data_Slice_3_REGISTER_BLOCK__OFFS))+Var.VALUE(&__DDRSS_PHY_894__SFR_OFFS)))) %Long Var.VALUE(&__DDRSS0_PHY_894_DATA)
	Data.Set D:((((Var.VALUE(&__J7_DDR0_SS_BASE)+Var.VALUE(&__DDRSS_Data_Slice_3_REGISTER_BLOCK__OFFS))+Var.VALUE(&__DDRSS_PHY_895__SFR_OFFS)))) %Long Var.VALUE(&__DDRSS0_PHY_895_DATA)
	Data.Set D:((((Var.VALUE(&__J7_DDR0_SS_BASE)+Var.VALUE(&__DDRSS_Data_Slice_3_REGISTER_BLOCK__OFFS))+Var.VALUE(&__DDRSS_PHY_896__SFR_OFFS)))) %Long Var.VALUE(&__DDRSS0_PHY_896_DATA)
	Data.Set D:((((Var.VALUE(&__J7_DDR0_SS_BASE)+Var.VALUE(&__DDRSS_Data_Slice_3_REGISTER_BLOCK__OFFS))+Var.VALUE(&__DDRSS_PHY_897__SFR_OFFS)))) %Long Var.VALUE(&__DDRSS0_PHY_897_DATA)
	Data.Set D:((((Var.VALUE(&__J7_DDR0_SS_BASE)+Var.VALUE(&__DDRSS_Data_Slice_3_REGISTER_BLOCK__OFFS))+Var.VALUE(&__DDRSS_PHY_898__SFR_OFFS)))) %Long Var.VALUE(&__DDRSS0_PHY_898_DATA)
	Data.Set D:((((Var.VALUE(&__J7_DDR0_SS_BASE)+Var.VALUE(&__DDRSS_Data_Slice_3_REGISTER_BLOCK__OFFS))+Var.VALUE(&__DDRSS_PHY_899__SFR_OFFS)))) %Long Var.VALUE(&__DDRSS0_PHY_899_DATA)
	Data.Set D:((((Var.VALUE(&__J7_DDR0_SS_BASE)+Var.VALUE(&__DDRSS_Data_Slice_3_REGISTER_BLOCK__OFFS))+Var.VALUE(&__DDRSS_PHY_900__SFR_OFFS)))) %Long Var.VALUE(&__DDRSS0_PHY_900_DATA)
	Data.Set D:((((Var.VALUE(&__J7_DDR0_SS_BASE)+Var.VALUE(&__DDRSS_Data_Slice_3_REGISTER_BLOCK__OFFS))+Var.VALUE(&__DDRSS_PHY_901__SFR_OFFS)))) %Long Var.VALUE(&__DDRSS0_PHY_901_DATA)
	Data.Set D:((((Var.VALUE(&__J7_DDR0_SS_BASE)+Var.VALUE(&__DDRSS_Data_Slice_3_REGISTER_BLOCK__OFFS))+Var.VALUE(&__DDRSS_PHY_902__SFR_OFFS)))) %Long Var.VALUE(&__DDRSS0_PHY_902_DATA)
	Data.Set D:((((Var.VALUE(&__J7_DDR0_SS_BASE)+Var.VALUE(&__DDRSS_Data_Slice_3_REGISTER_BLOCK__OFFS))+Var.VALUE(&__DDRSS_PHY_903__SFR_OFFS)))) %Long Var.VALUE(&__DDRSS0_PHY_903_DATA)
	Data.Set D:((((Var.VALUE(&__J7_DDR0_SS_BASE)+Var.VALUE(&__DDRSS_Data_Slice_3_REGISTER_BLOCK__OFFS))+Var.VALUE(&__DDRSS_PHY_904__SFR_OFFS)))) %Long Var.VALUE(&__DDRSS0_PHY_904_DATA)
	Data.Set D:((((Var.VALUE(&__J7_DDR0_SS_BASE)+Var.VALUE(&__DDRSS_Data_Slice_3_REGISTER_BLOCK__OFFS))+Var.VALUE(&__DDRSS_PHY_905__SFR_OFFS)))) %Long Var.VALUE(&__DDRSS0_PHY_905_DATA)
	Data.Set D:((((Var.VALUE(&__J7_DDR0_SS_BASE)+Var.VALUE(&__DDRSS_Data_Slice_3_REGISTER_BLOCK__OFFS))+Var.VALUE(&__DDRSS_PHY_906__SFR_OFFS)))) %Long Var.VALUE(&__DDRSS0_PHY_906_DATA)
	Data.Set D:((((Var.VALUE(&__J7_DDR0_SS_BASE)+Var.VALUE(&__DDRSS_Data_Slice_3_REGISTER_BLOCK__OFFS))+Var.VALUE(&__DDRSS_PHY_907__SFR_OFFS)))) %Long Var.VALUE(&__DDRSS0_PHY_907_DATA)
	Var.NEWLOCAL char[128] \strtmp = "--->>> DDR0 PHY Data Slice 3 programming completed... <<<---\n"
	GOSUB printf Var.String(\strtmp)
	
	Var.NEWLOCAL char[128] \strtmp = "--->>> DDR0 PHY Address slice 0 programming in progress.. <<<---\n"
	GOSUB printf Var.String(\strtmp)
	
	Data.Set D:((((Var.VALUE(&__J7_DDR0_SS_BASE)+Var.VALUE(&__DDRSS_Address_Slice_0_REGISTER_BLOCK__OFFS))+Var.VALUE(&__DDRSS_PHY_1024__SFR_OFFS)))) %Long Var.VALUE(&__DDRSS0_PHY_1024_DATA)
	Data.Set D:((((Var.VALUE(&__J7_DDR0_SS_BASE)+Var.VALUE(&__DDRSS_Address_Slice_0_REGISTER_BLOCK__OFFS))+Var.VALUE(&__DDRSS_PHY_1025__SFR_OFFS)))) %Long Var.VALUE(&__DDRSS0_PHY_1025_DATA)
	Data.Set D:((((Var.VALUE(&__J7_DDR0_SS_BASE)+Var.VALUE(&__DDRSS_Address_Slice_0_REGISTER_BLOCK__OFFS))+Var.VALUE(&__DDRSS_PHY_1026__SFR_OFFS)))) %Long Var.VALUE(&__DDRSS0_PHY_1026_DATA)
	Data.Set D:((((Var.VALUE(&__J7_DDR0_SS_BASE)+Var.VALUE(&__DDRSS_Address_Slice_0_REGISTER_BLOCK__OFFS))+Var.VALUE(&__DDRSS_PHY_1027__SFR_OFFS)))) %Long Var.VALUE(&__DDRSS0_PHY_1027_DATA)
	Data.Set D:((((Var.VALUE(&__J7_DDR0_SS_BASE)+Var.VALUE(&__DDRSS_Address_Slice_0_REGISTER_BLOCK__OFFS))+Var.VALUE(&__DDRSS_PHY_1028__SFR_OFFS)))) %Long Var.VALUE(&__DDRSS0_PHY_1028_DATA)
	Data.Set D:((((Var.VALUE(&__J7_DDR0_SS_BASE)+Var.VALUE(&__DDRSS_Address_Slice_0_REGISTER_BLOCK__OFFS))+Var.VALUE(&__DDRSS_PHY_1029__SFR_OFFS)))) %Long Var.VALUE(&__DDRSS0_PHY_1029_DATA)
	Data.Set D:((((Var.VALUE(&__J7_DDR0_SS_BASE)+Var.VALUE(&__DDRSS_Address_Slice_0_REGISTER_BLOCK__OFFS))+Var.VALUE(&__DDRSS_PHY_1030__SFR_OFFS)))) %Long Var.VALUE(&__DDRSS0_PHY_1030_DATA)
	Data.Set D:((((Var.VALUE(&__J7_DDR0_SS_BASE)+Var.VALUE(&__DDRSS_Address_Slice_0_REGISTER_BLOCK__OFFS))+Var.VALUE(&__DDRSS_PHY_1031__SFR_OFFS)))) %Long Var.VALUE(&__DDRSS0_PHY_1031_DATA)
	Data.Set D:((((Var.VALUE(&__J7_DDR0_SS_BASE)+Var.VALUE(&__DDRSS_Address_Slice_0_REGISTER_BLOCK__OFFS))+Var.VALUE(&__DDRSS_PHY_1032__SFR_OFFS)))) %Long Var.VALUE(&__DDRSS0_PHY_1032_DATA)
	Data.Set D:((((Var.VALUE(&__J7_DDR0_SS_BASE)+Var.VALUE(&__DDRSS_Address_Slice_0_REGISTER_BLOCK__OFFS))+Var.VALUE(&__DDRSS_PHY_1033__SFR_OFFS)))) %Long Var.VALUE(&__DDRSS0_PHY_1033_DATA)
	Data.Set D:((((Var.VALUE(&__J7_DDR0_SS_BASE)+Var.VALUE(&__DDRSS_Address_Slice_0_REGISTER_BLOCK__OFFS))+Var.VALUE(&__DDRSS_PHY_1034__SFR_OFFS)))) %Long Var.VALUE(&__DDRSS0_PHY_1034_DATA)
	Data.Set D:((((Var.VALUE(&__J7_DDR0_SS_BASE)+Var.VALUE(&__DDRSS_Address_Slice_0_REGISTER_BLOCK__OFFS))+Var.VALUE(&__DDRSS_PHY_1035__SFR_OFFS)))) %Long Var.VALUE(&__DDRSS0_PHY_1035_DATA)
	Data.Set D:((((Var.VALUE(&__J7_DDR0_SS_BASE)+Var.VALUE(&__DDRSS_Address_Slice_0_REGISTER_BLOCK__OFFS))+Var.VALUE(&__DDRSS_PHY_1036__SFR_OFFS)))) %Long Var.VALUE(&__DDRSS0_PHY_1036_DATA)
	Data.Set D:((((Var.VALUE(&__J7_DDR0_SS_BASE)+Var.VALUE(&__DDRSS_Address_Slice_0_REGISTER_BLOCK__OFFS))+Var.VALUE(&__DDRSS_PHY_1037__SFR_OFFS)))) %Long Var.VALUE(&__DDRSS0_PHY_1037_DATA)
	Data.Set D:((((Var.VALUE(&__J7_DDR0_SS_BASE)+Var.VALUE(&__DDRSS_Address_Slice_0_REGISTER_BLOCK__OFFS))+Var.VALUE(&__DDRSS_PHY_1038__SFR_OFFS)))) %Long Var.VALUE(&__DDRSS0_PHY_1038_DATA)
	Data.Set D:((((Var.VALUE(&__J7_DDR0_SS_BASE)+Var.VALUE(&__DDRSS_Address_Slice_0_REGISTER_BLOCK__OFFS))+Var.VALUE(&__DDRSS_PHY_1039__SFR_OFFS)))) %Long Var.VALUE(&__DDRSS0_PHY_1039_DATA)
	Data.Set D:((((Var.VALUE(&__J7_DDR0_SS_BASE)+Var.VALUE(&__DDRSS_Address_Slice_0_REGISTER_BLOCK__OFFS))+Var.VALUE(&__DDRSS_PHY_1040__SFR_OFFS)))) %Long Var.VALUE(&__DDRSS0_PHY_1040_DATA)
	Data.Set D:((((Var.VALUE(&__J7_DDR0_SS_BASE)+Var.VALUE(&__DDRSS_Address_Slice_0_REGISTER_BLOCK__OFFS))+Var.VALUE(&__DDRSS_PHY_1041__SFR_OFFS)))) %Long Var.VALUE(&__DDRSS0_PHY_1041_DATA)
	Data.Set D:((((Var.VALUE(&__J7_DDR0_SS_BASE)+Var.VALUE(&__DDRSS_Address_Slice_0_REGISTER_BLOCK__OFFS))+Var.VALUE(&__DDRSS_PHY_1042__SFR_OFFS)))) %Long Var.VALUE(&__DDRSS0_PHY_1042_DATA)
	Data.Set D:((((Var.VALUE(&__J7_DDR0_SS_BASE)+Var.VALUE(&__DDRSS_Address_Slice_0_REGISTER_BLOCK__OFFS))+Var.VALUE(&__DDRSS_PHY_1043__SFR_OFFS)))) %Long Var.VALUE(&__DDRSS0_PHY_1043_DATA)
	Data.Set D:((((Var.VALUE(&__J7_DDR0_SS_BASE)+Var.VALUE(&__DDRSS_Address_Slice_0_REGISTER_BLOCK__OFFS))+Var.VALUE(&__DDRSS_PHY_1044__SFR_OFFS)))) %Long Var.VALUE(&__DDRSS0_PHY_1044_DATA)
	Data.Set D:((((Var.VALUE(&__J7_DDR0_SS_BASE)+Var.VALUE(&__DDRSS_Address_Slice_0_REGISTER_BLOCK__OFFS))+Var.VALUE(&__DDRSS_PHY_1045__SFR_OFFS)))) %Long Var.VALUE(&__DDRSS0_PHY_1045_DATA)
	Data.Set D:((((Var.VALUE(&__J7_DDR0_SS_BASE)+Var.VALUE(&__DDRSS_Address_Slice_0_REGISTER_BLOCK__OFFS))+Var.VALUE(&__DDRSS_PHY_1046__SFR_OFFS)))) %Long Var.VALUE(&__DDRSS0_PHY_1046_DATA)
	Data.Set D:((((Var.VALUE(&__J7_DDR0_SS_BASE)+Var.VALUE(&__DDRSS_Address_Slice_0_REGISTER_BLOCK__OFFS))+Var.VALUE(&__DDRSS_PHY_1047__SFR_OFFS)))) %Long Var.VALUE(&__DDRSS0_PHY_1047_DATA)
	Data.Set D:((((Var.VALUE(&__J7_DDR0_SS_BASE)+Var.VALUE(&__DDRSS_Address_Slice_0_REGISTER_BLOCK__OFFS))+Var.VALUE(&__DDRSS_PHY_1048__SFR_OFFS)))) %Long Var.VALUE(&__DDRSS0_PHY_1048_DATA)
	Data.Set D:((((Var.VALUE(&__J7_DDR0_SS_BASE)+Var.VALUE(&__DDRSS_Address_Slice_0_REGISTER_BLOCK__OFFS))+Var.VALUE(&__DDRSS_PHY_1049__SFR_OFFS)))) %Long Var.VALUE(&__DDRSS0_PHY_1049_DATA)
	Data.Set D:((((Var.VALUE(&__J7_DDR0_SS_BASE)+Var.VALUE(&__DDRSS_Address_Slice_0_REGISTER_BLOCK__OFFS))+Var.VALUE(&__DDRSS_PHY_1050__SFR_OFFS)))) %Long Var.VALUE(&__DDRSS0_PHY_1050_DATA)
	Data.Set D:((((Var.VALUE(&__J7_DDR0_SS_BASE)+Var.VALUE(&__DDRSS_Address_Slice_0_REGISTER_BLOCK__OFFS))+Var.VALUE(&__DDRSS_PHY_1051__SFR_OFFS)))) %Long Var.VALUE(&__DDRSS0_PHY_1051_DATA)
	Data.Set D:((((Var.VALUE(&__J7_DDR0_SS_BASE)+Var.VALUE(&__DDRSS_Address_Slice_0_REGISTER_BLOCK__OFFS))+Var.VALUE(&__DDRSS_PHY_1052__SFR_OFFS)))) %Long Var.VALUE(&__DDRSS0_PHY_1052_DATA)
	Data.Set D:((((Var.VALUE(&__J7_DDR0_SS_BASE)+Var.VALUE(&__DDRSS_Address_Slice_0_REGISTER_BLOCK__OFFS))+Var.VALUE(&__DDRSS_PHY_1053__SFR_OFFS)))) %Long Var.VALUE(&__DDRSS0_PHY_1053_DATA)
	Data.Set D:((((Var.VALUE(&__J7_DDR0_SS_BASE)+Var.VALUE(&__DDRSS_Address_Slice_0_REGISTER_BLOCK__OFFS))+Var.VALUE(&__DDRSS_PHY_1054__SFR_OFFS)))) %Long Var.VALUE(&__DDRSS0_PHY_1054_DATA)
	Data.Set D:((((Var.VALUE(&__J7_DDR0_SS_BASE)+Var.VALUE(&__DDRSS_Address_Slice_0_REGISTER_BLOCK__OFFS))+Var.VALUE(&__DDRSS_PHY_1055__SFR_OFFS)))) %Long Var.VALUE(&__DDRSS0_PHY_1055_DATA)
	Data.Set D:((((Var.VALUE(&__J7_DDR0_SS_BASE)+Var.VALUE(&__DDRSS_Address_Slice_0_REGISTER_BLOCK__OFFS))+Var.VALUE(&__DDRSS_PHY_1056__SFR_OFFS)))) %Long Var.VALUE(&__DDRSS0_PHY_1056_DATA)
	Data.Set D:((((Var.VALUE(&__J7_DDR0_SS_BASE)+Var.VALUE(&__DDRSS_Address_Slice_0_REGISTER_BLOCK__OFFS))+Var.VALUE(&__DDRSS_PHY_1057__SFR_OFFS)))) %Long Var.VALUE(&__DDRSS0_PHY_1057_DATA)
	Data.Set D:((((Var.VALUE(&__J7_DDR0_SS_BASE)+Var.VALUE(&__DDRSS_Address_Slice_0_REGISTER_BLOCK__OFFS))+Var.VALUE(&__DDRSS_PHY_1058__SFR_OFFS)))) %Long Var.VALUE(&__DDRSS0_PHY_1058_DATA)
	Data.Set D:((((Var.VALUE(&__J7_DDR0_SS_BASE)+Var.VALUE(&__DDRSS_Address_Slice_0_REGISTER_BLOCK__OFFS))+Var.VALUE(&__DDRSS_PHY_1059__SFR_OFFS)))) %Long Var.VALUE(&__DDRSS0_PHY_1059_DATA)
	Data.Set D:((((Var.VALUE(&__J7_DDR0_SS_BASE)+Var.VALUE(&__DDRSS_Address_Slice_0_REGISTER_BLOCK__OFFS))+Var.VALUE(&__DDRSS_PHY_1060__SFR_OFFS)))) %Long Var.VALUE(&__DDRSS0_PHY_1060_DATA)
	Data.Set D:((((Var.VALUE(&__J7_DDR0_SS_BASE)+Var.VALUE(&__DDRSS_Address_Slice_0_REGISTER_BLOCK__OFFS))+Var.VALUE(&__DDRSS_PHY_1061__SFR_OFFS)))) %Long Var.VALUE(&__DDRSS0_PHY_1061_DATA)
	Data.Set D:((((Var.VALUE(&__J7_DDR0_SS_BASE)+Var.VALUE(&__DDRSS_Address_Slice_0_REGISTER_BLOCK__OFFS))+Var.VALUE(&__DDRSS_PHY_1062__SFR_OFFS)))) %Long Var.VALUE(&__DDRSS0_PHY_1062_DATA)
	Data.Set D:((((Var.VALUE(&__J7_DDR0_SS_BASE)+Var.VALUE(&__DDRSS_Address_Slice_0_REGISTER_BLOCK__OFFS))+Var.VALUE(&__DDRSS_PHY_1063__SFR_OFFS)))) %Long Var.VALUE(&__DDRSS0_PHY_1063_DATA)
	Data.Set D:((((Var.VALUE(&__J7_DDR0_SS_BASE)+Var.VALUE(&__DDRSS_Address_Slice_0_REGISTER_BLOCK__OFFS))+Var.VALUE(&__DDRSS_PHY_1064__SFR_OFFS)))) %Long Var.VALUE(&__DDRSS0_PHY_1064_DATA)
	Data.Set D:((((Var.VALUE(&__J7_DDR0_SS_BASE)+Var.VALUE(&__DDRSS_Address_Slice_0_REGISTER_BLOCK__OFFS))+Var.VALUE(&__DDRSS_PHY_1065__SFR_OFFS)))) %Long Var.VALUE(&__DDRSS0_PHY_1065_DATA)
	Data.Set D:((((Var.VALUE(&__J7_DDR0_SS_BASE)+Var.VALUE(&__DDRSS_Address_Slice_0_REGISTER_BLOCK__OFFS))+Var.VALUE(&__DDRSS_PHY_1066__SFR_OFFS)))) %Long Var.VALUE(&__DDRSS0_PHY_1066_DATA)
	Data.Set D:((((Var.VALUE(&__J7_DDR0_SS_BASE)+Var.VALUE(&__DDRSS_Address_Slice_0_REGISTER_BLOCK__OFFS))+Var.VALUE(&__DDRSS_PHY_1067__SFR_OFFS)))) %Long Var.VALUE(&__DDRSS0_PHY_1067_DATA)
	Data.Set D:((((Var.VALUE(&__J7_DDR0_SS_BASE)+Var.VALUE(&__DDRSS_Address_Slice_0_REGISTER_BLOCK__OFFS))+Var.VALUE(&__DDRSS_PHY_1068__SFR_OFFS)))) %Long Var.VALUE(&__DDRSS0_PHY_1068_DATA)
	Data.Set D:((((Var.VALUE(&__J7_DDR0_SS_BASE)+Var.VALUE(&__DDRSS_Address_Slice_0_REGISTER_BLOCK__OFFS))+Var.VALUE(&__DDRSS_PHY_1069__SFR_OFFS)))) %Long Var.VALUE(&__DDRSS0_PHY_1069_DATA)
	Data.Set D:((((Var.VALUE(&__J7_DDR0_SS_BASE)+Var.VALUE(&__DDRSS_Address_Slice_0_REGISTER_BLOCK__OFFS))+Var.VALUE(&__DDRSS_PHY_1070__SFR_OFFS)))) %Long Var.VALUE(&__DDRSS0_PHY_1070_DATA)
	Data.Set D:((((Var.VALUE(&__J7_DDR0_SS_BASE)+Var.VALUE(&__DDRSS_Address_Slice_0_REGISTER_BLOCK__OFFS))+Var.VALUE(&__DDRSS_PHY_1071__SFR_OFFS)))) %Long Var.VALUE(&__DDRSS0_PHY_1071_DATA)
	Data.Set D:((((Var.VALUE(&__J7_DDR0_SS_BASE)+Var.VALUE(&__DDRSS_Address_Slice_0_REGISTER_BLOCK__OFFS))+Var.VALUE(&__DDRSS_PHY_1072__SFR_OFFS)))) %Long Var.VALUE(&__DDRSS0_PHY_1072_DATA)
	Data.Set D:((((Var.VALUE(&__J7_DDR0_SS_BASE)+Var.VALUE(&__DDRSS_Address_Slice_0_REGISTER_BLOCK__OFFS))+Var.VALUE(&__DDRSS_PHY_1073__SFR_OFFS)))) %Long Var.VALUE(&__DDRSS0_PHY_1073_DATA)
	Data.Set D:((((Var.VALUE(&__J7_DDR0_SS_BASE)+Var.VALUE(&__DDRSS_Address_Slice_0_REGISTER_BLOCK__OFFS))+Var.VALUE(&__DDRSS_PHY_1074__SFR_OFFS)))) %Long Var.VALUE(&__DDRSS0_PHY_1074_DATA)
	Data.Set D:((((Var.VALUE(&__J7_DDR0_SS_BASE)+Var.VALUE(&__DDRSS_Address_Slice_0_REGISTER_BLOCK__OFFS))+Var.VALUE(&__DDRSS_PHY_1075__SFR_OFFS)))) %Long Var.VALUE(&__DDRSS0_PHY_1075_DATA)
	Var.NEWLOCAL char[128] \strtmp = "--->>> DDR0 PHY Address Slice 0 programming completed... <<<---\n"
	GOSUB printf Var.String(\strtmp)
	
	Var.NEWLOCAL char[128] \strtmp = "--->>> DDR0 PHY programming in progress.. <<<---\n"
	GOSUB printf Var.String(\strtmp)
	
	Data.Set D:((((Var.VALUE(&__J7_DDR0_SS_BASE)+Var.VALUE(&__DDRSS_PHY_Core_REGISTER_BLOCK__OFFS))+Var.VALUE(&__DDRSS_PHY_1280__SFR_OFFS)))) %Long Var.VALUE(&__DDRSS0_PHY_1280_DATA)
	Data.Set D:((((Var.VALUE(&__J7_DDR0_SS_BASE)+Var.VALUE(&__DDRSS_PHY_Core_REGISTER_BLOCK__OFFS))+Var.VALUE(&__DDRSS_PHY_1281__SFR_OFFS)))) %Long Var.VALUE(&__DDRSS0_PHY_1281_DATA)
	Data.Set D:((((Var.VALUE(&__J7_DDR0_SS_BASE)+Var.VALUE(&__DDRSS_PHY_Core_REGISTER_BLOCK__OFFS))+Var.VALUE(&__DDRSS_PHY_1282__SFR_OFFS)))) %Long Var.VALUE(&__DDRSS0_PHY_1282_DATA)
	Data.Set D:((((Var.VALUE(&__J7_DDR0_SS_BASE)+Var.VALUE(&__DDRSS_PHY_Core_REGISTER_BLOCK__OFFS))+Var.VALUE(&__DDRSS_PHY_1283__SFR_OFFS)))) %Long Var.VALUE(&__DDRSS0_PHY_1283_DATA)
	Data.Set D:((((Var.VALUE(&__J7_DDR0_SS_BASE)+Var.VALUE(&__DDRSS_PHY_Core_REGISTER_BLOCK__OFFS))+Var.VALUE(&__DDRSS_PHY_1284__SFR_OFFS)))) %Long Var.VALUE(&__DDRSS0_PHY_1284_DATA)
	Data.Set D:((((Var.VALUE(&__J7_DDR0_SS_BASE)+Var.VALUE(&__DDRSS_PHY_Core_REGISTER_BLOCK__OFFS))+Var.VALUE(&__DDRSS_PHY_1285__SFR_OFFS)))) %Long Var.VALUE(&__DDRSS0_PHY_1285_DATA)
	Data.Set D:((((Var.VALUE(&__J7_DDR0_SS_BASE)+Var.VALUE(&__DDRSS_PHY_Core_REGISTER_BLOCK__OFFS))+Var.VALUE(&__DDRSS_PHY_1286__SFR_OFFS)))) %Long Var.VALUE(&__DDRSS0_PHY_1286_DATA)
	Data.Set D:((((Var.VALUE(&__J7_DDR0_SS_BASE)+Var.VALUE(&__DDRSS_PHY_Core_REGISTER_BLOCK__OFFS))+Var.VALUE(&__DDRSS_PHY_1287__SFR_OFFS)))) %Long Var.VALUE(&__DDRSS0_PHY_1287_DATA)
	Data.Set D:((((Var.VALUE(&__J7_DDR0_SS_BASE)+Var.VALUE(&__DDRSS_PHY_Core_REGISTER_BLOCK__OFFS))+Var.VALUE(&__DDRSS_PHY_1288__SFR_OFFS)))) %Long Var.VALUE(&__DDRSS0_PHY_1288_DATA)
	Data.Set D:((((Var.VALUE(&__J7_DDR0_SS_BASE)+Var.VALUE(&__DDRSS_PHY_Core_REGISTER_BLOCK__OFFS))+Var.VALUE(&__DDRSS_PHY_1289__SFR_OFFS)))) %Long Var.VALUE(&__DDRSS0_PHY_1289_DATA)
	Data.Set D:((((Var.VALUE(&__J7_DDR0_SS_BASE)+Var.VALUE(&__DDRSS_PHY_Core_REGISTER_BLOCK__OFFS))+Var.VALUE(&__DDRSS_PHY_1290__SFR_OFFS)))) %Long Var.VALUE(&__DDRSS0_PHY_1290_DATA)
	Data.Set D:((((Var.VALUE(&__J7_DDR0_SS_BASE)+Var.VALUE(&__DDRSS_PHY_Core_REGISTER_BLOCK__OFFS))+Var.VALUE(&__DDRSS_PHY_1291__SFR_OFFS)))) %Long Var.VALUE(&__DDRSS0_PHY_1291_DATA)
	Data.Set D:((((Var.VALUE(&__J7_DDR0_SS_BASE)+Var.VALUE(&__DDRSS_PHY_Core_REGISTER_BLOCK__OFFS))+Var.VALUE(&__DDRSS_PHY_1292__SFR_OFFS)))) %Long Var.VALUE(&__DDRSS0_PHY_1292_DATA)
	Data.Set D:((((Var.VALUE(&__J7_DDR0_SS_BASE)+Var.VALUE(&__DDRSS_PHY_Core_REGISTER_BLOCK__OFFS))+Var.VALUE(&__DDRSS_PHY_1293__SFR_OFFS)))) %Long Var.VALUE(&__DDRSS0_PHY_1293_DATA)
	Data.Set D:((((Var.VALUE(&__J7_DDR0_SS_BASE)+Var.VALUE(&__DDRSS_PHY_Core_REGISTER_BLOCK__OFFS))+Var.VALUE(&__DDRSS_PHY_1294__SFR_OFFS)))) %Long Var.VALUE(&__DDRSS0_PHY_1294_DATA)
	Data.Set D:((((Var.VALUE(&__J7_DDR0_SS_BASE)+Var.VALUE(&__DDRSS_PHY_Core_REGISTER_BLOCK__OFFS))+Var.VALUE(&__DDRSS_PHY_1295__SFR_OFFS)))) %Long Var.VALUE(&__DDRSS0_PHY_1295_DATA)
	Data.Set D:((((Var.VALUE(&__J7_DDR0_SS_BASE)+Var.VALUE(&__DDRSS_PHY_Core_REGISTER_BLOCK__OFFS))+Var.VALUE(&__DDRSS_PHY_1296__SFR_OFFS)))) %Long Var.VALUE(&__DDRSS0_PHY_1296_DATA)
	Data.Set D:((((Var.VALUE(&__J7_DDR0_SS_BASE)+Var.VALUE(&__DDRSS_PHY_Core_REGISTER_BLOCK__OFFS))+Var.VALUE(&__DDRSS_PHY_1297__SFR_OFFS)))) %Long Var.VALUE(&__DDRSS0_PHY_1297_DATA)
	Data.Set D:((((Var.VALUE(&__J7_DDR0_SS_BASE)+Var.VALUE(&__DDRSS_PHY_Core_REGISTER_BLOCK__OFFS))+Var.VALUE(&__DDRSS_PHY_1298__SFR_OFFS)))) %Long Var.VALUE(&__DDRSS0_PHY_1298_DATA)
	Data.Set D:((((Var.VALUE(&__J7_DDR0_SS_BASE)+Var.VALUE(&__DDRSS_PHY_Core_REGISTER_BLOCK__OFFS))+Var.VALUE(&__DDRSS_PHY_1299__SFR_OFFS)))) %Long Var.VALUE(&__DDRSS0_PHY_1299_DATA)
	Data.Set D:((((Var.VALUE(&__J7_DDR0_SS_BASE)+Var.VALUE(&__DDRSS_PHY_Core_REGISTER_BLOCK__OFFS))+Var.VALUE(&__DDRSS_PHY_1300__SFR_OFFS)))) %Long Var.VALUE(&__DDRSS0_PHY_1300_DATA)
	Data.Set D:((((Var.VALUE(&__J7_DDR0_SS_BASE)+Var.VALUE(&__DDRSS_PHY_Core_REGISTER_BLOCK__OFFS))+Var.VALUE(&__DDRSS_PHY_1301__SFR_OFFS)))) %Long Var.VALUE(&__DDRSS0_PHY_1301_DATA)
	Data.Set D:((((Var.VALUE(&__J7_DDR0_SS_BASE)+Var.VALUE(&__DDRSS_PHY_Core_REGISTER_BLOCK__OFFS))+Var.VALUE(&__DDRSS_PHY_1302__SFR_OFFS)))) %Long Var.VALUE(&__DDRSS0_PHY_1302_DATA)
	Data.Set D:((((Var.VALUE(&__J7_DDR0_SS_BASE)+Var.VALUE(&__DDRSS_PHY_Core_REGISTER_BLOCK__OFFS))+Var.VALUE(&__DDRSS_PHY_1303__SFR_OFFS)))) %Long Var.VALUE(&__DDRSS0_PHY_1303_DATA)
	Data.Set D:((((Var.VALUE(&__J7_DDR0_SS_BASE)+Var.VALUE(&__DDRSS_PHY_Core_REGISTER_BLOCK__OFFS))+Var.VALUE(&__DDRSS_PHY_1304__SFR_OFFS)))) %Long Var.VALUE(&__DDRSS0_PHY_1304_DATA)
	Data.Set D:((((Var.VALUE(&__J7_DDR0_SS_BASE)+Var.VALUE(&__DDRSS_PHY_Core_REGISTER_BLOCK__OFFS))+Var.VALUE(&__DDRSS_PHY_1305__SFR_OFFS)))) %Long Var.VALUE(&__DDRSS0_PHY_1305_DATA)
	Data.Set D:((((Var.VALUE(&__J7_DDR0_SS_BASE)+Var.VALUE(&__DDRSS_PHY_Core_REGISTER_BLOCK__OFFS))+Var.VALUE(&__DDRSS_PHY_1306__SFR_OFFS)))) %Long Var.VALUE(&__DDRSS0_PHY_1306_DATA)
	Data.Set D:((((Var.VALUE(&__J7_DDR0_SS_BASE)+Var.VALUE(&__DDRSS_PHY_Core_REGISTER_BLOCK__OFFS))+Var.VALUE(&__DDRSS_PHY_1307__SFR_OFFS)))) %Long Var.VALUE(&__DDRSS0_PHY_1307_DATA)
	Data.Set D:((((Var.VALUE(&__J7_DDR0_SS_BASE)+Var.VALUE(&__DDRSS_PHY_Core_REGISTER_BLOCK__OFFS))+Var.VALUE(&__DDRSS_PHY_1308__SFR_OFFS)))) %Long Var.VALUE(&__DDRSS0_PHY_1308_DATA)
	Data.Set D:((((Var.VALUE(&__J7_DDR0_SS_BASE)+Var.VALUE(&__DDRSS_PHY_Core_REGISTER_BLOCK__OFFS))+Var.VALUE(&__DDRSS_PHY_1309__SFR_OFFS)))) %Long Var.VALUE(&__DDRSS0_PHY_1309_DATA)
	Data.Set D:((((Var.VALUE(&__J7_DDR0_SS_BASE)+Var.VALUE(&__DDRSS_PHY_Core_REGISTER_BLOCK__OFFS))+Var.VALUE(&__DDRSS_PHY_1310__SFR_OFFS)))) %Long Var.VALUE(&__DDRSS0_PHY_1310_DATA)
	Data.Set D:((((Var.VALUE(&__J7_DDR0_SS_BASE)+Var.VALUE(&__DDRSS_PHY_Core_REGISTER_BLOCK__OFFS))+Var.VALUE(&__DDRSS_PHY_1311__SFR_OFFS)))) %Long Var.VALUE(&__DDRSS0_PHY_1311_DATA)
	Data.Set D:((((Var.VALUE(&__J7_DDR0_SS_BASE)+Var.VALUE(&__DDRSS_PHY_Core_REGISTER_BLOCK__OFFS))+Var.VALUE(&__DDRSS_PHY_1312__SFR_OFFS)))) %Long Var.VALUE(&__DDRSS0_PHY_1312_DATA)
	Data.Set D:((((Var.VALUE(&__J7_DDR0_SS_BASE)+Var.VALUE(&__DDRSS_PHY_Core_REGISTER_BLOCK__OFFS))+Var.VALUE(&__DDRSS_PHY_1313__SFR_OFFS)))) %Long Var.VALUE(&__DDRSS0_PHY_1313_DATA)
	Data.Set D:((((Var.VALUE(&__J7_DDR0_SS_BASE)+Var.VALUE(&__DDRSS_PHY_Core_REGISTER_BLOCK__OFFS))+Var.VALUE(&__DDRSS_PHY_1314__SFR_OFFS)))) %Long Var.VALUE(&__DDRSS0_PHY_1314_DATA)
	Data.Set D:((((Var.VALUE(&__J7_DDR0_SS_BASE)+Var.VALUE(&__DDRSS_PHY_Core_REGISTER_BLOCK__OFFS))+Var.VALUE(&__DDRSS_PHY_1315__SFR_OFFS)))) %Long Var.VALUE(&__DDRSS0_PHY_1315_DATA)
	Data.Set D:((((Var.VALUE(&__J7_DDR0_SS_BASE)+Var.VALUE(&__DDRSS_PHY_Core_REGISTER_BLOCK__OFFS))+Var.VALUE(&__DDRSS_PHY_1316__SFR_OFFS)))) %Long Var.VALUE(&__DDRSS0_PHY_1316_DATA)
	Data.Set D:((((Var.VALUE(&__J7_DDR0_SS_BASE)+Var.VALUE(&__DDRSS_PHY_Core_REGISTER_BLOCK__OFFS))+Var.VALUE(&__DDRSS_PHY_1317__SFR_OFFS)))) %Long Var.VALUE(&__DDRSS0_PHY_1317_DATA)
	Data.Set D:((((Var.VALUE(&__J7_DDR0_SS_BASE)+Var.VALUE(&__DDRSS_PHY_Core_REGISTER_BLOCK__OFFS))+Var.VALUE(&__DDRSS_PHY_1318__SFR_OFFS)))) %Long Var.VALUE(&__DDRSS0_PHY_1318_DATA)
	Data.Set D:((((Var.VALUE(&__J7_DDR0_SS_BASE)+Var.VALUE(&__DDRSS_PHY_Core_REGISTER_BLOCK__OFFS))+Var.VALUE(&__DDRSS_PHY_1319__SFR_OFFS)))) %Long Var.VALUE(&__DDRSS0_PHY_1319_DATA)
	Data.Set D:((((Var.VALUE(&__J7_DDR0_SS_BASE)+Var.VALUE(&__DDRSS_PHY_Core_REGISTER_BLOCK__OFFS))+Var.VALUE(&__DDRSS_PHY_1320__SFR_OFFS)))) %Long Var.VALUE(&__DDRSS0_PHY_1320_DATA)
	Data.Set D:((((Var.VALUE(&__J7_DDR0_SS_BASE)+Var.VALUE(&__DDRSS_PHY_Core_REGISTER_BLOCK__OFFS))+Var.VALUE(&__DDRSS_PHY_1321__SFR_OFFS)))) %Long Var.VALUE(&__DDRSS0_PHY_1321_DATA)
	Data.Set D:((((Var.VALUE(&__J7_DDR0_SS_BASE)+Var.VALUE(&__DDRSS_PHY_Core_REGISTER_BLOCK__OFFS))+Var.VALUE(&__DDRSS_PHY_1322__SFR_OFFS)))) %Long Var.VALUE(&__DDRSS0_PHY_1322_DATA)
	Data.Set D:((((Var.VALUE(&__J7_DDR0_SS_BASE)+Var.VALUE(&__DDRSS_PHY_Core_REGISTER_BLOCK__OFFS))+Var.VALUE(&__DDRSS_PHY_1323__SFR_OFFS)))) %Long Var.VALUE(&__DDRSS0_PHY_1323_DATA)
	Data.Set D:((((Var.VALUE(&__J7_DDR0_SS_BASE)+Var.VALUE(&__DDRSS_PHY_Core_REGISTER_BLOCK__OFFS))+Var.VALUE(&__DDRSS_PHY_1324__SFR_OFFS)))) %Long Var.VALUE(&__DDRSS0_PHY_1324_DATA)
	Data.Set D:((((Var.VALUE(&__J7_DDR0_SS_BASE)+Var.VALUE(&__DDRSS_PHY_Core_REGISTER_BLOCK__OFFS))+Var.VALUE(&__DDRSS_PHY_1325__SFR_OFFS)))) %Long Var.VALUE(&__DDRSS0_PHY_1325_DATA)
	Data.Set D:((((Var.VALUE(&__J7_DDR0_SS_BASE)+Var.VALUE(&__DDRSS_PHY_Core_REGISTER_BLOCK__OFFS))+Var.VALUE(&__DDRSS_PHY_1326__SFR_OFFS)))) %Long Var.VALUE(&__DDRSS0_PHY_1326_DATA)
	Data.Set D:((((Var.VALUE(&__J7_DDR0_SS_BASE)+Var.VALUE(&__DDRSS_PHY_Core_REGISTER_BLOCK__OFFS))+Var.VALUE(&__DDRSS_PHY_1327__SFR_OFFS)))) %Long Var.VALUE(&__DDRSS0_PHY_1327_DATA)
	Data.Set D:((((Var.VALUE(&__J7_DDR0_SS_BASE)+Var.VALUE(&__DDRSS_PHY_Core_REGISTER_BLOCK__OFFS))+Var.VALUE(&__DDRSS_PHY_1328__SFR_OFFS)))) %Long Var.VALUE(&__DDRSS0_PHY_1328_DATA)
	Data.Set D:((((Var.VALUE(&__J7_DDR0_SS_BASE)+Var.VALUE(&__DDRSS_PHY_Core_REGISTER_BLOCK__OFFS))+Var.VALUE(&__DDRSS_PHY_1329__SFR_OFFS)))) %Long Var.VALUE(&__DDRSS0_PHY_1329_DATA)
	Data.Set D:((((Var.VALUE(&__J7_DDR0_SS_BASE)+Var.VALUE(&__DDRSS_PHY_Core_REGISTER_BLOCK__OFFS))+Var.VALUE(&__DDRSS_PHY_1330__SFR_OFFS)))) %Long Var.VALUE(&__DDRSS0_PHY_1330_DATA)
	Data.Set D:((((Var.VALUE(&__J7_DDR0_SS_BASE)+Var.VALUE(&__DDRSS_PHY_Core_REGISTER_BLOCK__OFFS))+Var.VALUE(&__DDRSS_PHY_1331__SFR_OFFS)))) %Long Var.VALUE(&__DDRSS0_PHY_1331_DATA)
	Data.Set D:((((Var.VALUE(&__J7_DDR0_SS_BASE)+Var.VALUE(&__DDRSS_PHY_Core_REGISTER_BLOCK__OFFS))+Var.VALUE(&__DDRSS_PHY_1332__SFR_OFFS)))) %Long Var.VALUE(&__DDRSS0_PHY_1332_DATA)
	Data.Set D:((((Var.VALUE(&__J7_DDR0_SS_BASE)+Var.VALUE(&__DDRSS_PHY_Core_REGISTER_BLOCK__OFFS))+Var.VALUE(&__DDRSS_PHY_1333__SFR_OFFS)))) %Long Var.VALUE(&__DDRSS0_PHY_1333_DATA)
	Data.Set D:((((Var.VALUE(&__J7_DDR0_SS_BASE)+Var.VALUE(&__DDRSS_PHY_Core_REGISTER_BLOCK__OFFS))+Var.VALUE(&__DDRSS_PHY_1334__SFR_OFFS)))) %Long Var.VALUE(&__DDRSS0_PHY_1334_DATA)
	Data.Set D:((((Var.VALUE(&__J7_DDR0_SS_BASE)+Var.VALUE(&__DDRSS_PHY_Core_REGISTER_BLOCK__OFFS))+Var.VALUE(&__DDRSS_PHY_1335__SFR_OFFS)))) %Long Var.VALUE(&__DDRSS0_PHY_1335_DATA)
	Data.Set D:((((Var.VALUE(&__J7_DDR0_SS_BASE)+Var.VALUE(&__DDRSS_PHY_Core_REGISTER_BLOCK__OFFS))+Var.VALUE(&__DDRSS_PHY_1336__SFR_OFFS)))) %Long Var.VALUE(&__DDRSS0_PHY_1336_DATA)
	Data.Set D:((((Var.VALUE(&__J7_DDR0_SS_BASE)+Var.VALUE(&__DDRSS_PHY_Core_REGISTER_BLOCK__OFFS))+Var.VALUE(&__DDRSS_PHY_1337__SFR_OFFS)))) %Long Var.VALUE(&__DDRSS0_PHY_1337_DATA)
	Data.Set D:((((Var.VALUE(&__J7_DDR0_SS_BASE)+Var.VALUE(&__DDRSS_PHY_Core_REGISTER_BLOCK__OFFS))+Var.VALUE(&__DDRSS_PHY_1338__SFR_OFFS)))) %Long Var.VALUE(&__DDRSS0_PHY_1338_DATA)
	Data.Set D:((((Var.VALUE(&__J7_DDR0_SS_BASE)+Var.VALUE(&__DDRSS_PHY_Core_REGISTER_BLOCK__OFFS))+Var.VALUE(&__DDRSS_PHY_1339__SFR_OFFS)))) %Long Var.VALUE(&__DDRSS0_PHY_1339_DATA)
	Data.Set D:((((Var.VALUE(&__J7_DDR0_SS_BASE)+Var.VALUE(&__DDRSS_PHY_Core_REGISTER_BLOCK__OFFS))+Var.VALUE(&__DDRSS_PHY_1340__SFR_OFFS)))) %Long Var.VALUE(&__DDRSS0_PHY_1340_DATA)
	Data.Set D:((((Var.VALUE(&__J7_DDR0_SS_BASE)+Var.VALUE(&__DDRSS_PHY_Core_REGISTER_BLOCK__OFFS))+Var.VALUE(&__DDRSS_PHY_1341__SFR_OFFS)))) %Long Var.VALUE(&__DDRSS0_PHY_1341_DATA)
	Data.Set D:((((Var.VALUE(&__J7_DDR0_SS_BASE)+Var.VALUE(&__DDRSS_PHY_Core_REGISTER_BLOCK__OFFS))+Var.VALUE(&__DDRSS_PHY_1342__SFR_OFFS)))) %Long Var.VALUE(&__DDRSS0_PHY_1342_DATA)
	Data.Set D:((((Var.VALUE(&__J7_DDR0_SS_BASE)+Var.VALUE(&__DDRSS_PHY_Core_REGISTER_BLOCK__OFFS))+Var.VALUE(&__DDRSS_PHY_1343__SFR_OFFS)))) %Long Var.VALUE(&__DDRSS0_PHY_1343_DATA)
	Data.Set D:((((Var.VALUE(&__J7_DDR0_SS_BASE)+Var.VALUE(&__DDRSS_PHY_Core_REGISTER_BLOCK__OFFS))+Var.VALUE(&__DDRSS_PHY_1344__SFR_OFFS)))) %Long Var.VALUE(&__DDRSS0_PHY_1344_DATA)
	Data.Set D:((((Var.VALUE(&__J7_DDR0_SS_BASE)+Var.VALUE(&__DDRSS_PHY_Core_REGISTER_BLOCK__OFFS))+Var.VALUE(&__DDRSS_PHY_1345__SFR_OFFS)))) %Long Var.VALUE(&__DDRSS0_PHY_1345_DATA)
	Data.Set D:((((Var.VALUE(&__J7_DDR0_SS_BASE)+Var.VALUE(&__DDRSS_PHY_Core_REGISTER_BLOCK__OFFS))+Var.VALUE(&__DDRSS_PHY_1346__SFR_OFFS)))) %Long Var.VALUE(&__DDRSS0_PHY_1346_DATA)
	Data.Set D:((((Var.VALUE(&__J7_DDR0_SS_BASE)+Var.VALUE(&__DDRSS_PHY_Core_REGISTER_BLOCK__OFFS))+Var.VALUE(&__DDRSS_PHY_1347__SFR_OFFS)))) %Long Var.VALUE(&__DDRSS0_PHY_1347_DATA)
	Data.Set D:((((Var.VALUE(&__J7_DDR0_SS_BASE)+Var.VALUE(&__DDRSS_PHY_Core_REGISTER_BLOCK__OFFS))+Var.VALUE(&__DDRSS_PHY_1348__SFR_OFFS)))) %Long Var.VALUE(&__DDRSS0_PHY_1348_DATA)
	Data.Set D:((((Var.VALUE(&__J7_DDR0_SS_BASE)+Var.VALUE(&__DDRSS_PHY_Core_REGISTER_BLOCK__OFFS))+Var.VALUE(&__DDRSS_PHY_1349__SFR_OFFS)))) %Long Var.VALUE(&__DDRSS0_PHY_1349_DATA)
	Data.Set D:((((Var.VALUE(&__J7_DDR0_SS_BASE)+Var.VALUE(&__DDRSS_PHY_Core_REGISTER_BLOCK__OFFS))+Var.VALUE(&__DDRSS_PHY_1350__SFR_OFFS)))) %Long Var.VALUE(&__DDRSS0_PHY_1350_DATA)
	Data.Set D:((((Var.VALUE(&__J7_DDR0_SS_BASE)+Var.VALUE(&__DDRSS_PHY_Core_REGISTER_BLOCK__OFFS))+Var.VALUE(&__DDRSS_PHY_1351__SFR_OFFS)))) %Long Var.VALUE(&__DDRSS0_PHY_1351_DATA)
	Data.Set D:((((Var.VALUE(&__J7_DDR0_SS_BASE)+Var.VALUE(&__DDRSS_PHY_Core_REGISTER_BLOCK__OFFS))+Var.VALUE(&__DDRSS_PHY_1352__SFR_OFFS)))) %Long Var.VALUE(&__DDRSS0_PHY_1352_DATA)
	Data.Set D:((((Var.VALUE(&__J7_DDR0_SS_BASE)+Var.VALUE(&__DDRSS_PHY_Core_REGISTER_BLOCK__OFFS))+Var.VALUE(&__DDRSS_PHY_1353__SFR_OFFS)))) %Long Var.VALUE(&__DDRSS0_PHY_1353_DATA)
	Data.Set D:((((Var.VALUE(&__J7_DDR0_SS_BASE)+Var.VALUE(&__DDRSS_PHY_Core_REGISTER_BLOCK__OFFS))+Var.VALUE(&__DDRSS_PHY_1354__SFR_OFFS)))) %Long Var.VALUE(&__DDRSS0_PHY_1354_DATA)
	Data.Set D:((((Var.VALUE(&__J7_DDR0_SS_BASE)+Var.VALUE(&__DDRSS_PHY_Core_REGISTER_BLOCK__OFFS))+Var.VALUE(&__DDRSS_PHY_1355__SFR_OFFS)))) %Long Var.VALUE(&__DDRSS0_PHY_1355_DATA)
	Data.Set D:((((Var.VALUE(&__J7_DDR0_SS_BASE)+Var.VALUE(&__DDRSS_PHY_Core_REGISTER_BLOCK__OFFS))+Var.VALUE(&__DDRSS_PHY_1356__SFR_OFFS)))) %Long Var.VALUE(&__DDRSS0_PHY_1356_DATA)
	Data.Set D:((((Var.VALUE(&__J7_DDR0_SS_BASE)+Var.VALUE(&__DDRSS_PHY_Core_REGISTER_BLOCK__OFFS))+Var.VALUE(&__DDRSS_PHY_1357__SFR_OFFS)))) %Long Var.VALUE(&__DDRSS0_PHY_1357_DATA)
	Data.Set D:((((Var.VALUE(&__J7_DDR0_SS_BASE)+Var.VALUE(&__DDRSS_PHY_Core_REGISTER_BLOCK__OFFS))+Var.VALUE(&__DDRSS_PHY_1358__SFR_OFFS)))) %Long Var.VALUE(&__DDRSS0_PHY_1358_DATA)
	Data.Set D:((((Var.VALUE(&__J7_DDR0_SS_BASE)+Var.VALUE(&__DDRSS_PHY_Core_REGISTER_BLOCK__OFFS))+Var.VALUE(&__DDRSS_PHY_1359__SFR_OFFS)))) %Long Var.VALUE(&__DDRSS0_PHY_1359_DATA)
	Data.Set D:((((Var.VALUE(&__J7_DDR0_SS_BASE)+Var.VALUE(&__DDRSS_PHY_Core_REGISTER_BLOCK__OFFS))+Var.VALUE(&__DDRSS_PHY_1360__SFR_OFFS)))) %Long Var.VALUE(&__DDRSS0_PHY_1360_DATA)
	Data.Set D:((((Var.VALUE(&__J7_DDR0_SS_BASE)+Var.VALUE(&__DDRSS_PHY_Core_REGISTER_BLOCK__OFFS))+Var.VALUE(&__DDRSS_PHY_1361__SFR_OFFS)))) %Long Var.VALUE(&__DDRSS0_PHY_1361_DATA)
	Data.Set D:((((Var.VALUE(&__J7_DDR0_SS_BASE)+Var.VALUE(&__DDRSS_PHY_Core_REGISTER_BLOCK__OFFS))+Var.VALUE(&__DDRSS_PHY_1362__SFR_OFFS)))) %Long Var.VALUE(&__DDRSS0_PHY_1362_DATA)
	Data.Set D:((((Var.VALUE(&__J7_DDR0_SS_BASE)+Var.VALUE(&__DDRSS_PHY_Core_REGISTER_BLOCK__OFFS))+Var.VALUE(&__DDRSS_PHY_1363__SFR_OFFS)))) %Long Var.VALUE(&__DDRSS0_PHY_1363_DATA)
	Data.Set D:((((Var.VALUE(&__J7_DDR0_SS_BASE)+Var.VALUE(&__DDRSS_PHY_Core_REGISTER_BLOCK__OFFS))+Var.VALUE(&__DDRSS_PHY_1364__SFR_OFFS)))) %Long Var.VALUE(&__DDRSS0_PHY_1364_DATA)
	Data.Set D:((((Var.VALUE(&__J7_DDR0_SS_BASE)+Var.VALUE(&__DDRSS_PHY_Core_REGISTER_BLOCK__OFFS))+Var.VALUE(&__DDRSS_PHY_1365__SFR_OFFS)))) %Long Var.VALUE(&__DDRSS0_PHY_1365_DATA)
	Data.Set D:((((Var.VALUE(&__J7_DDR0_SS_BASE)+Var.VALUE(&__DDRSS_PHY_Core_REGISTER_BLOCK__OFFS))+Var.VALUE(&__DDRSS_PHY_1366__SFR_OFFS)))) %Long Var.VALUE(&__DDRSS0_PHY_1366_DATA)
	Data.Set D:((((Var.VALUE(&__J7_DDR0_SS_BASE)+Var.VALUE(&__DDRSS_PHY_Core_REGISTER_BLOCK__OFFS))+Var.VALUE(&__DDRSS_PHY_1367__SFR_OFFS)))) %Long Var.VALUE(&__DDRSS0_PHY_1367_DATA)
	Data.Set D:((((Var.VALUE(&__J7_DDR0_SS_BASE)+Var.VALUE(&__DDRSS_PHY_Core_REGISTER_BLOCK__OFFS))+Var.VALUE(&__DDRSS_PHY_1368__SFR_OFFS)))) %Long Var.VALUE(&__DDRSS0_PHY_1368_DATA)
	Data.Set D:((((Var.VALUE(&__J7_DDR0_SS_BASE)+Var.VALUE(&__DDRSS_PHY_Core_REGISTER_BLOCK__OFFS))+Var.VALUE(&__DDRSS_PHY_1369__SFR_OFFS)))) %Long Var.VALUE(&__DDRSS0_PHY_1369_DATA)
	Data.Set D:((((Var.VALUE(&__J7_DDR0_SS_BASE)+Var.VALUE(&__DDRSS_PHY_Core_REGISTER_BLOCK__OFFS))+Var.VALUE(&__DDRSS_PHY_1370__SFR_OFFS)))) %Long Var.VALUE(&__DDRSS0_PHY_1370_DATA)
	Data.Set D:((((Var.VALUE(&__J7_DDR0_SS_BASE)+Var.VALUE(&__DDRSS_PHY_Core_REGISTER_BLOCK__OFFS))+Var.VALUE(&__DDRSS_PHY_1371__SFR_OFFS)))) %Long Var.VALUE(&__DDRSS0_PHY_1371_DATA)
	Data.Set D:((((Var.VALUE(&__J7_DDR0_SS_BASE)+Var.VALUE(&__DDRSS_PHY_Core_REGISTER_BLOCK__OFFS))+Var.VALUE(&__DDRSS_PHY_1372__SFR_OFFS)))) %Long Var.VALUE(&__DDRSS0_PHY_1372_DATA)
	Data.Set D:((((Var.VALUE(&__J7_DDR0_SS_BASE)+Var.VALUE(&__DDRSS_PHY_Core_REGISTER_BLOCK__OFFS))+Var.VALUE(&__DDRSS_PHY_1373__SFR_OFFS)))) %Long Var.VALUE(&__DDRSS0_PHY_1373_DATA)
	Data.Set D:((((Var.VALUE(&__J7_DDR0_SS_BASE)+Var.VALUE(&__DDRSS_PHY_Core_REGISTER_BLOCK__OFFS))+Var.VALUE(&__DDRSS_PHY_1374__SFR_OFFS)))) %Long Var.VALUE(&__DDRSS0_PHY_1374_DATA)
	Data.Set D:((((Var.VALUE(&__J7_DDR0_SS_BASE)+Var.VALUE(&__DDRSS_PHY_Core_REGISTER_BLOCK__OFFS))+Var.VALUE(&__DDRSS_PHY_1375__SFR_OFFS)))) %Long Var.VALUE(&__DDRSS0_PHY_1375_DATA)
	Data.Set D:((((Var.VALUE(&__J7_DDR0_SS_BASE)+Var.VALUE(&__DDRSS_PHY_Core_REGISTER_BLOCK__OFFS))+Var.VALUE(&__DDRSS_PHY_1376__SFR_OFFS)))) %Long Var.VALUE(&__DDRSS0_PHY_1376_DATA)
	Data.Set D:((((Var.VALUE(&__J7_DDR0_SS_BASE)+Var.VALUE(&__DDRSS_PHY_Core_REGISTER_BLOCK__OFFS))+Var.VALUE(&__DDRSS_PHY_1377__SFR_OFFS)))) %Long Var.VALUE(&__DDRSS0_PHY_1377_DATA)
	Data.Set D:((((Var.VALUE(&__J7_DDR0_SS_BASE)+Var.VALUE(&__DDRSS_PHY_Core_REGISTER_BLOCK__OFFS))+Var.VALUE(&__DDRSS_PHY_1378__SFR_OFFS)))) %Long Var.VALUE(&__DDRSS0_PHY_1378_DATA)
	Data.Set D:((((Var.VALUE(&__J7_DDR0_SS_BASE)+Var.VALUE(&__DDRSS_PHY_Core_REGISTER_BLOCK__OFFS))+Var.VALUE(&__DDRSS_PHY_1379__SFR_OFFS)))) %Long Var.VALUE(&__DDRSS0_PHY_1379_DATA)
	Data.Set D:((((Var.VALUE(&__J7_DDR0_SS_BASE)+Var.VALUE(&__DDRSS_PHY_Core_REGISTER_BLOCK__OFFS))+Var.VALUE(&__DDRSS_PHY_1380__SFR_OFFS)))) %Long Var.VALUE(&__DDRSS0_PHY_1380_DATA)
	Data.Set D:((((Var.VALUE(&__J7_DDR0_SS_BASE)+Var.VALUE(&__DDRSS_PHY_Core_REGISTER_BLOCK__OFFS))+Var.VALUE(&__DDRSS_PHY_1381__SFR_OFFS)))) %Long Var.VALUE(&__DDRSS0_PHY_1381_DATA)
	Data.Set D:((((Var.VALUE(&__J7_DDR0_SS_BASE)+Var.VALUE(&__DDRSS_PHY_Core_REGISTER_BLOCK__OFFS))+Var.VALUE(&__DDRSS_PHY_1382__SFR_OFFS)))) %Long Var.VALUE(&__DDRSS0_PHY_1382_DATA)
	Data.Set D:((((Var.VALUE(&__J7_DDR0_SS_BASE)+Var.VALUE(&__DDRSS_PHY_Core_REGISTER_BLOCK__OFFS))+Var.VALUE(&__DDRSS_PHY_1383__SFR_OFFS)))) %Long Var.VALUE(&__DDRSS0_PHY_1383_DATA)
	Data.Set D:((((Var.VALUE(&__J7_DDR0_SS_BASE)+Var.VALUE(&__DDRSS_PHY_Core_REGISTER_BLOCK__OFFS))+Var.VALUE(&__DDRSS_PHY_1384__SFR_OFFS)))) %Long Var.VALUE(&__DDRSS0_PHY_1384_DATA)
	Data.Set D:((((Var.VALUE(&__J7_DDR0_SS_BASE)+Var.VALUE(&__DDRSS_PHY_Core_REGISTER_BLOCK__OFFS))+Var.VALUE(&__DDRSS_PHY_1385__SFR_OFFS)))) %Long Var.VALUE(&__DDRSS0_PHY_1385_DATA)
	Data.Set D:((((Var.VALUE(&__J7_DDR0_SS_BASE)+Var.VALUE(&__DDRSS_PHY_Core_REGISTER_BLOCK__OFFS))+Var.VALUE(&__DDRSS_PHY_1386__SFR_OFFS)))) %Long Var.VALUE(&__DDRSS0_PHY_1386_DATA)
	Data.Set D:((((Var.VALUE(&__J7_DDR0_SS_BASE)+Var.VALUE(&__DDRSS_PHY_Core_REGISTER_BLOCK__OFFS))+Var.VALUE(&__DDRSS_PHY_1387__SFR_OFFS)))) %Long Var.VALUE(&__DDRSS0_PHY_1387_DATA)
	Data.Set D:((((Var.VALUE(&__J7_DDR0_SS_BASE)+Var.VALUE(&__DDRSS_PHY_Core_REGISTER_BLOCK__OFFS))+Var.VALUE(&__DDRSS_PHY_1388__SFR_OFFS)))) %Long Var.VALUE(&__DDRSS0_PHY_1388_DATA)
	Data.Set D:((((Var.VALUE(&__J7_DDR0_SS_BASE)+Var.VALUE(&__DDRSS_PHY_Core_REGISTER_BLOCK__OFFS))+Var.VALUE(&__DDRSS_PHY_1389__SFR_OFFS)))) %Long Var.VALUE(&__DDRSS0_PHY_1389_DATA)
	Data.Set D:((((Var.VALUE(&__J7_DDR0_SS_BASE)+Var.VALUE(&__DDRSS_PHY_Core_REGISTER_BLOCK__OFFS))+Var.VALUE(&__DDRSS_PHY_1390__SFR_OFFS)))) %Long Var.VALUE(&__DDRSS0_PHY_1390_DATA)
	Data.Set D:((((Var.VALUE(&__J7_DDR0_SS_BASE)+Var.VALUE(&__DDRSS_PHY_Core_REGISTER_BLOCK__OFFS))+Var.VALUE(&__DDRSS_PHY_1391__SFR_OFFS)))) %Long Var.VALUE(&__DDRSS0_PHY_1391_DATA)
	Data.Set D:((((Var.VALUE(&__J7_DDR0_SS_BASE)+Var.VALUE(&__DDRSS_PHY_Core_REGISTER_BLOCK__OFFS))+Var.VALUE(&__DDRSS_PHY_1392__SFR_OFFS)))) %Long Var.VALUE(&__DDRSS0_PHY_1392_DATA)
	Data.Set D:((((Var.VALUE(&__J7_DDR0_SS_BASE)+Var.VALUE(&__DDRSS_PHY_Core_REGISTER_BLOCK__OFFS))+Var.VALUE(&__DDRSS_PHY_1393__SFR_OFFS)))) %Long Var.VALUE(&__DDRSS0_PHY_1393_DATA)
	Data.Set D:((((Var.VALUE(&__J7_DDR0_SS_BASE)+Var.VALUE(&__DDRSS_PHY_Core_REGISTER_BLOCK__OFFS))+Var.VALUE(&__DDRSS_PHY_1394__SFR_OFFS)))) %Long Var.VALUE(&__DDRSS0_PHY_1394_DATA)
	Data.Set D:((((Var.VALUE(&__J7_DDR0_SS_BASE)+Var.VALUE(&__DDRSS_PHY_Core_REGISTER_BLOCK__OFFS))+Var.VALUE(&__DDRSS_PHY_1395__SFR_OFFS)))) %Long Var.VALUE(&__DDRSS0_PHY_1395_DATA)
	Data.Set D:((((Var.VALUE(&__J7_DDR0_SS_BASE)+Var.VALUE(&__DDRSS_PHY_Core_REGISTER_BLOCK__OFFS))+Var.VALUE(&__DDRSS_PHY_1396__SFR_OFFS)))) %Long Var.VALUE(&__DDRSS0_PHY_1396_DATA)
	Data.Set D:((((Var.VALUE(&__J7_DDR0_SS_BASE)+Var.VALUE(&__DDRSS_PHY_Core_REGISTER_BLOCK__OFFS))+Var.VALUE(&__DDRSS_PHY_1397__SFR_OFFS)))) %Long Var.VALUE(&__DDRSS0_PHY_1397_DATA)
	Data.Set D:((((Var.VALUE(&__J7_DDR0_SS_BASE)+Var.VALUE(&__DDRSS_PHY_Core_REGISTER_BLOCK__OFFS))+Var.VALUE(&__DDRSS_PHY_1398__SFR_OFFS)))) %Long Var.VALUE(&__DDRSS0_PHY_1398_DATA)
	Data.Set D:((((Var.VALUE(&__J7_DDR0_SS_BASE)+Var.VALUE(&__DDRSS_PHY_Core_REGISTER_BLOCK__OFFS))+Var.VALUE(&__DDRSS_PHY_1399__SFR_OFFS)))) %Long Var.VALUE(&__DDRSS0_PHY_1399_DATA)
	Data.Set D:((((Var.VALUE(&__J7_DDR0_SS_BASE)+Var.VALUE(&__DDRSS_PHY_Core_REGISTER_BLOCK__OFFS))+Var.VALUE(&__DDRSS_PHY_1400__SFR_OFFS)))) %Long Var.VALUE(&__DDRSS0_PHY_1400_DATA)
	Data.Set D:((((Var.VALUE(&__J7_DDR0_SS_BASE)+Var.VALUE(&__DDRSS_PHY_Core_REGISTER_BLOCK__OFFS))+Var.VALUE(&__DDRSS_PHY_1401__SFR_OFFS)))) %Long Var.VALUE(&__DDRSS0_PHY_1401_DATA)
	Data.Set D:((((Var.VALUE(&__J7_DDR0_SS_BASE)+Var.VALUE(&__DDRSS_PHY_Core_REGISTER_BLOCK__OFFS))+Var.VALUE(&__DDRSS_PHY_1402__SFR_OFFS)))) %Long Var.VALUE(&__DDRSS0_PHY_1402_DATA)
	Data.Set D:((((Var.VALUE(&__J7_DDR0_SS_BASE)+Var.VALUE(&__DDRSS_PHY_Core_REGISTER_BLOCK__OFFS))+Var.VALUE(&__DDRSS_PHY_1403__SFR_OFFS)))) %Long Var.VALUE(&__DDRSS0_PHY_1403_DATA)
	Data.Set D:((((Var.VALUE(&__J7_DDR0_SS_BASE)+Var.VALUE(&__DDRSS_PHY_Core_REGISTER_BLOCK__OFFS))+Var.VALUE(&__DDRSS_PHY_1404__SFR_OFFS)))) %Long Var.VALUE(&__DDRSS0_PHY_1404_DATA)
	Data.Set D:((((Var.VALUE(&__J7_DDR0_SS_BASE)+Var.VALUE(&__DDRSS_PHY_Core_REGISTER_BLOCK__OFFS))+Var.VALUE(&__DDRSS_PHY_1405__SFR_OFFS)))) %Long Var.VALUE(&__DDRSS0_PHY_1405_DATA)
	Data.Set D:((((Var.VALUE(&__J7_DDR0_SS_BASE)+Var.VALUE(&__DDRSS_PHY_Core_REGISTER_BLOCK__OFFS))+Var.VALUE(&__DDRSS_PHY_1406__SFR_OFFS)))) %Long Var.VALUE(&__DDRSS0_PHY_1406_DATA)
	Data.Set D:((((Var.VALUE(&__J7_DDR0_SS_BASE)+Var.VALUE(&__DDRSS_PHY_Core_REGISTER_BLOCK__OFFS))+Var.VALUE(&__DDRSS_PHY_1407__SFR_OFFS)))) %Long Var.VALUE(&__DDRSS0_PHY_1407_DATA)
	Data.Set D:((((Var.VALUE(&__J7_DDR0_SS_BASE)+Var.VALUE(&__DDRSS_PHY_Core_REGISTER_BLOCK__OFFS))+Var.VALUE(&__DDRSS_PHY_1408__SFR_OFFS)))) %Long Var.VALUE(&__DDRSS0_PHY_1408_DATA)
	Data.Set D:((((Var.VALUE(&__J7_DDR0_SS_BASE)+Var.VALUE(&__DDRSS_PHY_Core_REGISTER_BLOCK__OFFS))+Var.VALUE(&__DDRSS_PHY_1409__SFR_OFFS)))) %Long Var.VALUE(&__DDRSS0_PHY_1409_DATA)
	Data.Set D:((((Var.VALUE(&__J7_DDR0_SS_BASE)+Var.VALUE(&__DDRSS_PHY_Core_REGISTER_BLOCK__OFFS))+Var.VALUE(&__DDRSS_PHY_1410__SFR_OFFS)))) %Long Var.VALUE(&__DDRSS0_PHY_1410_DATA)
	Data.Set D:((((Var.VALUE(&__J7_DDR0_SS_BASE)+Var.VALUE(&__DDRSS_PHY_Core_REGISTER_BLOCK__OFFS))+Var.VALUE(&__DDRSS_PHY_1411__SFR_OFFS)))) %Long Var.VALUE(&__DDRSS0_PHY_1411_DATA)
	Data.Set D:((((Var.VALUE(&__J7_DDR0_SS_BASE)+Var.VALUE(&__DDRSS_PHY_Core_REGISTER_BLOCK__OFFS))+Var.VALUE(&__DDRSS_PHY_1412__SFR_OFFS)))) %Long Var.VALUE(&__DDRSS0_PHY_1412_DATA)
	Data.Set D:((((Var.VALUE(&__J7_DDR0_SS_BASE)+Var.VALUE(&__DDRSS_PHY_Core_REGISTER_BLOCK__OFFS))+Var.VALUE(&__DDRSS_PHY_1413__SFR_OFFS)))) %Long Var.VALUE(&__DDRSS0_PHY_1413_DATA)
	Data.Set D:((((Var.VALUE(&__J7_DDR0_SS_BASE)+Var.VALUE(&__DDRSS_PHY_Core_REGISTER_BLOCK__OFFS))+Var.VALUE(&__DDRSS_PHY_1414__SFR_OFFS)))) %Long Var.VALUE(&__DDRSS0_PHY_1414_DATA)
	Data.Set D:((((Var.VALUE(&__J7_DDR0_SS_BASE)+Var.VALUE(&__DDRSS_PHY_Core_REGISTER_BLOCK__OFFS))+Var.VALUE(&__DDRSS_PHY_1415__SFR_OFFS)))) %Long Var.VALUE(&__DDRSS0_PHY_1415_DATA)
	Data.Set D:((((Var.VALUE(&__J7_DDR0_SS_BASE)+Var.VALUE(&__DDRSS_PHY_Core_REGISTER_BLOCK__OFFS))+Var.VALUE(&__DDRSS_PHY_1416__SFR_OFFS)))) %Long Var.VALUE(&__DDRSS0_PHY_1416_DATA)
	Data.Set D:((((Var.VALUE(&__J7_DDR0_SS_BASE)+Var.VALUE(&__DDRSS_PHY_Core_REGISTER_BLOCK__OFFS))+Var.VALUE(&__DDRSS_PHY_1417__SFR_OFFS)))) %Long Var.VALUE(&__DDRSS0_PHY_1417_DATA)
	Data.Set D:((((Var.VALUE(&__J7_DDR0_SS_BASE)+Var.VALUE(&__DDRSS_PHY_Core_REGISTER_BLOCK__OFFS))+Var.VALUE(&__DDRSS_PHY_1418__SFR_OFFS)))) %Long Var.VALUE(&__DDRSS0_PHY_1418_DATA)
	Data.Set D:((((Var.VALUE(&__J7_DDR0_SS_BASE)+Var.VALUE(&__DDRSS_PHY_Core_REGISTER_BLOCK__OFFS))+Var.VALUE(&__DDRSS_PHY_1419__SFR_OFFS)))) %Long Var.VALUE(&__DDRSS0_PHY_1419_DATA)
	Data.Set D:((((Var.VALUE(&__J7_DDR0_SS_BASE)+Var.VALUE(&__DDRSS_PHY_Core_REGISTER_BLOCK__OFFS))+Var.VALUE(&__DDRSS_PHY_1420__SFR_OFFS)))) %Long Var.VALUE(&__DDRSS0_PHY_1420_DATA)
	Data.Set D:((((Var.VALUE(&__J7_DDR0_SS_BASE)+Var.VALUE(&__DDRSS_PHY_Core_REGISTER_BLOCK__OFFS))+Var.VALUE(&__DDRSS_PHY_1421__SFR_OFFS)))) %Long Var.VALUE(&__DDRSS0_PHY_1421_DATA)
	Data.Set D:((((Var.VALUE(&__J7_DDR0_SS_BASE)+Var.VALUE(&__DDRSS_PHY_Core_REGISTER_BLOCK__OFFS))+Var.VALUE(&__DDRSS_PHY_1422__SFR_OFFS)))) %Long Var.VALUE(&__DDRSS0_PHY_1422_DATA)
	IF (&__PRE_SILICON!=0)
	(
		Var.NEWLOCAL char[128] \strtmp = "--->>> Pre-SILICON SIMULATION: Manual modification by Rajesh... <<<---\n"
		GOSUB printf Var.String(\strtmp)
		
		Data.Set D:(((Var.VALUE(&__J7_DDR0_SS_BASE)+Var.VALUE(&__DDRSS_CTL_139__SFR_OFFS)))) %Long ((Var.VALUE(&__DDRSS0_CTL_139_DATA)&0xFEFFFFFF))
		Data.Set D:(((Var.VALUE(&__J7_DDR0_SS_BASE)+Var.VALUE(&__DDRSS_CTL_140__SFR_OFFS)))) %Long ((Var.VALUE(&__DDRSS0_CTL_140_DATA)&0xFFFFFFFE))
		Data.Set D:(((Var.VALUE(&__J7_DDR0_SS_BASE)+Var.VALUE(&__DDRSS_CTL_148__SFR_OFFS)))) %Long ((Var.VALUE(&__DDRSS0_CTL_148_DATA)&0xFFFFFEFF))
		Data.Set D:(((Var.VALUE(&__J7_DDR0_SS_BASE)+Var.VALUE(&__DDRSS_CTL_227__SFR_OFFS)))) %Long (((Var.VALUE(&__DDRSS0_CTL_227_DATA)&0xFFE0FFFF)|0x00130000))
		Data.Set D:(((Var.VALUE(&__J7_DDR0_SS_BASE)+Var.VALUE(&__DDRSS_CTL_277__SFR_OFFS)))) %Long (((Var.VALUE(&__DDRSS0_CTL_277_DATA)&0xFFE0FFFF)|0x00140000))
		Data.Set D:(((Var.VALUE(&__J7_DDR0_SS_BASE)+Var.VALUE(&__DDRSS_CTL_377__SFR_OFFS)))) %Long ((Var.VALUE(&__DDRSS0_CTL_377_DATA)|0x00010000))
		Data.Set D:(((Var.VALUE(&__J7_DDR0_SS_BASE)+Var.VALUE(&__DDRSS_CTL_430__SFR_OFFS)))) %Long ((Var.VALUE(&__DDRSS0_CTL_430_DATA)&0xFFFEFFFF))
		Var.NEWLOCAL char[128] \strtmp = "--->>> Disable all trainig for pre-silicon simulation <<<---\n"
		GOSUB printf Var.String(\strtmp)
		
		Data.Set D:((((Var.VALUE(&__J7_DDR0_SS_BASE)+Var.VALUE(&__DDRSS_PI_REGISTER_BLOCK__OFFS))+Var.VALUE(&__DDRSS_PI_175__SFR_OFFS)))) %Long Var.VALUE(0x00000404)
		Data.Set D:((((Var.VALUE(&__J7_DDR0_SS_BASE)+Var.VALUE(&__DDRSS_PI_REGISTER_BLOCK__OFFS))+Var.VALUE(&__DDRSS_PI_176__SFR_OFFS)))) %Long Var.VALUE(0x00001500)
		Data.Set D:((((Var.VALUE(&__J7_DDR0_SS_BASE)+Var.VALUE(&__DDRSS_PI_REGISTER_BLOCK__OFFS))+Var.VALUE(&__DDRSS_PI_191__SFR_OFFS)))) %Long Var.VALUE(0x01000000)
		Data.Set D:((((Var.VALUE(&__J7_DDR0_SS_BASE)+Var.VALUE(&__DDRSS_PI_REGISTER_BLOCK__OFFS))+Var.VALUE(&__DDRSS_PI_212__SFR_OFFS)))) %Long Var.VALUE(0x00000001)
		Data.Set D:((((Var.VALUE(&__J7_DDR0_SS_BASE)+Var.VALUE(&__DDRSS_PI_REGISTER_BLOCK__OFFS))+Var.VALUE(&__DDRSS_PI_214__SFR_OFFS)))) %Long Var.VALUE(0x00011E1A)
		Data.Set D:((((Var.VALUE(&__J7_DDR0_SS_BASE)+Var.VALUE(&__DDRSS_PI_REGISTER_BLOCK__OFFS))+Var.VALUE(&__DDRSS_PI_217__SFR_OFFS)))) %Long Var.VALUE(0x09000001)
		Var.NEWLOCAL char[128] \strtmp = "--->>> Adjust the latencies for pre-silicon simulation <<<---\n"
		GOSUB printf Var.String(\strtmp)
		
		Data.Set D:((((Var.VALUE(&__J7_DDR0_SS_BASE)+Var.VALUE(&__DDRSS_Data_Slice_0_REGISTER_BLOCK__OFFS))+Var.VALUE(&__DDRSS_PHY_131__SFR_OFFS)))) %Long Var.VALUE(0x01A00000)
		Data.Set D:((((Var.VALUE(&__J7_DDR0_SS_BASE)+Var.VALUE(&__DDRSS_Data_Slice_1_REGISTER_BLOCK__OFFS))+Var.VALUE(&__DDRSS_PHY_387__SFR_OFFS)))) %Long Var.VALUE(0x01A00000)
		Data.Set D:((((Var.VALUE(&__J7_DDR0_SS_BASE)+Var.VALUE(&__DDRSS_Data_Slice_2_REGISTER_BLOCK__OFFS))+Var.VALUE(&__DDRSS_PHY_643__SFR_OFFS)))) %Long Var.VALUE(0x01A00000)
		Data.Set D:((((Var.VALUE(&__J7_DDR0_SS_BASE)+Var.VALUE(&__DDRSS_Data_Slice_3_REGISTER_BLOCK__OFFS))+Var.VALUE(&__DDRSS_PHY_899__SFR_OFFS)))) %Long Var.VALUE(0x01A00000)
	)
	Var.NEWLOCAL char[128] \strtmp = "--->>> DDR0 PHY programming completed... <<<---\n"
	GOSUB printf Var.String(\strtmp)
	
	RETURN
)

DDRSS1_Register_Init:
(
	// -- Program the DDR Controller
	Var.NEWLOCAL char[128] \strtmp = "--->>> DDR1 controller programming in progress.. <<<---\n"
	GOSUB printf Var.String(\strtmp)
	
	Data.Set D:(((Var.VALUE(&__J7_DDR1_SS_BASE)+Var.VALUE(&__DDRSS_CTL_0__SFR_OFFS)))) %Long Var.VALUE(&__DDRSS1_CTL_00_DATA)
	Data.Set D:(((Var.VALUE(&__J7_DDR1_SS_BASE)+Var.VALUE(&__DDRSS_CTL_1__SFR_OFFS)))) %Long Var.VALUE(&__DDRSS1_CTL_01_DATA)
	Data.Set D:(((Var.VALUE(&__J7_DDR1_SS_BASE)+Var.VALUE(&__DDRSS_CTL_2__SFR_OFFS)))) %Long Var.VALUE(&__DDRSS1_CTL_02_DATA)
	Data.Set D:(((Var.VALUE(&__J7_DDR1_SS_BASE)+Var.VALUE(&__DDRSS_CTL_3__SFR_OFFS)))) %Long Var.VALUE(&__DDRSS1_CTL_03_DATA)
	Data.Set D:(((Var.VALUE(&__J7_DDR1_SS_BASE)+Var.VALUE(&__DDRSS_CTL_4__SFR_OFFS)))) %Long Var.VALUE(&__DDRSS1_CTL_04_DATA)
	Data.Set D:(((Var.VALUE(&__J7_DDR1_SS_BASE)+Var.VALUE(&__DDRSS_CTL_5__SFR_OFFS)))) %Long Var.VALUE(&__DDRSS1_CTL_05_DATA)
	Data.Set D:(((Var.VALUE(&__J7_DDR1_SS_BASE)+Var.VALUE(&__DDRSS_CTL_6__SFR_OFFS)))) %Long Var.VALUE(&__DDRSS1_CTL_06_DATA)
	Data.Set D:(((Var.VALUE(&__J7_DDR1_SS_BASE)+Var.VALUE(&__DDRSS_CTL_7__SFR_OFFS)))) %Long Var.VALUE(&__DDRSS1_CTL_07_DATA)
	Data.Set D:(((Var.VALUE(&__J7_DDR1_SS_BASE)+Var.VALUE(&__DDRSS_CTL_8__SFR_OFFS)))) %Long Var.VALUE(&__DDRSS1_CTL_08_DATA)
	Data.Set D:(((Var.VALUE(&__J7_DDR1_SS_BASE)+Var.VALUE(&__DDRSS_CTL_9__SFR_OFFS)))) %Long Var.VALUE(&__DDRSS1_CTL_09_DATA)
	Data.Set D:(((Var.VALUE(&__J7_DDR1_SS_BASE)+Var.VALUE(&__DDRSS_CTL_10__SFR_OFFS)))) %Long Var.VALUE(&__DDRSS1_CTL_10_DATA)
	Data.Set D:(((Var.VALUE(&__J7_DDR1_SS_BASE)+Var.VALUE(&__DDRSS_CTL_11__SFR_OFFS)))) %Long Var.VALUE(&__DDRSS1_CTL_11_DATA)
	Data.Set D:(((Var.VALUE(&__J7_DDR1_SS_BASE)+Var.VALUE(&__DDRSS_CTL_12__SFR_OFFS)))) %Long Var.VALUE(&__DDRSS1_CTL_12_DATA)
	Data.Set D:(((Var.VALUE(&__J7_DDR1_SS_BASE)+Var.VALUE(&__DDRSS_CTL_13__SFR_OFFS)))) %Long Var.VALUE(&__DDRSS1_CTL_13_DATA)
	Data.Set D:(((Var.VALUE(&__J7_DDR1_SS_BASE)+Var.VALUE(&__DDRSS_CTL_14__SFR_OFFS)))) %Long Var.VALUE(&__DDRSS1_CTL_14_DATA)
	Data.Set D:(((Var.VALUE(&__J7_DDR1_SS_BASE)+Var.VALUE(&__DDRSS_CTL_15__SFR_OFFS)))) %Long Var.VALUE(&__DDRSS1_CTL_15_DATA)
	Data.Set D:(((Var.VALUE(&__J7_DDR1_SS_BASE)+Var.VALUE(&__DDRSS_CTL_16__SFR_OFFS)))) %Long Var.VALUE(&__DDRSS1_CTL_16_DATA)
	Data.Set D:(((Var.VALUE(&__J7_DDR1_SS_BASE)+Var.VALUE(&__DDRSS_CTL_17__SFR_OFFS)))) %Long Var.VALUE(&__DDRSS1_CTL_17_DATA)
	Data.Set D:(((Var.VALUE(&__J7_DDR1_SS_BASE)+Var.VALUE(&__DDRSS_CTL_18__SFR_OFFS)))) %Long Var.VALUE(&__DDRSS1_CTL_18_DATA)
	Data.Set D:(((Var.VALUE(&__J7_DDR1_SS_BASE)+Var.VALUE(&__DDRSS_CTL_19__SFR_OFFS)))) %Long Var.VALUE(&__DDRSS1_CTL_19_DATA)
	Data.Set D:(((Var.VALUE(&__J7_DDR1_SS_BASE)+Var.VALUE(&__DDRSS_CTL_20__SFR_OFFS)))) %Long Var.VALUE(&__DDRSS1_CTL_20_DATA)
	Data.Set D:(((Var.VALUE(&__J7_DDR1_SS_BASE)+Var.VALUE(&__DDRSS_CTL_21__SFR_OFFS)))) %Long Var.VALUE(&__DDRSS1_CTL_21_DATA)
	Data.Set D:(((Var.VALUE(&__J7_DDR1_SS_BASE)+Var.VALUE(&__DDRSS_CTL_22__SFR_OFFS)))) %Long Var.VALUE(&__DDRSS1_CTL_22_DATA)
	Data.Set D:(((Var.VALUE(&__J7_DDR1_SS_BASE)+Var.VALUE(&__DDRSS_CTL_23__SFR_OFFS)))) %Long Var.VALUE(&__DDRSS1_CTL_23_DATA)
	Data.Set D:(((Var.VALUE(&__J7_DDR1_SS_BASE)+Var.VALUE(&__DDRSS_CTL_24__SFR_OFFS)))) %Long Var.VALUE(&__DDRSS1_CTL_24_DATA)
	Data.Set D:(((Var.VALUE(&__J7_DDR1_SS_BASE)+Var.VALUE(&__DDRSS_CTL_25__SFR_OFFS)))) %Long Var.VALUE(&__DDRSS1_CTL_25_DATA)
	Data.Set D:(((Var.VALUE(&__J7_DDR1_SS_BASE)+Var.VALUE(&__DDRSS_CTL_26__SFR_OFFS)))) %Long Var.VALUE(&__DDRSS1_CTL_26_DATA)
	Data.Set D:(((Var.VALUE(&__J7_DDR1_SS_BASE)+Var.VALUE(&__DDRSS_CTL_27__SFR_OFFS)))) %Long Var.VALUE(&__DDRSS1_CTL_27_DATA)
	Data.Set D:(((Var.VALUE(&__J7_DDR1_SS_BASE)+Var.VALUE(&__DDRSS_CTL_28__SFR_OFFS)))) %Long Var.VALUE(&__DDRSS1_CTL_28_DATA)
	Data.Set D:(((Var.VALUE(&__J7_DDR1_SS_BASE)+Var.VALUE(&__DDRSS_CTL_29__SFR_OFFS)))) %Long Var.VALUE(&__DDRSS1_CTL_29_DATA)
	Data.Set D:(((Var.VALUE(&__J7_DDR1_SS_BASE)+Var.VALUE(&__DDRSS_CTL_30__SFR_OFFS)))) %Long Var.VALUE(&__DDRSS1_CTL_30_DATA)
	Data.Set D:(((Var.VALUE(&__J7_DDR1_SS_BASE)+Var.VALUE(&__DDRSS_CTL_31__SFR_OFFS)))) %Long Var.VALUE(&__DDRSS1_CTL_31_DATA)
	Data.Set D:(((Var.VALUE(&__J7_DDR1_SS_BASE)+Var.VALUE(&__DDRSS_CTL_32__SFR_OFFS)))) %Long Var.VALUE(&__DDRSS1_CTL_32_DATA)
	Data.Set D:(((Var.VALUE(&__J7_DDR1_SS_BASE)+Var.VALUE(&__DDRSS_CTL_33__SFR_OFFS)))) %Long Var.VALUE(&__DDRSS1_CTL_33_DATA)
	Data.Set D:(((Var.VALUE(&__J7_DDR1_SS_BASE)+Var.VALUE(&__DDRSS_CTL_34__SFR_OFFS)))) %Long Var.VALUE(&__DDRSS1_CTL_34_DATA)
	Data.Set D:(((Var.VALUE(&__J7_DDR1_SS_BASE)+Var.VALUE(&__DDRSS_CTL_35__SFR_OFFS)))) %Long Var.VALUE(&__DDRSS1_CTL_35_DATA)
	Data.Set D:(((Var.VALUE(&__J7_DDR1_SS_BASE)+Var.VALUE(&__DDRSS_CTL_36__SFR_OFFS)))) %Long Var.VALUE(&__DDRSS1_CTL_36_DATA)
	Data.Set D:(((Var.VALUE(&__J7_DDR1_SS_BASE)+Var.VALUE(&__DDRSS_CTL_37__SFR_OFFS)))) %Long Var.VALUE(&__DDRSS1_CTL_37_DATA)
	Data.Set D:(((Var.VALUE(&__J7_DDR1_SS_BASE)+Var.VALUE(&__DDRSS_CTL_38__SFR_OFFS)))) %Long Var.VALUE(&__DDRSS1_CTL_38_DATA)
	Data.Set D:(((Var.VALUE(&__J7_DDR1_SS_BASE)+Var.VALUE(&__DDRSS_CTL_39__SFR_OFFS)))) %Long Var.VALUE(&__DDRSS1_CTL_39_DATA)
	Data.Set D:(((Var.VALUE(&__J7_DDR1_SS_BASE)+Var.VALUE(&__DDRSS_CTL_40__SFR_OFFS)))) %Long Var.VALUE(&__DDRSS1_CTL_40_DATA)
	Data.Set D:(((Var.VALUE(&__J7_DDR1_SS_BASE)+Var.VALUE(&__DDRSS_CTL_41__SFR_OFFS)))) %Long Var.VALUE(&__DDRSS1_CTL_41_DATA)
	Data.Set D:(((Var.VALUE(&__J7_DDR1_SS_BASE)+Var.VALUE(&__DDRSS_CTL_42__SFR_OFFS)))) %Long Var.VALUE(&__DDRSS1_CTL_42_DATA)
	Data.Set D:(((Var.VALUE(&__J7_DDR1_SS_BASE)+Var.VALUE(&__DDRSS_CTL_43__SFR_OFFS)))) %Long Var.VALUE(&__DDRSS1_CTL_43_DATA)
	Data.Set D:(((Var.VALUE(&__J7_DDR1_SS_BASE)+Var.VALUE(&__DDRSS_CTL_44__SFR_OFFS)))) %Long Var.VALUE(&__DDRSS1_CTL_44_DATA)
	Data.Set D:(((Var.VALUE(&__J7_DDR1_SS_BASE)+Var.VALUE(&__DDRSS_CTL_45__SFR_OFFS)))) %Long Var.VALUE(&__DDRSS1_CTL_45_DATA)
	Data.Set D:(((Var.VALUE(&__J7_DDR1_SS_BASE)+Var.VALUE(&__DDRSS_CTL_46__SFR_OFFS)))) %Long Var.VALUE(&__DDRSS1_CTL_46_DATA)
	Data.Set D:(((Var.VALUE(&__J7_DDR1_SS_BASE)+Var.VALUE(&__DDRSS_CTL_47__SFR_OFFS)))) %Long Var.VALUE(&__DDRSS1_CTL_47_DATA)
	Data.Set D:(((Var.VALUE(&__J7_DDR1_SS_BASE)+Var.VALUE(&__DDRSS_CTL_48__SFR_OFFS)))) %Long Var.VALUE(&__DDRSS1_CTL_48_DATA)
	Data.Set D:(((Var.VALUE(&__J7_DDR1_SS_BASE)+Var.VALUE(&__DDRSS_CTL_49__SFR_OFFS)))) %Long Var.VALUE(&__DDRSS1_CTL_49_DATA)
	Data.Set D:(((Var.VALUE(&__J7_DDR1_SS_BASE)+Var.VALUE(&__DDRSS_CTL_50__SFR_OFFS)))) %Long Var.VALUE(&__DDRSS1_CTL_50_DATA)
	Data.Set D:(((Var.VALUE(&__J7_DDR1_SS_BASE)+Var.VALUE(&__DDRSS_CTL_51__SFR_OFFS)))) %Long Var.VALUE(&__DDRSS1_CTL_51_DATA)
	Data.Set D:(((Var.VALUE(&__J7_DDR1_SS_BASE)+Var.VALUE(&__DDRSS_CTL_52__SFR_OFFS)))) %Long Var.VALUE(&__DDRSS1_CTL_52_DATA)
	Data.Set D:(((Var.VALUE(&__J7_DDR1_SS_BASE)+Var.VALUE(&__DDRSS_CTL_53__SFR_OFFS)))) %Long Var.VALUE(&__DDRSS1_CTL_53_DATA)
	Data.Set D:(((Var.VALUE(&__J7_DDR1_SS_BASE)+Var.VALUE(&__DDRSS_CTL_54__SFR_OFFS)))) %Long Var.VALUE(&__DDRSS1_CTL_54_DATA)
	Data.Set D:(((Var.VALUE(&__J7_DDR1_SS_BASE)+Var.VALUE(&__DDRSS_CTL_55__SFR_OFFS)))) %Long Var.VALUE(&__DDRSS1_CTL_55_DATA)
	Data.Set D:(((Var.VALUE(&__J7_DDR1_SS_BASE)+Var.VALUE(&__DDRSS_CTL_56__SFR_OFFS)))) %Long Var.VALUE(&__DDRSS1_CTL_56_DATA)
	Data.Set D:(((Var.VALUE(&__J7_DDR1_SS_BASE)+Var.VALUE(&__DDRSS_CTL_57__SFR_OFFS)))) %Long Var.VALUE(&__DDRSS1_CTL_57_DATA)
	Data.Set D:(((Var.VALUE(&__J7_DDR1_SS_BASE)+Var.VALUE(&__DDRSS_CTL_58__SFR_OFFS)))) %Long Var.VALUE(&__DDRSS1_CTL_58_DATA)
	Data.Set D:(((Var.VALUE(&__J7_DDR1_SS_BASE)+Var.VALUE(&__DDRSS_CTL_59__SFR_OFFS)))) %Long Var.VALUE(&__DDRSS1_CTL_59_DATA)
	Data.Set D:(((Var.VALUE(&__J7_DDR1_SS_BASE)+Var.VALUE(&__DDRSS_CTL_60__SFR_OFFS)))) %Long Var.VALUE(&__DDRSS1_CTL_60_DATA)
	Data.Set D:(((Var.VALUE(&__J7_DDR1_SS_BASE)+Var.VALUE(&__DDRSS_CTL_61__SFR_OFFS)))) %Long Var.VALUE(&__DDRSS1_CTL_61_DATA)
	Data.Set D:(((Var.VALUE(&__J7_DDR1_SS_BASE)+Var.VALUE(&__DDRSS_CTL_62__SFR_OFFS)))) %Long Var.VALUE(&__DDRSS1_CTL_62_DATA)
	Data.Set D:(((Var.VALUE(&__J7_DDR1_SS_BASE)+Var.VALUE(&__DDRSS_CTL_63__SFR_OFFS)))) %Long Var.VALUE(&__DDRSS1_CTL_63_DATA)
	Data.Set D:(((Var.VALUE(&__J7_DDR1_SS_BASE)+Var.VALUE(&__DDRSS_CTL_64__SFR_OFFS)))) %Long Var.VALUE(&__DDRSS1_CTL_64_DATA)
	Data.Set D:(((Var.VALUE(&__J7_DDR1_SS_BASE)+Var.VALUE(&__DDRSS_CTL_65__SFR_OFFS)))) %Long Var.VALUE(&__DDRSS1_CTL_65_DATA)
	Data.Set D:(((Var.VALUE(&__J7_DDR1_SS_BASE)+Var.VALUE(&__DDRSS_CTL_66__SFR_OFFS)))) %Long Var.VALUE(&__DDRSS1_CTL_66_DATA)
	Data.Set D:(((Var.VALUE(&__J7_DDR1_SS_BASE)+Var.VALUE(&__DDRSS_CTL_67__SFR_OFFS)))) %Long Var.VALUE(&__DDRSS1_CTL_67_DATA)
	Data.Set D:(((Var.VALUE(&__J7_DDR1_SS_BASE)+Var.VALUE(&__DDRSS_CTL_68__SFR_OFFS)))) %Long Var.VALUE(&__DDRSS1_CTL_68_DATA)
	Data.Set D:(((Var.VALUE(&__J7_DDR1_SS_BASE)+Var.VALUE(&__DDRSS_CTL_69__SFR_OFFS)))) %Long Var.VALUE(&__DDRSS1_CTL_69_DATA)
	Data.Set D:(((Var.VALUE(&__J7_DDR1_SS_BASE)+Var.VALUE(&__DDRSS_CTL_70__SFR_OFFS)))) %Long Var.VALUE(&__DDRSS1_CTL_70_DATA)
	Data.Set D:(((Var.VALUE(&__J7_DDR1_SS_BASE)+Var.VALUE(&__DDRSS_CTL_71__SFR_OFFS)))) %Long Var.VALUE(&__DDRSS1_CTL_71_DATA)
	Data.Set D:(((Var.VALUE(&__J7_DDR1_SS_BASE)+Var.VALUE(&__DDRSS_CTL_72__SFR_OFFS)))) %Long Var.VALUE(&__DDRSS1_CTL_72_DATA)
	Data.Set D:(((Var.VALUE(&__J7_DDR1_SS_BASE)+Var.VALUE(&__DDRSS_CTL_73__SFR_OFFS)))) %Long Var.VALUE(&__DDRSS1_CTL_73_DATA)
	Data.Set D:(((Var.VALUE(&__J7_DDR1_SS_BASE)+Var.VALUE(&__DDRSS_CTL_74__SFR_OFFS)))) %Long Var.VALUE(&__DDRSS1_CTL_74_DATA)
	Data.Set D:(((Var.VALUE(&__J7_DDR1_SS_BASE)+Var.VALUE(&__DDRSS_CTL_75__SFR_OFFS)))) %Long Var.VALUE(&__DDRSS1_CTL_75_DATA)
	Data.Set D:(((Var.VALUE(&__J7_DDR1_SS_BASE)+Var.VALUE(&__DDRSS_CTL_76__SFR_OFFS)))) %Long Var.VALUE(&__DDRSS1_CTL_76_DATA)
	Data.Set D:(((Var.VALUE(&__J7_DDR1_SS_BASE)+Var.VALUE(&__DDRSS_CTL_77__SFR_OFFS)))) %Long Var.VALUE(&__DDRSS1_CTL_77_DATA)
	Data.Set D:(((Var.VALUE(&__J7_DDR1_SS_BASE)+Var.VALUE(&__DDRSS_CTL_78__SFR_OFFS)))) %Long Var.VALUE(&__DDRSS1_CTL_78_DATA)
	Data.Set D:(((Var.VALUE(&__J7_DDR1_SS_BASE)+Var.VALUE(&__DDRSS_CTL_79__SFR_OFFS)))) %Long Var.VALUE(&__DDRSS1_CTL_79_DATA)
	Data.Set D:(((Var.VALUE(&__J7_DDR1_SS_BASE)+Var.VALUE(&__DDRSS_CTL_80__SFR_OFFS)))) %Long Var.VALUE(&__DDRSS1_CTL_80_DATA)
	Data.Set D:(((Var.VALUE(&__J7_DDR1_SS_BASE)+Var.VALUE(&__DDRSS_CTL_81__SFR_OFFS)))) %Long Var.VALUE(&__DDRSS1_CTL_81_DATA)
	Data.Set D:(((Var.VALUE(&__J7_DDR1_SS_BASE)+Var.VALUE(&__DDRSS_CTL_82__SFR_OFFS)))) %Long Var.VALUE(&__DDRSS1_CTL_82_DATA)
	Data.Set D:(((Var.VALUE(&__J7_DDR1_SS_BASE)+Var.VALUE(&__DDRSS_CTL_83__SFR_OFFS)))) %Long Var.VALUE(&__DDRSS1_CTL_83_DATA)
	Data.Set D:(((Var.VALUE(&__J7_DDR1_SS_BASE)+Var.VALUE(&__DDRSS_CTL_84__SFR_OFFS)))) %Long Var.VALUE(&__DDRSS1_CTL_84_DATA)
	Data.Set D:(((Var.VALUE(&__J7_DDR1_SS_BASE)+Var.VALUE(&__DDRSS_CTL_85__SFR_OFFS)))) %Long Var.VALUE(&__DDRSS1_CTL_85_DATA)
	Data.Set D:(((Var.VALUE(&__J7_DDR1_SS_BASE)+Var.VALUE(&__DDRSS_CTL_86__SFR_OFFS)))) %Long Var.VALUE(&__DDRSS1_CTL_86_DATA)
	Data.Set D:(((Var.VALUE(&__J7_DDR1_SS_BASE)+Var.VALUE(&__DDRSS_CTL_87__SFR_OFFS)))) %Long Var.VALUE(&__DDRSS1_CTL_87_DATA)
	Data.Set D:(((Var.VALUE(&__J7_DDR1_SS_BASE)+Var.VALUE(&__DDRSS_CTL_88__SFR_OFFS)))) %Long Var.VALUE(&__DDRSS1_CTL_88_DATA)
	Data.Set D:(((Var.VALUE(&__J7_DDR1_SS_BASE)+Var.VALUE(&__DDRSS_CTL_89__SFR_OFFS)))) %Long Var.VALUE(&__DDRSS1_CTL_89_DATA)
	Data.Set D:(((Var.VALUE(&__J7_DDR1_SS_BASE)+Var.VALUE(&__DDRSS_CTL_90__SFR_OFFS)))) %Long Var.VALUE(&__DDRSS1_CTL_90_DATA)
	Data.Set D:(((Var.VALUE(&__J7_DDR1_SS_BASE)+Var.VALUE(&__DDRSS_CTL_91__SFR_OFFS)))) %Long Var.VALUE(&__DDRSS1_CTL_91_DATA)
	Data.Set D:(((Var.VALUE(&__J7_DDR1_SS_BASE)+Var.VALUE(&__DDRSS_CTL_92__SFR_OFFS)))) %Long Var.VALUE(&__DDRSS1_CTL_92_DATA)
	Data.Set D:(((Var.VALUE(&__J7_DDR1_SS_BASE)+Var.VALUE(&__DDRSS_CTL_93__SFR_OFFS)))) %Long Var.VALUE(&__DDRSS1_CTL_93_DATA)
	Data.Set D:(((Var.VALUE(&__J7_DDR1_SS_BASE)+Var.VALUE(&__DDRSS_CTL_94__SFR_OFFS)))) %Long Var.VALUE(&__DDRSS1_CTL_94_DATA)
	Data.Set D:(((Var.VALUE(&__J7_DDR1_SS_BASE)+Var.VALUE(&__DDRSS_CTL_95__SFR_OFFS)))) %Long Var.VALUE(&__DDRSS1_CTL_95_DATA)
	Data.Set D:(((Var.VALUE(&__J7_DDR1_SS_BASE)+Var.VALUE(&__DDRSS_CTL_96__SFR_OFFS)))) %Long Var.VALUE(&__DDRSS1_CTL_96_DATA)
	Data.Set D:(((Var.VALUE(&__J7_DDR1_SS_BASE)+Var.VALUE(&__DDRSS_CTL_97__SFR_OFFS)))) %Long Var.VALUE(&__DDRSS1_CTL_97_DATA)
	Data.Set D:(((Var.VALUE(&__J7_DDR1_SS_BASE)+Var.VALUE(&__DDRSS_CTL_98__SFR_OFFS)))) %Long Var.VALUE(&__DDRSS1_CTL_98_DATA)
	Data.Set D:(((Var.VALUE(&__J7_DDR1_SS_BASE)+Var.VALUE(&__DDRSS_CTL_99__SFR_OFFS)))) %Long Var.VALUE(&__DDRSS1_CTL_99_DATA)
	Data.Set D:(((Var.VALUE(&__J7_DDR1_SS_BASE)+Var.VALUE(&__DDRSS_CTL_100__SFR_OFFS)))) %Long Var.VALUE(&__DDRSS1_CTL_100_DATA)
	Data.Set D:(((Var.VALUE(&__J7_DDR1_SS_BASE)+Var.VALUE(&__DDRSS_CTL_101__SFR_OFFS)))) %Long Var.VALUE(&__DDRSS1_CTL_101_DATA)
	Data.Set D:(((Var.VALUE(&__J7_DDR1_SS_BASE)+Var.VALUE(&__DDRSS_CTL_102__SFR_OFFS)))) %Long Var.VALUE(&__DDRSS1_CTL_102_DATA)
	Data.Set D:(((Var.VALUE(&__J7_DDR1_SS_BASE)+Var.VALUE(&__DDRSS_CTL_103__SFR_OFFS)))) %Long Var.VALUE(&__DDRSS1_CTL_103_DATA)
	Data.Set D:(((Var.VALUE(&__J7_DDR1_SS_BASE)+Var.VALUE(&__DDRSS_CTL_104__SFR_OFFS)))) %Long Var.VALUE(&__DDRSS1_CTL_104_DATA)
	Data.Set D:(((Var.VALUE(&__J7_DDR1_SS_BASE)+Var.VALUE(&__DDRSS_CTL_105__SFR_OFFS)))) %Long Var.VALUE(&__DDRSS1_CTL_105_DATA)
	Data.Set D:(((Var.VALUE(&__J7_DDR1_SS_BASE)+Var.VALUE(&__DDRSS_CTL_106__SFR_OFFS)))) %Long Var.VALUE(&__DDRSS1_CTL_106_DATA)
	Data.Set D:(((Var.VALUE(&__J7_DDR1_SS_BASE)+Var.VALUE(&__DDRSS_CTL_107__SFR_OFFS)))) %Long Var.VALUE(&__DDRSS1_CTL_107_DATA)
	Data.Set D:(((Var.VALUE(&__J7_DDR1_SS_BASE)+Var.VALUE(&__DDRSS_CTL_108__SFR_OFFS)))) %Long Var.VALUE(&__DDRSS1_CTL_108_DATA)
	Data.Set D:(((Var.VALUE(&__J7_DDR1_SS_BASE)+Var.VALUE(&__DDRSS_CTL_109__SFR_OFFS)))) %Long Var.VALUE(&__DDRSS1_CTL_109_DATA)
	Data.Set D:(((Var.VALUE(&__J7_DDR1_SS_BASE)+Var.VALUE(&__DDRSS_CTL_110__SFR_OFFS)))) %Long Var.VALUE(&__DDRSS1_CTL_110_DATA)
	Data.Set D:(((Var.VALUE(&__J7_DDR1_SS_BASE)+Var.VALUE(&__DDRSS_CTL_111__SFR_OFFS)))) %Long Var.VALUE(&__DDRSS1_CTL_111_DATA)
	Data.Set D:(((Var.VALUE(&__J7_DDR1_SS_BASE)+Var.VALUE(&__DDRSS_CTL_112__SFR_OFFS)))) %Long Var.VALUE(&__DDRSS1_CTL_112_DATA)
	Data.Set D:(((Var.VALUE(&__J7_DDR1_SS_BASE)+Var.VALUE(&__DDRSS_CTL_113__SFR_OFFS)))) %Long Var.VALUE(&__DDRSS1_CTL_113_DATA)
	Data.Set D:(((Var.VALUE(&__J7_DDR1_SS_BASE)+Var.VALUE(&__DDRSS_CTL_114__SFR_OFFS)))) %Long Var.VALUE(&__DDRSS1_CTL_114_DATA)
	Data.Set D:(((Var.VALUE(&__J7_DDR1_SS_BASE)+Var.VALUE(&__DDRSS_CTL_115__SFR_OFFS)))) %Long Var.VALUE(&__DDRSS1_CTL_115_DATA)
	Data.Set D:(((Var.VALUE(&__J7_DDR1_SS_BASE)+Var.VALUE(&__DDRSS_CTL_116__SFR_OFFS)))) %Long Var.VALUE(&__DDRSS1_CTL_116_DATA)
	Data.Set D:(((Var.VALUE(&__J7_DDR1_SS_BASE)+Var.VALUE(&__DDRSS_CTL_117__SFR_OFFS)))) %Long Var.VALUE(&__DDRSS1_CTL_117_DATA)
	Data.Set D:(((Var.VALUE(&__J7_DDR1_SS_BASE)+Var.VALUE(&__DDRSS_CTL_118__SFR_OFFS)))) %Long Var.VALUE(&__DDRSS1_CTL_118_DATA)
	Data.Set D:(((Var.VALUE(&__J7_DDR1_SS_BASE)+Var.VALUE(&__DDRSS_CTL_119__SFR_OFFS)))) %Long Var.VALUE(&__DDRSS1_CTL_119_DATA)
	Data.Set D:(((Var.VALUE(&__J7_DDR1_SS_BASE)+Var.VALUE(&__DDRSS_CTL_120__SFR_OFFS)))) %Long Var.VALUE(&__DDRSS1_CTL_120_DATA)
	Data.Set D:(((Var.VALUE(&__J7_DDR1_SS_BASE)+Var.VALUE(&__DDRSS_CTL_121__SFR_OFFS)))) %Long Var.VALUE(&__DDRSS1_CTL_121_DATA)
	Data.Set D:(((Var.VALUE(&__J7_DDR1_SS_BASE)+Var.VALUE(&__DDRSS_CTL_122__SFR_OFFS)))) %Long Var.VALUE(&__DDRSS1_CTL_122_DATA)
	Data.Set D:(((Var.VALUE(&__J7_DDR1_SS_BASE)+Var.VALUE(&__DDRSS_CTL_123__SFR_OFFS)))) %Long Var.VALUE(&__DDRSS1_CTL_123_DATA)
	Data.Set D:(((Var.VALUE(&__J7_DDR1_SS_BASE)+Var.VALUE(&__DDRSS_CTL_124__SFR_OFFS)))) %Long Var.VALUE(&__DDRSS1_CTL_124_DATA)
	Data.Set D:(((Var.VALUE(&__J7_DDR1_SS_BASE)+Var.VALUE(&__DDRSS_CTL_125__SFR_OFFS)))) %Long Var.VALUE(&__DDRSS1_CTL_125_DATA)
	Data.Set D:(((Var.VALUE(&__J7_DDR1_SS_BASE)+Var.VALUE(&__DDRSS_CTL_126__SFR_OFFS)))) %Long Var.VALUE(&__DDRSS1_CTL_126_DATA)
	Data.Set D:(((Var.VALUE(&__J7_DDR1_SS_BASE)+Var.VALUE(&__DDRSS_CTL_127__SFR_OFFS)))) %Long Var.VALUE(&__DDRSS1_CTL_127_DATA)
	Data.Set D:(((Var.VALUE(&__J7_DDR1_SS_BASE)+Var.VALUE(&__DDRSS_CTL_128__SFR_OFFS)))) %Long Var.VALUE(&__DDRSS1_CTL_128_DATA)
	Data.Set D:(((Var.VALUE(&__J7_DDR1_SS_BASE)+Var.VALUE(&__DDRSS_CTL_129__SFR_OFFS)))) %Long Var.VALUE(&__DDRSS1_CTL_129_DATA)
	Data.Set D:(((Var.VALUE(&__J7_DDR1_SS_BASE)+Var.VALUE(&__DDRSS_CTL_130__SFR_OFFS)))) %Long Var.VALUE(&__DDRSS1_CTL_130_DATA)
	Data.Set D:(((Var.VALUE(&__J7_DDR1_SS_BASE)+Var.VALUE(&__DDRSS_CTL_131__SFR_OFFS)))) %Long Var.VALUE(&__DDRSS1_CTL_131_DATA)
	Data.Set D:(((Var.VALUE(&__J7_DDR1_SS_BASE)+Var.VALUE(&__DDRSS_CTL_132__SFR_OFFS)))) %Long Var.VALUE(&__DDRSS1_CTL_132_DATA)
	Data.Set D:(((Var.VALUE(&__J7_DDR1_SS_BASE)+Var.VALUE(&__DDRSS_CTL_133__SFR_OFFS)))) %Long Var.VALUE(&__DDRSS1_CTL_133_DATA)
	Data.Set D:(((Var.VALUE(&__J7_DDR1_SS_BASE)+Var.VALUE(&__DDRSS_CTL_134__SFR_OFFS)))) %Long Var.VALUE(&__DDRSS1_CTL_134_DATA)
	Data.Set D:(((Var.VALUE(&__J7_DDR1_SS_BASE)+Var.VALUE(&__DDRSS_CTL_135__SFR_OFFS)))) %Long Var.VALUE(&__DDRSS1_CTL_135_DATA)
	Data.Set D:(((Var.VALUE(&__J7_DDR1_SS_BASE)+Var.VALUE(&__DDRSS_CTL_136__SFR_OFFS)))) %Long Var.VALUE(&__DDRSS1_CTL_136_DATA)
	Data.Set D:(((Var.VALUE(&__J7_DDR1_SS_BASE)+Var.VALUE(&__DDRSS_CTL_137__SFR_OFFS)))) %Long Var.VALUE(&__DDRSS1_CTL_137_DATA)
	Data.Set D:(((Var.VALUE(&__J7_DDR1_SS_BASE)+Var.VALUE(&__DDRSS_CTL_138__SFR_OFFS)))) %Long Var.VALUE(&__DDRSS1_CTL_138_DATA)
	Data.Set D:(((Var.VALUE(&__J7_DDR1_SS_BASE)+Var.VALUE(&__DDRSS_CTL_139__SFR_OFFS)))) %Long Var.VALUE(&__DDRSS1_CTL_139_DATA)
	Data.Set D:(((Var.VALUE(&__J7_DDR1_SS_BASE)+Var.VALUE(&__DDRSS_CTL_140__SFR_OFFS)))) %Long Var.VALUE(&__DDRSS1_CTL_140_DATA)
	Data.Set D:(((Var.VALUE(&__J7_DDR1_SS_BASE)+Var.VALUE(&__DDRSS_CTL_141__SFR_OFFS)))) %Long Var.VALUE(&__DDRSS1_CTL_141_DATA)
	Data.Set D:(((Var.VALUE(&__J7_DDR1_SS_BASE)+Var.VALUE(&__DDRSS_CTL_142__SFR_OFFS)))) %Long Var.VALUE(&__DDRSS1_CTL_142_DATA)
	Data.Set D:(((Var.VALUE(&__J7_DDR1_SS_BASE)+Var.VALUE(&__DDRSS_CTL_143__SFR_OFFS)))) %Long Var.VALUE(&__DDRSS1_CTL_143_DATA)
	Data.Set D:(((Var.VALUE(&__J7_DDR1_SS_BASE)+Var.VALUE(&__DDRSS_CTL_144__SFR_OFFS)))) %Long Var.VALUE(&__DDRSS1_CTL_144_DATA)
	Data.Set D:(((Var.VALUE(&__J7_DDR1_SS_BASE)+Var.VALUE(&__DDRSS_CTL_145__SFR_OFFS)))) %Long Var.VALUE(&__DDRSS1_CTL_145_DATA)
	Data.Set D:(((Var.VALUE(&__J7_DDR1_SS_BASE)+Var.VALUE(&__DDRSS_CTL_146__SFR_OFFS)))) %Long Var.VALUE(&__DDRSS1_CTL_146_DATA)
	Data.Set D:(((Var.VALUE(&__J7_DDR1_SS_BASE)+Var.VALUE(&__DDRSS_CTL_147__SFR_OFFS)))) %Long Var.VALUE(&__DDRSS1_CTL_147_DATA)
	Data.Set D:(((Var.VALUE(&__J7_DDR1_SS_BASE)+Var.VALUE(&__DDRSS_CTL_148__SFR_OFFS)))) %Long Var.VALUE(&__DDRSS1_CTL_148_DATA)
	Data.Set D:(((Var.VALUE(&__J7_DDR1_SS_BASE)+Var.VALUE(&__DDRSS_CTL_149__SFR_OFFS)))) %Long Var.VALUE(&__DDRSS1_CTL_149_DATA)
	Data.Set D:(((Var.VALUE(&__J7_DDR1_SS_BASE)+Var.VALUE(&__DDRSS_CTL_150__SFR_OFFS)))) %Long Var.VALUE(&__DDRSS1_CTL_150_DATA)
	Data.Set D:(((Var.VALUE(&__J7_DDR1_SS_BASE)+Var.VALUE(&__DDRSS_CTL_151__SFR_OFFS)))) %Long Var.VALUE(&__DDRSS1_CTL_151_DATA)
	Data.Set D:(((Var.VALUE(&__J7_DDR1_SS_BASE)+Var.VALUE(&__DDRSS_CTL_152__SFR_OFFS)))) %Long Var.VALUE(&__DDRSS1_CTL_152_DATA)
	Data.Set D:(((Var.VALUE(&__J7_DDR1_SS_BASE)+Var.VALUE(&__DDRSS_CTL_153__SFR_OFFS)))) %Long Var.VALUE(&__DDRSS1_CTL_153_DATA)
	Data.Set D:(((Var.VALUE(&__J7_DDR1_SS_BASE)+Var.VALUE(&__DDRSS_CTL_154__SFR_OFFS)))) %Long Var.VALUE(&__DDRSS1_CTL_154_DATA)
	Data.Set D:(((Var.VALUE(&__J7_DDR1_SS_BASE)+Var.VALUE(&__DDRSS_CTL_155__SFR_OFFS)))) %Long Var.VALUE(&__DDRSS1_CTL_155_DATA)
	Data.Set D:(((Var.VALUE(&__J7_DDR1_SS_BASE)+Var.VALUE(&__DDRSS_CTL_156__SFR_OFFS)))) %Long Var.VALUE(&__DDRSS1_CTL_156_DATA)
	Data.Set D:(((Var.VALUE(&__J7_DDR1_SS_BASE)+Var.VALUE(&__DDRSS_CTL_157__SFR_OFFS)))) %Long Var.VALUE(&__DDRSS1_CTL_157_DATA)
	Data.Set D:(((Var.VALUE(&__J7_DDR1_SS_BASE)+Var.VALUE(&__DDRSS_CTL_158__SFR_OFFS)))) %Long Var.VALUE(&__DDRSS1_CTL_158_DATA)
	Data.Set D:(((Var.VALUE(&__J7_DDR1_SS_BASE)+Var.VALUE(&__DDRSS_CTL_159__SFR_OFFS)))) %Long Var.VALUE(&__DDRSS1_CTL_159_DATA)
	Data.Set D:(((Var.VALUE(&__J7_DDR1_SS_BASE)+Var.VALUE(&__DDRSS_CTL_160__SFR_OFFS)))) %Long Var.VALUE(&__DDRSS1_CTL_160_DATA)
	Data.Set D:(((Var.VALUE(&__J7_DDR1_SS_BASE)+Var.VALUE(&__DDRSS_CTL_161__SFR_OFFS)))) %Long Var.VALUE(&__DDRSS1_CTL_161_DATA)
	Data.Set D:(((Var.VALUE(&__J7_DDR1_SS_BASE)+Var.VALUE(&__DDRSS_CTL_162__SFR_OFFS)))) %Long Var.VALUE(&__DDRSS1_CTL_162_DATA)
	Data.Set D:(((Var.VALUE(&__J7_DDR1_SS_BASE)+Var.VALUE(&__DDRSS_CTL_163__SFR_OFFS)))) %Long Var.VALUE(&__DDRSS1_CTL_163_DATA)
	Data.Set D:(((Var.VALUE(&__J7_DDR1_SS_BASE)+Var.VALUE(&__DDRSS_CTL_164__SFR_OFFS)))) %Long Var.VALUE(&__DDRSS1_CTL_164_DATA)
	Data.Set D:(((Var.VALUE(&__J7_DDR1_SS_BASE)+Var.VALUE(&__DDRSS_CTL_165__SFR_OFFS)))) %Long Var.VALUE(&__DDRSS1_CTL_165_DATA)
	Data.Set D:(((Var.VALUE(&__J7_DDR1_SS_BASE)+Var.VALUE(&__DDRSS_CTL_166__SFR_OFFS)))) %Long Var.VALUE(&__DDRSS1_CTL_166_DATA)
	Data.Set D:(((Var.VALUE(&__J7_DDR1_SS_BASE)+Var.VALUE(&__DDRSS_CTL_167__SFR_OFFS)))) %Long Var.VALUE(&__DDRSS1_CTL_167_DATA)
	Data.Set D:(((Var.VALUE(&__J7_DDR1_SS_BASE)+Var.VALUE(&__DDRSS_CTL_168__SFR_OFFS)))) %Long Var.VALUE(&__DDRSS1_CTL_168_DATA)
	Data.Set D:(((Var.VALUE(&__J7_DDR1_SS_BASE)+Var.VALUE(&__DDRSS_CTL_169__SFR_OFFS)))) %Long Var.VALUE(&__DDRSS1_CTL_169_DATA)
	Data.Set D:(((Var.VALUE(&__J7_DDR1_SS_BASE)+Var.VALUE(&__DDRSS_CTL_170__SFR_OFFS)))) %Long Var.VALUE(&__DDRSS1_CTL_170_DATA)
	Data.Set D:(((Var.VALUE(&__J7_DDR1_SS_BASE)+Var.VALUE(&__DDRSS_CTL_171__SFR_OFFS)))) %Long Var.VALUE(&__DDRSS1_CTL_171_DATA)
	Data.Set D:(((Var.VALUE(&__J7_DDR1_SS_BASE)+Var.VALUE(&__DDRSS_CTL_172__SFR_OFFS)))) %Long Var.VALUE(&__DDRSS1_CTL_172_DATA)
	Data.Set D:(((Var.VALUE(&__J7_DDR1_SS_BASE)+Var.VALUE(&__DDRSS_CTL_173__SFR_OFFS)))) %Long Var.VALUE(&__DDRSS1_CTL_173_DATA)
	Data.Set D:(((Var.VALUE(&__J7_DDR1_SS_BASE)+Var.VALUE(&__DDRSS_CTL_174__SFR_OFFS)))) %Long Var.VALUE(&__DDRSS1_CTL_174_DATA)
	Data.Set D:(((Var.VALUE(&__J7_DDR1_SS_BASE)+Var.VALUE(&__DDRSS_CTL_175__SFR_OFFS)))) %Long Var.VALUE(&__DDRSS1_CTL_175_DATA)
	Data.Set D:(((Var.VALUE(&__J7_DDR1_SS_BASE)+Var.VALUE(&__DDRSS_CTL_176__SFR_OFFS)))) %Long Var.VALUE(&__DDRSS1_CTL_176_DATA)
	Data.Set D:(((Var.VALUE(&__J7_DDR1_SS_BASE)+Var.VALUE(&__DDRSS_CTL_177__SFR_OFFS)))) %Long Var.VALUE(&__DDRSS1_CTL_177_DATA)
	Data.Set D:(((Var.VALUE(&__J7_DDR1_SS_BASE)+Var.VALUE(&__DDRSS_CTL_178__SFR_OFFS)))) %Long Var.VALUE(&__DDRSS1_CTL_178_DATA)
	Data.Set D:(((Var.VALUE(&__J7_DDR1_SS_BASE)+Var.VALUE(&__DDRSS_CTL_179__SFR_OFFS)))) %Long Var.VALUE(&__DDRSS1_CTL_179_DATA)
	Data.Set D:(((Var.VALUE(&__J7_DDR1_SS_BASE)+Var.VALUE(&__DDRSS_CTL_180__SFR_OFFS)))) %Long Var.VALUE(&__DDRSS1_CTL_180_DATA)
	Data.Set D:(((Var.VALUE(&__J7_DDR1_SS_BASE)+Var.VALUE(&__DDRSS_CTL_181__SFR_OFFS)))) %Long Var.VALUE(&__DDRSS1_CTL_181_DATA)
	Data.Set D:(((Var.VALUE(&__J7_DDR1_SS_BASE)+Var.VALUE(&__DDRSS_CTL_182__SFR_OFFS)))) %Long Var.VALUE(&__DDRSS1_CTL_182_DATA)
	Data.Set D:(((Var.VALUE(&__J7_DDR1_SS_BASE)+Var.VALUE(&__DDRSS_CTL_183__SFR_OFFS)))) %Long Var.VALUE(&__DDRSS1_CTL_183_DATA)
	Data.Set D:(((Var.VALUE(&__J7_DDR1_SS_BASE)+Var.VALUE(&__DDRSS_CTL_184__SFR_OFFS)))) %Long Var.VALUE(&__DDRSS1_CTL_184_DATA)
	Data.Set D:(((Var.VALUE(&__J7_DDR1_SS_BASE)+Var.VALUE(&__DDRSS_CTL_185__SFR_OFFS)))) %Long Var.VALUE(&__DDRSS1_CTL_185_DATA)
	Data.Set D:(((Var.VALUE(&__J7_DDR1_SS_BASE)+Var.VALUE(&__DDRSS_CTL_186__SFR_OFFS)))) %Long Var.VALUE(&__DDRSS1_CTL_186_DATA)
	Data.Set D:(((Var.VALUE(&__J7_DDR1_SS_BASE)+Var.VALUE(&__DDRSS_CTL_187__SFR_OFFS)))) %Long Var.VALUE(&__DDRSS1_CTL_187_DATA)
	Data.Set D:(((Var.VALUE(&__J7_DDR1_SS_BASE)+Var.VALUE(&__DDRSS_CTL_188__SFR_OFFS)))) %Long Var.VALUE(&__DDRSS1_CTL_188_DATA)
	Data.Set D:(((Var.VALUE(&__J7_DDR1_SS_BASE)+Var.VALUE(&__DDRSS_CTL_189__SFR_OFFS)))) %Long Var.VALUE(&__DDRSS1_CTL_189_DATA)
	Data.Set D:(((Var.VALUE(&__J7_DDR1_SS_BASE)+Var.VALUE(&__DDRSS_CTL_190__SFR_OFFS)))) %Long Var.VALUE(&__DDRSS1_CTL_190_DATA)
	Data.Set D:(((Var.VALUE(&__J7_DDR1_SS_BASE)+Var.VALUE(&__DDRSS_CTL_191__SFR_OFFS)))) %Long Var.VALUE(&__DDRSS1_CTL_191_DATA)
	Data.Set D:(((Var.VALUE(&__J7_DDR1_SS_BASE)+Var.VALUE(&__DDRSS_CTL_192__SFR_OFFS)))) %Long Var.VALUE(&__DDRSS1_CTL_192_DATA)
	Data.Set D:(((Var.VALUE(&__J7_DDR1_SS_BASE)+Var.VALUE(&__DDRSS_CTL_193__SFR_OFFS)))) %Long Var.VALUE(&__DDRSS1_CTL_193_DATA)
	Data.Set D:(((Var.VALUE(&__J7_DDR1_SS_BASE)+Var.VALUE(&__DDRSS_CTL_194__SFR_OFFS)))) %Long Var.VALUE(&__DDRSS1_CTL_194_DATA)
	Data.Set D:(((Var.VALUE(&__J7_DDR1_SS_BASE)+Var.VALUE(&__DDRSS_CTL_195__SFR_OFFS)))) %Long Var.VALUE(&__DDRSS1_CTL_195_DATA)
	Data.Set D:(((Var.VALUE(&__J7_DDR1_SS_BASE)+Var.VALUE(&__DDRSS_CTL_196__SFR_OFFS)))) %Long Var.VALUE(&__DDRSS1_CTL_196_DATA)
	Data.Set D:(((Var.VALUE(&__J7_DDR1_SS_BASE)+Var.VALUE(&__DDRSS_CTL_197__SFR_OFFS)))) %Long Var.VALUE(&__DDRSS1_CTL_197_DATA)
	Data.Set D:(((Var.VALUE(&__J7_DDR1_SS_BASE)+Var.VALUE(&__DDRSS_CTL_198__SFR_OFFS)))) %Long Var.VALUE(&__DDRSS1_CTL_198_DATA)
	Data.Set D:(((Var.VALUE(&__J7_DDR1_SS_BASE)+Var.VALUE(&__DDRSS_CTL_199__SFR_OFFS)))) %Long Var.VALUE(&__DDRSS1_CTL_199_DATA)
	Data.Set D:(((Var.VALUE(&__J7_DDR1_SS_BASE)+Var.VALUE(&__DDRSS_CTL_200__SFR_OFFS)))) %Long Var.VALUE(&__DDRSS1_CTL_200_DATA)
	Data.Set D:(((Var.VALUE(&__J7_DDR1_SS_BASE)+Var.VALUE(&__DDRSS_CTL_201__SFR_OFFS)))) %Long Var.VALUE(&__DDRSS1_CTL_201_DATA)
	Data.Set D:(((Var.VALUE(&__J7_DDR1_SS_BASE)+Var.VALUE(&__DDRSS_CTL_202__SFR_OFFS)))) %Long Var.VALUE(&__DDRSS1_CTL_202_DATA)
	Data.Set D:(((Var.VALUE(&__J7_DDR1_SS_BASE)+Var.VALUE(&__DDRSS_CTL_203__SFR_OFFS)))) %Long Var.VALUE(&__DDRSS1_CTL_203_DATA)
	Data.Set D:(((Var.VALUE(&__J7_DDR1_SS_BASE)+Var.VALUE(&__DDRSS_CTL_204__SFR_OFFS)))) %Long Var.VALUE(&__DDRSS1_CTL_204_DATA)
	Data.Set D:(((Var.VALUE(&__J7_DDR1_SS_BASE)+Var.VALUE(&__DDRSS_CTL_205__SFR_OFFS)))) %Long Var.VALUE(&__DDRSS1_CTL_205_DATA)
	Data.Set D:(((Var.VALUE(&__J7_DDR1_SS_BASE)+Var.VALUE(&__DDRSS_CTL_206__SFR_OFFS)))) %Long Var.VALUE(&__DDRSS1_CTL_206_DATA)
	Data.Set D:(((Var.VALUE(&__J7_DDR1_SS_BASE)+Var.VALUE(&__DDRSS_CTL_207__SFR_OFFS)))) %Long Var.VALUE(&__DDRSS1_CTL_207_DATA)
	Data.Set D:(((Var.VALUE(&__J7_DDR1_SS_BASE)+Var.VALUE(&__DDRSS_CTL_208__SFR_OFFS)))) %Long Var.VALUE(&__DDRSS1_CTL_208_DATA)
	Data.Set D:(((Var.VALUE(&__J7_DDR1_SS_BASE)+Var.VALUE(&__DDRSS_CTL_209__SFR_OFFS)))) %Long Var.VALUE(&__DDRSS1_CTL_209_DATA)
	Data.Set D:(((Var.VALUE(&__J7_DDR1_SS_BASE)+Var.VALUE(&__DDRSS_CTL_210__SFR_OFFS)))) %Long Var.VALUE(&__DDRSS1_CTL_210_DATA)
	Data.Set D:(((Var.VALUE(&__J7_DDR1_SS_BASE)+Var.VALUE(&__DDRSS_CTL_211__SFR_OFFS)))) %Long Var.VALUE(&__DDRSS1_CTL_211_DATA)
	Data.Set D:(((Var.VALUE(&__J7_DDR1_SS_BASE)+Var.VALUE(&__DDRSS_CTL_212__SFR_OFFS)))) %Long Var.VALUE(&__DDRSS1_CTL_212_DATA)
	Data.Set D:(((Var.VALUE(&__J7_DDR1_SS_BASE)+Var.VALUE(&__DDRSS_CTL_213__SFR_OFFS)))) %Long Var.VALUE(&__DDRSS1_CTL_213_DATA)
	Data.Set D:(((Var.VALUE(&__J7_DDR1_SS_BASE)+Var.VALUE(&__DDRSS_CTL_214__SFR_OFFS)))) %Long Var.VALUE(&__DDRSS1_CTL_214_DATA)
	Data.Set D:(((Var.VALUE(&__J7_DDR1_SS_BASE)+Var.VALUE(&__DDRSS_CTL_215__SFR_OFFS)))) %Long Var.VALUE(&__DDRSS1_CTL_215_DATA)
	Data.Set D:(((Var.VALUE(&__J7_DDR1_SS_BASE)+Var.VALUE(&__DDRSS_CTL_216__SFR_OFFS)))) %Long Var.VALUE(&__DDRSS1_CTL_216_DATA)
	Data.Set D:(((Var.VALUE(&__J7_DDR1_SS_BASE)+Var.VALUE(&__DDRSS_CTL_217__SFR_OFFS)))) %Long Var.VALUE(&__DDRSS1_CTL_217_DATA)
	Data.Set D:(((Var.VALUE(&__J7_DDR1_SS_BASE)+Var.VALUE(&__DDRSS_CTL_218__SFR_OFFS)))) %Long Var.VALUE(&__DDRSS1_CTL_218_DATA)
	Data.Set D:(((Var.VALUE(&__J7_DDR1_SS_BASE)+Var.VALUE(&__DDRSS_CTL_219__SFR_OFFS)))) %Long Var.VALUE(&__DDRSS1_CTL_219_DATA)
	Data.Set D:(((Var.VALUE(&__J7_DDR1_SS_BASE)+Var.VALUE(&__DDRSS_CTL_220__SFR_OFFS)))) %Long Var.VALUE(&__DDRSS1_CTL_220_DATA)
	Data.Set D:(((Var.VALUE(&__J7_DDR1_SS_BASE)+Var.VALUE(&__DDRSS_CTL_221__SFR_OFFS)))) %Long Var.VALUE(&__DDRSS1_CTL_221_DATA)
	Data.Set D:(((Var.VALUE(&__J7_DDR1_SS_BASE)+Var.VALUE(&__DDRSS_CTL_222__SFR_OFFS)))) %Long Var.VALUE(&__DDRSS1_CTL_222_DATA)
	Data.Set D:(((Var.VALUE(&__J7_DDR1_SS_BASE)+Var.VALUE(&__DDRSS_CTL_223__SFR_OFFS)))) %Long Var.VALUE(&__DDRSS1_CTL_223_DATA)
	Data.Set D:(((Var.VALUE(&__J7_DDR1_SS_BASE)+Var.VALUE(&__DDRSS_CTL_224__SFR_OFFS)))) %Long Var.VALUE(&__DDRSS1_CTL_224_DATA)
	Data.Set D:(((Var.VALUE(&__J7_DDR1_SS_BASE)+Var.VALUE(&__DDRSS_CTL_225__SFR_OFFS)))) %Long Var.VALUE(&__DDRSS1_CTL_225_DATA)
	Data.Set D:(((Var.VALUE(&__J7_DDR1_SS_BASE)+Var.VALUE(&__DDRSS_CTL_226__SFR_OFFS)))) %Long Var.VALUE(&__DDRSS1_CTL_226_DATA)
	Data.Set D:(((Var.VALUE(&__J7_DDR1_SS_BASE)+Var.VALUE(&__DDRSS_CTL_227__SFR_OFFS)))) %Long Var.VALUE(&__DDRSS1_CTL_227_DATA)
	Data.Set D:(((Var.VALUE(&__J7_DDR1_SS_BASE)+Var.VALUE(&__DDRSS_CTL_228__SFR_OFFS)))) %Long Var.VALUE(&__DDRSS1_CTL_228_DATA)
	Data.Set D:(((Var.VALUE(&__J7_DDR1_SS_BASE)+Var.VALUE(&__DDRSS_CTL_229__SFR_OFFS)))) %Long Var.VALUE(&__DDRSS1_CTL_229_DATA)
	Data.Set D:(((Var.VALUE(&__J7_DDR1_SS_BASE)+Var.VALUE(&__DDRSS_CTL_230__SFR_OFFS)))) %Long Var.VALUE(&__DDRSS1_CTL_230_DATA)
	Data.Set D:(((Var.VALUE(&__J7_DDR1_SS_BASE)+Var.VALUE(&__DDRSS_CTL_231__SFR_OFFS)))) %Long Var.VALUE(&__DDRSS1_CTL_231_DATA)
	Data.Set D:(((Var.VALUE(&__J7_DDR1_SS_BASE)+Var.VALUE(&__DDRSS_CTL_232__SFR_OFFS)))) %Long Var.VALUE(&__DDRSS1_CTL_232_DATA)
	Data.Set D:(((Var.VALUE(&__J7_DDR1_SS_BASE)+Var.VALUE(&__DDRSS_CTL_233__SFR_OFFS)))) %Long Var.VALUE(&__DDRSS1_CTL_233_DATA)
	Data.Set D:(((Var.VALUE(&__J7_DDR1_SS_BASE)+Var.VALUE(&__DDRSS_CTL_234__SFR_OFFS)))) %Long Var.VALUE(&__DDRSS1_CTL_234_DATA)
	Data.Set D:(((Var.VALUE(&__J7_DDR1_SS_BASE)+Var.VALUE(&__DDRSS_CTL_235__SFR_OFFS)))) %Long Var.VALUE(&__DDRSS1_CTL_235_DATA)
	Data.Set D:(((Var.VALUE(&__J7_DDR1_SS_BASE)+Var.VALUE(&__DDRSS_CTL_236__SFR_OFFS)))) %Long Var.VALUE(&__DDRSS1_CTL_236_DATA)
	Data.Set D:(((Var.VALUE(&__J7_DDR1_SS_BASE)+Var.VALUE(&__DDRSS_CTL_237__SFR_OFFS)))) %Long Var.VALUE(&__DDRSS1_CTL_237_DATA)
	Data.Set D:(((Var.VALUE(&__J7_DDR1_SS_BASE)+Var.VALUE(&__DDRSS_CTL_238__SFR_OFFS)))) %Long Var.VALUE(&__DDRSS1_CTL_238_DATA)
	Data.Set D:(((Var.VALUE(&__J7_DDR1_SS_BASE)+Var.VALUE(&__DDRSS_CTL_239__SFR_OFFS)))) %Long Var.VALUE(&__DDRSS1_CTL_239_DATA)
	Data.Set D:(((Var.VALUE(&__J7_DDR1_SS_BASE)+Var.VALUE(&__DDRSS_CTL_240__SFR_OFFS)))) %Long Var.VALUE(&__DDRSS1_CTL_240_DATA)
	Data.Set D:(((Var.VALUE(&__J7_DDR1_SS_BASE)+Var.VALUE(&__DDRSS_CTL_241__SFR_OFFS)))) %Long Var.VALUE(&__DDRSS1_CTL_241_DATA)
	Data.Set D:(((Var.VALUE(&__J7_DDR1_SS_BASE)+Var.VALUE(&__DDRSS_CTL_242__SFR_OFFS)))) %Long Var.VALUE(&__DDRSS1_CTL_242_DATA)
	Data.Set D:(((Var.VALUE(&__J7_DDR1_SS_BASE)+Var.VALUE(&__DDRSS_CTL_243__SFR_OFFS)))) %Long Var.VALUE(&__DDRSS1_CTL_243_DATA)
	Data.Set D:(((Var.VALUE(&__J7_DDR1_SS_BASE)+Var.VALUE(&__DDRSS_CTL_244__SFR_OFFS)))) %Long Var.VALUE(&__DDRSS1_CTL_244_DATA)
	Data.Set D:(((Var.VALUE(&__J7_DDR1_SS_BASE)+Var.VALUE(&__DDRSS_CTL_245__SFR_OFFS)))) %Long Var.VALUE(&__DDRSS1_CTL_245_DATA)
	Data.Set D:(((Var.VALUE(&__J7_DDR1_SS_BASE)+Var.VALUE(&__DDRSS_CTL_246__SFR_OFFS)))) %Long Var.VALUE(&__DDRSS1_CTL_246_DATA)
	Data.Set D:(((Var.VALUE(&__J7_DDR1_SS_BASE)+Var.VALUE(&__DDRSS_CTL_247__SFR_OFFS)))) %Long Var.VALUE(&__DDRSS1_CTL_247_DATA)
	Data.Set D:(((Var.VALUE(&__J7_DDR1_SS_BASE)+Var.VALUE(&__DDRSS_CTL_248__SFR_OFFS)))) %Long Var.VALUE(&__DDRSS1_CTL_248_DATA)
	Data.Set D:(((Var.VALUE(&__J7_DDR1_SS_BASE)+Var.VALUE(&__DDRSS_CTL_249__SFR_OFFS)))) %Long Var.VALUE(&__DDRSS1_CTL_249_DATA)
	Data.Set D:(((Var.VALUE(&__J7_DDR1_SS_BASE)+Var.VALUE(&__DDRSS_CTL_250__SFR_OFFS)))) %Long Var.VALUE(&__DDRSS1_CTL_250_DATA)
	Data.Set D:(((Var.VALUE(&__J7_DDR1_SS_BASE)+Var.VALUE(&__DDRSS_CTL_251__SFR_OFFS)))) %Long Var.VALUE(&__DDRSS1_CTL_251_DATA)
	Data.Set D:(((Var.VALUE(&__J7_DDR1_SS_BASE)+Var.VALUE(&__DDRSS_CTL_252__SFR_OFFS)))) %Long Var.VALUE(&__DDRSS1_CTL_252_DATA)
	Data.Set D:(((Var.VALUE(&__J7_DDR1_SS_BASE)+Var.VALUE(&__DDRSS_CTL_253__SFR_OFFS)))) %Long Var.VALUE(&__DDRSS1_CTL_253_DATA)
	Data.Set D:(((Var.VALUE(&__J7_DDR1_SS_BASE)+Var.VALUE(&__DDRSS_CTL_254__SFR_OFFS)))) %Long Var.VALUE(&__DDRSS1_CTL_254_DATA)
	Data.Set D:(((Var.VALUE(&__J7_DDR1_SS_BASE)+Var.VALUE(&__DDRSS_CTL_255__SFR_OFFS)))) %Long Var.VALUE(&__DDRSS1_CTL_255_DATA)
	Data.Set D:(((Var.VALUE(&__J7_DDR1_SS_BASE)+Var.VALUE(&__DDRSS_CTL_256__SFR_OFFS)))) %Long Var.VALUE(&__DDRSS1_CTL_256_DATA)
	Data.Set D:(((Var.VALUE(&__J7_DDR1_SS_BASE)+Var.VALUE(&__DDRSS_CTL_257__SFR_OFFS)))) %Long Var.VALUE(&__DDRSS1_CTL_257_DATA)
	Data.Set D:(((Var.VALUE(&__J7_DDR1_SS_BASE)+Var.VALUE(&__DDRSS_CTL_258__SFR_OFFS)))) %Long Var.VALUE(&__DDRSS1_CTL_258_DATA)
	Data.Set D:(((Var.VALUE(&__J7_DDR1_SS_BASE)+Var.VALUE(&__DDRSS_CTL_259__SFR_OFFS)))) %Long Var.VALUE(&__DDRSS1_CTL_259_DATA)
	Data.Set D:(((Var.VALUE(&__J7_DDR1_SS_BASE)+Var.VALUE(&__DDRSS_CTL_260__SFR_OFFS)))) %Long Var.VALUE(&__DDRSS1_CTL_260_DATA)
	Data.Set D:(((Var.VALUE(&__J7_DDR1_SS_BASE)+Var.VALUE(&__DDRSS_CTL_261__SFR_OFFS)))) %Long Var.VALUE(&__DDRSS1_CTL_261_DATA)
	Data.Set D:(((Var.VALUE(&__J7_DDR1_SS_BASE)+Var.VALUE(&__DDRSS_CTL_262__SFR_OFFS)))) %Long Var.VALUE(&__DDRSS1_CTL_262_DATA)
	Data.Set D:(((Var.VALUE(&__J7_DDR1_SS_BASE)+Var.VALUE(&__DDRSS_CTL_263__SFR_OFFS)))) %Long Var.VALUE(&__DDRSS1_CTL_263_DATA)
	Data.Set D:(((Var.VALUE(&__J7_DDR1_SS_BASE)+Var.VALUE(&__DDRSS_CTL_264__SFR_OFFS)))) %Long Var.VALUE(&__DDRSS1_CTL_264_DATA)
	Data.Set D:(((Var.VALUE(&__J7_DDR1_SS_BASE)+Var.VALUE(&__DDRSS_CTL_265__SFR_OFFS)))) %Long Var.VALUE(&__DDRSS1_CTL_265_DATA)
	Data.Set D:(((Var.VALUE(&__J7_DDR1_SS_BASE)+Var.VALUE(&__DDRSS_CTL_266__SFR_OFFS)))) %Long Var.VALUE(&__DDRSS1_CTL_266_DATA)
	Data.Set D:(((Var.VALUE(&__J7_DDR1_SS_BASE)+Var.VALUE(&__DDRSS_CTL_267__SFR_OFFS)))) %Long Var.VALUE(&__DDRSS1_CTL_267_DATA)
	Data.Set D:(((Var.VALUE(&__J7_DDR1_SS_BASE)+Var.VALUE(&__DDRSS_CTL_268__SFR_OFFS)))) %Long Var.VALUE(&__DDRSS1_CTL_268_DATA)
	Data.Set D:(((Var.VALUE(&__J7_DDR1_SS_BASE)+Var.VALUE(&__DDRSS_CTL_269__SFR_OFFS)))) %Long Var.VALUE(&__DDRSS1_CTL_269_DATA)
	Data.Set D:(((Var.VALUE(&__J7_DDR1_SS_BASE)+Var.VALUE(&__DDRSS_CTL_270__SFR_OFFS)))) %Long Var.VALUE(&__DDRSS1_CTL_270_DATA)
	Data.Set D:(((Var.VALUE(&__J7_DDR1_SS_BASE)+Var.VALUE(&__DDRSS_CTL_271__SFR_OFFS)))) %Long Var.VALUE(&__DDRSS1_CTL_271_DATA)
	Data.Set D:(((Var.VALUE(&__J7_DDR1_SS_BASE)+Var.VALUE(&__DDRSS_CTL_272__SFR_OFFS)))) %Long Var.VALUE(&__DDRSS1_CTL_272_DATA)
	Data.Set D:(((Var.VALUE(&__J7_DDR1_SS_BASE)+Var.VALUE(&__DDRSS_CTL_273__SFR_OFFS)))) %Long Var.VALUE(&__DDRSS1_CTL_273_DATA)
	Data.Set D:(((Var.VALUE(&__J7_DDR1_SS_BASE)+Var.VALUE(&__DDRSS_CTL_274__SFR_OFFS)))) %Long Var.VALUE(&__DDRSS1_CTL_274_DATA)
	Data.Set D:(((Var.VALUE(&__J7_DDR1_SS_BASE)+Var.VALUE(&__DDRSS_CTL_275__SFR_OFFS)))) %Long Var.VALUE(&__DDRSS1_CTL_275_DATA)
	Data.Set D:(((Var.VALUE(&__J7_DDR1_SS_BASE)+Var.VALUE(&__DDRSS_CTL_276__SFR_OFFS)))) %Long Var.VALUE(&__DDRSS1_CTL_276_DATA)
	Data.Set D:(((Var.VALUE(&__J7_DDR1_SS_BASE)+Var.VALUE(&__DDRSS_CTL_277__SFR_OFFS)))) %Long Var.VALUE(&__DDRSS1_CTL_277_DATA)
	Data.Set D:(((Var.VALUE(&__J7_DDR1_SS_BASE)+Var.VALUE(&__DDRSS_CTL_278__SFR_OFFS)))) %Long Var.VALUE(&__DDRSS1_CTL_278_DATA)
	Data.Set D:(((Var.VALUE(&__J7_DDR1_SS_BASE)+Var.VALUE(&__DDRSS_CTL_279__SFR_OFFS)))) %Long Var.VALUE(&__DDRSS1_CTL_279_DATA)
	Data.Set D:(((Var.VALUE(&__J7_DDR1_SS_BASE)+Var.VALUE(&__DDRSS_CTL_280__SFR_OFFS)))) %Long Var.VALUE(&__DDRSS1_CTL_280_DATA)
	Data.Set D:(((Var.VALUE(&__J7_DDR1_SS_BASE)+Var.VALUE(&__DDRSS_CTL_281__SFR_OFFS)))) %Long Var.VALUE(&__DDRSS1_CTL_281_DATA)
	Data.Set D:(((Var.VALUE(&__J7_DDR1_SS_BASE)+Var.VALUE(&__DDRSS_CTL_282__SFR_OFFS)))) %Long Var.VALUE(&__DDRSS1_CTL_282_DATA)
	Data.Set D:(((Var.VALUE(&__J7_DDR1_SS_BASE)+Var.VALUE(&__DDRSS_CTL_283__SFR_OFFS)))) %Long Var.VALUE(&__DDRSS1_CTL_283_DATA)
	Data.Set D:(((Var.VALUE(&__J7_DDR1_SS_BASE)+Var.VALUE(&__DDRSS_CTL_284__SFR_OFFS)))) %Long Var.VALUE(&__DDRSS1_CTL_284_DATA)
	Data.Set D:(((Var.VALUE(&__J7_DDR1_SS_BASE)+Var.VALUE(&__DDRSS_CTL_285__SFR_OFFS)))) %Long Var.VALUE(&__DDRSS1_CTL_285_DATA)
	Data.Set D:(((Var.VALUE(&__J7_DDR1_SS_BASE)+Var.VALUE(&__DDRSS_CTL_286__SFR_OFFS)))) %Long Var.VALUE(&__DDRSS1_CTL_286_DATA)
	Data.Set D:(((Var.VALUE(&__J7_DDR1_SS_BASE)+Var.VALUE(&__DDRSS_CTL_287__SFR_OFFS)))) %Long Var.VALUE(&__DDRSS1_CTL_287_DATA)
	Data.Set D:(((Var.VALUE(&__J7_DDR1_SS_BASE)+Var.VALUE(&__DDRSS_CTL_288__SFR_OFFS)))) %Long Var.VALUE(&__DDRSS1_CTL_288_DATA)
	Data.Set D:(((Var.VALUE(&__J7_DDR1_SS_BASE)+Var.VALUE(&__DDRSS_CTL_289__SFR_OFFS)))) %Long Var.VALUE(&__DDRSS1_CTL_289_DATA)
	Data.Set D:(((Var.VALUE(&__J7_DDR1_SS_BASE)+Var.VALUE(&__DDRSS_CTL_290__SFR_OFFS)))) %Long Var.VALUE(&__DDRSS1_CTL_290_DATA)
	Data.Set D:(((Var.VALUE(&__J7_DDR1_SS_BASE)+Var.VALUE(&__DDRSS_CTL_291__SFR_OFFS)))) %Long Var.VALUE(&__DDRSS1_CTL_291_DATA)
	Data.Set D:(((Var.VALUE(&__J7_DDR1_SS_BASE)+Var.VALUE(&__DDRSS_CTL_292__SFR_OFFS)))) %Long Var.VALUE(&__DDRSS1_CTL_292_DATA)
	Data.Set D:(((Var.VALUE(&__J7_DDR1_SS_BASE)+Var.VALUE(&__DDRSS_CTL_293__SFR_OFFS)))) %Long Var.VALUE(&__DDRSS1_CTL_293_DATA)
	Data.Set D:(((Var.VALUE(&__J7_DDR1_SS_BASE)+Var.VALUE(&__DDRSS_CTL_294__SFR_OFFS)))) %Long Var.VALUE(&__DDRSS1_CTL_294_DATA)
	Data.Set D:(((Var.VALUE(&__J7_DDR1_SS_BASE)+Var.VALUE(&__DDRSS_CTL_295__SFR_OFFS)))) %Long Var.VALUE(&__DDRSS1_CTL_295_DATA)
	Data.Set D:(((Var.VALUE(&__J7_DDR1_SS_BASE)+Var.VALUE(&__DDRSS_CTL_296__SFR_OFFS)))) %Long Var.VALUE(&__DDRSS1_CTL_296_DATA)
	Data.Set D:(((Var.VALUE(&__J7_DDR1_SS_BASE)+Var.VALUE(&__DDRSS_CTL_297__SFR_OFFS)))) %Long Var.VALUE(&__DDRSS1_CTL_297_DATA)
	Data.Set D:(((Var.VALUE(&__J7_DDR1_SS_BASE)+Var.VALUE(&__DDRSS_CTL_298__SFR_OFFS)))) %Long Var.VALUE(&__DDRSS1_CTL_298_DATA)
	Data.Set D:(((Var.VALUE(&__J7_DDR1_SS_BASE)+Var.VALUE(&__DDRSS_CTL_299__SFR_OFFS)))) %Long Var.VALUE(&__DDRSS1_CTL_299_DATA)
	Data.Set D:(((Var.VALUE(&__J7_DDR1_SS_BASE)+Var.VALUE(&__DDRSS_CTL_300__SFR_OFFS)))) %Long Var.VALUE(&__DDRSS1_CTL_300_DATA)
	Data.Set D:(((Var.VALUE(&__J7_DDR1_SS_BASE)+Var.VALUE(&__DDRSS_CTL_301__SFR_OFFS)))) %Long Var.VALUE(&__DDRSS1_CTL_301_DATA)
	Data.Set D:(((Var.VALUE(&__J7_DDR1_SS_BASE)+Var.VALUE(&__DDRSS_CTL_302__SFR_OFFS)))) %Long Var.VALUE(&__DDRSS1_CTL_302_DATA)
	Data.Set D:(((Var.VALUE(&__J7_DDR1_SS_BASE)+Var.VALUE(&__DDRSS_CTL_303__SFR_OFFS)))) %Long Var.VALUE(&__DDRSS1_CTL_303_DATA)
	Data.Set D:(((Var.VALUE(&__J7_DDR1_SS_BASE)+Var.VALUE(&__DDRSS_CTL_304__SFR_OFFS)))) %Long Var.VALUE(&__DDRSS1_CTL_304_DATA)
	Data.Set D:(((Var.VALUE(&__J7_DDR1_SS_BASE)+Var.VALUE(&__DDRSS_CTL_305__SFR_OFFS)))) %Long Var.VALUE(&__DDRSS1_CTL_305_DATA)
	Data.Set D:(((Var.VALUE(&__J7_DDR1_SS_BASE)+Var.VALUE(&__DDRSS_CTL_306__SFR_OFFS)))) %Long Var.VALUE(&__DDRSS1_CTL_306_DATA)
	Data.Set D:(((Var.VALUE(&__J7_DDR1_SS_BASE)+Var.VALUE(&__DDRSS_CTL_307__SFR_OFFS)))) %Long Var.VALUE(&__DDRSS1_CTL_307_DATA)
	Data.Set D:(((Var.VALUE(&__J7_DDR1_SS_BASE)+Var.VALUE(&__DDRSS_CTL_308__SFR_OFFS)))) %Long Var.VALUE(&__DDRSS1_CTL_308_DATA)
	Data.Set D:(((Var.VALUE(&__J7_DDR1_SS_BASE)+Var.VALUE(&__DDRSS_CTL_309__SFR_OFFS)))) %Long Var.VALUE(&__DDRSS1_CTL_309_DATA)
	Data.Set D:(((Var.VALUE(&__J7_DDR1_SS_BASE)+Var.VALUE(&__DDRSS_CTL_310__SFR_OFFS)))) %Long Var.VALUE(&__DDRSS1_CTL_310_DATA)
	Data.Set D:(((Var.VALUE(&__J7_DDR1_SS_BASE)+Var.VALUE(&__DDRSS_CTL_311__SFR_OFFS)))) %Long Var.VALUE(&__DDRSS1_CTL_311_DATA)
	Data.Set D:(((Var.VALUE(&__J7_DDR1_SS_BASE)+Var.VALUE(&__DDRSS_CTL_312__SFR_OFFS)))) %Long Var.VALUE(&__DDRSS1_CTL_312_DATA)
	Data.Set D:(((Var.VALUE(&__J7_DDR1_SS_BASE)+Var.VALUE(&__DDRSS_CTL_313__SFR_OFFS)))) %Long Var.VALUE(&__DDRSS1_CTL_313_DATA)
	Data.Set D:(((Var.VALUE(&__J7_DDR1_SS_BASE)+Var.VALUE(&__DDRSS_CTL_314__SFR_OFFS)))) %Long Var.VALUE(&__DDRSS1_CTL_314_DATA)
	Data.Set D:(((Var.VALUE(&__J7_DDR1_SS_BASE)+Var.VALUE(&__DDRSS_CTL_315__SFR_OFFS)))) %Long Var.VALUE(&__DDRSS1_CTL_315_DATA)
	Data.Set D:(((Var.VALUE(&__J7_DDR1_SS_BASE)+Var.VALUE(&__DDRSS_CTL_316__SFR_OFFS)))) %Long Var.VALUE(&__DDRSS1_CTL_316_DATA)
	Data.Set D:(((Var.VALUE(&__J7_DDR1_SS_BASE)+Var.VALUE(&__DDRSS_CTL_317__SFR_OFFS)))) %Long Var.VALUE(&__DDRSS1_CTL_317_DATA)
	Data.Set D:(((Var.VALUE(&__J7_DDR1_SS_BASE)+Var.VALUE(&__DDRSS_CTL_318__SFR_OFFS)))) %Long Var.VALUE(&__DDRSS1_CTL_318_DATA)
	Data.Set D:(((Var.VALUE(&__J7_DDR1_SS_BASE)+Var.VALUE(&__DDRSS_CTL_319__SFR_OFFS)))) %Long Var.VALUE(&__DDRSS1_CTL_319_DATA)
	Data.Set D:(((Var.VALUE(&__J7_DDR1_SS_BASE)+Var.VALUE(&__DDRSS_CTL_320__SFR_OFFS)))) %Long Var.VALUE(&__DDRSS1_CTL_320_DATA)
	Data.Set D:(((Var.VALUE(&__J7_DDR1_SS_BASE)+Var.VALUE(&__DDRSS_CTL_321__SFR_OFFS)))) %Long Var.VALUE(&__DDRSS1_CTL_321_DATA)
	Data.Set D:(((Var.VALUE(&__J7_DDR1_SS_BASE)+Var.VALUE(&__DDRSS_CTL_322__SFR_OFFS)))) %Long Var.VALUE(&__DDRSS1_CTL_322_DATA)
	Data.Set D:(((Var.VALUE(&__J7_DDR1_SS_BASE)+Var.VALUE(&__DDRSS_CTL_323__SFR_OFFS)))) %Long Var.VALUE(&__DDRSS1_CTL_323_DATA)
	Data.Set D:(((Var.VALUE(&__J7_DDR1_SS_BASE)+Var.VALUE(&__DDRSS_CTL_324__SFR_OFFS)))) %Long Var.VALUE(&__DDRSS1_CTL_324_DATA)
	Data.Set D:(((Var.VALUE(&__J7_DDR1_SS_BASE)+Var.VALUE(&__DDRSS_CTL_325__SFR_OFFS)))) %Long Var.VALUE(&__DDRSS1_CTL_325_DATA)
	Data.Set D:(((Var.VALUE(&__J7_DDR1_SS_BASE)+Var.VALUE(&__DDRSS_CTL_326__SFR_OFFS)))) %Long Var.VALUE(&__DDRSS1_CTL_326_DATA)
	Data.Set D:(((Var.VALUE(&__J7_DDR1_SS_BASE)+Var.VALUE(&__DDRSS_CTL_327__SFR_OFFS)))) %Long Var.VALUE(&__DDRSS1_CTL_327_DATA)
	Data.Set D:(((Var.VALUE(&__J7_DDR1_SS_BASE)+Var.VALUE(&__DDRSS_CTL_328__SFR_OFFS)))) %Long Var.VALUE(&__DDRSS1_CTL_328_DATA)
	Data.Set D:(((Var.VALUE(&__J7_DDR1_SS_BASE)+Var.VALUE(&__DDRSS_CTL_329__SFR_OFFS)))) %Long Var.VALUE(&__DDRSS1_CTL_329_DATA)
	Data.Set D:(((Var.VALUE(&__J7_DDR1_SS_BASE)+Var.VALUE(&__DDRSS_CTL_330__SFR_OFFS)))) %Long Var.VALUE(&__DDRSS1_CTL_330_DATA)
	Data.Set D:(((Var.VALUE(&__J7_DDR1_SS_BASE)+Var.VALUE(&__DDRSS_CTL_331__SFR_OFFS)))) %Long Var.VALUE(&__DDRSS1_CTL_331_DATA)
	Data.Set D:(((Var.VALUE(&__J7_DDR1_SS_BASE)+Var.VALUE(&__DDRSS_CTL_332__SFR_OFFS)))) %Long Var.VALUE(&__DDRSS1_CTL_332_DATA)
	Data.Set D:(((Var.VALUE(&__J7_DDR1_SS_BASE)+Var.VALUE(&__DDRSS_CTL_333__SFR_OFFS)))) %Long Var.VALUE(&__DDRSS1_CTL_333_DATA)
	Data.Set D:(((Var.VALUE(&__J7_DDR1_SS_BASE)+Var.VALUE(&__DDRSS_CTL_334__SFR_OFFS)))) %Long Var.VALUE(&__DDRSS1_CTL_334_DATA)
	Data.Set D:(((Var.VALUE(&__J7_DDR1_SS_BASE)+Var.VALUE(&__DDRSS_CTL_335__SFR_OFFS)))) %Long Var.VALUE(&__DDRSS1_CTL_335_DATA)
	Data.Set D:(((Var.VALUE(&__J7_DDR1_SS_BASE)+Var.VALUE(&__DDRSS_CTL_336__SFR_OFFS)))) %Long Var.VALUE(&__DDRSS1_CTL_336_DATA)
	Data.Set D:(((Var.VALUE(&__J7_DDR1_SS_BASE)+Var.VALUE(&__DDRSS_CTL_337__SFR_OFFS)))) %Long Var.VALUE(&__DDRSS1_CTL_337_DATA)
	Data.Set D:(((Var.VALUE(&__J7_DDR1_SS_BASE)+Var.VALUE(&__DDRSS_CTL_338__SFR_OFFS)))) %Long Var.VALUE(&__DDRSS1_CTL_338_DATA)
	Data.Set D:(((Var.VALUE(&__J7_DDR1_SS_BASE)+Var.VALUE(&__DDRSS_CTL_339__SFR_OFFS)))) %Long Var.VALUE(&__DDRSS1_CTL_339_DATA)
	Data.Set D:(((Var.VALUE(&__J7_DDR1_SS_BASE)+Var.VALUE(&__DDRSS_CTL_340__SFR_OFFS)))) %Long Var.VALUE(&__DDRSS1_CTL_340_DATA)
	Data.Set D:(((Var.VALUE(&__J7_DDR1_SS_BASE)+Var.VALUE(&__DDRSS_CTL_341__SFR_OFFS)))) %Long Var.VALUE(&__DDRSS1_CTL_341_DATA)
	Data.Set D:(((Var.VALUE(&__J7_DDR1_SS_BASE)+Var.VALUE(&__DDRSS_CTL_342__SFR_OFFS)))) %Long Var.VALUE(&__DDRSS1_CTL_342_DATA)
	Data.Set D:(((Var.VALUE(&__J7_DDR1_SS_BASE)+Var.VALUE(&__DDRSS_CTL_343__SFR_OFFS)))) %Long Var.VALUE(&__DDRSS1_CTL_343_DATA)
	Data.Set D:(((Var.VALUE(&__J7_DDR1_SS_BASE)+Var.VALUE(&__DDRSS_CTL_344__SFR_OFFS)))) %Long Var.VALUE(&__DDRSS1_CTL_344_DATA)
	Data.Set D:(((Var.VALUE(&__J7_DDR1_SS_BASE)+Var.VALUE(&__DDRSS_CTL_345__SFR_OFFS)))) %Long Var.VALUE(&__DDRSS1_CTL_345_DATA)
	Data.Set D:(((Var.VALUE(&__J7_DDR1_SS_BASE)+Var.VALUE(&__DDRSS_CTL_346__SFR_OFFS)))) %Long Var.VALUE(&__DDRSS1_CTL_346_DATA)
	Data.Set D:(((Var.VALUE(&__J7_DDR1_SS_BASE)+Var.VALUE(&__DDRSS_CTL_347__SFR_OFFS)))) %Long Var.VALUE(&__DDRSS1_CTL_347_DATA)
	Data.Set D:(((Var.VALUE(&__J7_DDR1_SS_BASE)+Var.VALUE(&__DDRSS_CTL_348__SFR_OFFS)))) %Long Var.VALUE(&__DDRSS1_CTL_348_DATA)
	Data.Set D:(((Var.VALUE(&__J7_DDR1_SS_BASE)+Var.VALUE(&__DDRSS_CTL_349__SFR_OFFS)))) %Long Var.VALUE(&__DDRSS1_CTL_349_DATA)
	Data.Set D:(((Var.VALUE(&__J7_DDR1_SS_BASE)+Var.VALUE(&__DDRSS_CTL_350__SFR_OFFS)))) %Long Var.VALUE(&__DDRSS1_CTL_350_DATA)
	Data.Set D:(((Var.VALUE(&__J7_DDR1_SS_BASE)+Var.VALUE(&__DDRSS_CTL_351__SFR_OFFS)))) %Long Var.VALUE(&__DDRSS1_CTL_351_DATA)
	Data.Set D:(((Var.VALUE(&__J7_DDR1_SS_BASE)+Var.VALUE(&__DDRSS_CTL_352__SFR_OFFS)))) %Long Var.VALUE(&__DDRSS1_CTL_352_DATA)
	Data.Set D:(((Var.VALUE(&__J7_DDR1_SS_BASE)+Var.VALUE(&__DDRSS_CTL_353__SFR_OFFS)))) %Long Var.VALUE(&__DDRSS1_CTL_353_DATA)
	Data.Set D:(((Var.VALUE(&__J7_DDR1_SS_BASE)+Var.VALUE(&__DDRSS_CTL_354__SFR_OFFS)))) %Long Var.VALUE(&__DDRSS1_CTL_354_DATA)
	Data.Set D:(((Var.VALUE(&__J7_DDR1_SS_BASE)+Var.VALUE(&__DDRSS_CTL_355__SFR_OFFS)))) %Long Var.VALUE(&__DDRSS1_CTL_355_DATA)
	Data.Set D:(((Var.VALUE(&__J7_DDR1_SS_BASE)+Var.VALUE(&__DDRSS_CTL_356__SFR_OFFS)))) %Long Var.VALUE(&__DDRSS1_CTL_356_DATA)
	Data.Set D:(((Var.VALUE(&__J7_DDR1_SS_BASE)+Var.VALUE(&__DDRSS_CTL_357__SFR_OFFS)))) %Long Var.VALUE(&__DDRSS1_CTL_357_DATA)
	Data.Set D:(((Var.VALUE(&__J7_DDR1_SS_BASE)+Var.VALUE(&__DDRSS_CTL_358__SFR_OFFS)))) %Long Var.VALUE(&__DDRSS1_CTL_358_DATA)
	Data.Set D:(((Var.VALUE(&__J7_DDR1_SS_BASE)+Var.VALUE(&__DDRSS_CTL_359__SFR_OFFS)))) %Long Var.VALUE(&__DDRSS1_CTL_359_DATA)
	Data.Set D:(((Var.VALUE(&__J7_DDR1_SS_BASE)+Var.VALUE(&__DDRSS_CTL_360__SFR_OFFS)))) %Long Var.VALUE(&__DDRSS1_CTL_360_DATA)
	Data.Set D:(((Var.VALUE(&__J7_DDR1_SS_BASE)+Var.VALUE(&__DDRSS_CTL_361__SFR_OFFS)))) %Long Var.VALUE(&__DDRSS1_CTL_361_DATA)
	Data.Set D:(((Var.VALUE(&__J7_DDR1_SS_BASE)+Var.VALUE(&__DDRSS_CTL_362__SFR_OFFS)))) %Long Var.VALUE(&__DDRSS1_CTL_362_DATA)
	Data.Set D:(((Var.VALUE(&__J7_DDR1_SS_BASE)+Var.VALUE(&__DDRSS_CTL_363__SFR_OFFS)))) %Long Var.VALUE(&__DDRSS1_CTL_363_DATA)
	Data.Set D:(((Var.VALUE(&__J7_DDR1_SS_BASE)+Var.VALUE(&__DDRSS_CTL_364__SFR_OFFS)))) %Long Var.VALUE(&__DDRSS1_CTL_364_DATA)
	Data.Set D:(((Var.VALUE(&__J7_DDR1_SS_BASE)+Var.VALUE(&__DDRSS_CTL_365__SFR_OFFS)))) %Long Var.VALUE(&__DDRSS1_CTL_365_DATA)
	Data.Set D:(((Var.VALUE(&__J7_DDR1_SS_BASE)+Var.VALUE(&__DDRSS_CTL_366__SFR_OFFS)))) %Long Var.VALUE(&__DDRSS1_CTL_366_DATA)
	Data.Set D:(((Var.VALUE(&__J7_DDR1_SS_BASE)+Var.VALUE(&__DDRSS_CTL_367__SFR_OFFS)))) %Long Var.VALUE(&__DDRSS1_CTL_367_DATA)
	Data.Set D:(((Var.VALUE(&__J7_DDR1_SS_BASE)+Var.VALUE(&__DDRSS_CTL_368__SFR_OFFS)))) %Long Var.VALUE(&__DDRSS1_CTL_368_DATA)
	Data.Set D:(((Var.VALUE(&__J7_DDR1_SS_BASE)+Var.VALUE(&__DDRSS_CTL_369__SFR_OFFS)))) %Long Var.VALUE(&__DDRSS1_CTL_369_DATA)
	Data.Set D:(((Var.VALUE(&__J7_DDR1_SS_BASE)+Var.VALUE(&__DDRSS_CTL_370__SFR_OFFS)))) %Long Var.VALUE(&__DDRSS1_CTL_370_DATA)
	Data.Set D:(((Var.VALUE(&__J7_DDR1_SS_BASE)+Var.VALUE(&__DDRSS_CTL_371__SFR_OFFS)))) %Long Var.VALUE(&__DDRSS1_CTL_371_DATA)
	Data.Set D:(((Var.VALUE(&__J7_DDR1_SS_BASE)+Var.VALUE(&__DDRSS_CTL_372__SFR_OFFS)))) %Long Var.VALUE(&__DDRSS1_CTL_372_DATA)
	Data.Set D:(((Var.VALUE(&__J7_DDR1_SS_BASE)+Var.VALUE(&__DDRSS_CTL_373__SFR_OFFS)))) %Long Var.VALUE(&__DDRSS1_CTL_373_DATA)
	Data.Set D:(((Var.VALUE(&__J7_DDR1_SS_BASE)+Var.VALUE(&__DDRSS_CTL_374__SFR_OFFS)))) %Long Var.VALUE(&__DDRSS1_CTL_374_DATA)
	Data.Set D:(((Var.VALUE(&__J7_DDR1_SS_BASE)+Var.VALUE(&__DDRSS_CTL_375__SFR_OFFS)))) %Long Var.VALUE(&__DDRSS1_CTL_375_DATA)
	Data.Set D:(((Var.VALUE(&__J7_DDR1_SS_BASE)+Var.VALUE(&__DDRSS_CTL_376__SFR_OFFS)))) %Long Var.VALUE(&__DDRSS1_CTL_376_DATA)
	Data.Set D:(((Var.VALUE(&__J7_DDR1_SS_BASE)+Var.VALUE(&__DDRSS_CTL_377__SFR_OFFS)))) %Long Var.VALUE(&__DDRSS1_CTL_377_DATA)
	Data.Set D:(((Var.VALUE(&__J7_DDR1_SS_BASE)+Var.VALUE(&__DDRSS_CTL_378__SFR_OFFS)))) %Long Var.VALUE(&__DDRSS1_CTL_378_DATA)
	Data.Set D:(((Var.VALUE(&__J7_DDR1_SS_BASE)+Var.VALUE(&__DDRSS_CTL_379__SFR_OFFS)))) %Long Var.VALUE(&__DDRSS1_CTL_379_DATA)
	Data.Set D:(((Var.VALUE(&__J7_DDR1_SS_BASE)+Var.VALUE(&__DDRSS_CTL_380__SFR_OFFS)))) %Long Var.VALUE(&__DDRSS1_CTL_380_DATA)
	Data.Set D:(((Var.VALUE(&__J7_DDR1_SS_BASE)+Var.VALUE(&__DDRSS_CTL_381__SFR_OFFS)))) %Long Var.VALUE(&__DDRSS1_CTL_381_DATA)
	Data.Set D:(((Var.VALUE(&__J7_DDR1_SS_BASE)+Var.VALUE(&__DDRSS_CTL_382__SFR_OFFS)))) %Long Var.VALUE(&__DDRSS1_CTL_382_DATA)
	Data.Set D:(((Var.VALUE(&__J7_DDR1_SS_BASE)+Var.VALUE(&__DDRSS_CTL_383__SFR_OFFS)))) %Long Var.VALUE(&__DDRSS1_CTL_383_DATA)
	Data.Set D:(((Var.VALUE(&__J7_DDR1_SS_BASE)+Var.VALUE(&__DDRSS_CTL_384__SFR_OFFS)))) %Long Var.VALUE(&__DDRSS1_CTL_384_DATA)
	Data.Set D:(((Var.VALUE(&__J7_DDR1_SS_BASE)+Var.VALUE(&__DDRSS_CTL_385__SFR_OFFS)))) %Long Var.VALUE(&__DDRSS1_CTL_385_DATA)
	Data.Set D:(((Var.VALUE(&__J7_DDR1_SS_BASE)+Var.VALUE(&__DDRSS_CTL_386__SFR_OFFS)))) %Long Var.VALUE(&__DDRSS1_CTL_386_DATA)
	Data.Set D:(((Var.VALUE(&__J7_DDR1_SS_BASE)+Var.VALUE(&__DDRSS_CTL_387__SFR_OFFS)))) %Long Var.VALUE(&__DDRSS1_CTL_387_DATA)
	Data.Set D:(((Var.VALUE(&__J7_DDR1_SS_BASE)+Var.VALUE(&__DDRSS_CTL_388__SFR_OFFS)))) %Long Var.VALUE(&__DDRSS1_CTL_388_DATA)
	Data.Set D:(((Var.VALUE(&__J7_DDR1_SS_BASE)+Var.VALUE(&__DDRSS_CTL_389__SFR_OFFS)))) %Long Var.VALUE(&__DDRSS1_CTL_389_DATA)
	Data.Set D:(((Var.VALUE(&__J7_DDR1_SS_BASE)+Var.VALUE(&__DDRSS_CTL_390__SFR_OFFS)))) %Long Var.VALUE(&__DDRSS1_CTL_390_DATA)
	Data.Set D:(((Var.VALUE(&__J7_DDR1_SS_BASE)+Var.VALUE(&__DDRSS_CTL_391__SFR_OFFS)))) %Long Var.VALUE(&__DDRSS1_CTL_391_DATA)
	Data.Set D:(((Var.VALUE(&__J7_DDR1_SS_BASE)+Var.VALUE(&__DDRSS_CTL_392__SFR_OFFS)))) %Long Var.VALUE(&__DDRSS1_CTL_392_DATA)
	Data.Set D:(((Var.VALUE(&__J7_DDR1_SS_BASE)+Var.VALUE(&__DDRSS_CTL_393__SFR_OFFS)))) %Long Var.VALUE(&__DDRSS1_CTL_393_DATA)
	Data.Set D:(((Var.VALUE(&__J7_DDR1_SS_BASE)+Var.VALUE(&__DDRSS_CTL_394__SFR_OFFS)))) %Long Var.VALUE(&__DDRSS1_CTL_394_DATA)
	Data.Set D:(((Var.VALUE(&__J7_DDR1_SS_BASE)+Var.VALUE(&__DDRSS_CTL_395__SFR_OFFS)))) %Long Var.VALUE(&__DDRSS1_CTL_395_DATA)
	Data.Set D:(((Var.VALUE(&__J7_DDR1_SS_BASE)+Var.VALUE(&__DDRSS_CTL_396__SFR_OFFS)))) %Long Var.VALUE(&__DDRSS1_CTL_396_DATA)
	Data.Set D:(((Var.VALUE(&__J7_DDR1_SS_BASE)+Var.VALUE(&__DDRSS_CTL_397__SFR_OFFS)))) %Long Var.VALUE(&__DDRSS1_CTL_397_DATA)
	Data.Set D:(((Var.VALUE(&__J7_DDR1_SS_BASE)+Var.VALUE(&__DDRSS_CTL_398__SFR_OFFS)))) %Long Var.VALUE(&__DDRSS1_CTL_398_DATA)
	Data.Set D:(((Var.VALUE(&__J7_DDR1_SS_BASE)+Var.VALUE(&__DDRSS_CTL_399__SFR_OFFS)))) %Long Var.VALUE(&__DDRSS1_CTL_399_DATA)
	Data.Set D:(((Var.VALUE(&__J7_DDR1_SS_BASE)+Var.VALUE(&__DDRSS_CTL_400__SFR_OFFS)))) %Long Var.VALUE(&__DDRSS1_CTL_400_DATA)
	Data.Set D:(((Var.VALUE(&__J7_DDR1_SS_BASE)+Var.VALUE(&__DDRSS_CTL_401__SFR_OFFS)))) %Long Var.VALUE(&__DDRSS1_CTL_401_DATA)
	Data.Set D:(((Var.VALUE(&__J7_DDR1_SS_BASE)+Var.VALUE(&__DDRSS_CTL_402__SFR_OFFS)))) %Long Var.VALUE(&__DDRSS1_CTL_402_DATA)
	Data.Set D:(((Var.VALUE(&__J7_DDR1_SS_BASE)+Var.VALUE(&__DDRSS_CTL_403__SFR_OFFS)))) %Long Var.VALUE(&__DDRSS1_CTL_403_DATA)
	Data.Set D:(((Var.VALUE(&__J7_DDR1_SS_BASE)+Var.VALUE(&__DDRSS_CTL_404__SFR_OFFS)))) %Long Var.VALUE(&__DDRSS1_CTL_404_DATA)
	Data.Set D:(((Var.VALUE(&__J7_DDR1_SS_BASE)+Var.VALUE(&__DDRSS_CTL_405__SFR_OFFS)))) %Long Var.VALUE(&__DDRSS1_CTL_405_DATA)
	Data.Set D:(((Var.VALUE(&__J7_DDR1_SS_BASE)+Var.VALUE(&__DDRSS_CTL_406__SFR_OFFS)))) %Long Var.VALUE(&__DDRSS1_CTL_406_DATA)
	Data.Set D:(((Var.VALUE(&__J7_DDR1_SS_BASE)+Var.VALUE(&__DDRSS_CTL_407__SFR_OFFS)))) %Long Var.VALUE(&__DDRSS1_CTL_407_DATA)
	Data.Set D:(((Var.VALUE(&__J7_DDR1_SS_BASE)+Var.VALUE(&__DDRSS_CTL_408__SFR_OFFS)))) %Long Var.VALUE(&__DDRSS1_CTL_408_DATA)
	Data.Set D:(((Var.VALUE(&__J7_DDR1_SS_BASE)+Var.VALUE(&__DDRSS_CTL_409__SFR_OFFS)))) %Long Var.VALUE(&__DDRSS1_CTL_409_DATA)
	Data.Set D:(((Var.VALUE(&__J7_DDR1_SS_BASE)+Var.VALUE(&__DDRSS_CTL_410__SFR_OFFS)))) %Long Var.VALUE(&__DDRSS1_CTL_410_DATA)
	Data.Set D:(((Var.VALUE(&__J7_DDR1_SS_BASE)+Var.VALUE(&__DDRSS_CTL_411__SFR_OFFS)))) %Long Var.VALUE(&__DDRSS1_CTL_411_DATA)
	Data.Set D:(((Var.VALUE(&__J7_DDR1_SS_BASE)+Var.VALUE(&__DDRSS_CTL_412__SFR_OFFS)))) %Long Var.VALUE(&__DDRSS1_CTL_412_DATA)
	Data.Set D:(((Var.VALUE(&__J7_DDR1_SS_BASE)+Var.VALUE(&__DDRSS_CTL_413__SFR_OFFS)))) %Long Var.VALUE(&__DDRSS1_CTL_413_DATA)
	Data.Set D:(((Var.VALUE(&__J7_DDR1_SS_BASE)+Var.VALUE(&__DDRSS_CTL_414__SFR_OFFS)))) %Long Var.VALUE(&__DDRSS1_CTL_414_DATA)
	Data.Set D:(((Var.VALUE(&__J7_DDR1_SS_BASE)+Var.VALUE(&__DDRSS_CTL_415__SFR_OFFS)))) %Long Var.VALUE(&__DDRSS1_CTL_415_DATA)
	Data.Set D:(((Var.VALUE(&__J7_DDR1_SS_BASE)+Var.VALUE(&__DDRSS_CTL_416__SFR_OFFS)))) %Long Var.VALUE(&__DDRSS1_CTL_416_DATA)
	Data.Set D:(((Var.VALUE(&__J7_DDR1_SS_BASE)+Var.VALUE(&__DDRSS_CTL_417__SFR_OFFS)))) %Long Var.VALUE(&__DDRSS1_CTL_417_DATA)
	Data.Set D:(((Var.VALUE(&__J7_DDR1_SS_BASE)+Var.VALUE(&__DDRSS_CTL_418__SFR_OFFS)))) %Long Var.VALUE(&__DDRSS1_CTL_418_DATA)
	Data.Set D:(((Var.VALUE(&__J7_DDR1_SS_BASE)+Var.VALUE(&__DDRSS_CTL_419__SFR_OFFS)))) %Long Var.VALUE(&__DDRSS1_CTL_419_DATA)
	Data.Set D:(((Var.VALUE(&__J7_DDR1_SS_BASE)+Var.VALUE(&__DDRSS_CTL_420__SFR_OFFS)))) %Long Var.VALUE(&__DDRSS1_CTL_420_DATA)
	Data.Set D:(((Var.VALUE(&__J7_DDR1_SS_BASE)+Var.VALUE(&__DDRSS_CTL_421__SFR_OFFS)))) %Long Var.VALUE(&__DDRSS1_CTL_421_DATA)
	Data.Set D:(((Var.VALUE(&__J7_DDR1_SS_BASE)+Var.VALUE(&__DDRSS_CTL_422__SFR_OFFS)))) %Long Var.VALUE(&__DDRSS1_CTL_422_DATA)
	Data.Set D:(((Var.VALUE(&__J7_DDR1_SS_BASE)+Var.VALUE(&__DDRSS_CTL_423__SFR_OFFS)))) %Long Var.VALUE(&__DDRSS1_CTL_423_DATA)
	Data.Set D:(((Var.VALUE(&__J7_DDR1_SS_BASE)+Var.VALUE(&__DDRSS_CTL_424__SFR_OFFS)))) %Long Var.VALUE(&__DDRSS1_CTL_424_DATA)
	Data.Set D:(((Var.VALUE(&__J7_DDR1_SS_BASE)+Var.VALUE(&__DDRSS_CTL_425__SFR_OFFS)))) %Long Var.VALUE(&__DDRSS1_CTL_425_DATA)
	Data.Set D:(((Var.VALUE(&__J7_DDR1_SS_BASE)+Var.VALUE(&__DDRSS_CTL_426__SFR_OFFS)))) %Long Var.VALUE(&__DDRSS1_CTL_426_DATA)
	Data.Set D:(((Var.VALUE(&__J7_DDR1_SS_BASE)+Var.VALUE(&__DDRSS_CTL_427__SFR_OFFS)))) %Long Var.VALUE(&__DDRSS1_CTL_427_DATA)
	Data.Set D:(((Var.VALUE(&__J7_DDR1_SS_BASE)+Var.VALUE(&__DDRSS_CTL_428__SFR_OFFS)))) %Long Var.VALUE(&__DDRSS1_CTL_428_DATA)
	Data.Set D:(((Var.VALUE(&__J7_DDR1_SS_BASE)+Var.VALUE(&__DDRSS_CTL_429__SFR_OFFS)))) %Long Var.VALUE(&__DDRSS1_CTL_429_DATA)
	Data.Set D:(((Var.VALUE(&__J7_DDR1_SS_BASE)+Var.VALUE(&__DDRSS_CTL_430__SFR_OFFS)))) %Long Var.VALUE(&__DDRSS1_CTL_430_DATA)
	Data.Set D:(((Var.VALUE(&__J7_DDR1_SS_BASE)+Var.VALUE(&__DDRSS_CTL_431__SFR_OFFS)))) %Long Var.VALUE(&__DDRSS1_CTL_431_DATA)
	Data.Set D:(((Var.VALUE(&__J7_DDR1_SS_BASE)+Var.VALUE(&__DDRSS_CTL_432__SFR_OFFS)))) %Long Var.VALUE(&__DDRSS1_CTL_432_DATA)
	Data.Set D:(((Var.VALUE(&__J7_DDR1_SS_BASE)+Var.VALUE(&__DDRSS_CTL_433__SFR_OFFS)))) %Long Var.VALUE(&__DDRSS1_CTL_433_DATA)
	Data.Set D:(((Var.VALUE(&__J7_DDR1_SS_BASE)+Var.VALUE(&__DDRSS_CTL_434__SFR_OFFS)))) %Long Var.VALUE(&__DDRSS1_CTL_434_DATA)
	Data.Set D:(((Var.VALUE(&__J7_DDR1_SS_BASE)+Var.VALUE(&__DDRSS_CTL_435__SFR_OFFS)))) %Long Var.VALUE(&__DDRSS1_CTL_435_DATA)
	Data.Set D:(((Var.VALUE(&__J7_DDR1_SS_BASE)+Var.VALUE(&__DDRSS_CTL_436__SFR_OFFS)))) %Long Var.VALUE(&__DDRSS1_CTL_436_DATA)
	Data.Set D:(((Var.VALUE(&__J7_DDR1_SS_BASE)+Var.VALUE(&__DDRSS_CTL_437__SFR_OFFS)))) %Long Var.VALUE(&__DDRSS1_CTL_437_DATA)
	Data.Set D:(((Var.VALUE(&__J7_DDR1_SS_BASE)+Var.VALUE(&__DDRSS_CTL_438__SFR_OFFS)))) %Long Var.VALUE(&__DDRSS1_CTL_438_DATA)
	Data.Set D:(((Var.VALUE(&__J7_DDR1_SS_BASE)+Var.VALUE(&__DDRSS_CTL_439__SFR_OFFS)))) %Long Var.VALUE(&__DDRSS1_CTL_439_DATA)
	Data.Set D:(((Var.VALUE(&__J7_DDR1_SS_BASE)+Var.VALUE(&__DDRSS_CTL_440__SFR_OFFS)))) %Long Var.VALUE(&__DDRSS1_CTL_440_DATA)
	Data.Set D:(((Var.VALUE(&__J7_DDR1_SS_BASE)+Var.VALUE(&__DDRSS_CTL_441__SFR_OFFS)))) %Long Var.VALUE(&__DDRSS1_CTL_441_DATA)
	Data.Set D:(((Var.VALUE(&__J7_DDR1_SS_BASE)+Var.VALUE(&__DDRSS_CTL_442__SFR_OFFS)))) %Long Var.VALUE(&__DDRSS1_CTL_442_DATA)
	Data.Set D:(((Var.VALUE(&__J7_DDR1_SS_BASE)+Var.VALUE(&__DDRSS_CTL_443__SFR_OFFS)))) %Long Var.VALUE(&__DDRSS1_CTL_443_DATA)
	Data.Set D:(((Var.VALUE(&__J7_DDR1_SS_BASE)+Var.VALUE(&__DDRSS_CTL_444__SFR_OFFS)))) %Long Var.VALUE(&__DDRSS1_CTL_444_DATA)
	Data.Set D:(((Var.VALUE(&__J7_DDR1_SS_BASE)+Var.VALUE(&__DDRSS_CTL_445__SFR_OFFS)))) %Long Var.VALUE(&__DDRSS1_CTL_445_DATA)
	Data.Set D:(((Var.VALUE(&__J7_DDR1_SS_BASE)+Var.VALUE(&__DDRSS_CTL_446__SFR_OFFS)))) %Long Var.VALUE(&__DDRSS1_CTL_446_DATA)
	Data.Set D:(((Var.VALUE(&__J7_DDR1_SS_BASE)+Var.VALUE(&__DDRSS_CTL_447__SFR_OFFS)))) %Long Var.VALUE(&__DDRSS1_CTL_447_DATA)
	Data.Set D:(((Var.VALUE(&__J7_DDR1_SS_BASE)+Var.VALUE(&__DDRSS_CTL_448__SFR_OFFS)))) %Long Var.VALUE(&__DDRSS1_CTL_448_DATA)
	Data.Set D:(((Var.VALUE(&__J7_DDR1_SS_BASE)+Var.VALUE(&__DDRSS_CTL_449__SFR_OFFS)))) %Long Var.VALUE(&__DDRSS1_CTL_449_DATA)
	Data.Set D:(((Var.VALUE(&__J7_DDR1_SS_BASE)+Var.VALUE(&__DDRSS_CTL_450__SFR_OFFS)))) %Long Var.VALUE(&__DDRSS1_CTL_450_DATA)
	Data.Set D:(((Var.VALUE(&__J7_DDR1_SS_BASE)+Var.VALUE(&__DDRSS_CTL_451__SFR_OFFS)))) %Long Var.VALUE(&__DDRSS1_CTL_451_DATA)
	Data.Set D:(((Var.VALUE(&__J7_DDR1_SS_BASE)+Var.VALUE(&__DDRSS_CTL_452__SFR_OFFS)))) %Long Var.VALUE(&__DDRSS1_CTL_452_DATA)
	Data.Set D:(((Var.VALUE(&__J7_DDR1_SS_BASE)+Var.VALUE(&__DDRSS_CTL_453__SFR_OFFS)))) %Long Var.VALUE(&__DDRSS1_CTL_453_DATA)
	Data.Set D:(((Var.VALUE(&__J7_DDR1_SS_BASE)+Var.VALUE(&__DDRSS_CTL_454__SFR_OFFS)))) %Long Var.VALUE(&__DDRSS1_CTL_454_DATA)
	Data.Set D:(((Var.VALUE(&__J7_DDR1_SS_BASE)+Var.VALUE(&__DDRSS_CTL_455__SFR_OFFS)))) %Long Var.VALUE(&__DDRSS1_CTL_455_DATA)
	Data.Set D:(((Var.VALUE(&__J7_DDR1_SS_BASE)+Var.VALUE(&__DDRSS_CTL_456__SFR_OFFS)))) %Long Var.VALUE(&__DDRSS1_CTL_456_DATA)
	Data.Set D:(((Var.VALUE(&__J7_DDR1_SS_BASE)+Var.VALUE(&__DDRSS_CTL_457__SFR_OFFS)))) %Long Var.VALUE(&__DDRSS1_CTL_457_DATA)
	Data.Set D:(((Var.VALUE(&__J7_DDR1_SS_BASE)+Var.VALUE(&__DDRSS_CTL_458__SFR_OFFS)))) %Long Var.VALUE(&__DDRSS1_CTL_458_DATA)
	Var.NEWLOCAL char[128] \strtmp = "--->>> DDR1 controller programming completed... <<<---\n"
	GOSUB printf Var.String(\strtmp)
	
	Var.NEWLOCAL char[128] \strtmp = "--->>> DDR1 PI programming in progress.. <<<---\n"
	GOSUB printf Var.String(\strtmp)
	
	Data.Set D:((((Var.VALUE(&__J7_DDR1_SS_BASE)+Var.VALUE(&__DDRSS_PI_REGISTER_BLOCK__OFFS))+Var.VALUE(&__DDRSS_PI_0__SFR_OFFS)))) %Long Var.VALUE(&__DDRSS1_PI_00_DATA)
	Data.Set D:((((Var.VALUE(&__J7_DDR1_SS_BASE)+Var.VALUE(&__DDRSS_PI_REGISTER_BLOCK__OFFS))+Var.VALUE(&__DDRSS_PI_1__SFR_OFFS)))) %Long Var.VALUE(&__DDRSS1_PI_01_DATA)
	Data.Set D:((((Var.VALUE(&__J7_DDR1_SS_BASE)+Var.VALUE(&__DDRSS_PI_REGISTER_BLOCK__OFFS))+Var.VALUE(&__DDRSS_PI_2__SFR_OFFS)))) %Long Var.VALUE(&__DDRSS1_PI_02_DATA)
	Data.Set D:((((Var.VALUE(&__J7_DDR1_SS_BASE)+Var.VALUE(&__DDRSS_PI_REGISTER_BLOCK__OFFS))+Var.VALUE(&__DDRSS_PI_3__SFR_OFFS)))) %Long Var.VALUE(&__DDRSS1_PI_03_DATA)
	Data.Set D:((((Var.VALUE(&__J7_DDR1_SS_BASE)+Var.VALUE(&__DDRSS_PI_REGISTER_BLOCK__OFFS))+Var.VALUE(&__DDRSS_PI_4__SFR_OFFS)))) %Long Var.VALUE(&__DDRSS1_PI_04_DATA)
	Data.Set D:((((Var.VALUE(&__J7_DDR1_SS_BASE)+Var.VALUE(&__DDRSS_PI_REGISTER_BLOCK__OFFS))+Var.VALUE(&__DDRSS_PI_5__SFR_OFFS)))) %Long Var.VALUE(&__DDRSS1_PI_05_DATA)
	Data.Set D:((((Var.VALUE(&__J7_DDR1_SS_BASE)+Var.VALUE(&__DDRSS_PI_REGISTER_BLOCK__OFFS))+Var.VALUE(&__DDRSS_PI_6__SFR_OFFS)))) %Long Var.VALUE(&__DDRSS1_PI_06_DATA)
	Data.Set D:((((Var.VALUE(&__J7_DDR1_SS_BASE)+Var.VALUE(&__DDRSS_PI_REGISTER_BLOCK__OFFS))+Var.VALUE(&__DDRSS_PI_7__SFR_OFFS)))) %Long Var.VALUE(&__DDRSS1_PI_07_DATA)
	Data.Set D:((((Var.VALUE(&__J7_DDR1_SS_BASE)+Var.VALUE(&__DDRSS_PI_REGISTER_BLOCK__OFFS))+Var.VALUE(&__DDRSS_PI_8__SFR_OFFS)))) %Long Var.VALUE(&__DDRSS1_PI_08_DATA)
	Data.Set D:((((Var.VALUE(&__J7_DDR1_SS_BASE)+Var.VALUE(&__DDRSS_PI_REGISTER_BLOCK__OFFS))+Var.VALUE(&__DDRSS_PI_9__SFR_OFFS)))) %Long Var.VALUE(&__DDRSS1_PI_09_DATA)
	Data.Set D:((((Var.VALUE(&__J7_DDR1_SS_BASE)+Var.VALUE(&__DDRSS_PI_REGISTER_BLOCK__OFFS))+Var.VALUE(&__DDRSS_PI_10__SFR_OFFS)))) %Long Var.VALUE(&__DDRSS1_PI_10_DATA)
	Data.Set D:((((Var.VALUE(&__J7_DDR1_SS_BASE)+Var.VALUE(&__DDRSS_PI_REGISTER_BLOCK__OFFS))+Var.VALUE(&__DDRSS_PI_11__SFR_OFFS)))) %Long Var.VALUE(&__DDRSS1_PI_11_DATA)
	Data.Set D:((((Var.VALUE(&__J7_DDR1_SS_BASE)+Var.VALUE(&__DDRSS_PI_REGISTER_BLOCK__OFFS))+Var.VALUE(&__DDRSS_PI_12__SFR_OFFS)))) %Long Var.VALUE(&__DDRSS1_PI_12_DATA)
	Data.Set D:((((Var.VALUE(&__J7_DDR1_SS_BASE)+Var.VALUE(&__DDRSS_PI_REGISTER_BLOCK__OFFS))+Var.VALUE(&__DDRSS_PI_13__SFR_OFFS)))) %Long Var.VALUE(&__DDRSS1_PI_13_DATA)
	Data.Set D:((((Var.VALUE(&__J7_DDR1_SS_BASE)+Var.VALUE(&__DDRSS_PI_REGISTER_BLOCK__OFFS))+Var.VALUE(&__DDRSS_PI_14__SFR_OFFS)))) %Long Var.VALUE(&__DDRSS1_PI_14_DATA)
	Data.Set D:((((Var.VALUE(&__J7_DDR1_SS_BASE)+Var.VALUE(&__DDRSS_PI_REGISTER_BLOCK__OFFS))+Var.VALUE(&__DDRSS_PI_15__SFR_OFFS)))) %Long Var.VALUE(&__DDRSS1_PI_15_DATA)
	Data.Set D:((((Var.VALUE(&__J7_DDR1_SS_BASE)+Var.VALUE(&__DDRSS_PI_REGISTER_BLOCK__OFFS))+Var.VALUE(&__DDRSS_PI_16__SFR_OFFS)))) %Long Var.VALUE(&__DDRSS1_PI_16_DATA)
	Data.Set D:((((Var.VALUE(&__J7_DDR1_SS_BASE)+Var.VALUE(&__DDRSS_PI_REGISTER_BLOCK__OFFS))+Var.VALUE(&__DDRSS_PI_17__SFR_OFFS)))) %Long Var.VALUE(&__DDRSS1_PI_17_DATA)
	Data.Set D:((((Var.VALUE(&__J7_DDR1_SS_BASE)+Var.VALUE(&__DDRSS_PI_REGISTER_BLOCK__OFFS))+Var.VALUE(&__DDRSS_PI_18__SFR_OFFS)))) %Long Var.VALUE(&__DDRSS1_PI_18_DATA)
	Data.Set D:((((Var.VALUE(&__J7_DDR1_SS_BASE)+Var.VALUE(&__DDRSS_PI_REGISTER_BLOCK__OFFS))+Var.VALUE(&__DDRSS_PI_19__SFR_OFFS)))) %Long Var.VALUE(&__DDRSS1_PI_19_DATA)
	Data.Set D:((((Var.VALUE(&__J7_DDR1_SS_BASE)+Var.VALUE(&__DDRSS_PI_REGISTER_BLOCK__OFFS))+Var.VALUE(&__DDRSS_PI_20__SFR_OFFS)))) %Long Var.VALUE(&__DDRSS1_PI_20_DATA)
	Data.Set D:((((Var.VALUE(&__J7_DDR1_SS_BASE)+Var.VALUE(&__DDRSS_PI_REGISTER_BLOCK__OFFS))+Var.VALUE(&__DDRSS_PI_21__SFR_OFFS)))) %Long Var.VALUE(&__DDRSS1_PI_21_DATA)
	Data.Set D:((((Var.VALUE(&__J7_DDR1_SS_BASE)+Var.VALUE(&__DDRSS_PI_REGISTER_BLOCK__OFFS))+Var.VALUE(&__DDRSS_PI_22__SFR_OFFS)))) %Long Var.VALUE(&__DDRSS1_PI_22_DATA)
	Data.Set D:((((Var.VALUE(&__J7_DDR1_SS_BASE)+Var.VALUE(&__DDRSS_PI_REGISTER_BLOCK__OFFS))+Var.VALUE(&__DDRSS_PI_23__SFR_OFFS)))) %Long Var.VALUE(&__DDRSS1_PI_23_DATA)
	Data.Set D:((((Var.VALUE(&__J7_DDR1_SS_BASE)+Var.VALUE(&__DDRSS_PI_REGISTER_BLOCK__OFFS))+Var.VALUE(&__DDRSS_PI_24__SFR_OFFS)))) %Long Var.VALUE(&__DDRSS1_PI_24_DATA)
	Data.Set D:((((Var.VALUE(&__J7_DDR1_SS_BASE)+Var.VALUE(&__DDRSS_PI_REGISTER_BLOCK__OFFS))+Var.VALUE(&__DDRSS_PI_25__SFR_OFFS)))) %Long Var.VALUE(&__DDRSS1_PI_25_DATA)
	Data.Set D:((((Var.VALUE(&__J7_DDR1_SS_BASE)+Var.VALUE(&__DDRSS_PI_REGISTER_BLOCK__OFFS))+Var.VALUE(&__DDRSS_PI_26__SFR_OFFS)))) %Long Var.VALUE(&__DDRSS1_PI_26_DATA)
	Data.Set D:((((Var.VALUE(&__J7_DDR1_SS_BASE)+Var.VALUE(&__DDRSS_PI_REGISTER_BLOCK__OFFS))+Var.VALUE(&__DDRSS_PI_27__SFR_OFFS)))) %Long Var.VALUE(&__DDRSS1_PI_27_DATA)
	Data.Set D:((((Var.VALUE(&__J7_DDR1_SS_BASE)+Var.VALUE(&__DDRSS_PI_REGISTER_BLOCK__OFFS))+Var.VALUE(&__DDRSS_PI_28__SFR_OFFS)))) %Long Var.VALUE(&__DDRSS1_PI_28_DATA)
	Data.Set D:((((Var.VALUE(&__J7_DDR1_SS_BASE)+Var.VALUE(&__DDRSS_PI_REGISTER_BLOCK__OFFS))+Var.VALUE(&__DDRSS_PI_29__SFR_OFFS)))) %Long Var.VALUE(&__DDRSS1_PI_29_DATA)
	Data.Set D:((((Var.VALUE(&__J7_DDR1_SS_BASE)+Var.VALUE(&__DDRSS_PI_REGISTER_BLOCK__OFFS))+Var.VALUE(&__DDRSS_PI_30__SFR_OFFS)))) %Long Var.VALUE(&__DDRSS1_PI_30_DATA)
	Data.Set D:((((Var.VALUE(&__J7_DDR1_SS_BASE)+Var.VALUE(&__DDRSS_PI_REGISTER_BLOCK__OFFS))+Var.VALUE(&__DDRSS_PI_31__SFR_OFFS)))) %Long Var.VALUE(&__DDRSS1_PI_31_DATA)
	Data.Set D:((((Var.VALUE(&__J7_DDR1_SS_BASE)+Var.VALUE(&__DDRSS_PI_REGISTER_BLOCK__OFFS))+Var.VALUE(&__DDRSS_PI_32__SFR_OFFS)))) %Long Var.VALUE(&__DDRSS1_PI_32_DATA)
	Data.Set D:((((Var.VALUE(&__J7_DDR1_SS_BASE)+Var.VALUE(&__DDRSS_PI_REGISTER_BLOCK__OFFS))+Var.VALUE(&__DDRSS_PI_33__SFR_OFFS)))) %Long Var.VALUE(&__DDRSS1_PI_33_DATA)
	Data.Set D:((((Var.VALUE(&__J7_DDR1_SS_BASE)+Var.VALUE(&__DDRSS_PI_REGISTER_BLOCK__OFFS))+Var.VALUE(&__DDRSS_PI_34__SFR_OFFS)))) %Long Var.VALUE(&__DDRSS1_PI_34_DATA)
	Data.Set D:((((Var.VALUE(&__J7_DDR1_SS_BASE)+Var.VALUE(&__DDRSS_PI_REGISTER_BLOCK__OFFS))+Var.VALUE(&__DDRSS_PI_35__SFR_OFFS)))) %Long Var.VALUE(&__DDRSS1_PI_35_DATA)
	Data.Set D:((((Var.VALUE(&__J7_DDR1_SS_BASE)+Var.VALUE(&__DDRSS_PI_REGISTER_BLOCK__OFFS))+Var.VALUE(&__DDRSS_PI_36__SFR_OFFS)))) %Long Var.VALUE(&__DDRSS1_PI_36_DATA)
	Data.Set D:((((Var.VALUE(&__J7_DDR1_SS_BASE)+Var.VALUE(&__DDRSS_PI_REGISTER_BLOCK__OFFS))+Var.VALUE(&__DDRSS_PI_37__SFR_OFFS)))) %Long Var.VALUE(&__DDRSS1_PI_37_DATA)
	Data.Set D:((((Var.VALUE(&__J7_DDR1_SS_BASE)+Var.VALUE(&__DDRSS_PI_REGISTER_BLOCK__OFFS))+Var.VALUE(&__DDRSS_PI_38__SFR_OFFS)))) %Long Var.VALUE(&__DDRSS1_PI_38_DATA)
	Data.Set D:((((Var.VALUE(&__J7_DDR1_SS_BASE)+Var.VALUE(&__DDRSS_PI_REGISTER_BLOCK__OFFS))+Var.VALUE(&__DDRSS_PI_39__SFR_OFFS)))) %Long Var.VALUE(&__DDRSS1_PI_39_DATA)
	Data.Set D:((((Var.VALUE(&__J7_DDR1_SS_BASE)+Var.VALUE(&__DDRSS_PI_REGISTER_BLOCK__OFFS))+Var.VALUE(&__DDRSS_PI_40__SFR_OFFS)))) %Long Var.VALUE(&__DDRSS1_PI_40_DATA)
	Data.Set D:((((Var.VALUE(&__J7_DDR1_SS_BASE)+Var.VALUE(&__DDRSS_PI_REGISTER_BLOCK__OFFS))+Var.VALUE(&__DDRSS_PI_41__SFR_OFFS)))) %Long Var.VALUE(&__DDRSS1_PI_41_DATA)
	Data.Set D:((((Var.VALUE(&__J7_DDR1_SS_BASE)+Var.VALUE(&__DDRSS_PI_REGISTER_BLOCK__OFFS))+Var.VALUE(&__DDRSS_PI_42__SFR_OFFS)))) %Long Var.VALUE(&__DDRSS1_PI_42_DATA)
	Data.Set D:((((Var.VALUE(&__J7_DDR1_SS_BASE)+Var.VALUE(&__DDRSS_PI_REGISTER_BLOCK__OFFS))+Var.VALUE(&__DDRSS_PI_43__SFR_OFFS)))) %Long Var.VALUE(&__DDRSS1_PI_43_DATA)
	Data.Set D:((((Var.VALUE(&__J7_DDR1_SS_BASE)+Var.VALUE(&__DDRSS_PI_REGISTER_BLOCK__OFFS))+Var.VALUE(&__DDRSS_PI_44__SFR_OFFS)))) %Long Var.VALUE(&__DDRSS1_PI_44_DATA)
	Data.Set D:((((Var.VALUE(&__J7_DDR1_SS_BASE)+Var.VALUE(&__DDRSS_PI_REGISTER_BLOCK__OFFS))+Var.VALUE(&__DDRSS_PI_45__SFR_OFFS)))) %Long Var.VALUE(&__DDRSS1_PI_45_DATA)
	Data.Set D:((((Var.VALUE(&__J7_DDR1_SS_BASE)+Var.VALUE(&__DDRSS_PI_REGISTER_BLOCK__OFFS))+Var.VALUE(&__DDRSS_PI_46__SFR_OFFS)))) %Long Var.VALUE(&__DDRSS1_PI_46_DATA)
	Data.Set D:((((Var.VALUE(&__J7_DDR1_SS_BASE)+Var.VALUE(&__DDRSS_PI_REGISTER_BLOCK__OFFS))+Var.VALUE(&__DDRSS_PI_47__SFR_OFFS)))) %Long Var.VALUE(&__DDRSS1_PI_47_DATA)
	Data.Set D:((((Var.VALUE(&__J7_DDR1_SS_BASE)+Var.VALUE(&__DDRSS_PI_REGISTER_BLOCK__OFFS))+Var.VALUE(&__DDRSS_PI_48__SFR_OFFS)))) %Long Var.VALUE(&__DDRSS1_PI_48_DATA)
	Data.Set D:((((Var.VALUE(&__J7_DDR1_SS_BASE)+Var.VALUE(&__DDRSS_PI_REGISTER_BLOCK__OFFS))+Var.VALUE(&__DDRSS_PI_49__SFR_OFFS)))) %Long Var.VALUE(&__DDRSS1_PI_49_DATA)
	Data.Set D:((((Var.VALUE(&__J7_DDR1_SS_BASE)+Var.VALUE(&__DDRSS_PI_REGISTER_BLOCK__OFFS))+Var.VALUE(&__DDRSS_PI_50__SFR_OFFS)))) %Long Var.VALUE(&__DDRSS1_PI_50_DATA)
	Data.Set D:((((Var.VALUE(&__J7_DDR1_SS_BASE)+Var.VALUE(&__DDRSS_PI_REGISTER_BLOCK__OFFS))+Var.VALUE(&__DDRSS_PI_51__SFR_OFFS)))) %Long Var.VALUE(&__DDRSS1_PI_51_DATA)
	Data.Set D:((((Var.VALUE(&__J7_DDR1_SS_BASE)+Var.VALUE(&__DDRSS_PI_REGISTER_BLOCK__OFFS))+Var.VALUE(&__DDRSS_PI_52__SFR_OFFS)))) %Long Var.VALUE(&__DDRSS1_PI_52_DATA)
	Data.Set D:((((Var.VALUE(&__J7_DDR1_SS_BASE)+Var.VALUE(&__DDRSS_PI_REGISTER_BLOCK__OFFS))+Var.VALUE(&__DDRSS_PI_53__SFR_OFFS)))) %Long Var.VALUE(&__DDRSS1_PI_53_DATA)
	Data.Set D:((((Var.VALUE(&__J7_DDR1_SS_BASE)+Var.VALUE(&__DDRSS_PI_REGISTER_BLOCK__OFFS))+Var.VALUE(&__DDRSS_PI_54__SFR_OFFS)))) %Long Var.VALUE(&__DDRSS1_PI_54_DATA)
	Data.Set D:((((Var.VALUE(&__J7_DDR1_SS_BASE)+Var.VALUE(&__DDRSS_PI_REGISTER_BLOCK__OFFS))+Var.VALUE(&__DDRSS_PI_55__SFR_OFFS)))) %Long Var.VALUE(&__DDRSS1_PI_55_DATA)
	Data.Set D:((((Var.VALUE(&__J7_DDR1_SS_BASE)+Var.VALUE(&__DDRSS_PI_REGISTER_BLOCK__OFFS))+Var.VALUE(&__DDRSS_PI_56__SFR_OFFS)))) %Long Var.VALUE(&__DDRSS1_PI_56_DATA)
	Data.Set D:((((Var.VALUE(&__J7_DDR1_SS_BASE)+Var.VALUE(&__DDRSS_PI_REGISTER_BLOCK__OFFS))+Var.VALUE(&__DDRSS_PI_57__SFR_OFFS)))) %Long Var.VALUE(&__DDRSS1_PI_57_DATA)
	Data.Set D:((((Var.VALUE(&__J7_DDR1_SS_BASE)+Var.VALUE(&__DDRSS_PI_REGISTER_BLOCK__OFFS))+Var.VALUE(&__DDRSS_PI_58__SFR_OFFS)))) %Long Var.VALUE(&__DDRSS1_PI_58_DATA)
	Data.Set D:((((Var.VALUE(&__J7_DDR1_SS_BASE)+Var.VALUE(&__DDRSS_PI_REGISTER_BLOCK__OFFS))+Var.VALUE(&__DDRSS_PI_59__SFR_OFFS)))) %Long Var.VALUE(&__DDRSS1_PI_59_DATA)
	Data.Set D:((((Var.VALUE(&__J7_DDR1_SS_BASE)+Var.VALUE(&__DDRSS_PI_REGISTER_BLOCK__OFFS))+Var.VALUE(&__DDRSS_PI_60__SFR_OFFS)))) %Long Var.VALUE(&__DDRSS1_PI_60_DATA)
	Data.Set D:((((Var.VALUE(&__J7_DDR1_SS_BASE)+Var.VALUE(&__DDRSS_PI_REGISTER_BLOCK__OFFS))+Var.VALUE(&__DDRSS_PI_61__SFR_OFFS)))) %Long Var.VALUE(&__DDRSS1_PI_61_DATA)
	Data.Set D:((((Var.VALUE(&__J7_DDR1_SS_BASE)+Var.VALUE(&__DDRSS_PI_REGISTER_BLOCK__OFFS))+Var.VALUE(&__DDRSS_PI_62__SFR_OFFS)))) %Long Var.VALUE(&__DDRSS1_PI_62_DATA)
	Data.Set D:((((Var.VALUE(&__J7_DDR1_SS_BASE)+Var.VALUE(&__DDRSS_PI_REGISTER_BLOCK__OFFS))+Var.VALUE(&__DDRSS_PI_63__SFR_OFFS)))) %Long Var.VALUE(&__DDRSS1_PI_63_DATA)
	Data.Set D:((((Var.VALUE(&__J7_DDR1_SS_BASE)+Var.VALUE(&__DDRSS_PI_REGISTER_BLOCK__OFFS))+Var.VALUE(&__DDRSS_PI_64__SFR_OFFS)))) %Long Var.VALUE(&__DDRSS1_PI_64_DATA)
	Data.Set D:((((Var.VALUE(&__J7_DDR1_SS_BASE)+Var.VALUE(&__DDRSS_PI_REGISTER_BLOCK__OFFS))+Var.VALUE(&__DDRSS_PI_65__SFR_OFFS)))) %Long Var.VALUE(&__DDRSS1_PI_65_DATA)
	Data.Set D:((((Var.VALUE(&__J7_DDR1_SS_BASE)+Var.VALUE(&__DDRSS_PI_REGISTER_BLOCK__OFFS))+Var.VALUE(&__DDRSS_PI_66__SFR_OFFS)))) %Long Var.VALUE(&__DDRSS1_PI_66_DATA)
	Data.Set D:((((Var.VALUE(&__J7_DDR1_SS_BASE)+Var.VALUE(&__DDRSS_PI_REGISTER_BLOCK__OFFS))+Var.VALUE(&__DDRSS_PI_67__SFR_OFFS)))) %Long Var.VALUE(&__DDRSS1_PI_67_DATA)
	Data.Set D:((((Var.VALUE(&__J7_DDR1_SS_BASE)+Var.VALUE(&__DDRSS_PI_REGISTER_BLOCK__OFFS))+Var.VALUE(&__DDRSS_PI_68__SFR_OFFS)))) %Long Var.VALUE(&__DDRSS1_PI_68_DATA)
	Data.Set D:((((Var.VALUE(&__J7_DDR1_SS_BASE)+Var.VALUE(&__DDRSS_PI_REGISTER_BLOCK__OFFS))+Var.VALUE(&__DDRSS_PI_69__SFR_OFFS)))) %Long Var.VALUE(&__DDRSS1_PI_69_DATA)
	Data.Set D:((((Var.VALUE(&__J7_DDR1_SS_BASE)+Var.VALUE(&__DDRSS_PI_REGISTER_BLOCK__OFFS))+Var.VALUE(&__DDRSS_PI_70__SFR_OFFS)))) %Long Var.VALUE(&__DDRSS1_PI_70_DATA)
	Data.Set D:((((Var.VALUE(&__J7_DDR1_SS_BASE)+Var.VALUE(&__DDRSS_PI_REGISTER_BLOCK__OFFS))+Var.VALUE(&__DDRSS_PI_71__SFR_OFFS)))) %Long Var.VALUE(&__DDRSS1_PI_71_DATA)
	Data.Set D:((((Var.VALUE(&__J7_DDR1_SS_BASE)+Var.VALUE(&__DDRSS_PI_REGISTER_BLOCK__OFFS))+Var.VALUE(&__DDRSS_PI_72__SFR_OFFS)))) %Long Var.VALUE(&__DDRSS1_PI_72_DATA)
	Data.Set D:((((Var.VALUE(&__J7_DDR1_SS_BASE)+Var.VALUE(&__DDRSS_PI_REGISTER_BLOCK__OFFS))+Var.VALUE(&__DDRSS_PI_73__SFR_OFFS)))) %Long Var.VALUE(&__DDRSS1_PI_73_DATA)
	Data.Set D:((((Var.VALUE(&__J7_DDR1_SS_BASE)+Var.VALUE(&__DDRSS_PI_REGISTER_BLOCK__OFFS))+Var.VALUE(&__DDRSS_PI_74__SFR_OFFS)))) %Long Var.VALUE(&__DDRSS1_PI_74_DATA)
	Data.Set D:((((Var.VALUE(&__J7_DDR1_SS_BASE)+Var.VALUE(&__DDRSS_PI_REGISTER_BLOCK__OFFS))+Var.VALUE(&__DDRSS_PI_75__SFR_OFFS)))) %Long Var.VALUE(&__DDRSS1_PI_75_DATA)
	Data.Set D:((((Var.VALUE(&__J7_DDR1_SS_BASE)+Var.VALUE(&__DDRSS_PI_REGISTER_BLOCK__OFFS))+Var.VALUE(&__DDRSS_PI_76__SFR_OFFS)))) %Long Var.VALUE(&__DDRSS1_PI_76_DATA)
	Data.Set D:((((Var.VALUE(&__J7_DDR1_SS_BASE)+Var.VALUE(&__DDRSS_PI_REGISTER_BLOCK__OFFS))+Var.VALUE(&__DDRSS_PI_77__SFR_OFFS)))) %Long Var.VALUE(&__DDRSS1_PI_77_DATA)
	Data.Set D:((((Var.VALUE(&__J7_DDR1_SS_BASE)+Var.VALUE(&__DDRSS_PI_REGISTER_BLOCK__OFFS))+Var.VALUE(&__DDRSS_PI_78__SFR_OFFS)))) %Long Var.VALUE(&__DDRSS1_PI_78_DATA)
	Data.Set D:((((Var.VALUE(&__J7_DDR1_SS_BASE)+Var.VALUE(&__DDRSS_PI_REGISTER_BLOCK__OFFS))+Var.VALUE(&__DDRSS_PI_79__SFR_OFFS)))) %Long Var.VALUE(&__DDRSS1_PI_79_DATA)
	Data.Set D:((((Var.VALUE(&__J7_DDR1_SS_BASE)+Var.VALUE(&__DDRSS_PI_REGISTER_BLOCK__OFFS))+Var.VALUE(&__DDRSS_PI_80__SFR_OFFS)))) %Long Var.VALUE(&__DDRSS1_PI_80_DATA)
	Data.Set D:((((Var.VALUE(&__J7_DDR1_SS_BASE)+Var.VALUE(&__DDRSS_PI_REGISTER_BLOCK__OFFS))+Var.VALUE(&__DDRSS_PI_81__SFR_OFFS)))) %Long Var.VALUE(&__DDRSS1_PI_81_DATA)
	Data.Set D:((((Var.VALUE(&__J7_DDR1_SS_BASE)+Var.VALUE(&__DDRSS_PI_REGISTER_BLOCK__OFFS))+Var.VALUE(&__DDRSS_PI_82__SFR_OFFS)))) %Long Var.VALUE(&__DDRSS1_PI_82_DATA)
	Data.Set D:((((Var.VALUE(&__J7_DDR1_SS_BASE)+Var.VALUE(&__DDRSS_PI_REGISTER_BLOCK__OFFS))+Var.VALUE(&__DDRSS_PI_83__SFR_OFFS)))) %Long Var.VALUE(&__DDRSS1_PI_83_DATA)
	Data.Set D:((((Var.VALUE(&__J7_DDR1_SS_BASE)+Var.VALUE(&__DDRSS_PI_REGISTER_BLOCK__OFFS))+Var.VALUE(&__DDRSS_PI_84__SFR_OFFS)))) %Long Var.VALUE(&__DDRSS1_PI_84_DATA)
	Data.Set D:((((Var.VALUE(&__J7_DDR1_SS_BASE)+Var.VALUE(&__DDRSS_PI_REGISTER_BLOCK__OFFS))+Var.VALUE(&__DDRSS_PI_85__SFR_OFFS)))) %Long Var.VALUE(&__DDRSS1_PI_85_DATA)
	Data.Set D:((((Var.VALUE(&__J7_DDR1_SS_BASE)+Var.VALUE(&__DDRSS_PI_REGISTER_BLOCK__OFFS))+Var.VALUE(&__DDRSS_PI_86__SFR_OFFS)))) %Long Var.VALUE(&__DDRSS1_PI_86_DATA)
	Data.Set D:((((Var.VALUE(&__J7_DDR1_SS_BASE)+Var.VALUE(&__DDRSS_PI_REGISTER_BLOCK__OFFS))+Var.VALUE(&__DDRSS_PI_87__SFR_OFFS)))) %Long Var.VALUE(&__DDRSS1_PI_87_DATA)
	Data.Set D:((((Var.VALUE(&__J7_DDR1_SS_BASE)+Var.VALUE(&__DDRSS_PI_REGISTER_BLOCK__OFFS))+Var.VALUE(&__DDRSS_PI_88__SFR_OFFS)))) %Long Var.VALUE(&__DDRSS1_PI_88_DATA)
	Data.Set D:((((Var.VALUE(&__J7_DDR1_SS_BASE)+Var.VALUE(&__DDRSS_PI_REGISTER_BLOCK__OFFS))+Var.VALUE(&__DDRSS_PI_89__SFR_OFFS)))) %Long Var.VALUE(&__DDRSS1_PI_89_DATA)
	Data.Set D:((((Var.VALUE(&__J7_DDR1_SS_BASE)+Var.VALUE(&__DDRSS_PI_REGISTER_BLOCK__OFFS))+Var.VALUE(&__DDRSS_PI_90__SFR_OFFS)))) %Long Var.VALUE(&__DDRSS1_PI_90_DATA)
	Data.Set D:((((Var.VALUE(&__J7_DDR1_SS_BASE)+Var.VALUE(&__DDRSS_PI_REGISTER_BLOCK__OFFS))+Var.VALUE(&__DDRSS_PI_91__SFR_OFFS)))) %Long Var.VALUE(&__DDRSS1_PI_91_DATA)
	Data.Set D:((((Var.VALUE(&__J7_DDR1_SS_BASE)+Var.VALUE(&__DDRSS_PI_REGISTER_BLOCK__OFFS))+Var.VALUE(&__DDRSS_PI_92__SFR_OFFS)))) %Long Var.VALUE(&__DDRSS1_PI_92_DATA)
	Data.Set D:((((Var.VALUE(&__J7_DDR1_SS_BASE)+Var.VALUE(&__DDRSS_PI_REGISTER_BLOCK__OFFS))+Var.VALUE(&__DDRSS_PI_93__SFR_OFFS)))) %Long Var.VALUE(&__DDRSS1_PI_93_DATA)
	Data.Set D:((((Var.VALUE(&__J7_DDR1_SS_BASE)+Var.VALUE(&__DDRSS_PI_REGISTER_BLOCK__OFFS))+Var.VALUE(&__DDRSS_PI_94__SFR_OFFS)))) %Long Var.VALUE(&__DDRSS1_PI_94_DATA)
	Data.Set D:((((Var.VALUE(&__J7_DDR1_SS_BASE)+Var.VALUE(&__DDRSS_PI_REGISTER_BLOCK__OFFS))+Var.VALUE(&__DDRSS_PI_95__SFR_OFFS)))) %Long Var.VALUE(&__DDRSS1_PI_95_DATA)
	Data.Set D:((((Var.VALUE(&__J7_DDR1_SS_BASE)+Var.VALUE(&__DDRSS_PI_REGISTER_BLOCK__OFFS))+Var.VALUE(&__DDRSS_PI_96__SFR_OFFS)))) %Long Var.VALUE(&__DDRSS1_PI_96_DATA)
	Data.Set D:((((Var.VALUE(&__J7_DDR1_SS_BASE)+Var.VALUE(&__DDRSS_PI_REGISTER_BLOCK__OFFS))+Var.VALUE(&__DDRSS_PI_97__SFR_OFFS)))) %Long Var.VALUE(&__DDRSS1_PI_97_DATA)
	Data.Set D:((((Var.VALUE(&__J7_DDR1_SS_BASE)+Var.VALUE(&__DDRSS_PI_REGISTER_BLOCK__OFFS))+Var.VALUE(&__DDRSS_PI_98__SFR_OFFS)))) %Long Var.VALUE(&__DDRSS1_PI_98_DATA)
	Data.Set D:((((Var.VALUE(&__J7_DDR1_SS_BASE)+Var.VALUE(&__DDRSS_PI_REGISTER_BLOCK__OFFS))+Var.VALUE(&__DDRSS_PI_99__SFR_OFFS)))) %Long Var.VALUE(&__DDRSS1_PI_99_DATA)
	Data.Set D:((((Var.VALUE(&__J7_DDR1_SS_BASE)+Var.VALUE(&__DDRSS_PI_REGISTER_BLOCK__OFFS))+Var.VALUE(&__DDRSS_PI_100__SFR_OFFS)))) %Long Var.VALUE(&__DDRSS1_PI_100_DATA)
	Data.Set D:((((Var.VALUE(&__J7_DDR1_SS_BASE)+Var.VALUE(&__DDRSS_PI_REGISTER_BLOCK__OFFS))+Var.VALUE(&__DDRSS_PI_101__SFR_OFFS)))) %Long Var.VALUE(&__DDRSS1_PI_101_DATA)
	Data.Set D:((((Var.VALUE(&__J7_DDR1_SS_BASE)+Var.VALUE(&__DDRSS_PI_REGISTER_BLOCK__OFFS))+Var.VALUE(&__DDRSS_PI_102__SFR_OFFS)))) %Long Var.VALUE(&__DDRSS1_PI_102_DATA)
	Data.Set D:((((Var.VALUE(&__J7_DDR1_SS_BASE)+Var.VALUE(&__DDRSS_PI_REGISTER_BLOCK__OFFS))+Var.VALUE(&__DDRSS_PI_103__SFR_OFFS)))) %Long Var.VALUE(&__DDRSS1_PI_103_DATA)
	Data.Set D:((((Var.VALUE(&__J7_DDR1_SS_BASE)+Var.VALUE(&__DDRSS_PI_REGISTER_BLOCK__OFFS))+Var.VALUE(&__DDRSS_PI_104__SFR_OFFS)))) %Long Var.VALUE(&__DDRSS1_PI_104_DATA)
	Data.Set D:((((Var.VALUE(&__J7_DDR1_SS_BASE)+Var.VALUE(&__DDRSS_PI_REGISTER_BLOCK__OFFS))+Var.VALUE(&__DDRSS_PI_105__SFR_OFFS)))) %Long Var.VALUE(&__DDRSS1_PI_105_DATA)
	Data.Set D:((((Var.VALUE(&__J7_DDR1_SS_BASE)+Var.VALUE(&__DDRSS_PI_REGISTER_BLOCK__OFFS))+Var.VALUE(&__DDRSS_PI_106__SFR_OFFS)))) %Long Var.VALUE(&__DDRSS1_PI_106_DATA)
	Data.Set D:((((Var.VALUE(&__J7_DDR1_SS_BASE)+Var.VALUE(&__DDRSS_PI_REGISTER_BLOCK__OFFS))+Var.VALUE(&__DDRSS_PI_107__SFR_OFFS)))) %Long Var.VALUE(&__DDRSS1_PI_107_DATA)
	Data.Set D:((((Var.VALUE(&__J7_DDR1_SS_BASE)+Var.VALUE(&__DDRSS_PI_REGISTER_BLOCK__OFFS))+Var.VALUE(&__DDRSS_PI_108__SFR_OFFS)))) %Long Var.VALUE(&__DDRSS1_PI_108_DATA)
	Data.Set D:((((Var.VALUE(&__J7_DDR1_SS_BASE)+Var.VALUE(&__DDRSS_PI_REGISTER_BLOCK__OFFS))+Var.VALUE(&__DDRSS_PI_109__SFR_OFFS)))) %Long Var.VALUE(&__DDRSS1_PI_109_DATA)
	Data.Set D:((((Var.VALUE(&__J7_DDR1_SS_BASE)+Var.VALUE(&__DDRSS_PI_REGISTER_BLOCK__OFFS))+Var.VALUE(&__DDRSS_PI_110__SFR_OFFS)))) %Long Var.VALUE(&__DDRSS1_PI_110_DATA)
	Data.Set D:((((Var.VALUE(&__J7_DDR1_SS_BASE)+Var.VALUE(&__DDRSS_PI_REGISTER_BLOCK__OFFS))+Var.VALUE(&__DDRSS_PI_111__SFR_OFFS)))) %Long Var.VALUE(&__DDRSS1_PI_111_DATA)
	Data.Set D:((((Var.VALUE(&__J7_DDR1_SS_BASE)+Var.VALUE(&__DDRSS_PI_REGISTER_BLOCK__OFFS))+Var.VALUE(&__DDRSS_PI_112__SFR_OFFS)))) %Long Var.VALUE(&__DDRSS1_PI_112_DATA)
	Data.Set D:((((Var.VALUE(&__J7_DDR1_SS_BASE)+Var.VALUE(&__DDRSS_PI_REGISTER_BLOCK__OFFS))+Var.VALUE(&__DDRSS_PI_113__SFR_OFFS)))) %Long Var.VALUE(&__DDRSS1_PI_113_DATA)
	Data.Set D:((((Var.VALUE(&__J7_DDR1_SS_BASE)+Var.VALUE(&__DDRSS_PI_REGISTER_BLOCK__OFFS))+Var.VALUE(&__DDRSS_PI_114__SFR_OFFS)))) %Long Var.VALUE(&__DDRSS1_PI_114_DATA)
	Data.Set D:((((Var.VALUE(&__J7_DDR1_SS_BASE)+Var.VALUE(&__DDRSS_PI_REGISTER_BLOCK__OFFS))+Var.VALUE(&__DDRSS_PI_115__SFR_OFFS)))) %Long Var.VALUE(&__DDRSS1_PI_115_DATA)
	Data.Set D:((((Var.VALUE(&__J7_DDR1_SS_BASE)+Var.VALUE(&__DDRSS_PI_REGISTER_BLOCK__OFFS))+Var.VALUE(&__DDRSS_PI_116__SFR_OFFS)))) %Long Var.VALUE(&__DDRSS1_PI_116_DATA)
	Data.Set D:((((Var.VALUE(&__J7_DDR1_SS_BASE)+Var.VALUE(&__DDRSS_PI_REGISTER_BLOCK__OFFS))+Var.VALUE(&__DDRSS_PI_117__SFR_OFFS)))) %Long Var.VALUE(&__DDRSS1_PI_117_DATA)
	Data.Set D:((((Var.VALUE(&__J7_DDR1_SS_BASE)+Var.VALUE(&__DDRSS_PI_REGISTER_BLOCK__OFFS))+Var.VALUE(&__DDRSS_PI_118__SFR_OFFS)))) %Long Var.VALUE(&__DDRSS1_PI_118_DATA)
	Data.Set D:((((Var.VALUE(&__J7_DDR1_SS_BASE)+Var.VALUE(&__DDRSS_PI_REGISTER_BLOCK__OFFS))+Var.VALUE(&__DDRSS_PI_119__SFR_OFFS)))) %Long Var.VALUE(&__DDRSS1_PI_119_DATA)
	Data.Set D:((((Var.VALUE(&__J7_DDR1_SS_BASE)+Var.VALUE(&__DDRSS_PI_REGISTER_BLOCK__OFFS))+Var.VALUE(&__DDRSS_PI_120__SFR_OFFS)))) %Long Var.VALUE(&__DDRSS1_PI_120_DATA)
	Data.Set D:((((Var.VALUE(&__J7_DDR1_SS_BASE)+Var.VALUE(&__DDRSS_PI_REGISTER_BLOCK__OFFS))+Var.VALUE(&__DDRSS_PI_121__SFR_OFFS)))) %Long Var.VALUE(&__DDRSS1_PI_121_DATA)
	Data.Set D:((((Var.VALUE(&__J7_DDR1_SS_BASE)+Var.VALUE(&__DDRSS_PI_REGISTER_BLOCK__OFFS))+Var.VALUE(&__DDRSS_PI_122__SFR_OFFS)))) %Long Var.VALUE(&__DDRSS1_PI_122_DATA)
	Data.Set D:((((Var.VALUE(&__J7_DDR1_SS_BASE)+Var.VALUE(&__DDRSS_PI_REGISTER_BLOCK__OFFS))+Var.VALUE(&__DDRSS_PI_123__SFR_OFFS)))) %Long Var.VALUE(&__DDRSS1_PI_123_DATA)
	Data.Set D:((((Var.VALUE(&__J7_DDR1_SS_BASE)+Var.VALUE(&__DDRSS_PI_REGISTER_BLOCK__OFFS))+Var.VALUE(&__DDRSS_PI_124__SFR_OFFS)))) %Long Var.VALUE(&__DDRSS1_PI_124_DATA)
	Data.Set D:((((Var.VALUE(&__J7_DDR1_SS_BASE)+Var.VALUE(&__DDRSS_PI_REGISTER_BLOCK__OFFS))+Var.VALUE(&__DDRSS_PI_125__SFR_OFFS)))) %Long Var.VALUE(&__DDRSS1_PI_125_DATA)
	Data.Set D:((((Var.VALUE(&__J7_DDR1_SS_BASE)+Var.VALUE(&__DDRSS_PI_REGISTER_BLOCK__OFFS))+Var.VALUE(&__DDRSS_PI_126__SFR_OFFS)))) %Long Var.VALUE(&__DDRSS1_PI_126_DATA)
	Data.Set D:((((Var.VALUE(&__J7_DDR1_SS_BASE)+Var.VALUE(&__DDRSS_PI_REGISTER_BLOCK__OFFS))+Var.VALUE(&__DDRSS_PI_127__SFR_OFFS)))) %Long Var.VALUE(&__DDRSS1_PI_127_DATA)
	Data.Set D:((((Var.VALUE(&__J7_DDR1_SS_BASE)+Var.VALUE(&__DDRSS_PI_REGISTER_BLOCK__OFFS))+Var.VALUE(&__DDRSS_PI_128__SFR_OFFS)))) %Long Var.VALUE(&__DDRSS1_PI_128_DATA)
	Data.Set D:((((Var.VALUE(&__J7_DDR1_SS_BASE)+Var.VALUE(&__DDRSS_PI_REGISTER_BLOCK__OFFS))+Var.VALUE(&__DDRSS_PI_129__SFR_OFFS)))) %Long Var.VALUE(&__DDRSS1_PI_129_DATA)
	Data.Set D:((((Var.VALUE(&__J7_DDR1_SS_BASE)+Var.VALUE(&__DDRSS_PI_REGISTER_BLOCK__OFFS))+Var.VALUE(&__DDRSS_PI_130__SFR_OFFS)))) %Long Var.VALUE(&__DDRSS1_PI_130_DATA)
	Data.Set D:((((Var.VALUE(&__J7_DDR1_SS_BASE)+Var.VALUE(&__DDRSS_PI_REGISTER_BLOCK__OFFS))+Var.VALUE(&__DDRSS_PI_131__SFR_OFFS)))) %Long Var.VALUE(&__DDRSS1_PI_131_DATA)
	Data.Set D:((((Var.VALUE(&__J7_DDR1_SS_BASE)+Var.VALUE(&__DDRSS_PI_REGISTER_BLOCK__OFFS))+Var.VALUE(&__DDRSS_PI_132__SFR_OFFS)))) %Long Var.VALUE(&__DDRSS1_PI_132_DATA)
	Data.Set D:((((Var.VALUE(&__J7_DDR1_SS_BASE)+Var.VALUE(&__DDRSS_PI_REGISTER_BLOCK__OFFS))+Var.VALUE(&__DDRSS_PI_133__SFR_OFFS)))) %Long Var.VALUE(&__DDRSS1_PI_133_DATA)
	Data.Set D:((((Var.VALUE(&__J7_DDR1_SS_BASE)+Var.VALUE(&__DDRSS_PI_REGISTER_BLOCK__OFFS))+Var.VALUE(&__DDRSS_PI_134__SFR_OFFS)))) %Long Var.VALUE(&__DDRSS1_PI_134_DATA)
	Data.Set D:((((Var.VALUE(&__J7_DDR1_SS_BASE)+Var.VALUE(&__DDRSS_PI_REGISTER_BLOCK__OFFS))+Var.VALUE(&__DDRSS_PI_135__SFR_OFFS)))) %Long Var.VALUE(&__DDRSS1_PI_135_DATA)
	Data.Set D:((((Var.VALUE(&__J7_DDR1_SS_BASE)+Var.VALUE(&__DDRSS_PI_REGISTER_BLOCK__OFFS))+Var.VALUE(&__DDRSS_PI_136__SFR_OFFS)))) %Long Var.VALUE(&__DDRSS1_PI_136_DATA)
	Data.Set D:((((Var.VALUE(&__J7_DDR1_SS_BASE)+Var.VALUE(&__DDRSS_PI_REGISTER_BLOCK__OFFS))+Var.VALUE(&__DDRSS_PI_137__SFR_OFFS)))) %Long Var.VALUE(&__DDRSS1_PI_137_DATA)
	Data.Set D:((((Var.VALUE(&__J7_DDR1_SS_BASE)+Var.VALUE(&__DDRSS_PI_REGISTER_BLOCK__OFFS))+Var.VALUE(&__DDRSS_PI_138__SFR_OFFS)))) %Long Var.VALUE(&__DDRSS1_PI_138_DATA)
	Data.Set D:((((Var.VALUE(&__J7_DDR1_SS_BASE)+Var.VALUE(&__DDRSS_PI_REGISTER_BLOCK__OFFS))+Var.VALUE(&__DDRSS_PI_139__SFR_OFFS)))) %Long Var.VALUE(&__DDRSS1_PI_139_DATA)
	Data.Set D:((((Var.VALUE(&__J7_DDR1_SS_BASE)+Var.VALUE(&__DDRSS_PI_REGISTER_BLOCK__OFFS))+Var.VALUE(&__DDRSS_PI_140__SFR_OFFS)))) %Long Var.VALUE(&__DDRSS1_PI_140_DATA)
	Data.Set D:((((Var.VALUE(&__J7_DDR1_SS_BASE)+Var.VALUE(&__DDRSS_PI_REGISTER_BLOCK__OFFS))+Var.VALUE(&__DDRSS_PI_141__SFR_OFFS)))) %Long Var.VALUE(&__DDRSS1_PI_141_DATA)
	Data.Set D:((((Var.VALUE(&__J7_DDR1_SS_BASE)+Var.VALUE(&__DDRSS_PI_REGISTER_BLOCK__OFFS))+Var.VALUE(&__DDRSS_PI_142__SFR_OFFS)))) %Long Var.VALUE(&__DDRSS1_PI_142_DATA)
	Data.Set D:((((Var.VALUE(&__J7_DDR1_SS_BASE)+Var.VALUE(&__DDRSS_PI_REGISTER_BLOCK__OFFS))+Var.VALUE(&__DDRSS_PI_143__SFR_OFFS)))) %Long Var.VALUE(&__DDRSS1_PI_143_DATA)
	Data.Set D:((((Var.VALUE(&__J7_DDR1_SS_BASE)+Var.VALUE(&__DDRSS_PI_REGISTER_BLOCK__OFFS))+Var.VALUE(&__DDRSS_PI_144__SFR_OFFS)))) %Long Var.VALUE(&__DDRSS1_PI_144_DATA)
	Data.Set D:((((Var.VALUE(&__J7_DDR1_SS_BASE)+Var.VALUE(&__DDRSS_PI_REGISTER_BLOCK__OFFS))+Var.VALUE(&__DDRSS_PI_145__SFR_OFFS)))) %Long Var.VALUE(&__DDRSS1_PI_145_DATA)
	Data.Set D:((((Var.VALUE(&__J7_DDR1_SS_BASE)+Var.VALUE(&__DDRSS_PI_REGISTER_BLOCK__OFFS))+Var.VALUE(&__DDRSS_PI_146__SFR_OFFS)))) %Long Var.VALUE(&__DDRSS1_PI_146_DATA)
	Data.Set D:((((Var.VALUE(&__J7_DDR1_SS_BASE)+Var.VALUE(&__DDRSS_PI_REGISTER_BLOCK__OFFS))+Var.VALUE(&__DDRSS_PI_147__SFR_OFFS)))) %Long Var.VALUE(&__DDRSS1_PI_147_DATA)
	Data.Set D:((((Var.VALUE(&__J7_DDR1_SS_BASE)+Var.VALUE(&__DDRSS_PI_REGISTER_BLOCK__OFFS))+Var.VALUE(&__DDRSS_PI_148__SFR_OFFS)))) %Long Var.VALUE(&__DDRSS1_PI_148_DATA)
	Data.Set D:((((Var.VALUE(&__J7_DDR1_SS_BASE)+Var.VALUE(&__DDRSS_PI_REGISTER_BLOCK__OFFS))+Var.VALUE(&__DDRSS_PI_149__SFR_OFFS)))) %Long Var.VALUE(&__DDRSS1_PI_149_DATA)
	Data.Set D:((((Var.VALUE(&__J7_DDR1_SS_BASE)+Var.VALUE(&__DDRSS_PI_REGISTER_BLOCK__OFFS))+Var.VALUE(&__DDRSS_PI_150__SFR_OFFS)))) %Long Var.VALUE(&__DDRSS1_PI_150_DATA)
	Data.Set D:((((Var.VALUE(&__J7_DDR1_SS_BASE)+Var.VALUE(&__DDRSS_PI_REGISTER_BLOCK__OFFS))+Var.VALUE(&__DDRSS_PI_151__SFR_OFFS)))) %Long Var.VALUE(&__DDRSS1_PI_151_DATA)
	Data.Set D:((((Var.VALUE(&__J7_DDR1_SS_BASE)+Var.VALUE(&__DDRSS_PI_REGISTER_BLOCK__OFFS))+Var.VALUE(&__DDRSS_PI_152__SFR_OFFS)))) %Long Var.VALUE(&__DDRSS1_PI_152_DATA)
	Data.Set D:((((Var.VALUE(&__J7_DDR1_SS_BASE)+Var.VALUE(&__DDRSS_PI_REGISTER_BLOCK__OFFS))+Var.VALUE(&__DDRSS_PI_153__SFR_OFFS)))) %Long Var.VALUE(&__DDRSS1_PI_153_DATA)
	Data.Set D:((((Var.VALUE(&__J7_DDR1_SS_BASE)+Var.VALUE(&__DDRSS_PI_REGISTER_BLOCK__OFFS))+Var.VALUE(&__DDRSS_PI_154__SFR_OFFS)))) %Long Var.VALUE(&__DDRSS1_PI_154_DATA)
	Data.Set D:((((Var.VALUE(&__J7_DDR1_SS_BASE)+Var.VALUE(&__DDRSS_PI_REGISTER_BLOCK__OFFS))+Var.VALUE(&__DDRSS_PI_155__SFR_OFFS)))) %Long Var.VALUE(&__DDRSS1_PI_155_DATA)
	Data.Set D:((((Var.VALUE(&__J7_DDR1_SS_BASE)+Var.VALUE(&__DDRSS_PI_REGISTER_BLOCK__OFFS))+Var.VALUE(&__DDRSS_PI_156__SFR_OFFS)))) %Long Var.VALUE(&__DDRSS1_PI_156_DATA)
	Data.Set D:((((Var.VALUE(&__J7_DDR1_SS_BASE)+Var.VALUE(&__DDRSS_PI_REGISTER_BLOCK__OFFS))+Var.VALUE(&__DDRSS_PI_157__SFR_OFFS)))) %Long Var.VALUE(&__DDRSS1_PI_157_DATA)
	Data.Set D:((((Var.VALUE(&__J7_DDR1_SS_BASE)+Var.VALUE(&__DDRSS_PI_REGISTER_BLOCK__OFFS))+Var.VALUE(&__DDRSS_PI_158__SFR_OFFS)))) %Long Var.VALUE(&__DDRSS1_PI_158_DATA)
	Data.Set D:((((Var.VALUE(&__J7_DDR1_SS_BASE)+Var.VALUE(&__DDRSS_PI_REGISTER_BLOCK__OFFS))+Var.VALUE(&__DDRSS_PI_159__SFR_OFFS)))) %Long Var.VALUE(&__DDRSS1_PI_159_DATA)
	Data.Set D:((((Var.VALUE(&__J7_DDR1_SS_BASE)+Var.VALUE(&__DDRSS_PI_REGISTER_BLOCK__OFFS))+Var.VALUE(&__DDRSS_PI_160__SFR_OFFS)))) %Long Var.VALUE(&__DDRSS1_PI_160_DATA)
	Data.Set D:((((Var.VALUE(&__J7_DDR1_SS_BASE)+Var.VALUE(&__DDRSS_PI_REGISTER_BLOCK__OFFS))+Var.VALUE(&__DDRSS_PI_161__SFR_OFFS)))) %Long Var.VALUE(&__DDRSS1_PI_161_DATA)
	Data.Set D:((((Var.VALUE(&__J7_DDR1_SS_BASE)+Var.VALUE(&__DDRSS_PI_REGISTER_BLOCK__OFFS))+Var.VALUE(&__DDRSS_PI_162__SFR_OFFS)))) %Long Var.VALUE(&__DDRSS1_PI_162_DATA)
	Data.Set D:((((Var.VALUE(&__J7_DDR1_SS_BASE)+Var.VALUE(&__DDRSS_PI_REGISTER_BLOCK__OFFS))+Var.VALUE(&__DDRSS_PI_163__SFR_OFFS)))) %Long Var.VALUE(&__DDRSS1_PI_163_DATA)
	Data.Set D:((((Var.VALUE(&__J7_DDR1_SS_BASE)+Var.VALUE(&__DDRSS_PI_REGISTER_BLOCK__OFFS))+Var.VALUE(&__DDRSS_PI_164__SFR_OFFS)))) %Long Var.VALUE(&__DDRSS1_PI_164_DATA)
	Data.Set D:((((Var.VALUE(&__J7_DDR1_SS_BASE)+Var.VALUE(&__DDRSS_PI_REGISTER_BLOCK__OFFS))+Var.VALUE(&__DDRSS_PI_165__SFR_OFFS)))) %Long Var.VALUE(&__DDRSS1_PI_165_DATA)
	Data.Set D:((((Var.VALUE(&__J7_DDR1_SS_BASE)+Var.VALUE(&__DDRSS_PI_REGISTER_BLOCK__OFFS))+Var.VALUE(&__DDRSS_PI_166__SFR_OFFS)))) %Long Var.VALUE(&__DDRSS1_PI_166_DATA)
	Data.Set D:((((Var.VALUE(&__J7_DDR1_SS_BASE)+Var.VALUE(&__DDRSS_PI_REGISTER_BLOCK__OFFS))+Var.VALUE(&__DDRSS_PI_167__SFR_OFFS)))) %Long Var.VALUE(&__DDRSS1_PI_167_DATA)
	Data.Set D:((((Var.VALUE(&__J7_DDR1_SS_BASE)+Var.VALUE(&__DDRSS_PI_REGISTER_BLOCK__OFFS))+Var.VALUE(&__DDRSS_PI_168__SFR_OFFS)))) %Long Var.VALUE(&__DDRSS1_PI_168_DATA)
	Data.Set D:((((Var.VALUE(&__J7_DDR1_SS_BASE)+Var.VALUE(&__DDRSS_PI_REGISTER_BLOCK__OFFS))+Var.VALUE(&__DDRSS_PI_169__SFR_OFFS)))) %Long Var.VALUE(&__DDRSS1_PI_169_DATA)
	Data.Set D:((((Var.VALUE(&__J7_DDR1_SS_BASE)+Var.VALUE(&__DDRSS_PI_REGISTER_BLOCK__OFFS))+Var.VALUE(&__DDRSS_PI_170__SFR_OFFS)))) %Long Var.VALUE(&__DDRSS1_PI_170_DATA)
	Data.Set D:((((Var.VALUE(&__J7_DDR1_SS_BASE)+Var.VALUE(&__DDRSS_PI_REGISTER_BLOCK__OFFS))+Var.VALUE(&__DDRSS_PI_171__SFR_OFFS)))) %Long Var.VALUE(&__DDRSS1_PI_171_DATA)
	Data.Set D:((((Var.VALUE(&__J7_DDR1_SS_BASE)+Var.VALUE(&__DDRSS_PI_REGISTER_BLOCK__OFFS))+Var.VALUE(&__DDRSS_PI_172__SFR_OFFS)))) %Long Var.VALUE(&__DDRSS1_PI_172_DATA)
	Data.Set D:((((Var.VALUE(&__J7_DDR1_SS_BASE)+Var.VALUE(&__DDRSS_PI_REGISTER_BLOCK__OFFS))+Var.VALUE(&__DDRSS_PI_173__SFR_OFFS)))) %Long Var.VALUE(&__DDRSS1_PI_173_DATA)
	Data.Set D:((((Var.VALUE(&__J7_DDR1_SS_BASE)+Var.VALUE(&__DDRSS_PI_REGISTER_BLOCK__OFFS))+Var.VALUE(&__DDRSS_PI_174__SFR_OFFS)))) %Long Var.VALUE(&__DDRSS1_PI_174_DATA)
	Data.Set D:((((Var.VALUE(&__J7_DDR1_SS_BASE)+Var.VALUE(&__DDRSS_PI_REGISTER_BLOCK__OFFS))+Var.VALUE(&__DDRSS_PI_175__SFR_OFFS)))) %Long Var.VALUE(&__DDRSS1_PI_175_DATA)
	Data.Set D:((((Var.VALUE(&__J7_DDR1_SS_BASE)+Var.VALUE(&__DDRSS_PI_REGISTER_BLOCK__OFFS))+Var.VALUE(&__DDRSS_PI_176__SFR_OFFS)))) %Long Var.VALUE(&__DDRSS1_PI_176_DATA)
	Data.Set D:((((Var.VALUE(&__J7_DDR1_SS_BASE)+Var.VALUE(&__DDRSS_PI_REGISTER_BLOCK__OFFS))+Var.VALUE(&__DDRSS_PI_177__SFR_OFFS)))) %Long Var.VALUE(&__DDRSS1_PI_177_DATA)
	Data.Set D:((((Var.VALUE(&__J7_DDR1_SS_BASE)+Var.VALUE(&__DDRSS_PI_REGISTER_BLOCK__OFFS))+Var.VALUE(&__DDRSS_PI_178__SFR_OFFS)))) %Long Var.VALUE(&__DDRSS1_PI_178_DATA)
	Data.Set D:((((Var.VALUE(&__J7_DDR1_SS_BASE)+Var.VALUE(&__DDRSS_PI_REGISTER_BLOCK__OFFS))+Var.VALUE(&__DDRSS_PI_179__SFR_OFFS)))) %Long Var.VALUE(&__DDRSS1_PI_179_DATA)
	Data.Set D:((((Var.VALUE(&__J7_DDR1_SS_BASE)+Var.VALUE(&__DDRSS_PI_REGISTER_BLOCK__OFFS))+Var.VALUE(&__DDRSS_PI_180__SFR_OFFS)))) %Long Var.VALUE(&__DDRSS1_PI_180_DATA)
	Data.Set D:((((Var.VALUE(&__J7_DDR1_SS_BASE)+Var.VALUE(&__DDRSS_PI_REGISTER_BLOCK__OFFS))+Var.VALUE(&__DDRSS_PI_181__SFR_OFFS)))) %Long Var.VALUE(&__DDRSS1_PI_181_DATA)
	Data.Set D:((((Var.VALUE(&__J7_DDR1_SS_BASE)+Var.VALUE(&__DDRSS_PI_REGISTER_BLOCK__OFFS))+Var.VALUE(&__DDRSS_PI_182__SFR_OFFS)))) %Long Var.VALUE(&__DDRSS1_PI_182_DATA)
	Data.Set D:((((Var.VALUE(&__J7_DDR1_SS_BASE)+Var.VALUE(&__DDRSS_PI_REGISTER_BLOCK__OFFS))+Var.VALUE(&__DDRSS_PI_183__SFR_OFFS)))) %Long Var.VALUE(&__DDRSS1_PI_183_DATA)
	Data.Set D:((((Var.VALUE(&__J7_DDR1_SS_BASE)+Var.VALUE(&__DDRSS_PI_REGISTER_BLOCK__OFFS))+Var.VALUE(&__DDRSS_PI_184__SFR_OFFS)))) %Long Var.VALUE(&__DDRSS1_PI_184_DATA)
	Data.Set D:((((Var.VALUE(&__J7_DDR1_SS_BASE)+Var.VALUE(&__DDRSS_PI_REGISTER_BLOCK__OFFS))+Var.VALUE(&__DDRSS_PI_185__SFR_OFFS)))) %Long Var.VALUE(&__DDRSS1_PI_185_DATA)
	Data.Set D:((((Var.VALUE(&__J7_DDR1_SS_BASE)+Var.VALUE(&__DDRSS_PI_REGISTER_BLOCK__OFFS))+Var.VALUE(&__DDRSS_PI_186__SFR_OFFS)))) %Long Var.VALUE(&__DDRSS1_PI_186_DATA)
	Data.Set D:((((Var.VALUE(&__J7_DDR1_SS_BASE)+Var.VALUE(&__DDRSS_PI_REGISTER_BLOCK__OFFS))+Var.VALUE(&__DDRSS_PI_187__SFR_OFFS)))) %Long Var.VALUE(&__DDRSS1_PI_187_DATA)
	Data.Set D:((((Var.VALUE(&__J7_DDR1_SS_BASE)+Var.VALUE(&__DDRSS_PI_REGISTER_BLOCK__OFFS))+Var.VALUE(&__DDRSS_PI_188__SFR_OFFS)))) %Long Var.VALUE(&__DDRSS1_PI_188_DATA)
	Data.Set D:((((Var.VALUE(&__J7_DDR1_SS_BASE)+Var.VALUE(&__DDRSS_PI_REGISTER_BLOCK__OFFS))+Var.VALUE(&__DDRSS_PI_189__SFR_OFFS)))) %Long Var.VALUE(&__DDRSS1_PI_189_DATA)
	Data.Set D:((((Var.VALUE(&__J7_DDR1_SS_BASE)+Var.VALUE(&__DDRSS_PI_REGISTER_BLOCK__OFFS))+Var.VALUE(&__DDRSS_PI_190__SFR_OFFS)))) %Long Var.VALUE(&__DDRSS1_PI_190_DATA)
	Data.Set D:((((Var.VALUE(&__J7_DDR1_SS_BASE)+Var.VALUE(&__DDRSS_PI_REGISTER_BLOCK__OFFS))+Var.VALUE(&__DDRSS_PI_191__SFR_OFFS)))) %Long Var.VALUE(&__DDRSS1_PI_191_DATA)
	Data.Set D:((((Var.VALUE(&__J7_DDR1_SS_BASE)+Var.VALUE(&__DDRSS_PI_REGISTER_BLOCK__OFFS))+Var.VALUE(&__DDRSS_PI_192__SFR_OFFS)))) %Long Var.VALUE(&__DDRSS1_PI_192_DATA)
	Data.Set D:((((Var.VALUE(&__J7_DDR1_SS_BASE)+Var.VALUE(&__DDRSS_PI_REGISTER_BLOCK__OFFS))+Var.VALUE(&__DDRSS_PI_193__SFR_OFFS)))) %Long Var.VALUE(&__DDRSS1_PI_193_DATA)
	Data.Set D:((((Var.VALUE(&__J7_DDR1_SS_BASE)+Var.VALUE(&__DDRSS_PI_REGISTER_BLOCK__OFFS))+Var.VALUE(&__DDRSS_PI_194__SFR_OFFS)))) %Long Var.VALUE(&__DDRSS1_PI_194_DATA)
	Data.Set D:((((Var.VALUE(&__J7_DDR1_SS_BASE)+Var.VALUE(&__DDRSS_PI_REGISTER_BLOCK__OFFS))+Var.VALUE(&__DDRSS_PI_195__SFR_OFFS)))) %Long Var.VALUE(&__DDRSS1_PI_195_DATA)
	Data.Set D:((((Var.VALUE(&__J7_DDR1_SS_BASE)+Var.VALUE(&__DDRSS_PI_REGISTER_BLOCK__OFFS))+Var.VALUE(&__DDRSS_PI_196__SFR_OFFS)))) %Long Var.VALUE(&__DDRSS1_PI_196_DATA)
	Data.Set D:((((Var.VALUE(&__J7_DDR1_SS_BASE)+Var.VALUE(&__DDRSS_PI_REGISTER_BLOCK__OFFS))+Var.VALUE(&__DDRSS_PI_197__SFR_OFFS)))) %Long Var.VALUE(&__DDRSS1_PI_197_DATA)
	Data.Set D:((((Var.VALUE(&__J7_DDR1_SS_BASE)+Var.VALUE(&__DDRSS_PI_REGISTER_BLOCK__OFFS))+Var.VALUE(&__DDRSS_PI_198__SFR_OFFS)))) %Long Var.VALUE(&__DDRSS1_PI_198_DATA)
	Data.Set D:((((Var.VALUE(&__J7_DDR1_SS_BASE)+Var.VALUE(&__DDRSS_PI_REGISTER_BLOCK__OFFS))+Var.VALUE(&__DDRSS_PI_199__SFR_OFFS)))) %Long Var.VALUE(&__DDRSS1_PI_199_DATA)
	Data.Set D:((((Var.VALUE(&__J7_DDR1_SS_BASE)+Var.VALUE(&__DDRSS_PI_REGISTER_BLOCK__OFFS))+Var.VALUE(&__DDRSS_PI_200__SFR_OFFS)))) %Long Var.VALUE(&__DDRSS1_PI_200_DATA)
	Data.Set D:((((Var.VALUE(&__J7_DDR1_SS_BASE)+Var.VALUE(&__DDRSS_PI_REGISTER_BLOCK__OFFS))+Var.VALUE(&__DDRSS_PI_201__SFR_OFFS)))) %Long Var.VALUE(&__DDRSS1_PI_201_DATA)
	Data.Set D:((((Var.VALUE(&__J7_DDR1_SS_BASE)+Var.VALUE(&__DDRSS_PI_REGISTER_BLOCK__OFFS))+Var.VALUE(&__DDRSS_PI_202__SFR_OFFS)))) %Long Var.VALUE(&__DDRSS1_PI_202_DATA)
	Data.Set D:((((Var.VALUE(&__J7_DDR1_SS_BASE)+Var.VALUE(&__DDRSS_PI_REGISTER_BLOCK__OFFS))+Var.VALUE(&__DDRSS_PI_203__SFR_OFFS)))) %Long Var.VALUE(&__DDRSS1_PI_203_DATA)
	Data.Set D:((((Var.VALUE(&__J7_DDR1_SS_BASE)+Var.VALUE(&__DDRSS_PI_REGISTER_BLOCK__OFFS))+Var.VALUE(&__DDRSS_PI_204__SFR_OFFS)))) %Long Var.VALUE(&__DDRSS1_PI_204_DATA)
	Data.Set D:((((Var.VALUE(&__J7_DDR1_SS_BASE)+Var.VALUE(&__DDRSS_PI_REGISTER_BLOCK__OFFS))+Var.VALUE(&__DDRSS_PI_205__SFR_OFFS)))) %Long Var.VALUE(&__DDRSS1_PI_205_DATA)
	Data.Set D:((((Var.VALUE(&__J7_DDR1_SS_BASE)+Var.VALUE(&__DDRSS_PI_REGISTER_BLOCK__OFFS))+Var.VALUE(&__DDRSS_PI_206__SFR_OFFS)))) %Long Var.VALUE(&__DDRSS1_PI_206_DATA)
	Data.Set D:((((Var.VALUE(&__J7_DDR1_SS_BASE)+Var.VALUE(&__DDRSS_PI_REGISTER_BLOCK__OFFS))+Var.VALUE(&__DDRSS_PI_207__SFR_OFFS)))) %Long Var.VALUE(&__DDRSS1_PI_207_DATA)
	Data.Set D:((((Var.VALUE(&__J7_DDR1_SS_BASE)+Var.VALUE(&__DDRSS_PI_REGISTER_BLOCK__OFFS))+Var.VALUE(&__DDRSS_PI_208__SFR_OFFS)))) %Long Var.VALUE(&__DDRSS1_PI_208_DATA)
	Data.Set D:((((Var.VALUE(&__J7_DDR1_SS_BASE)+Var.VALUE(&__DDRSS_PI_REGISTER_BLOCK__OFFS))+Var.VALUE(&__DDRSS_PI_209__SFR_OFFS)))) %Long Var.VALUE(&__DDRSS1_PI_209_DATA)
	Data.Set D:((((Var.VALUE(&__J7_DDR1_SS_BASE)+Var.VALUE(&__DDRSS_PI_REGISTER_BLOCK__OFFS))+Var.VALUE(&__DDRSS_PI_210__SFR_OFFS)))) %Long Var.VALUE(&__DDRSS1_PI_210_DATA)
	Data.Set D:((((Var.VALUE(&__J7_DDR1_SS_BASE)+Var.VALUE(&__DDRSS_PI_REGISTER_BLOCK__OFFS))+Var.VALUE(&__DDRSS_PI_211__SFR_OFFS)))) %Long Var.VALUE(&__DDRSS1_PI_211_DATA)
	Data.Set D:((((Var.VALUE(&__J7_DDR1_SS_BASE)+Var.VALUE(&__DDRSS_PI_REGISTER_BLOCK__OFFS))+Var.VALUE(&__DDRSS_PI_212__SFR_OFFS)))) %Long Var.VALUE(&__DDRSS1_PI_212_DATA)
	Data.Set D:((((Var.VALUE(&__J7_DDR1_SS_BASE)+Var.VALUE(&__DDRSS_PI_REGISTER_BLOCK__OFFS))+Var.VALUE(&__DDRSS_PI_213__SFR_OFFS)))) %Long Var.VALUE(&__DDRSS1_PI_213_DATA)
	Data.Set D:((((Var.VALUE(&__J7_DDR1_SS_BASE)+Var.VALUE(&__DDRSS_PI_REGISTER_BLOCK__OFFS))+Var.VALUE(&__DDRSS_PI_214__SFR_OFFS)))) %Long Var.VALUE(&__DDRSS1_PI_214_DATA)
	Data.Set D:((((Var.VALUE(&__J7_DDR1_SS_BASE)+Var.VALUE(&__DDRSS_PI_REGISTER_BLOCK__OFFS))+Var.VALUE(&__DDRSS_PI_215__SFR_OFFS)))) %Long Var.VALUE(&__DDRSS1_PI_215_DATA)
	Data.Set D:((((Var.VALUE(&__J7_DDR1_SS_BASE)+Var.VALUE(&__DDRSS_PI_REGISTER_BLOCK__OFFS))+Var.VALUE(&__DDRSS_PI_216__SFR_OFFS)))) %Long Var.VALUE(&__DDRSS1_PI_216_DATA)
	Data.Set D:((((Var.VALUE(&__J7_DDR1_SS_BASE)+Var.VALUE(&__DDRSS_PI_REGISTER_BLOCK__OFFS))+Var.VALUE(&__DDRSS_PI_217__SFR_OFFS)))) %Long Var.VALUE(&__DDRSS1_PI_217_DATA)
	Data.Set D:((((Var.VALUE(&__J7_DDR1_SS_BASE)+Var.VALUE(&__DDRSS_PI_REGISTER_BLOCK__OFFS))+Var.VALUE(&__DDRSS_PI_218__SFR_OFFS)))) %Long Var.VALUE(&__DDRSS1_PI_218_DATA)
	Data.Set D:((((Var.VALUE(&__J7_DDR1_SS_BASE)+Var.VALUE(&__DDRSS_PI_REGISTER_BLOCK__OFFS))+Var.VALUE(&__DDRSS_PI_219__SFR_OFFS)))) %Long Var.VALUE(&__DDRSS1_PI_219_DATA)
	Data.Set D:((((Var.VALUE(&__J7_DDR1_SS_BASE)+Var.VALUE(&__DDRSS_PI_REGISTER_BLOCK__OFFS))+Var.VALUE(&__DDRSS_PI_220__SFR_OFFS)))) %Long Var.VALUE(&__DDRSS1_PI_220_DATA)
	Data.Set D:((((Var.VALUE(&__J7_DDR1_SS_BASE)+Var.VALUE(&__DDRSS_PI_REGISTER_BLOCK__OFFS))+Var.VALUE(&__DDRSS_PI_221__SFR_OFFS)))) %Long Var.VALUE(&__DDRSS1_PI_221_DATA)
	Data.Set D:((((Var.VALUE(&__J7_DDR1_SS_BASE)+Var.VALUE(&__DDRSS_PI_REGISTER_BLOCK__OFFS))+Var.VALUE(&__DDRSS_PI_222__SFR_OFFS)))) %Long Var.VALUE(&__DDRSS1_PI_222_DATA)
	Data.Set D:((((Var.VALUE(&__J7_DDR1_SS_BASE)+Var.VALUE(&__DDRSS_PI_REGISTER_BLOCK__OFFS))+Var.VALUE(&__DDRSS_PI_223__SFR_OFFS)))) %Long Var.VALUE(&__DDRSS1_PI_223_DATA)
	Data.Set D:((((Var.VALUE(&__J7_DDR1_SS_BASE)+Var.VALUE(&__DDRSS_PI_REGISTER_BLOCK__OFFS))+Var.VALUE(&__DDRSS_PI_224__SFR_OFFS)))) %Long Var.VALUE(&__DDRSS1_PI_224_DATA)
	Data.Set D:((((Var.VALUE(&__J7_DDR1_SS_BASE)+Var.VALUE(&__DDRSS_PI_REGISTER_BLOCK__OFFS))+Var.VALUE(&__DDRSS_PI_225__SFR_OFFS)))) %Long Var.VALUE(&__DDRSS1_PI_225_DATA)
	Data.Set D:((((Var.VALUE(&__J7_DDR1_SS_BASE)+Var.VALUE(&__DDRSS_PI_REGISTER_BLOCK__OFFS))+Var.VALUE(&__DDRSS_PI_226__SFR_OFFS)))) %Long Var.VALUE(&__DDRSS1_PI_226_DATA)
	Data.Set D:((((Var.VALUE(&__J7_DDR1_SS_BASE)+Var.VALUE(&__DDRSS_PI_REGISTER_BLOCK__OFFS))+Var.VALUE(&__DDRSS_PI_227__SFR_OFFS)))) %Long Var.VALUE(&__DDRSS1_PI_227_DATA)
	Data.Set D:((((Var.VALUE(&__J7_DDR1_SS_BASE)+Var.VALUE(&__DDRSS_PI_REGISTER_BLOCK__OFFS))+Var.VALUE(&__DDRSS_PI_228__SFR_OFFS)))) %Long Var.VALUE(&__DDRSS1_PI_228_DATA)
	Data.Set D:((((Var.VALUE(&__J7_DDR1_SS_BASE)+Var.VALUE(&__DDRSS_PI_REGISTER_BLOCK__OFFS))+Var.VALUE(&__DDRSS_PI_229__SFR_OFFS)))) %Long Var.VALUE(&__DDRSS1_PI_229_DATA)
	Data.Set D:((((Var.VALUE(&__J7_DDR1_SS_BASE)+Var.VALUE(&__DDRSS_PI_REGISTER_BLOCK__OFFS))+Var.VALUE(&__DDRSS_PI_230__SFR_OFFS)))) %Long Var.VALUE(&__DDRSS1_PI_230_DATA)
	Data.Set D:((((Var.VALUE(&__J7_DDR1_SS_BASE)+Var.VALUE(&__DDRSS_PI_REGISTER_BLOCK__OFFS))+Var.VALUE(&__DDRSS_PI_231__SFR_OFFS)))) %Long Var.VALUE(&__DDRSS1_PI_231_DATA)
	Data.Set D:((((Var.VALUE(&__J7_DDR1_SS_BASE)+Var.VALUE(&__DDRSS_PI_REGISTER_BLOCK__OFFS))+Var.VALUE(&__DDRSS_PI_232__SFR_OFFS)))) %Long Var.VALUE(&__DDRSS1_PI_232_DATA)
	Data.Set D:((((Var.VALUE(&__J7_DDR1_SS_BASE)+Var.VALUE(&__DDRSS_PI_REGISTER_BLOCK__OFFS))+Var.VALUE(&__DDRSS_PI_233__SFR_OFFS)))) %Long Var.VALUE(&__DDRSS1_PI_233_DATA)
	Data.Set D:((((Var.VALUE(&__J7_DDR1_SS_BASE)+Var.VALUE(&__DDRSS_PI_REGISTER_BLOCK__OFFS))+Var.VALUE(&__DDRSS_PI_234__SFR_OFFS)))) %Long Var.VALUE(&__DDRSS1_PI_234_DATA)
	Data.Set D:((((Var.VALUE(&__J7_DDR1_SS_BASE)+Var.VALUE(&__DDRSS_PI_REGISTER_BLOCK__OFFS))+Var.VALUE(&__DDRSS_PI_235__SFR_OFFS)))) %Long Var.VALUE(&__DDRSS1_PI_235_DATA)
	Data.Set D:((((Var.VALUE(&__J7_DDR1_SS_BASE)+Var.VALUE(&__DDRSS_PI_REGISTER_BLOCK__OFFS))+Var.VALUE(&__DDRSS_PI_236__SFR_OFFS)))) %Long Var.VALUE(&__DDRSS1_PI_236_DATA)
	Data.Set D:((((Var.VALUE(&__J7_DDR1_SS_BASE)+Var.VALUE(&__DDRSS_PI_REGISTER_BLOCK__OFFS))+Var.VALUE(&__DDRSS_PI_237__SFR_OFFS)))) %Long Var.VALUE(&__DDRSS1_PI_237_DATA)
	Data.Set D:((((Var.VALUE(&__J7_DDR1_SS_BASE)+Var.VALUE(&__DDRSS_PI_REGISTER_BLOCK__OFFS))+Var.VALUE(&__DDRSS_PI_238__SFR_OFFS)))) %Long Var.VALUE(&__DDRSS1_PI_238_DATA)
	Data.Set D:((((Var.VALUE(&__J7_DDR1_SS_BASE)+Var.VALUE(&__DDRSS_PI_REGISTER_BLOCK__OFFS))+Var.VALUE(&__DDRSS_PI_239__SFR_OFFS)))) %Long Var.VALUE(&__DDRSS1_PI_239_DATA)
	Data.Set D:((((Var.VALUE(&__J7_DDR1_SS_BASE)+Var.VALUE(&__DDRSS_PI_REGISTER_BLOCK__OFFS))+Var.VALUE(&__DDRSS_PI_240__SFR_OFFS)))) %Long Var.VALUE(&__DDRSS1_PI_240_DATA)
	Data.Set D:((((Var.VALUE(&__J7_DDR1_SS_BASE)+Var.VALUE(&__DDRSS_PI_REGISTER_BLOCK__OFFS))+Var.VALUE(&__DDRSS_PI_241__SFR_OFFS)))) %Long Var.VALUE(&__DDRSS1_PI_241_DATA)
	Data.Set D:((((Var.VALUE(&__J7_DDR1_SS_BASE)+Var.VALUE(&__DDRSS_PI_REGISTER_BLOCK__OFFS))+Var.VALUE(&__DDRSS_PI_242__SFR_OFFS)))) %Long Var.VALUE(&__DDRSS1_PI_242_DATA)
	Data.Set D:((((Var.VALUE(&__J7_DDR1_SS_BASE)+Var.VALUE(&__DDRSS_PI_REGISTER_BLOCK__OFFS))+Var.VALUE(&__DDRSS_PI_243__SFR_OFFS)))) %Long Var.VALUE(&__DDRSS1_PI_243_DATA)
	Data.Set D:((((Var.VALUE(&__J7_DDR1_SS_BASE)+Var.VALUE(&__DDRSS_PI_REGISTER_BLOCK__OFFS))+Var.VALUE(&__DDRSS_PI_244__SFR_OFFS)))) %Long Var.VALUE(&__DDRSS1_PI_244_DATA)
	Data.Set D:((((Var.VALUE(&__J7_DDR1_SS_BASE)+Var.VALUE(&__DDRSS_PI_REGISTER_BLOCK__OFFS))+Var.VALUE(&__DDRSS_PI_245__SFR_OFFS)))) %Long Var.VALUE(&__DDRSS1_PI_245_DATA)
	Data.Set D:((((Var.VALUE(&__J7_DDR1_SS_BASE)+Var.VALUE(&__DDRSS_PI_REGISTER_BLOCK__OFFS))+Var.VALUE(&__DDRSS_PI_246__SFR_OFFS)))) %Long Var.VALUE(&__DDRSS1_PI_246_DATA)
	Data.Set D:((((Var.VALUE(&__J7_DDR1_SS_BASE)+Var.VALUE(&__DDRSS_PI_REGISTER_BLOCK__OFFS))+Var.VALUE(&__DDRSS_PI_247__SFR_OFFS)))) %Long Var.VALUE(&__DDRSS1_PI_247_DATA)
	Data.Set D:((((Var.VALUE(&__J7_DDR1_SS_BASE)+Var.VALUE(&__DDRSS_PI_REGISTER_BLOCK__OFFS))+Var.VALUE(&__DDRSS_PI_248__SFR_OFFS)))) %Long Var.VALUE(&__DDRSS1_PI_248_DATA)
	Data.Set D:((((Var.VALUE(&__J7_DDR1_SS_BASE)+Var.VALUE(&__DDRSS_PI_REGISTER_BLOCK__OFFS))+Var.VALUE(&__DDRSS_PI_249__SFR_OFFS)))) %Long Var.VALUE(&__DDRSS1_PI_249_DATA)
	Data.Set D:((((Var.VALUE(&__J7_DDR1_SS_BASE)+Var.VALUE(&__DDRSS_PI_REGISTER_BLOCK__OFFS))+Var.VALUE(&__DDRSS_PI_250__SFR_OFFS)))) %Long Var.VALUE(&__DDRSS1_PI_250_DATA)
	Data.Set D:((((Var.VALUE(&__J7_DDR1_SS_BASE)+Var.VALUE(&__DDRSS_PI_REGISTER_BLOCK__OFFS))+Var.VALUE(&__DDRSS_PI_251__SFR_OFFS)))) %Long Var.VALUE(&__DDRSS1_PI_251_DATA)
	Data.Set D:((((Var.VALUE(&__J7_DDR1_SS_BASE)+Var.VALUE(&__DDRSS_PI_REGISTER_BLOCK__OFFS))+Var.VALUE(&__DDRSS_PI_252__SFR_OFFS)))) %Long Var.VALUE(&__DDRSS1_PI_252_DATA)
	Data.Set D:((((Var.VALUE(&__J7_DDR1_SS_BASE)+Var.VALUE(&__DDRSS_PI_REGISTER_BLOCK__OFFS))+Var.VALUE(&__DDRSS_PI_253__SFR_OFFS)))) %Long Var.VALUE(&__DDRSS1_PI_253_DATA)
	Data.Set D:((((Var.VALUE(&__J7_DDR1_SS_BASE)+Var.VALUE(&__DDRSS_PI_REGISTER_BLOCK__OFFS))+Var.VALUE(&__DDRSS_PI_254__SFR_OFFS)))) %Long Var.VALUE(&__DDRSS1_PI_254_DATA)
	Data.Set D:((((Var.VALUE(&__J7_DDR1_SS_BASE)+Var.VALUE(&__DDRSS_PI_REGISTER_BLOCK__OFFS))+Var.VALUE(&__DDRSS_PI_255__SFR_OFFS)))) %Long Var.VALUE(&__DDRSS1_PI_255_DATA)
	Data.Set D:((((Var.VALUE(&__J7_DDR1_SS_BASE)+Var.VALUE(&__DDRSS_PI_REGISTER_BLOCK__OFFS))+Var.VALUE(&__DDRSS_PI_256__SFR_OFFS)))) %Long Var.VALUE(&__DDRSS1_PI_256_DATA)
	Data.Set D:((((Var.VALUE(&__J7_DDR1_SS_BASE)+Var.VALUE(&__DDRSS_PI_REGISTER_BLOCK__OFFS))+Var.VALUE(&__DDRSS_PI_257__SFR_OFFS)))) %Long Var.VALUE(&__DDRSS1_PI_257_DATA)
	Data.Set D:((((Var.VALUE(&__J7_DDR1_SS_BASE)+Var.VALUE(&__DDRSS_PI_REGISTER_BLOCK__OFFS))+Var.VALUE(&__DDRSS_PI_258__SFR_OFFS)))) %Long Var.VALUE(&__DDRSS1_PI_258_DATA)
	Data.Set D:((((Var.VALUE(&__J7_DDR1_SS_BASE)+Var.VALUE(&__DDRSS_PI_REGISTER_BLOCK__OFFS))+Var.VALUE(&__DDRSS_PI_259__SFR_OFFS)))) %Long Var.VALUE(&__DDRSS1_PI_259_DATA)
	Data.Set D:((((Var.VALUE(&__J7_DDR1_SS_BASE)+Var.VALUE(&__DDRSS_PI_REGISTER_BLOCK__OFFS))+Var.VALUE(&__DDRSS_PI_260__SFR_OFFS)))) %Long Var.VALUE(&__DDRSS1_PI_260_DATA)
	Data.Set D:((((Var.VALUE(&__J7_DDR1_SS_BASE)+Var.VALUE(&__DDRSS_PI_REGISTER_BLOCK__OFFS))+Var.VALUE(&__DDRSS_PI_261__SFR_OFFS)))) %Long Var.VALUE(&__DDRSS1_PI_261_DATA)
	Data.Set D:((((Var.VALUE(&__J7_DDR1_SS_BASE)+Var.VALUE(&__DDRSS_PI_REGISTER_BLOCK__OFFS))+Var.VALUE(&__DDRSS_PI_262__SFR_OFFS)))) %Long Var.VALUE(&__DDRSS1_PI_262_DATA)
	Data.Set D:((((Var.VALUE(&__J7_DDR1_SS_BASE)+Var.VALUE(&__DDRSS_PI_REGISTER_BLOCK__OFFS))+Var.VALUE(&__DDRSS_PI_263__SFR_OFFS)))) %Long Var.VALUE(&__DDRSS1_PI_263_DATA)
	Data.Set D:((((Var.VALUE(&__J7_DDR1_SS_BASE)+Var.VALUE(&__DDRSS_PI_REGISTER_BLOCK__OFFS))+Var.VALUE(&__DDRSS_PI_264__SFR_OFFS)))) %Long Var.VALUE(&__DDRSS1_PI_264_DATA)
	Data.Set D:((((Var.VALUE(&__J7_DDR1_SS_BASE)+Var.VALUE(&__DDRSS_PI_REGISTER_BLOCK__OFFS))+Var.VALUE(&__DDRSS_PI_265__SFR_OFFS)))) %Long Var.VALUE(&__DDRSS1_PI_265_DATA)
	Data.Set D:((((Var.VALUE(&__J7_DDR1_SS_BASE)+Var.VALUE(&__DDRSS_PI_REGISTER_BLOCK__OFFS))+Var.VALUE(&__DDRSS_PI_266__SFR_OFFS)))) %Long Var.VALUE(&__DDRSS1_PI_266_DATA)
	Data.Set D:((((Var.VALUE(&__J7_DDR1_SS_BASE)+Var.VALUE(&__DDRSS_PI_REGISTER_BLOCK__OFFS))+Var.VALUE(&__DDRSS_PI_267__SFR_OFFS)))) %Long Var.VALUE(&__DDRSS1_PI_267_DATA)
	Data.Set D:((((Var.VALUE(&__J7_DDR1_SS_BASE)+Var.VALUE(&__DDRSS_PI_REGISTER_BLOCK__OFFS))+Var.VALUE(&__DDRSS_PI_268__SFR_OFFS)))) %Long Var.VALUE(&__DDRSS1_PI_268_DATA)
	Data.Set D:((((Var.VALUE(&__J7_DDR1_SS_BASE)+Var.VALUE(&__DDRSS_PI_REGISTER_BLOCK__OFFS))+Var.VALUE(&__DDRSS_PI_269__SFR_OFFS)))) %Long Var.VALUE(&__DDRSS1_PI_269_DATA)
	Data.Set D:((((Var.VALUE(&__J7_DDR1_SS_BASE)+Var.VALUE(&__DDRSS_PI_REGISTER_BLOCK__OFFS))+Var.VALUE(&__DDRSS_PI_270__SFR_OFFS)))) %Long Var.VALUE(&__DDRSS1_PI_270_DATA)
	Data.Set D:((((Var.VALUE(&__J7_DDR1_SS_BASE)+Var.VALUE(&__DDRSS_PI_REGISTER_BLOCK__OFFS))+Var.VALUE(&__DDRSS_PI_271__SFR_OFFS)))) %Long Var.VALUE(&__DDRSS1_PI_271_DATA)
	Data.Set D:((((Var.VALUE(&__J7_DDR1_SS_BASE)+Var.VALUE(&__DDRSS_PI_REGISTER_BLOCK__OFFS))+Var.VALUE(&__DDRSS_PI_272__SFR_OFFS)))) %Long Var.VALUE(&__DDRSS1_PI_272_DATA)
	Data.Set D:((((Var.VALUE(&__J7_DDR1_SS_BASE)+Var.VALUE(&__DDRSS_PI_REGISTER_BLOCK__OFFS))+Var.VALUE(&__DDRSS_PI_273__SFR_OFFS)))) %Long Var.VALUE(&__DDRSS1_PI_273_DATA)
	Data.Set D:((((Var.VALUE(&__J7_DDR1_SS_BASE)+Var.VALUE(&__DDRSS_PI_REGISTER_BLOCK__OFFS))+Var.VALUE(&__DDRSS_PI_274__SFR_OFFS)))) %Long Var.VALUE(&__DDRSS1_PI_274_DATA)
	Data.Set D:((((Var.VALUE(&__J7_DDR1_SS_BASE)+Var.VALUE(&__DDRSS_PI_REGISTER_BLOCK__OFFS))+Var.VALUE(&__DDRSS_PI_275__SFR_OFFS)))) %Long Var.VALUE(&__DDRSS1_PI_275_DATA)
	Data.Set D:((((Var.VALUE(&__J7_DDR1_SS_BASE)+Var.VALUE(&__DDRSS_PI_REGISTER_BLOCK__OFFS))+Var.VALUE(&__DDRSS_PI_276__SFR_OFFS)))) %Long Var.VALUE(&__DDRSS1_PI_276_DATA)
	Data.Set D:((((Var.VALUE(&__J7_DDR1_SS_BASE)+Var.VALUE(&__DDRSS_PI_REGISTER_BLOCK__OFFS))+Var.VALUE(&__DDRSS_PI_277__SFR_OFFS)))) %Long Var.VALUE(&__DDRSS1_PI_277_DATA)
	Data.Set D:((((Var.VALUE(&__J7_DDR1_SS_BASE)+Var.VALUE(&__DDRSS_PI_REGISTER_BLOCK__OFFS))+Var.VALUE(&__DDRSS_PI_278__SFR_OFFS)))) %Long Var.VALUE(&__DDRSS1_PI_278_DATA)
	Data.Set D:((((Var.VALUE(&__J7_DDR1_SS_BASE)+Var.VALUE(&__DDRSS_PI_REGISTER_BLOCK__OFFS))+Var.VALUE(&__DDRSS_PI_279__SFR_OFFS)))) %Long Var.VALUE(&__DDRSS1_PI_279_DATA)
	Data.Set D:((((Var.VALUE(&__J7_DDR1_SS_BASE)+Var.VALUE(&__DDRSS_PI_REGISTER_BLOCK__OFFS))+Var.VALUE(&__DDRSS_PI_280__SFR_OFFS)))) %Long Var.VALUE(&__DDRSS1_PI_280_DATA)
	Data.Set D:((((Var.VALUE(&__J7_DDR1_SS_BASE)+Var.VALUE(&__DDRSS_PI_REGISTER_BLOCK__OFFS))+Var.VALUE(&__DDRSS_PI_281__SFR_OFFS)))) %Long Var.VALUE(&__DDRSS1_PI_281_DATA)
	Data.Set D:((((Var.VALUE(&__J7_DDR1_SS_BASE)+Var.VALUE(&__DDRSS_PI_REGISTER_BLOCK__OFFS))+Var.VALUE(&__DDRSS_PI_282__SFR_OFFS)))) %Long Var.VALUE(&__DDRSS1_PI_282_DATA)
	Data.Set D:((((Var.VALUE(&__J7_DDR1_SS_BASE)+Var.VALUE(&__DDRSS_PI_REGISTER_BLOCK__OFFS))+Var.VALUE(&__DDRSS_PI_283__SFR_OFFS)))) %Long Var.VALUE(&__DDRSS1_PI_283_DATA)
	Data.Set D:((((Var.VALUE(&__J7_DDR1_SS_BASE)+Var.VALUE(&__DDRSS_PI_REGISTER_BLOCK__OFFS))+Var.VALUE(&__DDRSS_PI_284__SFR_OFFS)))) %Long Var.VALUE(&__DDRSS1_PI_284_DATA)
	Data.Set D:((((Var.VALUE(&__J7_DDR1_SS_BASE)+Var.VALUE(&__DDRSS_PI_REGISTER_BLOCK__OFFS))+Var.VALUE(&__DDRSS_PI_285__SFR_OFFS)))) %Long Var.VALUE(&__DDRSS1_PI_285_DATA)
	Data.Set D:((((Var.VALUE(&__J7_DDR1_SS_BASE)+Var.VALUE(&__DDRSS_PI_REGISTER_BLOCK__OFFS))+Var.VALUE(&__DDRSS_PI_286__SFR_OFFS)))) %Long Var.VALUE(&__DDRSS1_PI_286_DATA)
	Data.Set D:((((Var.VALUE(&__J7_DDR1_SS_BASE)+Var.VALUE(&__DDRSS_PI_REGISTER_BLOCK__OFFS))+Var.VALUE(&__DDRSS_PI_287__SFR_OFFS)))) %Long Var.VALUE(&__DDRSS1_PI_287_DATA)
	Data.Set D:((((Var.VALUE(&__J7_DDR1_SS_BASE)+Var.VALUE(&__DDRSS_PI_REGISTER_BLOCK__OFFS))+Var.VALUE(&__DDRSS_PI_288__SFR_OFFS)))) %Long Var.VALUE(&__DDRSS1_PI_288_DATA)
	Data.Set D:((((Var.VALUE(&__J7_DDR1_SS_BASE)+Var.VALUE(&__DDRSS_PI_REGISTER_BLOCK__OFFS))+Var.VALUE(&__DDRSS_PI_289__SFR_OFFS)))) %Long Var.VALUE(&__DDRSS1_PI_289_DATA)
	Data.Set D:((((Var.VALUE(&__J7_DDR1_SS_BASE)+Var.VALUE(&__DDRSS_PI_REGISTER_BLOCK__OFFS))+Var.VALUE(&__DDRSS_PI_290__SFR_OFFS)))) %Long Var.VALUE(&__DDRSS1_PI_290_DATA)
	Data.Set D:((((Var.VALUE(&__J7_DDR1_SS_BASE)+Var.VALUE(&__DDRSS_PI_REGISTER_BLOCK__OFFS))+Var.VALUE(&__DDRSS_PI_291__SFR_OFFS)))) %Long Var.VALUE(&__DDRSS1_PI_291_DATA)
	Data.Set D:((((Var.VALUE(&__J7_DDR1_SS_BASE)+Var.VALUE(&__DDRSS_PI_REGISTER_BLOCK__OFFS))+Var.VALUE(&__DDRSS_PI_292__SFR_OFFS)))) %Long Var.VALUE(&__DDRSS1_PI_292_DATA)
	Data.Set D:((((Var.VALUE(&__J7_DDR1_SS_BASE)+Var.VALUE(&__DDRSS_PI_REGISTER_BLOCK__OFFS))+Var.VALUE(&__DDRSS_PI_293__SFR_OFFS)))) %Long Var.VALUE(&__DDRSS1_PI_293_DATA)
	Data.Set D:((((Var.VALUE(&__J7_DDR1_SS_BASE)+Var.VALUE(&__DDRSS_PI_REGISTER_BLOCK__OFFS))+Var.VALUE(&__DDRSS_PI_294__SFR_OFFS)))) %Long Var.VALUE(&__DDRSS1_PI_294_DATA)
	Data.Set D:((((Var.VALUE(&__J7_DDR1_SS_BASE)+Var.VALUE(&__DDRSS_PI_REGISTER_BLOCK__OFFS))+Var.VALUE(&__DDRSS_PI_295__SFR_OFFS)))) %Long Var.VALUE(&__DDRSS1_PI_295_DATA)
	Data.Set D:((((Var.VALUE(&__J7_DDR1_SS_BASE)+Var.VALUE(&__DDRSS_PI_REGISTER_BLOCK__OFFS))+Var.VALUE(&__DDRSS_PI_296__SFR_OFFS)))) %Long Var.VALUE(&__DDRSS1_PI_296_DATA)
	Data.Set D:((((Var.VALUE(&__J7_DDR1_SS_BASE)+Var.VALUE(&__DDRSS_PI_REGISTER_BLOCK__OFFS))+Var.VALUE(&__DDRSS_PI_297__SFR_OFFS)))) %Long Var.VALUE(&__DDRSS1_PI_297_DATA)
	Data.Set D:((((Var.VALUE(&__J7_DDR1_SS_BASE)+Var.VALUE(&__DDRSS_PI_REGISTER_BLOCK__OFFS))+Var.VALUE(&__DDRSS_PI_298__SFR_OFFS)))) %Long Var.VALUE(&__DDRSS1_PI_298_DATA)
	Data.Set D:((((Var.VALUE(&__J7_DDR1_SS_BASE)+Var.VALUE(&__DDRSS_PI_REGISTER_BLOCK__OFFS))+Var.VALUE(&__DDRSS_PI_299__SFR_OFFS)))) %Long Var.VALUE(&__DDRSS1_PI_299_DATA)
	Var.NEWLOCAL char[128] \strtmp = "--->>> DDR1 PI programming completed... <<<---\n"
	GOSUB printf Var.String(\strtmp)
	
	Var.NEWLOCAL char[128] \strtmp = "--->>> DDR1 PHY Data Slice 0 programming in progress.. <<<---\n"
	GOSUB printf Var.String(\strtmp)
	
	Data.Set D:((((Var.VALUE(&__J7_DDR1_SS_BASE)+Var.VALUE(&__DDRSS_Data_Slice_0_REGISTER_BLOCK__OFFS))+Var.VALUE(&__DDRSS_PHY_0__SFR_OFFS)))) %Long Var.VALUE(&__DDRSS1_PHY_00_DATA)
	Data.Set D:((((Var.VALUE(&__J7_DDR1_SS_BASE)+Var.VALUE(&__DDRSS_Data_Slice_0_REGISTER_BLOCK__OFFS))+Var.VALUE(&__DDRSS_PHY_1__SFR_OFFS)))) %Long Var.VALUE(&__DDRSS1_PHY_01_DATA)
	Data.Set D:((((Var.VALUE(&__J7_DDR1_SS_BASE)+Var.VALUE(&__DDRSS_Data_Slice_0_REGISTER_BLOCK__OFFS))+Var.VALUE(&__DDRSS_PHY_2__SFR_OFFS)))) %Long Var.VALUE(&__DDRSS1_PHY_02_DATA)
	Data.Set D:((((Var.VALUE(&__J7_DDR1_SS_BASE)+Var.VALUE(&__DDRSS_Data_Slice_0_REGISTER_BLOCK__OFFS))+Var.VALUE(&__DDRSS_PHY_3__SFR_OFFS)))) %Long Var.VALUE(&__DDRSS1_PHY_03_DATA)
	Data.Set D:((((Var.VALUE(&__J7_DDR1_SS_BASE)+Var.VALUE(&__DDRSS_Data_Slice_0_REGISTER_BLOCK__OFFS))+Var.VALUE(&__DDRSS_PHY_4__SFR_OFFS)))) %Long Var.VALUE(&__DDRSS1_PHY_04_DATA)
	Data.Set D:((((Var.VALUE(&__J7_DDR1_SS_BASE)+Var.VALUE(&__DDRSS_Data_Slice_0_REGISTER_BLOCK__OFFS))+Var.VALUE(&__DDRSS_PHY_5__SFR_OFFS)))) %Long Var.VALUE(&__DDRSS1_PHY_05_DATA)
	Data.Set D:((((Var.VALUE(&__J7_DDR1_SS_BASE)+Var.VALUE(&__DDRSS_Data_Slice_0_REGISTER_BLOCK__OFFS))+Var.VALUE(&__DDRSS_PHY_6__SFR_OFFS)))) %Long Var.VALUE(&__DDRSS1_PHY_06_DATA)
	Data.Set D:((((Var.VALUE(&__J7_DDR1_SS_BASE)+Var.VALUE(&__DDRSS_Data_Slice_0_REGISTER_BLOCK__OFFS))+Var.VALUE(&__DDRSS_PHY_7__SFR_OFFS)))) %Long Var.VALUE(&__DDRSS1_PHY_07_DATA)
	Data.Set D:((((Var.VALUE(&__J7_DDR1_SS_BASE)+Var.VALUE(&__DDRSS_Data_Slice_0_REGISTER_BLOCK__OFFS))+Var.VALUE(&__DDRSS_PHY_8__SFR_OFFS)))) %Long Var.VALUE(&__DDRSS1_PHY_08_DATA)
	Data.Set D:((((Var.VALUE(&__J7_DDR1_SS_BASE)+Var.VALUE(&__DDRSS_Data_Slice_0_REGISTER_BLOCK__OFFS))+Var.VALUE(&__DDRSS_PHY_9__SFR_OFFS)))) %Long Var.VALUE(&__DDRSS1_PHY_09_DATA)
	Data.Set D:((((Var.VALUE(&__J7_DDR1_SS_BASE)+Var.VALUE(&__DDRSS_Data_Slice_0_REGISTER_BLOCK__OFFS))+Var.VALUE(&__DDRSS_PHY_10__SFR_OFFS)))) %Long Var.VALUE(&__DDRSS1_PHY_10_DATA)
	Data.Set D:((((Var.VALUE(&__J7_DDR1_SS_BASE)+Var.VALUE(&__DDRSS_Data_Slice_0_REGISTER_BLOCK__OFFS))+Var.VALUE(&__DDRSS_PHY_11__SFR_OFFS)))) %Long Var.VALUE(&__DDRSS1_PHY_11_DATA)
	Data.Set D:((((Var.VALUE(&__J7_DDR1_SS_BASE)+Var.VALUE(&__DDRSS_Data_Slice_0_REGISTER_BLOCK__OFFS))+Var.VALUE(&__DDRSS_PHY_12__SFR_OFFS)))) %Long Var.VALUE(&__DDRSS1_PHY_12_DATA)
	Data.Set D:((((Var.VALUE(&__J7_DDR1_SS_BASE)+Var.VALUE(&__DDRSS_Data_Slice_0_REGISTER_BLOCK__OFFS))+Var.VALUE(&__DDRSS_PHY_13__SFR_OFFS)))) %Long Var.VALUE(&__DDRSS1_PHY_13_DATA)
	Data.Set D:((((Var.VALUE(&__J7_DDR1_SS_BASE)+Var.VALUE(&__DDRSS_Data_Slice_0_REGISTER_BLOCK__OFFS))+Var.VALUE(&__DDRSS_PHY_14__SFR_OFFS)))) %Long Var.VALUE(&__DDRSS1_PHY_14_DATA)
	Data.Set D:((((Var.VALUE(&__J7_DDR1_SS_BASE)+Var.VALUE(&__DDRSS_Data_Slice_0_REGISTER_BLOCK__OFFS))+Var.VALUE(&__DDRSS_PHY_15__SFR_OFFS)))) %Long Var.VALUE(&__DDRSS1_PHY_15_DATA)
	Data.Set D:((((Var.VALUE(&__J7_DDR1_SS_BASE)+Var.VALUE(&__DDRSS_Data_Slice_0_REGISTER_BLOCK__OFFS))+Var.VALUE(&__DDRSS_PHY_16__SFR_OFFS)))) %Long Var.VALUE(&__DDRSS1_PHY_16_DATA)
	Data.Set D:((((Var.VALUE(&__J7_DDR1_SS_BASE)+Var.VALUE(&__DDRSS_Data_Slice_0_REGISTER_BLOCK__OFFS))+Var.VALUE(&__DDRSS_PHY_17__SFR_OFFS)))) %Long Var.VALUE(&__DDRSS1_PHY_17_DATA)
	Data.Set D:((((Var.VALUE(&__J7_DDR1_SS_BASE)+Var.VALUE(&__DDRSS_Data_Slice_0_REGISTER_BLOCK__OFFS))+Var.VALUE(&__DDRSS_PHY_18__SFR_OFFS)))) %Long Var.VALUE(&__DDRSS1_PHY_18_DATA)
	Data.Set D:((((Var.VALUE(&__J7_DDR1_SS_BASE)+Var.VALUE(&__DDRSS_Data_Slice_0_REGISTER_BLOCK__OFFS))+Var.VALUE(&__DDRSS_PHY_19__SFR_OFFS)))) %Long Var.VALUE(&__DDRSS1_PHY_19_DATA)
	Data.Set D:((((Var.VALUE(&__J7_DDR1_SS_BASE)+Var.VALUE(&__DDRSS_Data_Slice_0_REGISTER_BLOCK__OFFS))+Var.VALUE(&__DDRSS_PHY_20__SFR_OFFS)))) %Long Var.VALUE(&__DDRSS1_PHY_20_DATA)
	Data.Set D:((((Var.VALUE(&__J7_DDR1_SS_BASE)+Var.VALUE(&__DDRSS_Data_Slice_0_REGISTER_BLOCK__OFFS))+Var.VALUE(&__DDRSS_PHY_21__SFR_OFFS)))) %Long Var.VALUE(&__DDRSS1_PHY_21_DATA)
	Data.Set D:((((Var.VALUE(&__J7_DDR1_SS_BASE)+Var.VALUE(&__DDRSS_Data_Slice_0_REGISTER_BLOCK__OFFS))+Var.VALUE(&__DDRSS_PHY_22__SFR_OFFS)))) %Long Var.VALUE(&__DDRSS1_PHY_22_DATA)
	Data.Set D:((((Var.VALUE(&__J7_DDR1_SS_BASE)+Var.VALUE(&__DDRSS_Data_Slice_0_REGISTER_BLOCK__OFFS))+Var.VALUE(&__DDRSS_PHY_23__SFR_OFFS)))) %Long Var.VALUE(&__DDRSS1_PHY_23_DATA)
	Data.Set D:((((Var.VALUE(&__J7_DDR1_SS_BASE)+Var.VALUE(&__DDRSS_Data_Slice_0_REGISTER_BLOCK__OFFS))+Var.VALUE(&__DDRSS_PHY_24__SFR_OFFS)))) %Long Var.VALUE(&__DDRSS1_PHY_24_DATA)
	Data.Set D:((((Var.VALUE(&__J7_DDR1_SS_BASE)+Var.VALUE(&__DDRSS_Data_Slice_0_REGISTER_BLOCK__OFFS))+Var.VALUE(&__DDRSS_PHY_25__SFR_OFFS)))) %Long Var.VALUE(&__DDRSS1_PHY_25_DATA)
	Data.Set D:((((Var.VALUE(&__J7_DDR1_SS_BASE)+Var.VALUE(&__DDRSS_Data_Slice_0_REGISTER_BLOCK__OFFS))+Var.VALUE(&__DDRSS_PHY_26__SFR_OFFS)))) %Long Var.VALUE(&__DDRSS1_PHY_26_DATA)
	Data.Set D:((((Var.VALUE(&__J7_DDR1_SS_BASE)+Var.VALUE(&__DDRSS_Data_Slice_0_REGISTER_BLOCK__OFFS))+Var.VALUE(&__DDRSS_PHY_27__SFR_OFFS)))) %Long Var.VALUE(&__DDRSS1_PHY_27_DATA)
	Data.Set D:((((Var.VALUE(&__J7_DDR1_SS_BASE)+Var.VALUE(&__DDRSS_Data_Slice_0_REGISTER_BLOCK__OFFS))+Var.VALUE(&__DDRSS_PHY_28__SFR_OFFS)))) %Long Var.VALUE(&__DDRSS1_PHY_28_DATA)
	Data.Set D:((((Var.VALUE(&__J7_DDR1_SS_BASE)+Var.VALUE(&__DDRSS_Data_Slice_0_REGISTER_BLOCK__OFFS))+Var.VALUE(&__DDRSS_PHY_29__SFR_OFFS)))) %Long Var.VALUE(&__DDRSS1_PHY_29_DATA)
	Data.Set D:((((Var.VALUE(&__J7_DDR1_SS_BASE)+Var.VALUE(&__DDRSS_Data_Slice_0_REGISTER_BLOCK__OFFS))+Var.VALUE(&__DDRSS_PHY_30__SFR_OFFS)))) %Long Var.VALUE(&__DDRSS1_PHY_30_DATA)
	Data.Set D:((((Var.VALUE(&__J7_DDR1_SS_BASE)+Var.VALUE(&__DDRSS_Data_Slice_0_REGISTER_BLOCK__OFFS))+Var.VALUE(&__DDRSS_PHY_31__SFR_OFFS)))) %Long Var.VALUE(&__DDRSS1_PHY_31_DATA)
	Data.Set D:((((Var.VALUE(&__J7_DDR1_SS_BASE)+Var.VALUE(&__DDRSS_Data_Slice_0_REGISTER_BLOCK__OFFS))+Var.VALUE(&__DDRSS_PHY_32__SFR_OFFS)))) %Long Var.VALUE(&__DDRSS1_PHY_32_DATA)
	Data.Set D:((((Var.VALUE(&__J7_DDR1_SS_BASE)+Var.VALUE(&__DDRSS_Data_Slice_0_REGISTER_BLOCK__OFFS))+Var.VALUE(&__DDRSS_PHY_33__SFR_OFFS)))) %Long Var.VALUE(&__DDRSS1_PHY_33_DATA)
	Data.Set D:((((Var.VALUE(&__J7_DDR1_SS_BASE)+Var.VALUE(&__DDRSS_Data_Slice_0_REGISTER_BLOCK__OFFS))+Var.VALUE(&__DDRSS_PHY_34__SFR_OFFS)))) %Long Var.VALUE(&__DDRSS1_PHY_34_DATA)
	Data.Set D:((((Var.VALUE(&__J7_DDR1_SS_BASE)+Var.VALUE(&__DDRSS_Data_Slice_0_REGISTER_BLOCK__OFFS))+Var.VALUE(&__DDRSS_PHY_35__SFR_OFFS)))) %Long Var.VALUE(&__DDRSS1_PHY_35_DATA)
	Data.Set D:((((Var.VALUE(&__J7_DDR1_SS_BASE)+Var.VALUE(&__DDRSS_Data_Slice_0_REGISTER_BLOCK__OFFS))+Var.VALUE(&__DDRSS_PHY_36__SFR_OFFS)))) %Long Var.VALUE(&__DDRSS1_PHY_36_DATA)
	Data.Set D:((((Var.VALUE(&__J7_DDR1_SS_BASE)+Var.VALUE(&__DDRSS_Data_Slice_0_REGISTER_BLOCK__OFFS))+Var.VALUE(&__DDRSS_PHY_37__SFR_OFFS)))) %Long Var.VALUE(&__DDRSS1_PHY_37_DATA)
	Data.Set D:((((Var.VALUE(&__J7_DDR1_SS_BASE)+Var.VALUE(&__DDRSS_Data_Slice_0_REGISTER_BLOCK__OFFS))+Var.VALUE(&__DDRSS_PHY_38__SFR_OFFS)))) %Long Var.VALUE(&__DDRSS1_PHY_38_DATA)
	Data.Set D:((((Var.VALUE(&__J7_DDR1_SS_BASE)+Var.VALUE(&__DDRSS_Data_Slice_0_REGISTER_BLOCK__OFFS))+Var.VALUE(&__DDRSS_PHY_39__SFR_OFFS)))) %Long Var.VALUE(&__DDRSS1_PHY_39_DATA)
	Data.Set D:((((Var.VALUE(&__J7_DDR1_SS_BASE)+Var.VALUE(&__DDRSS_Data_Slice_0_REGISTER_BLOCK__OFFS))+Var.VALUE(&__DDRSS_PHY_40__SFR_OFFS)))) %Long Var.VALUE(&__DDRSS1_PHY_40_DATA)
	Data.Set D:((((Var.VALUE(&__J7_DDR1_SS_BASE)+Var.VALUE(&__DDRSS_Data_Slice_0_REGISTER_BLOCK__OFFS))+Var.VALUE(&__DDRSS_PHY_41__SFR_OFFS)))) %Long Var.VALUE(&__DDRSS1_PHY_41_DATA)
	Data.Set D:((((Var.VALUE(&__J7_DDR1_SS_BASE)+Var.VALUE(&__DDRSS_Data_Slice_0_REGISTER_BLOCK__OFFS))+Var.VALUE(&__DDRSS_PHY_42__SFR_OFFS)))) %Long Var.VALUE(&__DDRSS1_PHY_42_DATA)
	Data.Set D:((((Var.VALUE(&__J7_DDR1_SS_BASE)+Var.VALUE(&__DDRSS_Data_Slice_0_REGISTER_BLOCK__OFFS))+Var.VALUE(&__DDRSS_PHY_43__SFR_OFFS)))) %Long Var.VALUE(&__DDRSS1_PHY_43_DATA)
	Data.Set D:((((Var.VALUE(&__J7_DDR1_SS_BASE)+Var.VALUE(&__DDRSS_Data_Slice_0_REGISTER_BLOCK__OFFS))+Var.VALUE(&__DDRSS_PHY_44__SFR_OFFS)))) %Long Var.VALUE(&__DDRSS1_PHY_44_DATA)
	Data.Set D:((((Var.VALUE(&__J7_DDR1_SS_BASE)+Var.VALUE(&__DDRSS_Data_Slice_0_REGISTER_BLOCK__OFFS))+Var.VALUE(&__DDRSS_PHY_45__SFR_OFFS)))) %Long Var.VALUE(&__DDRSS1_PHY_45_DATA)
	Data.Set D:((((Var.VALUE(&__J7_DDR1_SS_BASE)+Var.VALUE(&__DDRSS_Data_Slice_0_REGISTER_BLOCK__OFFS))+Var.VALUE(&__DDRSS_PHY_46__SFR_OFFS)))) %Long Var.VALUE(&__DDRSS1_PHY_46_DATA)
	Data.Set D:((((Var.VALUE(&__J7_DDR1_SS_BASE)+Var.VALUE(&__DDRSS_Data_Slice_0_REGISTER_BLOCK__OFFS))+Var.VALUE(&__DDRSS_PHY_47__SFR_OFFS)))) %Long Var.VALUE(&__DDRSS1_PHY_47_DATA)
	Data.Set D:((((Var.VALUE(&__J7_DDR1_SS_BASE)+Var.VALUE(&__DDRSS_Data_Slice_0_REGISTER_BLOCK__OFFS))+Var.VALUE(&__DDRSS_PHY_48__SFR_OFFS)))) %Long Var.VALUE(&__DDRSS1_PHY_48_DATA)
	Data.Set D:((((Var.VALUE(&__J7_DDR1_SS_BASE)+Var.VALUE(&__DDRSS_Data_Slice_0_REGISTER_BLOCK__OFFS))+Var.VALUE(&__DDRSS_PHY_49__SFR_OFFS)))) %Long Var.VALUE(&__DDRSS1_PHY_49_DATA)
	Data.Set D:((((Var.VALUE(&__J7_DDR1_SS_BASE)+Var.VALUE(&__DDRSS_Data_Slice_0_REGISTER_BLOCK__OFFS))+Var.VALUE(&__DDRSS_PHY_50__SFR_OFFS)))) %Long Var.VALUE(&__DDRSS1_PHY_50_DATA)
	Data.Set D:((((Var.VALUE(&__J7_DDR1_SS_BASE)+Var.VALUE(&__DDRSS_Data_Slice_0_REGISTER_BLOCK__OFFS))+Var.VALUE(&__DDRSS_PHY_51__SFR_OFFS)))) %Long Var.VALUE(&__DDRSS1_PHY_51_DATA)
	Data.Set D:((((Var.VALUE(&__J7_DDR1_SS_BASE)+Var.VALUE(&__DDRSS_Data_Slice_0_REGISTER_BLOCK__OFFS))+Var.VALUE(&__DDRSS_PHY_52__SFR_OFFS)))) %Long Var.VALUE(&__DDRSS1_PHY_52_DATA)
	Data.Set D:((((Var.VALUE(&__J7_DDR1_SS_BASE)+Var.VALUE(&__DDRSS_Data_Slice_0_REGISTER_BLOCK__OFFS))+Var.VALUE(&__DDRSS_PHY_53__SFR_OFFS)))) %Long Var.VALUE(&__DDRSS1_PHY_53_DATA)
	Data.Set D:((((Var.VALUE(&__J7_DDR1_SS_BASE)+Var.VALUE(&__DDRSS_Data_Slice_0_REGISTER_BLOCK__OFFS))+Var.VALUE(&__DDRSS_PHY_54__SFR_OFFS)))) %Long Var.VALUE(&__DDRSS1_PHY_54_DATA)
	Data.Set D:((((Var.VALUE(&__J7_DDR1_SS_BASE)+Var.VALUE(&__DDRSS_Data_Slice_0_REGISTER_BLOCK__OFFS))+Var.VALUE(&__DDRSS_PHY_55__SFR_OFFS)))) %Long Var.VALUE(&__DDRSS1_PHY_55_DATA)
	Data.Set D:((((Var.VALUE(&__J7_DDR1_SS_BASE)+Var.VALUE(&__DDRSS_Data_Slice_0_REGISTER_BLOCK__OFFS))+Var.VALUE(&__DDRSS_PHY_56__SFR_OFFS)))) %Long Var.VALUE(&__DDRSS1_PHY_56_DATA)
	Data.Set D:((((Var.VALUE(&__J7_DDR1_SS_BASE)+Var.VALUE(&__DDRSS_Data_Slice_0_REGISTER_BLOCK__OFFS))+Var.VALUE(&__DDRSS_PHY_57__SFR_OFFS)))) %Long Var.VALUE(&__DDRSS1_PHY_57_DATA)
	Data.Set D:((((Var.VALUE(&__J7_DDR1_SS_BASE)+Var.VALUE(&__DDRSS_Data_Slice_0_REGISTER_BLOCK__OFFS))+Var.VALUE(&__DDRSS_PHY_58__SFR_OFFS)))) %Long Var.VALUE(&__DDRSS1_PHY_58_DATA)
	Data.Set D:((((Var.VALUE(&__J7_DDR1_SS_BASE)+Var.VALUE(&__DDRSS_Data_Slice_0_REGISTER_BLOCK__OFFS))+Var.VALUE(&__DDRSS_PHY_59__SFR_OFFS)))) %Long Var.VALUE(&__DDRSS1_PHY_59_DATA)
	Data.Set D:((((Var.VALUE(&__J7_DDR1_SS_BASE)+Var.VALUE(&__DDRSS_Data_Slice_0_REGISTER_BLOCK__OFFS))+Var.VALUE(&__DDRSS_PHY_60__SFR_OFFS)))) %Long Var.VALUE(&__DDRSS1_PHY_60_DATA)
	Data.Set D:((((Var.VALUE(&__J7_DDR1_SS_BASE)+Var.VALUE(&__DDRSS_Data_Slice_0_REGISTER_BLOCK__OFFS))+Var.VALUE(&__DDRSS_PHY_61__SFR_OFFS)))) %Long Var.VALUE(&__DDRSS1_PHY_61_DATA)
	Data.Set D:((((Var.VALUE(&__J7_DDR1_SS_BASE)+Var.VALUE(&__DDRSS_Data_Slice_0_REGISTER_BLOCK__OFFS))+Var.VALUE(&__DDRSS_PHY_62__SFR_OFFS)))) %Long Var.VALUE(&__DDRSS1_PHY_62_DATA)
	Data.Set D:((((Var.VALUE(&__J7_DDR1_SS_BASE)+Var.VALUE(&__DDRSS_Data_Slice_0_REGISTER_BLOCK__OFFS))+Var.VALUE(&__DDRSS_PHY_63__SFR_OFFS)))) %Long Var.VALUE(&__DDRSS1_PHY_63_DATA)
	Data.Set D:((((Var.VALUE(&__J7_DDR1_SS_BASE)+Var.VALUE(&__DDRSS_Data_Slice_0_REGISTER_BLOCK__OFFS))+Var.VALUE(&__DDRSS_PHY_64__SFR_OFFS)))) %Long Var.VALUE(&__DDRSS1_PHY_64_DATA)
	Data.Set D:((((Var.VALUE(&__J7_DDR1_SS_BASE)+Var.VALUE(&__DDRSS_Data_Slice_0_REGISTER_BLOCK__OFFS))+Var.VALUE(&__DDRSS_PHY_65__SFR_OFFS)))) %Long Var.VALUE(&__DDRSS1_PHY_65_DATA)
	Data.Set D:((((Var.VALUE(&__J7_DDR1_SS_BASE)+Var.VALUE(&__DDRSS_Data_Slice_0_REGISTER_BLOCK__OFFS))+Var.VALUE(&__DDRSS_PHY_66__SFR_OFFS)))) %Long Var.VALUE(&__DDRSS1_PHY_66_DATA)
	Data.Set D:((((Var.VALUE(&__J7_DDR1_SS_BASE)+Var.VALUE(&__DDRSS_Data_Slice_0_REGISTER_BLOCK__OFFS))+Var.VALUE(&__DDRSS_PHY_67__SFR_OFFS)))) %Long Var.VALUE(&__DDRSS1_PHY_67_DATA)
	Data.Set D:((((Var.VALUE(&__J7_DDR1_SS_BASE)+Var.VALUE(&__DDRSS_Data_Slice_0_REGISTER_BLOCK__OFFS))+Var.VALUE(&__DDRSS_PHY_68__SFR_OFFS)))) %Long Var.VALUE(&__DDRSS1_PHY_68_DATA)
	Data.Set D:((((Var.VALUE(&__J7_DDR1_SS_BASE)+Var.VALUE(&__DDRSS_Data_Slice_0_REGISTER_BLOCK__OFFS))+Var.VALUE(&__DDRSS_PHY_69__SFR_OFFS)))) %Long Var.VALUE(&__DDRSS1_PHY_69_DATA)
	Data.Set D:((((Var.VALUE(&__J7_DDR1_SS_BASE)+Var.VALUE(&__DDRSS_Data_Slice_0_REGISTER_BLOCK__OFFS))+Var.VALUE(&__DDRSS_PHY_70__SFR_OFFS)))) %Long Var.VALUE(&__DDRSS1_PHY_70_DATA)
	Data.Set D:((((Var.VALUE(&__J7_DDR1_SS_BASE)+Var.VALUE(&__DDRSS_Data_Slice_0_REGISTER_BLOCK__OFFS))+Var.VALUE(&__DDRSS_PHY_71__SFR_OFFS)))) %Long Var.VALUE(&__DDRSS1_PHY_71_DATA)
	Data.Set D:((((Var.VALUE(&__J7_DDR1_SS_BASE)+Var.VALUE(&__DDRSS_Data_Slice_0_REGISTER_BLOCK__OFFS))+Var.VALUE(&__DDRSS_PHY_72__SFR_OFFS)))) %Long Var.VALUE(&__DDRSS1_PHY_72_DATA)
	Data.Set D:((((Var.VALUE(&__J7_DDR1_SS_BASE)+Var.VALUE(&__DDRSS_Data_Slice_0_REGISTER_BLOCK__OFFS))+Var.VALUE(&__DDRSS_PHY_73__SFR_OFFS)))) %Long Var.VALUE(&__DDRSS1_PHY_73_DATA)
	Data.Set D:((((Var.VALUE(&__J7_DDR1_SS_BASE)+Var.VALUE(&__DDRSS_Data_Slice_0_REGISTER_BLOCK__OFFS))+Var.VALUE(&__DDRSS_PHY_74__SFR_OFFS)))) %Long Var.VALUE(&__DDRSS1_PHY_74_DATA)
	Data.Set D:((((Var.VALUE(&__J7_DDR1_SS_BASE)+Var.VALUE(&__DDRSS_Data_Slice_0_REGISTER_BLOCK__OFFS))+Var.VALUE(&__DDRSS_PHY_75__SFR_OFFS)))) %Long Var.VALUE(&__DDRSS1_PHY_75_DATA)
	Data.Set D:((((Var.VALUE(&__J7_DDR1_SS_BASE)+Var.VALUE(&__DDRSS_Data_Slice_0_REGISTER_BLOCK__OFFS))+Var.VALUE(&__DDRSS_PHY_76__SFR_OFFS)))) %Long Var.VALUE(&__DDRSS1_PHY_76_DATA)
	Data.Set D:((((Var.VALUE(&__J7_DDR1_SS_BASE)+Var.VALUE(&__DDRSS_Data_Slice_0_REGISTER_BLOCK__OFFS))+Var.VALUE(&__DDRSS_PHY_77__SFR_OFFS)))) %Long Var.VALUE(&__DDRSS1_PHY_77_DATA)
	Data.Set D:((((Var.VALUE(&__J7_DDR1_SS_BASE)+Var.VALUE(&__DDRSS_Data_Slice_0_REGISTER_BLOCK__OFFS))+Var.VALUE(&__DDRSS_PHY_78__SFR_OFFS)))) %Long Var.VALUE(&__DDRSS1_PHY_78_DATA)
	Data.Set D:((((Var.VALUE(&__J7_DDR1_SS_BASE)+Var.VALUE(&__DDRSS_Data_Slice_0_REGISTER_BLOCK__OFFS))+Var.VALUE(&__DDRSS_PHY_79__SFR_OFFS)))) %Long Var.VALUE(&__DDRSS1_PHY_79_DATA)
	Data.Set D:((((Var.VALUE(&__J7_DDR1_SS_BASE)+Var.VALUE(&__DDRSS_Data_Slice_0_REGISTER_BLOCK__OFFS))+Var.VALUE(&__DDRSS_PHY_80__SFR_OFFS)))) %Long Var.VALUE(&__DDRSS1_PHY_80_DATA)
	Data.Set D:((((Var.VALUE(&__J7_DDR1_SS_BASE)+Var.VALUE(&__DDRSS_Data_Slice_0_REGISTER_BLOCK__OFFS))+Var.VALUE(&__DDRSS_PHY_81__SFR_OFFS)))) %Long Var.VALUE(&__DDRSS1_PHY_81_DATA)
	Data.Set D:((((Var.VALUE(&__J7_DDR1_SS_BASE)+Var.VALUE(&__DDRSS_Data_Slice_0_REGISTER_BLOCK__OFFS))+Var.VALUE(&__DDRSS_PHY_82__SFR_OFFS)))) %Long Var.VALUE(&__DDRSS1_PHY_82_DATA)
	Data.Set D:((((Var.VALUE(&__J7_DDR1_SS_BASE)+Var.VALUE(&__DDRSS_Data_Slice_0_REGISTER_BLOCK__OFFS))+Var.VALUE(&__DDRSS_PHY_83__SFR_OFFS)))) %Long Var.VALUE(&__DDRSS1_PHY_83_DATA)
	Data.Set D:((((Var.VALUE(&__J7_DDR1_SS_BASE)+Var.VALUE(&__DDRSS_Data_Slice_0_REGISTER_BLOCK__OFFS))+Var.VALUE(&__DDRSS_PHY_84__SFR_OFFS)))) %Long Var.VALUE(&__DDRSS1_PHY_84_DATA)
	Data.Set D:((((Var.VALUE(&__J7_DDR1_SS_BASE)+Var.VALUE(&__DDRSS_Data_Slice_0_REGISTER_BLOCK__OFFS))+Var.VALUE(&__DDRSS_PHY_85__SFR_OFFS)))) %Long Var.VALUE(&__DDRSS1_PHY_85_DATA)
	Data.Set D:((((Var.VALUE(&__J7_DDR1_SS_BASE)+Var.VALUE(&__DDRSS_Data_Slice_0_REGISTER_BLOCK__OFFS))+Var.VALUE(&__DDRSS_PHY_86__SFR_OFFS)))) %Long Var.VALUE(&__DDRSS1_PHY_86_DATA)
	Data.Set D:((((Var.VALUE(&__J7_DDR1_SS_BASE)+Var.VALUE(&__DDRSS_Data_Slice_0_REGISTER_BLOCK__OFFS))+Var.VALUE(&__DDRSS_PHY_87__SFR_OFFS)))) %Long Var.VALUE(&__DDRSS1_PHY_87_DATA)
	Data.Set D:((((Var.VALUE(&__J7_DDR1_SS_BASE)+Var.VALUE(&__DDRSS_Data_Slice_0_REGISTER_BLOCK__OFFS))+Var.VALUE(&__DDRSS_PHY_88__SFR_OFFS)))) %Long Var.VALUE(&__DDRSS1_PHY_88_DATA)
	Data.Set D:((((Var.VALUE(&__J7_DDR1_SS_BASE)+Var.VALUE(&__DDRSS_Data_Slice_0_REGISTER_BLOCK__OFFS))+Var.VALUE(&__DDRSS_PHY_89__SFR_OFFS)))) %Long Var.VALUE(&__DDRSS1_PHY_89_DATA)
	Data.Set D:((((Var.VALUE(&__J7_DDR1_SS_BASE)+Var.VALUE(&__DDRSS_Data_Slice_0_REGISTER_BLOCK__OFFS))+Var.VALUE(&__DDRSS_PHY_90__SFR_OFFS)))) %Long Var.VALUE(&__DDRSS1_PHY_90_DATA)
	Data.Set D:((((Var.VALUE(&__J7_DDR1_SS_BASE)+Var.VALUE(&__DDRSS_Data_Slice_0_REGISTER_BLOCK__OFFS))+Var.VALUE(&__DDRSS_PHY_91__SFR_OFFS)))) %Long Var.VALUE(&__DDRSS1_PHY_91_DATA)
	Data.Set D:((((Var.VALUE(&__J7_DDR1_SS_BASE)+Var.VALUE(&__DDRSS_Data_Slice_0_REGISTER_BLOCK__OFFS))+Var.VALUE(&__DDRSS_PHY_92__SFR_OFFS)))) %Long Var.VALUE(&__DDRSS1_PHY_92_DATA)
	Data.Set D:((((Var.VALUE(&__J7_DDR1_SS_BASE)+Var.VALUE(&__DDRSS_Data_Slice_0_REGISTER_BLOCK__OFFS))+Var.VALUE(&__DDRSS_PHY_93__SFR_OFFS)))) %Long Var.VALUE(&__DDRSS1_PHY_93_DATA)
	Data.Set D:((((Var.VALUE(&__J7_DDR1_SS_BASE)+Var.VALUE(&__DDRSS_Data_Slice_0_REGISTER_BLOCK__OFFS))+Var.VALUE(&__DDRSS_PHY_94__SFR_OFFS)))) %Long Var.VALUE(&__DDRSS1_PHY_94_DATA)
	Data.Set D:((((Var.VALUE(&__J7_DDR1_SS_BASE)+Var.VALUE(&__DDRSS_Data_Slice_0_REGISTER_BLOCK__OFFS))+Var.VALUE(&__DDRSS_PHY_95__SFR_OFFS)))) %Long Var.VALUE(&__DDRSS1_PHY_95_DATA)
	Data.Set D:((((Var.VALUE(&__J7_DDR1_SS_BASE)+Var.VALUE(&__DDRSS_Data_Slice_0_REGISTER_BLOCK__OFFS))+Var.VALUE(&__DDRSS_PHY_96__SFR_OFFS)))) %Long Var.VALUE(&__DDRSS1_PHY_96_DATA)
	Data.Set D:((((Var.VALUE(&__J7_DDR1_SS_BASE)+Var.VALUE(&__DDRSS_Data_Slice_0_REGISTER_BLOCK__OFFS))+Var.VALUE(&__DDRSS_PHY_97__SFR_OFFS)))) %Long Var.VALUE(&__DDRSS1_PHY_97_DATA)
	Data.Set D:((((Var.VALUE(&__J7_DDR1_SS_BASE)+Var.VALUE(&__DDRSS_Data_Slice_0_REGISTER_BLOCK__OFFS))+Var.VALUE(&__DDRSS_PHY_98__SFR_OFFS)))) %Long Var.VALUE(&__DDRSS1_PHY_98_DATA)
	Data.Set D:((((Var.VALUE(&__J7_DDR1_SS_BASE)+Var.VALUE(&__DDRSS_Data_Slice_0_REGISTER_BLOCK__OFFS))+Var.VALUE(&__DDRSS_PHY_99__SFR_OFFS)))) %Long Var.VALUE(&__DDRSS1_PHY_99_DATA)
	Data.Set D:((((Var.VALUE(&__J7_DDR1_SS_BASE)+Var.VALUE(&__DDRSS_Data_Slice_0_REGISTER_BLOCK__OFFS))+Var.VALUE(&__DDRSS_PHY_100__SFR_OFFS)))) %Long Var.VALUE(&__DDRSS1_PHY_100_DATA)
	Data.Set D:((((Var.VALUE(&__J7_DDR1_SS_BASE)+Var.VALUE(&__DDRSS_Data_Slice_0_REGISTER_BLOCK__OFFS))+Var.VALUE(&__DDRSS_PHY_101__SFR_OFFS)))) %Long Var.VALUE(&__DDRSS1_PHY_101_DATA)
	Data.Set D:((((Var.VALUE(&__J7_DDR1_SS_BASE)+Var.VALUE(&__DDRSS_Data_Slice_0_REGISTER_BLOCK__OFFS))+Var.VALUE(&__DDRSS_PHY_102__SFR_OFFS)))) %Long Var.VALUE(&__DDRSS1_PHY_102_DATA)
	Data.Set D:((((Var.VALUE(&__J7_DDR1_SS_BASE)+Var.VALUE(&__DDRSS_Data_Slice_0_REGISTER_BLOCK__OFFS))+Var.VALUE(&__DDRSS_PHY_103__SFR_OFFS)))) %Long Var.VALUE(&__DDRSS1_PHY_103_DATA)
	Data.Set D:((((Var.VALUE(&__J7_DDR1_SS_BASE)+Var.VALUE(&__DDRSS_Data_Slice_0_REGISTER_BLOCK__OFFS))+Var.VALUE(&__DDRSS_PHY_104__SFR_OFFS)))) %Long Var.VALUE(&__DDRSS1_PHY_104_DATA)
	Data.Set D:((((Var.VALUE(&__J7_DDR1_SS_BASE)+Var.VALUE(&__DDRSS_Data_Slice_0_REGISTER_BLOCK__OFFS))+Var.VALUE(&__DDRSS_PHY_105__SFR_OFFS)))) %Long Var.VALUE(&__DDRSS1_PHY_105_DATA)
	Data.Set D:((((Var.VALUE(&__J7_DDR1_SS_BASE)+Var.VALUE(&__DDRSS_Data_Slice_0_REGISTER_BLOCK__OFFS))+Var.VALUE(&__DDRSS_PHY_106__SFR_OFFS)))) %Long Var.VALUE(&__DDRSS1_PHY_106_DATA)
	Data.Set D:((((Var.VALUE(&__J7_DDR1_SS_BASE)+Var.VALUE(&__DDRSS_Data_Slice_0_REGISTER_BLOCK__OFFS))+Var.VALUE(&__DDRSS_PHY_107__SFR_OFFS)))) %Long Var.VALUE(&__DDRSS1_PHY_107_DATA)
	Data.Set D:((((Var.VALUE(&__J7_DDR1_SS_BASE)+Var.VALUE(&__DDRSS_Data_Slice_0_REGISTER_BLOCK__OFFS))+Var.VALUE(&__DDRSS_PHY_108__SFR_OFFS)))) %Long Var.VALUE(&__DDRSS1_PHY_108_DATA)
	Data.Set D:((((Var.VALUE(&__J7_DDR1_SS_BASE)+Var.VALUE(&__DDRSS_Data_Slice_0_REGISTER_BLOCK__OFFS))+Var.VALUE(&__DDRSS_PHY_109__SFR_OFFS)))) %Long Var.VALUE(&__DDRSS1_PHY_109_DATA)
	Data.Set D:((((Var.VALUE(&__J7_DDR1_SS_BASE)+Var.VALUE(&__DDRSS_Data_Slice_0_REGISTER_BLOCK__OFFS))+Var.VALUE(&__DDRSS_PHY_110__SFR_OFFS)))) %Long Var.VALUE(&__DDRSS1_PHY_110_DATA)
	Data.Set D:((((Var.VALUE(&__J7_DDR1_SS_BASE)+Var.VALUE(&__DDRSS_Data_Slice_0_REGISTER_BLOCK__OFFS))+Var.VALUE(&__DDRSS_PHY_111__SFR_OFFS)))) %Long Var.VALUE(&__DDRSS1_PHY_111_DATA)
	Data.Set D:((((Var.VALUE(&__J7_DDR1_SS_BASE)+Var.VALUE(&__DDRSS_Data_Slice_0_REGISTER_BLOCK__OFFS))+Var.VALUE(&__DDRSS_PHY_112__SFR_OFFS)))) %Long Var.VALUE(&__DDRSS1_PHY_112_DATA)
	Data.Set D:((((Var.VALUE(&__J7_DDR1_SS_BASE)+Var.VALUE(&__DDRSS_Data_Slice_0_REGISTER_BLOCK__OFFS))+Var.VALUE(&__DDRSS_PHY_113__SFR_OFFS)))) %Long Var.VALUE(&__DDRSS1_PHY_113_DATA)
	Data.Set D:((((Var.VALUE(&__J7_DDR1_SS_BASE)+Var.VALUE(&__DDRSS_Data_Slice_0_REGISTER_BLOCK__OFFS))+Var.VALUE(&__DDRSS_PHY_114__SFR_OFFS)))) %Long Var.VALUE(&__DDRSS1_PHY_114_DATA)
	Data.Set D:((((Var.VALUE(&__J7_DDR1_SS_BASE)+Var.VALUE(&__DDRSS_Data_Slice_0_REGISTER_BLOCK__OFFS))+Var.VALUE(&__DDRSS_PHY_115__SFR_OFFS)))) %Long Var.VALUE(&__DDRSS1_PHY_115_DATA)
	Data.Set D:((((Var.VALUE(&__J7_DDR1_SS_BASE)+Var.VALUE(&__DDRSS_Data_Slice_0_REGISTER_BLOCK__OFFS))+Var.VALUE(&__DDRSS_PHY_116__SFR_OFFS)))) %Long Var.VALUE(&__DDRSS1_PHY_116_DATA)
	Data.Set D:((((Var.VALUE(&__J7_DDR1_SS_BASE)+Var.VALUE(&__DDRSS_Data_Slice_0_REGISTER_BLOCK__OFFS))+Var.VALUE(&__DDRSS_PHY_117__SFR_OFFS)))) %Long Var.VALUE(&__DDRSS1_PHY_117_DATA)
	Data.Set D:((((Var.VALUE(&__J7_DDR1_SS_BASE)+Var.VALUE(&__DDRSS_Data_Slice_0_REGISTER_BLOCK__OFFS))+Var.VALUE(&__DDRSS_PHY_118__SFR_OFFS)))) %Long Var.VALUE(&__DDRSS1_PHY_118_DATA)
	Data.Set D:((((Var.VALUE(&__J7_DDR1_SS_BASE)+Var.VALUE(&__DDRSS_Data_Slice_0_REGISTER_BLOCK__OFFS))+Var.VALUE(&__DDRSS_PHY_119__SFR_OFFS)))) %Long Var.VALUE(&__DDRSS1_PHY_119_DATA)
	Data.Set D:((((Var.VALUE(&__J7_DDR1_SS_BASE)+Var.VALUE(&__DDRSS_Data_Slice_0_REGISTER_BLOCK__OFFS))+Var.VALUE(&__DDRSS_PHY_120__SFR_OFFS)))) %Long Var.VALUE(&__DDRSS1_PHY_120_DATA)
	Data.Set D:((((Var.VALUE(&__J7_DDR1_SS_BASE)+Var.VALUE(&__DDRSS_Data_Slice_0_REGISTER_BLOCK__OFFS))+Var.VALUE(&__DDRSS_PHY_121__SFR_OFFS)))) %Long Var.VALUE(&__DDRSS1_PHY_121_DATA)
	Data.Set D:((((Var.VALUE(&__J7_DDR1_SS_BASE)+Var.VALUE(&__DDRSS_Data_Slice_0_REGISTER_BLOCK__OFFS))+Var.VALUE(&__DDRSS_PHY_122__SFR_OFFS)))) %Long Var.VALUE(&__DDRSS1_PHY_122_DATA)
	Data.Set D:((((Var.VALUE(&__J7_DDR1_SS_BASE)+Var.VALUE(&__DDRSS_Data_Slice_0_REGISTER_BLOCK__OFFS))+Var.VALUE(&__DDRSS_PHY_123__SFR_OFFS)))) %Long Var.VALUE(&__DDRSS1_PHY_123_DATA)
	Data.Set D:((((Var.VALUE(&__J7_DDR1_SS_BASE)+Var.VALUE(&__DDRSS_Data_Slice_0_REGISTER_BLOCK__OFFS))+Var.VALUE(&__DDRSS_PHY_124__SFR_OFFS)))) %Long Var.VALUE(&__DDRSS1_PHY_124_DATA)
	Data.Set D:((((Var.VALUE(&__J7_DDR1_SS_BASE)+Var.VALUE(&__DDRSS_Data_Slice_0_REGISTER_BLOCK__OFFS))+Var.VALUE(&__DDRSS_PHY_125__SFR_OFFS)))) %Long Var.VALUE(&__DDRSS1_PHY_125_DATA)
	Data.Set D:((((Var.VALUE(&__J7_DDR1_SS_BASE)+Var.VALUE(&__DDRSS_Data_Slice_0_REGISTER_BLOCK__OFFS))+Var.VALUE(&__DDRSS_PHY_126__SFR_OFFS)))) %Long Var.VALUE(&__DDRSS1_PHY_126_DATA)
	Data.Set D:((((Var.VALUE(&__J7_DDR1_SS_BASE)+Var.VALUE(&__DDRSS_Data_Slice_0_REGISTER_BLOCK__OFFS))+Var.VALUE(&__DDRSS_PHY_127__SFR_OFFS)))) %Long Var.VALUE(&__DDRSS1_PHY_127_DATA)
	Data.Set D:((((Var.VALUE(&__J7_DDR1_SS_BASE)+Var.VALUE(&__DDRSS_Data_Slice_0_REGISTER_BLOCK__OFFS))+Var.VALUE(&__DDRSS_PHY_128__SFR_OFFS)))) %Long Var.VALUE(&__DDRSS1_PHY_128_DATA)
	Data.Set D:((((Var.VALUE(&__J7_DDR1_SS_BASE)+Var.VALUE(&__DDRSS_Data_Slice_0_REGISTER_BLOCK__OFFS))+Var.VALUE(&__DDRSS_PHY_129__SFR_OFFS)))) %Long Var.VALUE(&__DDRSS1_PHY_129_DATA)
	Data.Set D:((((Var.VALUE(&__J7_DDR1_SS_BASE)+Var.VALUE(&__DDRSS_Data_Slice_0_REGISTER_BLOCK__OFFS))+Var.VALUE(&__DDRSS_PHY_130__SFR_OFFS)))) %Long Var.VALUE(&__DDRSS1_PHY_130_DATA)
	Data.Set D:((((Var.VALUE(&__J7_DDR1_SS_BASE)+Var.VALUE(&__DDRSS_Data_Slice_0_REGISTER_BLOCK__OFFS))+Var.VALUE(&__DDRSS_PHY_131__SFR_OFFS)))) %Long Var.VALUE(&__DDRSS1_PHY_131_DATA)
	Data.Set D:((((Var.VALUE(&__J7_DDR1_SS_BASE)+Var.VALUE(&__DDRSS_Data_Slice_0_REGISTER_BLOCK__OFFS))+Var.VALUE(&__DDRSS_PHY_132__SFR_OFFS)))) %Long Var.VALUE(&__DDRSS1_PHY_132_DATA)
	Data.Set D:((((Var.VALUE(&__J7_DDR1_SS_BASE)+Var.VALUE(&__DDRSS_Data_Slice_0_REGISTER_BLOCK__OFFS))+Var.VALUE(&__DDRSS_PHY_133__SFR_OFFS)))) %Long Var.VALUE(&__DDRSS1_PHY_133_DATA)
	Data.Set D:((((Var.VALUE(&__J7_DDR1_SS_BASE)+Var.VALUE(&__DDRSS_Data_Slice_0_REGISTER_BLOCK__OFFS))+Var.VALUE(&__DDRSS_PHY_134__SFR_OFFS)))) %Long Var.VALUE(&__DDRSS1_PHY_134_DATA)
	Data.Set D:((((Var.VALUE(&__J7_DDR1_SS_BASE)+Var.VALUE(&__DDRSS_Data_Slice_0_REGISTER_BLOCK__OFFS))+Var.VALUE(&__DDRSS_PHY_135__SFR_OFFS)))) %Long Var.VALUE(&__DDRSS1_PHY_135_DATA)
	Data.Set D:((((Var.VALUE(&__J7_DDR1_SS_BASE)+Var.VALUE(&__DDRSS_Data_Slice_0_REGISTER_BLOCK__OFFS))+Var.VALUE(&__DDRSS_PHY_136__SFR_OFFS)))) %Long Var.VALUE(&__DDRSS1_PHY_136_DATA)
	Data.Set D:((((Var.VALUE(&__J7_DDR1_SS_BASE)+Var.VALUE(&__DDRSS_Data_Slice_0_REGISTER_BLOCK__OFFS))+Var.VALUE(&__DDRSS_PHY_137__SFR_OFFS)))) %Long Var.VALUE(&__DDRSS1_PHY_137_DATA)
	Data.Set D:((((Var.VALUE(&__J7_DDR1_SS_BASE)+Var.VALUE(&__DDRSS_Data_Slice_0_REGISTER_BLOCK__OFFS))+Var.VALUE(&__DDRSS_PHY_138__SFR_OFFS)))) %Long Var.VALUE(&__DDRSS1_PHY_138_DATA)
	Data.Set D:((((Var.VALUE(&__J7_DDR1_SS_BASE)+Var.VALUE(&__DDRSS_Data_Slice_0_REGISTER_BLOCK__OFFS))+Var.VALUE(&__DDRSS_PHY_139__SFR_OFFS)))) %Long Var.VALUE(&__DDRSS1_PHY_139_DATA)
	Var.NEWLOCAL char[128] \strtmp = "--->>> DDR1 PHY Data Slice 0 programming completed... <<<---\n"
	GOSUB printf Var.String(\strtmp)
	
	Var.NEWLOCAL char[128] \strtmp = "--->>> DDR1 PHY Data Slice 1 programming in progress.. <<<---\n"
	GOSUB printf Var.String(\strtmp)
	
	Data.Set D:((((Var.VALUE(&__J7_DDR1_SS_BASE)+Var.VALUE(&__DDRSS_Data_Slice_1_REGISTER_BLOCK__OFFS))+Var.VALUE(&__DDRSS_PHY_256__SFR_OFFS)))) %Long Var.VALUE(&__DDRSS1_PHY_256_DATA)
	Data.Set D:((((Var.VALUE(&__J7_DDR1_SS_BASE)+Var.VALUE(&__DDRSS_Data_Slice_1_REGISTER_BLOCK__OFFS))+Var.VALUE(&__DDRSS_PHY_257__SFR_OFFS)))) %Long Var.VALUE(&__DDRSS1_PHY_257_DATA)
	Data.Set D:((((Var.VALUE(&__J7_DDR1_SS_BASE)+Var.VALUE(&__DDRSS_Data_Slice_1_REGISTER_BLOCK__OFFS))+Var.VALUE(&__DDRSS_PHY_258__SFR_OFFS)))) %Long Var.VALUE(&__DDRSS1_PHY_258_DATA)
	Data.Set D:((((Var.VALUE(&__J7_DDR1_SS_BASE)+Var.VALUE(&__DDRSS_Data_Slice_1_REGISTER_BLOCK__OFFS))+Var.VALUE(&__DDRSS_PHY_259__SFR_OFFS)))) %Long Var.VALUE(&__DDRSS1_PHY_259_DATA)
	Data.Set D:((((Var.VALUE(&__J7_DDR1_SS_BASE)+Var.VALUE(&__DDRSS_Data_Slice_1_REGISTER_BLOCK__OFFS))+Var.VALUE(&__DDRSS_PHY_260__SFR_OFFS)))) %Long Var.VALUE(&__DDRSS1_PHY_260_DATA)
	Data.Set D:((((Var.VALUE(&__J7_DDR1_SS_BASE)+Var.VALUE(&__DDRSS_Data_Slice_1_REGISTER_BLOCK__OFFS))+Var.VALUE(&__DDRSS_PHY_261__SFR_OFFS)))) %Long Var.VALUE(&__DDRSS1_PHY_261_DATA)
	Data.Set D:((((Var.VALUE(&__J7_DDR1_SS_BASE)+Var.VALUE(&__DDRSS_Data_Slice_1_REGISTER_BLOCK__OFFS))+Var.VALUE(&__DDRSS_PHY_262__SFR_OFFS)))) %Long Var.VALUE(&__DDRSS1_PHY_262_DATA)
	Data.Set D:((((Var.VALUE(&__J7_DDR1_SS_BASE)+Var.VALUE(&__DDRSS_Data_Slice_1_REGISTER_BLOCK__OFFS))+Var.VALUE(&__DDRSS_PHY_263__SFR_OFFS)))) %Long Var.VALUE(&__DDRSS1_PHY_263_DATA)
	Data.Set D:((((Var.VALUE(&__J7_DDR1_SS_BASE)+Var.VALUE(&__DDRSS_Data_Slice_1_REGISTER_BLOCK__OFFS))+Var.VALUE(&__DDRSS_PHY_264__SFR_OFFS)))) %Long Var.VALUE(&__DDRSS1_PHY_264_DATA)
	Data.Set D:((((Var.VALUE(&__J7_DDR1_SS_BASE)+Var.VALUE(&__DDRSS_Data_Slice_1_REGISTER_BLOCK__OFFS))+Var.VALUE(&__DDRSS_PHY_265__SFR_OFFS)))) %Long Var.VALUE(&__DDRSS1_PHY_265_DATA)
	Data.Set D:((((Var.VALUE(&__J7_DDR1_SS_BASE)+Var.VALUE(&__DDRSS_Data_Slice_1_REGISTER_BLOCK__OFFS))+Var.VALUE(&__DDRSS_PHY_266__SFR_OFFS)))) %Long Var.VALUE(&__DDRSS1_PHY_266_DATA)
	Data.Set D:((((Var.VALUE(&__J7_DDR1_SS_BASE)+Var.VALUE(&__DDRSS_Data_Slice_1_REGISTER_BLOCK__OFFS))+Var.VALUE(&__DDRSS_PHY_267__SFR_OFFS)))) %Long Var.VALUE(&__DDRSS1_PHY_267_DATA)
	Data.Set D:((((Var.VALUE(&__J7_DDR1_SS_BASE)+Var.VALUE(&__DDRSS_Data_Slice_1_REGISTER_BLOCK__OFFS))+Var.VALUE(&__DDRSS_PHY_268__SFR_OFFS)))) %Long Var.VALUE(&__DDRSS1_PHY_268_DATA)
	Data.Set D:((((Var.VALUE(&__J7_DDR1_SS_BASE)+Var.VALUE(&__DDRSS_Data_Slice_1_REGISTER_BLOCK__OFFS))+Var.VALUE(&__DDRSS_PHY_269__SFR_OFFS)))) %Long Var.VALUE(&__DDRSS1_PHY_269_DATA)
	Data.Set D:((((Var.VALUE(&__J7_DDR1_SS_BASE)+Var.VALUE(&__DDRSS_Data_Slice_1_REGISTER_BLOCK__OFFS))+Var.VALUE(&__DDRSS_PHY_270__SFR_OFFS)))) %Long Var.VALUE(&__DDRSS1_PHY_270_DATA)
	Data.Set D:((((Var.VALUE(&__J7_DDR1_SS_BASE)+Var.VALUE(&__DDRSS_Data_Slice_1_REGISTER_BLOCK__OFFS))+Var.VALUE(&__DDRSS_PHY_271__SFR_OFFS)))) %Long Var.VALUE(&__DDRSS1_PHY_271_DATA)
	Data.Set D:((((Var.VALUE(&__J7_DDR1_SS_BASE)+Var.VALUE(&__DDRSS_Data_Slice_1_REGISTER_BLOCK__OFFS))+Var.VALUE(&__DDRSS_PHY_272__SFR_OFFS)))) %Long Var.VALUE(&__DDRSS1_PHY_272_DATA)
	Data.Set D:((((Var.VALUE(&__J7_DDR1_SS_BASE)+Var.VALUE(&__DDRSS_Data_Slice_1_REGISTER_BLOCK__OFFS))+Var.VALUE(&__DDRSS_PHY_273__SFR_OFFS)))) %Long Var.VALUE(&__DDRSS1_PHY_273_DATA)
	Data.Set D:((((Var.VALUE(&__J7_DDR1_SS_BASE)+Var.VALUE(&__DDRSS_Data_Slice_1_REGISTER_BLOCK__OFFS))+Var.VALUE(&__DDRSS_PHY_274__SFR_OFFS)))) %Long Var.VALUE(&__DDRSS1_PHY_274_DATA)
	Data.Set D:((((Var.VALUE(&__J7_DDR1_SS_BASE)+Var.VALUE(&__DDRSS_Data_Slice_1_REGISTER_BLOCK__OFFS))+Var.VALUE(&__DDRSS_PHY_275__SFR_OFFS)))) %Long Var.VALUE(&__DDRSS1_PHY_275_DATA)
	Data.Set D:((((Var.VALUE(&__J7_DDR1_SS_BASE)+Var.VALUE(&__DDRSS_Data_Slice_1_REGISTER_BLOCK__OFFS))+Var.VALUE(&__DDRSS_PHY_276__SFR_OFFS)))) %Long Var.VALUE(&__DDRSS1_PHY_276_DATA)
	Data.Set D:((((Var.VALUE(&__J7_DDR1_SS_BASE)+Var.VALUE(&__DDRSS_Data_Slice_1_REGISTER_BLOCK__OFFS))+Var.VALUE(&__DDRSS_PHY_277__SFR_OFFS)))) %Long Var.VALUE(&__DDRSS1_PHY_277_DATA)
	Data.Set D:((((Var.VALUE(&__J7_DDR1_SS_BASE)+Var.VALUE(&__DDRSS_Data_Slice_1_REGISTER_BLOCK__OFFS))+Var.VALUE(&__DDRSS_PHY_278__SFR_OFFS)))) %Long Var.VALUE(&__DDRSS1_PHY_278_DATA)
	Data.Set D:((((Var.VALUE(&__J7_DDR1_SS_BASE)+Var.VALUE(&__DDRSS_Data_Slice_1_REGISTER_BLOCK__OFFS))+Var.VALUE(&__DDRSS_PHY_279__SFR_OFFS)))) %Long Var.VALUE(&__DDRSS1_PHY_279_DATA)
	Data.Set D:((((Var.VALUE(&__J7_DDR1_SS_BASE)+Var.VALUE(&__DDRSS_Data_Slice_1_REGISTER_BLOCK__OFFS))+Var.VALUE(&__DDRSS_PHY_280__SFR_OFFS)))) %Long Var.VALUE(&__DDRSS1_PHY_280_DATA)
	Data.Set D:((((Var.VALUE(&__J7_DDR1_SS_BASE)+Var.VALUE(&__DDRSS_Data_Slice_1_REGISTER_BLOCK__OFFS))+Var.VALUE(&__DDRSS_PHY_281__SFR_OFFS)))) %Long Var.VALUE(&__DDRSS1_PHY_281_DATA)
	Data.Set D:((((Var.VALUE(&__J7_DDR1_SS_BASE)+Var.VALUE(&__DDRSS_Data_Slice_1_REGISTER_BLOCK__OFFS))+Var.VALUE(&__DDRSS_PHY_282__SFR_OFFS)))) %Long Var.VALUE(&__DDRSS1_PHY_282_DATA)
	Data.Set D:((((Var.VALUE(&__J7_DDR1_SS_BASE)+Var.VALUE(&__DDRSS_Data_Slice_1_REGISTER_BLOCK__OFFS))+Var.VALUE(&__DDRSS_PHY_283__SFR_OFFS)))) %Long Var.VALUE(&__DDRSS1_PHY_283_DATA)
	Data.Set D:((((Var.VALUE(&__J7_DDR1_SS_BASE)+Var.VALUE(&__DDRSS_Data_Slice_1_REGISTER_BLOCK__OFFS))+Var.VALUE(&__DDRSS_PHY_284__SFR_OFFS)))) %Long Var.VALUE(&__DDRSS1_PHY_284_DATA)
	Data.Set D:((((Var.VALUE(&__J7_DDR1_SS_BASE)+Var.VALUE(&__DDRSS_Data_Slice_1_REGISTER_BLOCK__OFFS))+Var.VALUE(&__DDRSS_PHY_285__SFR_OFFS)))) %Long Var.VALUE(&__DDRSS1_PHY_285_DATA)
	Data.Set D:((((Var.VALUE(&__J7_DDR1_SS_BASE)+Var.VALUE(&__DDRSS_Data_Slice_1_REGISTER_BLOCK__OFFS))+Var.VALUE(&__DDRSS_PHY_286__SFR_OFFS)))) %Long Var.VALUE(&__DDRSS1_PHY_286_DATA)
	Data.Set D:((((Var.VALUE(&__J7_DDR1_SS_BASE)+Var.VALUE(&__DDRSS_Data_Slice_1_REGISTER_BLOCK__OFFS))+Var.VALUE(&__DDRSS_PHY_287__SFR_OFFS)))) %Long Var.VALUE(&__DDRSS1_PHY_287_DATA)
	Data.Set D:((((Var.VALUE(&__J7_DDR1_SS_BASE)+Var.VALUE(&__DDRSS_Data_Slice_1_REGISTER_BLOCK__OFFS))+Var.VALUE(&__DDRSS_PHY_288__SFR_OFFS)))) %Long Var.VALUE(&__DDRSS1_PHY_288_DATA)
	Data.Set D:((((Var.VALUE(&__J7_DDR1_SS_BASE)+Var.VALUE(&__DDRSS_Data_Slice_1_REGISTER_BLOCK__OFFS))+Var.VALUE(&__DDRSS_PHY_289__SFR_OFFS)))) %Long Var.VALUE(&__DDRSS1_PHY_289_DATA)
	Data.Set D:((((Var.VALUE(&__J7_DDR1_SS_BASE)+Var.VALUE(&__DDRSS_Data_Slice_1_REGISTER_BLOCK__OFFS))+Var.VALUE(&__DDRSS_PHY_290__SFR_OFFS)))) %Long Var.VALUE(&__DDRSS1_PHY_290_DATA)
	Data.Set D:((((Var.VALUE(&__J7_DDR1_SS_BASE)+Var.VALUE(&__DDRSS_Data_Slice_1_REGISTER_BLOCK__OFFS))+Var.VALUE(&__DDRSS_PHY_291__SFR_OFFS)))) %Long Var.VALUE(&__DDRSS1_PHY_291_DATA)
	Data.Set D:((((Var.VALUE(&__J7_DDR1_SS_BASE)+Var.VALUE(&__DDRSS_Data_Slice_1_REGISTER_BLOCK__OFFS))+Var.VALUE(&__DDRSS_PHY_292__SFR_OFFS)))) %Long Var.VALUE(&__DDRSS1_PHY_292_DATA)
	Data.Set D:((((Var.VALUE(&__J7_DDR1_SS_BASE)+Var.VALUE(&__DDRSS_Data_Slice_1_REGISTER_BLOCK__OFFS))+Var.VALUE(&__DDRSS_PHY_293__SFR_OFFS)))) %Long Var.VALUE(&__DDRSS1_PHY_293_DATA)
	Data.Set D:((((Var.VALUE(&__J7_DDR1_SS_BASE)+Var.VALUE(&__DDRSS_Data_Slice_1_REGISTER_BLOCK__OFFS))+Var.VALUE(&__DDRSS_PHY_294__SFR_OFFS)))) %Long Var.VALUE(&__DDRSS1_PHY_294_DATA)
	Data.Set D:((((Var.VALUE(&__J7_DDR1_SS_BASE)+Var.VALUE(&__DDRSS_Data_Slice_1_REGISTER_BLOCK__OFFS))+Var.VALUE(&__DDRSS_PHY_295__SFR_OFFS)))) %Long Var.VALUE(&__DDRSS1_PHY_295_DATA)
	Data.Set D:((((Var.VALUE(&__J7_DDR1_SS_BASE)+Var.VALUE(&__DDRSS_Data_Slice_1_REGISTER_BLOCK__OFFS))+Var.VALUE(&__DDRSS_PHY_296__SFR_OFFS)))) %Long Var.VALUE(&__DDRSS1_PHY_296_DATA)
	Data.Set D:((((Var.VALUE(&__J7_DDR1_SS_BASE)+Var.VALUE(&__DDRSS_Data_Slice_1_REGISTER_BLOCK__OFFS))+Var.VALUE(&__DDRSS_PHY_297__SFR_OFFS)))) %Long Var.VALUE(&__DDRSS1_PHY_297_DATA)
	Data.Set D:((((Var.VALUE(&__J7_DDR1_SS_BASE)+Var.VALUE(&__DDRSS_Data_Slice_1_REGISTER_BLOCK__OFFS))+Var.VALUE(&__DDRSS_PHY_298__SFR_OFFS)))) %Long Var.VALUE(&__DDRSS1_PHY_298_DATA)
	Data.Set D:((((Var.VALUE(&__J7_DDR1_SS_BASE)+Var.VALUE(&__DDRSS_Data_Slice_1_REGISTER_BLOCK__OFFS))+Var.VALUE(&__DDRSS_PHY_299__SFR_OFFS)))) %Long Var.VALUE(&__DDRSS1_PHY_299_DATA)
	Data.Set D:((((Var.VALUE(&__J7_DDR1_SS_BASE)+Var.VALUE(&__DDRSS_Data_Slice_1_REGISTER_BLOCK__OFFS))+Var.VALUE(&__DDRSS_PHY_300__SFR_OFFS)))) %Long Var.VALUE(&__DDRSS1_PHY_300_DATA)
	Data.Set D:((((Var.VALUE(&__J7_DDR1_SS_BASE)+Var.VALUE(&__DDRSS_Data_Slice_1_REGISTER_BLOCK__OFFS))+Var.VALUE(&__DDRSS_PHY_301__SFR_OFFS)))) %Long Var.VALUE(&__DDRSS1_PHY_301_DATA)
	Data.Set D:((((Var.VALUE(&__J7_DDR1_SS_BASE)+Var.VALUE(&__DDRSS_Data_Slice_1_REGISTER_BLOCK__OFFS))+Var.VALUE(&__DDRSS_PHY_302__SFR_OFFS)))) %Long Var.VALUE(&__DDRSS1_PHY_302_DATA)
	Data.Set D:((((Var.VALUE(&__J7_DDR1_SS_BASE)+Var.VALUE(&__DDRSS_Data_Slice_1_REGISTER_BLOCK__OFFS))+Var.VALUE(&__DDRSS_PHY_303__SFR_OFFS)))) %Long Var.VALUE(&__DDRSS1_PHY_303_DATA)
	Data.Set D:((((Var.VALUE(&__J7_DDR1_SS_BASE)+Var.VALUE(&__DDRSS_Data_Slice_1_REGISTER_BLOCK__OFFS))+Var.VALUE(&__DDRSS_PHY_304__SFR_OFFS)))) %Long Var.VALUE(&__DDRSS1_PHY_304_DATA)
	Data.Set D:((((Var.VALUE(&__J7_DDR1_SS_BASE)+Var.VALUE(&__DDRSS_Data_Slice_1_REGISTER_BLOCK__OFFS))+Var.VALUE(&__DDRSS_PHY_305__SFR_OFFS)))) %Long Var.VALUE(&__DDRSS1_PHY_305_DATA)
	Data.Set D:((((Var.VALUE(&__J7_DDR1_SS_BASE)+Var.VALUE(&__DDRSS_Data_Slice_1_REGISTER_BLOCK__OFFS))+Var.VALUE(&__DDRSS_PHY_306__SFR_OFFS)))) %Long Var.VALUE(&__DDRSS1_PHY_306_DATA)
	Data.Set D:((((Var.VALUE(&__J7_DDR1_SS_BASE)+Var.VALUE(&__DDRSS_Data_Slice_1_REGISTER_BLOCK__OFFS))+Var.VALUE(&__DDRSS_PHY_307__SFR_OFFS)))) %Long Var.VALUE(&__DDRSS1_PHY_307_DATA)
	Data.Set D:((((Var.VALUE(&__J7_DDR1_SS_BASE)+Var.VALUE(&__DDRSS_Data_Slice_1_REGISTER_BLOCK__OFFS))+Var.VALUE(&__DDRSS_PHY_308__SFR_OFFS)))) %Long Var.VALUE(&__DDRSS1_PHY_308_DATA)
	Data.Set D:((((Var.VALUE(&__J7_DDR1_SS_BASE)+Var.VALUE(&__DDRSS_Data_Slice_1_REGISTER_BLOCK__OFFS))+Var.VALUE(&__DDRSS_PHY_309__SFR_OFFS)))) %Long Var.VALUE(&__DDRSS1_PHY_309_DATA)
	Data.Set D:((((Var.VALUE(&__J7_DDR1_SS_BASE)+Var.VALUE(&__DDRSS_Data_Slice_1_REGISTER_BLOCK__OFFS))+Var.VALUE(&__DDRSS_PHY_310__SFR_OFFS)))) %Long Var.VALUE(&__DDRSS1_PHY_310_DATA)
	Data.Set D:((((Var.VALUE(&__J7_DDR1_SS_BASE)+Var.VALUE(&__DDRSS_Data_Slice_1_REGISTER_BLOCK__OFFS))+Var.VALUE(&__DDRSS_PHY_311__SFR_OFFS)))) %Long Var.VALUE(&__DDRSS1_PHY_311_DATA)
	Data.Set D:((((Var.VALUE(&__J7_DDR1_SS_BASE)+Var.VALUE(&__DDRSS_Data_Slice_1_REGISTER_BLOCK__OFFS))+Var.VALUE(&__DDRSS_PHY_312__SFR_OFFS)))) %Long Var.VALUE(&__DDRSS1_PHY_312_DATA)
	Data.Set D:((((Var.VALUE(&__J7_DDR1_SS_BASE)+Var.VALUE(&__DDRSS_Data_Slice_1_REGISTER_BLOCK__OFFS))+Var.VALUE(&__DDRSS_PHY_313__SFR_OFFS)))) %Long Var.VALUE(&__DDRSS1_PHY_313_DATA)
	Data.Set D:((((Var.VALUE(&__J7_DDR1_SS_BASE)+Var.VALUE(&__DDRSS_Data_Slice_1_REGISTER_BLOCK__OFFS))+Var.VALUE(&__DDRSS_PHY_314__SFR_OFFS)))) %Long Var.VALUE(&__DDRSS1_PHY_314_DATA)
	Data.Set D:((((Var.VALUE(&__J7_DDR1_SS_BASE)+Var.VALUE(&__DDRSS_Data_Slice_1_REGISTER_BLOCK__OFFS))+Var.VALUE(&__DDRSS_PHY_315__SFR_OFFS)))) %Long Var.VALUE(&__DDRSS1_PHY_315_DATA)
	Data.Set D:((((Var.VALUE(&__J7_DDR1_SS_BASE)+Var.VALUE(&__DDRSS_Data_Slice_1_REGISTER_BLOCK__OFFS))+Var.VALUE(&__DDRSS_PHY_316__SFR_OFFS)))) %Long Var.VALUE(&__DDRSS1_PHY_316_DATA)
	Data.Set D:((((Var.VALUE(&__J7_DDR1_SS_BASE)+Var.VALUE(&__DDRSS_Data_Slice_1_REGISTER_BLOCK__OFFS))+Var.VALUE(&__DDRSS_PHY_317__SFR_OFFS)))) %Long Var.VALUE(&__DDRSS1_PHY_317_DATA)
	Data.Set D:((((Var.VALUE(&__J7_DDR1_SS_BASE)+Var.VALUE(&__DDRSS_Data_Slice_1_REGISTER_BLOCK__OFFS))+Var.VALUE(&__DDRSS_PHY_318__SFR_OFFS)))) %Long Var.VALUE(&__DDRSS1_PHY_318_DATA)
	Data.Set D:((((Var.VALUE(&__J7_DDR1_SS_BASE)+Var.VALUE(&__DDRSS_Data_Slice_1_REGISTER_BLOCK__OFFS))+Var.VALUE(&__DDRSS_PHY_319__SFR_OFFS)))) %Long Var.VALUE(&__DDRSS1_PHY_319_DATA)
	Data.Set D:((((Var.VALUE(&__J7_DDR1_SS_BASE)+Var.VALUE(&__DDRSS_Data_Slice_1_REGISTER_BLOCK__OFFS))+Var.VALUE(&__DDRSS_PHY_320__SFR_OFFS)))) %Long Var.VALUE(&__DDRSS1_PHY_320_DATA)
	Data.Set D:((((Var.VALUE(&__J7_DDR1_SS_BASE)+Var.VALUE(&__DDRSS_Data_Slice_1_REGISTER_BLOCK__OFFS))+Var.VALUE(&__DDRSS_PHY_321__SFR_OFFS)))) %Long Var.VALUE(&__DDRSS1_PHY_321_DATA)
	Data.Set D:((((Var.VALUE(&__J7_DDR1_SS_BASE)+Var.VALUE(&__DDRSS_Data_Slice_1_REGISTER_BLOCK__OFFS))+Var.VALUE(&__DDRSS_PHY_322__SFR_OFFS)))) %Long Var.VALUE(&__DDRSS1_PHY_322_DATA)
	Data.Set D:((((Var.VALUE(&__J7_DDR1_SS_BASE)+Var.VALUE(&__DDRSS_Data_Slice_1_REGISTER_BLOCK__OFFS))+Var.VALUE(&__DDRSS_PHY_323__SFR_OFFS)))) %Long Var.VALUE(&__DDRSS1_PHY_323_DATA)
	Data.Set D:((((Var.VALUE(&__J7_DDR1_SS_BASE)+Var.VALUE(&__DDRSS_Data_Slice_1_REGISTER_BLOCK__OFFS))+Var.VALUE(&__DDRSS_PHY_324__SFR_OFFS)))) %Long Var.VALUE(&__DDRSS1_PHY_324_DATA)
	Data.Set D:((((Var.VALUE(&__J7_DDR1_SS_BASE)+Var.VALUE(&__DDRSS_Data_Slice_1_REGISTER_BLOCK__OFFS))+Var.VALUE(&__DDRSS_PHY_325__SFR_OFFS)))) %Long Var.VALUE(&__DDRSS1_PHY_325_DATA)
	Data.Set D:((((Var.VALUE(&__J7_DDR1_SS_BASE)+Var.VALUE(&__DDRSS_Data_Slice_1_REGISTER_BLOCK__OFFS))+Var.VALUE(&__DDRSS_PHY_326__SFR_OFFS)))) %Long Var.VALUE(&__DDRSS1_PHY_326_DATA)
	Data.Set D:((((Var.VALUE(&__J7_DDR1_SS_BASE)+Var.VALUE(&__DDRSS_Data_Slice_1_REGISTER_BLOCK__OFFS))+Var.VALUE(&__DDRSS_PHY_327__SFR_OFFS)))) %Long Var.VALUE(&__DDRSS1_PHY_327_DATA)
	Data.Set D:((((Var.VALUE(&__J7_DDR1_SS_BASE)+Var.VALUE(&__DDRSS_Data_Slice_1_REGISTER_BLOCK__OFFS))+Var.VALUE(&__DDRSS_PHY_328__SFR_OFFS)))) %Long Var.VALUE(&__DDRSS1_PHY_328_DATA)
	Data.Set D:((((Var.VALUE(&__J7_DDR1_SS_BASE)+Var.VALUE(&__DDRSS_Data_Slice_1_REGISTER_BLOCK__OFFS))+Var.VALUE(&__DDRSS_PHY_329__SFR_OFFS)))) %Long Var.VALUE(&__DDRSS1_PHY_329_DATA)
	Data.Set D:((((Var.VALUE(&__J7_DDR1_SS_BASE)+Var.VALUE(&__DDRSS_Data_Slice_1_REGISTER_BLOCK__OFFS))+Var.VALUE(&__DDRSS_PHY_330__SFR_OFFS)))) %Long Var.VALUE(&__DDRSS1_PHY_330_DATA)
	Data.Set D:((((Var.VALUE(&__J7_DDR1_SS_BASE)+Var.VALUE(&__DDRSS_Data_Slice_1_REGISTER_BLOCK__OFFS))+Var.VALUE(&__DDRSS_PHY_331__SFR_OFFS)))) %Long Var.VALUE(&__DDRSS1_PHY_331_DATA)
	Data.Set D:((((Var.VALUE(&__J7_DDR1_SS_BASE)+Var.VALUE(&__DDRSS_Data_Slice_1_REGISTER_BLOCK__OFFS))+Var.VALUE(&__DDRSS_PHY_332__SFR_OFFS)))) %Long Var.VALUE(&__DDRSS1_PHY_332_DATA)
	Data.Set D:((((Var.VALUE(&__J7_DDR1_SS_BASE)+Var.VALUE(&__DDRSS_Data_Slice_1_REGISTER_BLOCK__OFFS))+Var.VALUE(&__DDRSS_PHY_333__SFR_OFFS)))) %Long Var.VALUE(&__DDRSS1_PHY_333_DATA)
	Data.Set D:((((Var.VALUE(&__J7_DDR1_SS_BASE)+Var.VALUE(&__DDRSS_Data_Slice_1_REGISTER_BLOCK__OFFS))+Var.VALUE(&__DDRSS_PHY_334__SFR_OFFS)))) %Long Var.VALUE(&__DDRSS1_PHY_334_DATA)
	Data.Set D:((((Var.VALUE(&__J7_DDR1_SS_BASE)+Var.VALUE(&__DDRSS_Data_Slice_1_REGISTER_BLOCK__OFFS))+Var.VALUE(&__DDRSS_PHY_335__SFR_OFFS)))) %Long Var.VALUE(&__DDRSS1_PHY_335_DATA)
	Data.Set D:((((Var.VALUE(&__J7_DDR1_SS_BASE)+Var.VALUE(&__DDRSS_Data_Slice_1_REGISTER_BLOCK__OFFS))+Var.VALUE(&__DDRSS_PHY_336__SFR_OFFS)))) %Long Var.VALUE(&__DDRSS1_PHY_336_DATA)
	Data.Set D:((((Var.VALUE(&__J7_DDR1_SS_BASE)+Var.VALUE(&__DDRSS_Data_Slice_1_REGISTER_BLOCK__OFFS))+Var.VALUE(&__DDRSS_PHY_337__SFR_OFFS)))) %Long Var.VALUE(&__DDRSS1_PHY_337_DATA)
	Data.Set D:((((Var.VALUE(&__J7_DDR1_SS_BASE)+Var.VALUE(&__DDRSS_Data_Slice_1_REGISTER_BLOCK__OFFS))+Var.VALUE(&__DDRSS_PHY_338__SFR_OFFS)))) %Long Var.VALUE(&__DDRSS1_PHY_338_DATA)
	Data.Set D:((((Var.VALUE(&__J7_DDR1_SS_BASE)+Var.VALUE(&__DDRSS_Data_Slice_1_REGISTER_BLOCK__OFFS))+Var.VALUE(&__DDRSS_PHY_339__SFR_OFFS)))) %Long Var.VALUE(&__DDRSS1_PHY_339_DATA)
	Data.Set D:((((Var.VALUE(&__J7_DDR1_SS_BASE)+Var.VALUE(&__DDRSS_Data_Slice_1_REGISTER_BLOCK__OFFS))+Var.VALUE(&__DDRSS_PHY_340__SFR_OFFS)))) %Long Var.VALUE(&__DDRSS1_PHY_340_DATA)
	Data.Set D:((((Var.VALUE(&__J7_DDR1_SS_BASE)+Var.VALUE(&__DDRSS_Data_Slice_1_REGISTER_BLOCK__OFFS))+Var.VALUE(&__DDRSS_PHY_341__SFR_OFFS)))) %Long Var.VALUE(&__DDRSS1_PHY_341_DATA)
	Data.Set D:((((Var.VALUE(&__J7_DDR1_SS_BASE)+Var.VALUE(&__DDRSS_Data_Slice_1_REGISTER_BLOCK__OFFS))+Var.VALUE(&__DDRSS_PHY_342__SFR_OFFS)))) %Long Var.VALUE(&__DDRSS1_PHY_342_DATA)
	Data.Set D:((((Var.VALUE(&__J7_DDR1_SS_BASE)+Var.VALUE(&__DDRSS_Data_Slice_1_REGISTER_BLOCK__OFFS))+Var.VALUE(&__DDRSS_PHY_343__SFR_OFFS)))) %Long Var.VALUE(&__DDRSS1_PHY_343_DATA)
	Data.Set D:((((Var.VALUE(&__J7_DDR1_SS_BASE)+Var.VALUE(&__DDRSS_Data_Slice_1_REGISTER_BLOCK__OFFS))+Var.VALUE(&__DDRSS_PHY_344__SFR_OFFS)))) %Long Var.VALUE(&__DDRSS1_PHY_344_DATA)
	Data.Set D:((((Var.VALUE(&__J7_DDR1_SS_BASE)+Var.VALUE(&__DDRSS_Data_Slice_1_REGISTER_BLOCK__OFFS))+Var.VALUE(&__DDRSS_PHY_345__SFR_OFFS)))) %Long Var.VALUE(&__DDRSS1_PHY_345_DATA)
	Data.Set D:((((Var.VALUE(&__J7_DDR1_SS_BASE)+Var.VALUE(&__DDRSS_Data_Slice_1_REGISTER_BLOCK__OFFS))+Var.VALUE(&__DDRSS_PHY_346__SFR_OFFS)))) %Long Var.VALUE(&__DDRSS1_PHY_346_DATA)
	Data.Set D:((((Var.VALUE(&__J7_DDR1_SS_BASE)+Var.VALUE(&__DDRSS_Data_Slice_1_REGISTER_BLOCK__OFFS))+Var.VALUE(&__DDRSS_PHY_347__SFR_OFFS)))) %Long Var.VALUE(&__DDRSS1_PHY_347_DATA)
	Data.Set D:((((Var.VALUE(&__J7_DDR1_SS_BASE)+Var.VALUE(&__DDRSS_Data_Slice_1_REGISTER_BLOCK__OFFS))+Var.VALUE(&__DDRSS_PHY_348__SFR_OFFS)))) %Long Var.VALUE(&__DDRSS1_PHY_348_DATA)
	Data.Set D:((((Var.VALUE(&__J7_DDR1_SS_BASE)+Var.VALUE(&__DDRSS_Data_Slice_1_REGISTER_BLOCK__OFFS))+Var.VALUE(&__DDRSS_PHY_349__SFR_OFFS)))) %Long Var.VALUE(&__DDRSS1_PHY_349_DATA)
	Data.Set D:((((Var.VALUE(&__J7_DDR1_SS_BASE)+Var.VALUE(&__DDRSS_Data_Slice_1_REGISTER_BLOCK__OFFS))+Var.VALUE(&__DDRSS_PHY_350__SFR_OFFS)))) %Long Var.VALUE(&__DDRSS1_PHY_350_DATA)
	Data.Set D:((((Var.VALUE(&__J7_DDR1_SS_BASE)+Var.VALUE(&__DDRSS_Data_Slice_1_REGISTER_BLOCK__OFFS))+Var.VALUE(&__DDRSS_PHY_351__SFR_OFFS)))) %Long Var.VALUE(&__DDRSS1_PHY_351_DATA)
	Data.Set D:((((Var.VALUE(&__J7_DDR1_SS_BASE)+Var.VALUE(&__DDRSS_Data_Slice_1_REGISTER_BLOCK__OFFS))+Var.VALUE(&__DDRSS_PHY_352__SFR_OFFS)))) %Long Var.VALUE(&__DDRSS1_PHY_352_DATA)
	Data.Set D:((((Var.VALUE(&__J7_DDR1_SS_BASE)+Var.VALUE(&__DDRSS_Data_Slice_1_REGISTER_BLOCK__OFFS))+Var.VALUE(&__DDRSS_PHY_353__SFR_OFFS)))) %Long Var.VALUE(&__DDRSS1_PHY_353_DATA)
	Data.Set D:((((Var.VALUE(&__J7_DDR1_SS_BASE)+Var.VALUE(&__DDRSS_Data_Slice_1_REGISTER_BLOCK__OFFS))+Var.VALUE(&__DDRSS_PHY_354__SFR_OFFS)))) %Long Var.VALUE(&__DDRSS1_PHY_354_DATA)
	Data.Set D:((((Var.VALUE(&__J7_DDR1_SS_BASE)+Var.VALUE(&__DDRSS_Data_Slice_1_REGISTER_BLOCK__OFFS))+Var.VALUE(&__DDRSS_PHY_355__SFR_OFFS)))) %Long Var.VALUE(&__DDRSS1_PHY_355_DATA)
	Data.Set D:((((Var.VALUE(&__J7_DDR1_SS_BASE)+Var.VALUE(&__DDRSS_Data_Slice_1_REGISTER_BLOCK__OFFS))+Var.VALUE(&__DDRSS_PHY_356__SFR_OFFS)))) %Long Var.VALUE(&__DDRSS1_PHY_356_DATA)
	Data.Set D:((((Var.VALUE(&__J7_DDR1_SS_BASE)+Var.VALUE(&__DDRSS_Data_Slice_1_REGISTER_BLOCK__OFFS))+Var.VALUE(&__DDRSS_PHY_357__SFR_OFFS)))) %Long Var.VALUE(&__DDRSS1_PHY_357_DATA)
	Data.Set D:((((Var.VALUE(&__J7_DDR1_SS_BASE)+Var.VALUE(&__DDRSS_Data_Slice_1_REGISTER_BLOCK__OFFS))+Var.VALUE(&__DDRSS_PHY_358__SFR_OFFS)))) %Long Var.VALUE(&__DDRSS1_PHY_358_DATA)
	Data.Set D:((((Var.VALUE(&__J7_DDR1_SS_BASE)+Var.VALUE(&__DDRSS_Data_Slice_1_REGISTER_BLOCK__OFFS))+Var.VALUE(&__DDRSS_PHY_359__SFR_OFFS)))) %Long Var.VALUE(&__DDRSS1_PHY_359_DATA)
	Data.Set D:((((Var.VALUE(&__J7_DDR1_SS_BASE)+Var.VALUE(&__DDRSS_Data_Slice_1_REGISTER_BLOCK__OFFS))+Var.VALUE(&__DDRSS_PHY_360__SFR_OFFS)))) %Long Var.VALUE(&__DDRSS1_PHY_360_DATA)
	Data.Set D:((((Var.VALUE(&__J7_DDR1_SS_BASE)+Var.VALUE(&__DDRSS_Data_Slice_1_REGISTER_BLOCK__OFFS))+Var.VALUE(&__DDRSS_PHY_361__SFR_OFFS)))) %Long Var.VALUE(&__DDRSS1_PHY_361_DATA)
	Data.Set D:((((Var.VALUE(&__J7_DDR1_SS_BASE)+Var.VALUE(&__DDRSS_Data_Slice_1_REGISTER_BLOCK__OFFS))+Var.VALUE(&__DDRSS_PHY_362__SFR_OFFS)))) %Long Var.VALUE(&__DDRSS1_PHY_362_DATA)
	Data.Set D:((((Var.VALUE(&__J7_DDR1_SS_BASE)+Var.VALUE(&__DDRSS_Data_Slice_1_REGISTER_BLOCK__OFFS))+Var.VALUE(&__DDRSS_PHY_363__SFR_OFFS)))) %Long Var.VALUE(&__DDRSS1_PHY_363_DATA)
	Data.Set D:((((Var.VALUE(&__J7_DDR1_SS_BASE)+Var.VALUE(&__DDRSS_Data_Slice_1_REGISTER_BLOCK__OFFS))+Var.VALUE(&__DDRSS_PHY_364__SFR_OFFS)))) %Long Var.VALUE(&__DDRSS1_PHY_364_DATA)
	Data.Set D:((((Var.VALUE(&__J7_DDR1_SS_BASE)+Var.VALUE(&__DDRSS_Data_Slice_1_REGISTER_BLOCK__OFFS))+Var.VALUE(&__DDRSS_PHY_365__SFR_OFFS)))) %Long Var.VALUE(&__DDRSS1_PHY_365_DATA)
	Data.Set D:((((Var.VALUE(&__J7_DDR1_SS_BASE)+Var.VALUE(&__DDRSS_Data_Slice_1_REGISTER_BLOCK__OFFS))+Var.VALUE(&__DDRSS_PHY_366__SFR_OFFS)))) %Long Var.VALUE(&__DDRSS1_PHY_366_DATA)
	Data.Set D:((((Var.VALUE(&__J7_DDR1_SS_BASE)+Var.VALUE(&__DDRSS_Data_Slice_1_REGISTER_BLOCK__OFFS))+Var.VALUE(&__DDRSS_PHY_367__SFR_OFFS)))) %Long Var.VALUE(&__DDRSS1_PHY_367_DATA)
	Data.Set D:((((Var.VALUE(&__J7_DDR1_SS_BASE)+Var.VALUE(&__DDRSS_Data_Slice_1_REGISTER_BLOCK__OFFS))+Var.VALUE(&__DDRSS_PHY_368__SFR_OFFS)))) %Long Var.VALUE(&__DDRSS1_PHY_368_DATA)
	Data.Set D:((((Var.VALUE(&__J7_DDR1_SS_BASE)+Var.VALUE(&__DDRSS_Data_Slice_1_REGISTER_BLOCK__OFFS))+Var.VALUE(&__DDRSS_PHY_369__SFR_OFFS)))) %Long Var.VALUE(&__DDRSS1_PHY_369_DATA)
	Data.Set D:((((Var.VALUE(&__J7_DDR1_SS_BASE)+Var.VALUE(&__DDRSS_Data_Slice_1_REGISTER_BLOCK__OFFS))+Var.VALUE(&__DDRSS_PHY_370__SFR_OFFS)))) %Long Var.VALUE(&__DDRSS1_PHY_370_DATA)
	Data.Set D:((((Var.VALUE(&__J7_DDR1_SS_BASE)+Var.VALUE(&__DDRSS_Data_Slice_1_REGISTER_BLOCK__OFFS))+Var.VALUE(&__DDRSS_PHY_371__SFR_OFFS)))) %Long Var.VALUE(&__DDRSS1_PHY_371_DATA)
	Data.Set D:((((Var.VALUE(&__J7_DDR1_SS_BASE)+Var.VALUE(&__DDRSS_Data_Slice_1_REGISTER_BLOCK__OFFS))+Var.VALUE(&__DDRSS_PHY_372__SFR_OFFS)))) %Long Var.VALUE(&__DDRSS1_PHY_372_DATA)
	Data.Set D:((((Var.VALUE(&__J7_DDR1_SS_BASE)+Var.VALUE(&__DDRSS_Data_Slice_1_REGISTER_BLOCK__OFFS))+Var.VALUE(&__DDRSS_PHY_373__SFR_OFFS)))) %Long Var.VALUE(&__DDRSS1_PHY_373_DATA)
	Data.Set D:((((Var.VALUE(&__J7_DDR1_SS_BASE)+Var.VALUE(&__DDRSS_Data_Slice_1_REGISTER_BLOCK__OFFS))+Var.VALUE(&__DDRSS_PHY_374__SFR_OFFS)))) %Long Var.VALUE(&__DDRSS1_PHY_374_DATA)
	Data.Set D:((((Var.VALUE(&__J7_DDR1_SS_BASE)+Var.VALUE(&__DDRSS_Data_Slice_1_REGISTER_BLOCK__OFFS))+Var.VALUE(&__DDRSS_PHY_375__SFR_OFFS)))) %Long Var.VALUE(&__DDRSS1_PHY_375_DATA)
	Data.Set D:((((Var.VALUE(&__J7_DDR1_SS_BASE)+Var.VALUE(&__DDRSS_Data_Slice_1_REGISTER_BLOCK__OFFS))+Var.VALUE(&__DDRSS_PHY_376__SFR_OFFS)))) %Long Var.VALUE(&__DDRSS1_PHY_376_DATA)
	Data.Set D:((((Var.VALUE(&__J7_DDR1_SS_BASE)+Var.VALUE(&__DDRSS_Data_Slice_1_REGISTER_BLOCK__OFFS))+Var.VALUE(&__DDRSS_PHY_377__SFR_OFFS)))) %Long Var.VALUE(&__DDRSS1_PHY_377_DATA)
	Data.Set D:((((Var.VALUE(&__J7_DDR1_SS_BASE)+Var.VALUE(&__DDRSS_Data_Slice_1_REGISTER_BLOCK__OFFS))+Var.VALUE(&__DDRSS_PHY_378__SFR_OFFS)))) %Long Var.VALUE(&__DDRSS1_PHY_378_DATA)
	Data.Set D:((((Var.VALUE(&__J7_DDR1_SS_BASE)+Var.VALUE(&__DDRSS_Data_Slice_1_REGISTER_BLOCK__OFFS))+Var.VALUE(&__DDRSS_PHY_379__SFR_OFFS)))) %Long Var.VALUE(&__DDRSS1_PHY_379_DATA)
	Data.Set D:((((Var.VALUE(&__J7_DDR1_SS_BASE)+Var.VALUE(&__DDRSS_Data_Slice_1_REGISTER_BLOCK__OFFS))+Var.VALUE(&__DDRSS_PHY_380__SFR_OFFS)))) %Long Var.VALUE(&__DDRSS1_PHY_380_DATA)
	Data.Set D:((((Var.VALUE(&__J7_DDR1_SS_BASE)+Var.VALUE(&__DDRSS_Data_Slice_1_REGISTER_BLOCK__OFFS))+Var.VALUE(&__DDRSS_PHY_381__SFR_OFFS)))) %Long Var.VALUE(&__DDRSS1_PHY_381_DATA)
	Data.Set D:((((Var.VALUE(&__J7_DDR1_SS_BASE)+Var.VALUE(&__DDRSS_Data_Slice_1_REGISTER_BLOCK__OFFS))+Var.VALUE(&__DDRSS_PHY_382__SFR_OFFS)))) %Long Var.VALUE(&__DDRSS1_PHY_382_DATA)
	Data.Set D:((((Var.VALUE(&__J7_DDR1_SS_BASE)+Var.VALUE(&__DDRSS_Data_Slice_1_REGISTER_BLOCK__OFFS))+Var.VALUE(&__DDRSS_PHY_383__SFR_OFFS)))) %Long Var.VALUE(&__DDRSS1_PHY_383_DATA)
	Data.Set D:((((Var.VALUE(&__J7_DDR1_SS_BASE)+Var.VALUE(&__DDRSS_Data_Slice_1_REGISTER_BLOCK__OFFS))+Var.VALUE(&__DDRSS_PHY_384__SFR_OFFS)))) %Long Var.VALUE(&__DDRSS1_PHY_384_DATA)
	Data.Set D:((((Var.VALUE(&__J7_DDR1_SS_BASE)+Var.VALUE(&__DDRSS_Data_Slice_1_REGISTER_BLOCK__OFFS))+Var.VALUE(&__DDRSS_PHY_385__SFR_OFFS)))) %Long Var.VALUE(&__DDRSS1_PHY_385_DATA)
	Data.Set D:((((Var.VALUE(&__J7_DDR1_SS_BASE)+Var.VALUE(&__DDRSS_Data_Slice_1_REGISTER_BLOCK__OFFS))+Var.VALUE(&__DDRSS_PHY_386__SFR_OFFS)))) %Long Var.VALUE(&__DDRSS1_PHY_386_DATA)
	Data.Set D:((((Var.VALUE(&__J7_DDR1_SS_BASE)+Var.VALUE(&__DDRSS_Data_Slice_1_REGISTER_BLOCK__OFFS))+Var.VALUE(&__DDRSS_PHY_387__SFR_OFFS)))) %Long Var.VALUE(&__DDRSS1_PHY_387_DATA)
	Data.Set D:((((Var.VALUE(&__J7_DDR1_SS_BASE)+Var.VALUE(&__DDRSS_Data_Slice_1_REGISTER_BLOCK__OFFS))+Var.VALUE(&__DDRSS_PHY_388__SFR_OFFS)))) %Long Var.VALUE(&__DDRSS1_PHY_388_DATA)
	Data.Set D:((((Var.VALUE(&__J7_DDR1_SS_BASE)+Var.VALUE(&__DDRSS_Data_Slice_1_REGISTER_BLOCK__OFFS))+Var.VALUE(&__DDRSS_PHY_389__SFR_OFFS)))) %Long Var.VALUE(&__DDRSS1_PHY_389_DATA)
	Data.Set D:((((Var.VALUE(&__J7_DDR1_SS_BASE)+Var.VALUE(&__DDRSS_Data_Slice_1_REGISTER_BLOCK__OFFS))+Var.VALUE(&__DDRSS_PHY_390__SFR_OFFS)))) %Long Var.VALUE(&__DDRSS1_PHY_390_DATA)
	Data.Set D:((((Var.VALUE(&__J7_DDR1_SS_BASE)+Var.VALUE(&__DDRSS_Data_Slice_1_REGISTER_BLOCK__OFFS))+Var.VALUE(&__DDRSS_PHY_391__SFR_OFFS)))) %Long Var.VALUE(&__DDRSS1_PHY_391_DATA)
	Data.Set D:((((Var.VALUE(&__J7_DDR1_SS_BASE)+Var.VALUE(&__DDRSS_Data_Slice_1_REGISTER_BLOCK__OFFS))+Var.VALUE(&__DDRSS_PHY_392__SFR_OFFS)))) %Long Var.VALUE(&__DDRSS1_PHY_392_DATA)
	Data.Set D:((((Var.VALUE(&__J7_DDR1_SS_BASE)+Var.VALUE(&__DDRSS_Data_Slice_1_REGISTER_BLOCK__OFFS))+Var.VALUE(&__DDRSS_PHY_393__SFR_OFFS)))) %Long Var.VALUE(&__DDRSS1_PHY_393_DATA)
	Data.Set D:((((Var.VALUE(&__J7_DDR1_SS_BASE)+Var.VALUE(&__DDRSS_Data_Slice_1_REGISTER_BLOCK__OFFS))+Var.VALUE(&__DDRSS_PHY_394__SFR_OFFS)))) %Long Var.VALUE(&__DDRSS1_PHY_394_DATA)
	Data.Set D:((((Var.VALUE(&__J7_DDR1_SS_BASE)+Var.VALUE(&__DDRSS_Data_Slice_1_REGISTER_BLOCK__OFFS))+Var.VALUE(&__DDRSS_PHY_395__SFR_OFFS)))) %Long Var.VALUE(&__DDRSS1_PHY_395_DATA)
	Var.NEWLOCAL char[128] \strtmp = "--->>> DDR1 PHY Data Slice 1 programming completed... <<<---\n"
	GOSUB printf Var.String(\strtmp)
	
	Var.NEWLOCAL char[128] \strtmp = "--->>> DDR1 PHY Data Slice 2 programming in progress.. <<<---\n"
	GOSUB printf Var.String(\strtmp)
	
	Data.Set D:((((Var.VALUE(&__J7_DDR1_SS_BASE)+Var.VALUE(&__DDRSS_Data_Slice_2_REGISTER_BLOCK__OFFS))+Var.VALUE(&__DDRSS_PHY_512__SFR_OFFS)))) %Long Var.VALUE(&__DDRSS1_PHY_512_DATA)
	Data.Set D:((((Var.VALUE(&__J7_DDR1_SS_BASE)+Var.VALUE(&__DDRSS_Data_Slice_2_REGISTER_BLOCK__OFFS))+Var.VALUE(&__DDRSS_PHY_513__SFR_OFFS)))) %Long Var.VALUE(&__DDRSS1_PHY_513_DATA)
	Data.Set D:((((Var.VALUE(&__J7_DDR1_SS_BASE)+Var.VALUE(&__DDRSS_Data_Slice_2_REGISTER_BLOCK__OFFS))+Var.VALUE(&__DDRSS_PHY_514__SFR_OFFS)))) %Long Var.VALUE(&__DDRSS1_PHY_514_DATA)
	Data.Set D:((((Var.VALUE(&__J7_DDR1_SS_BASE)+Var.VALUE(&__DDRSS_Data_Slice_2_REGISTER_BLOCK__OFFS))+Var.VALUE(&__DDRSS_PHY_515__SFR_OFFS)))) %Long Var.VALUE(&__DDRSS1_PHY_515_DATA)
	Data.Set D:((((Var.VALUE(&__J7_DDR1_SS_BASE)+Var.VALUE(&__DDRSS_Data_Slice_2_REGISTER_BLOCK__OFFS))+Var.VALUE(&__DDRSS_PHY_516__SFR_OFFS)))) %Long Var.VALUE(&__DDRSS1_PHY_516_DATA)
	Data.Set D:((((Var.VALUE(&__J7_DDR1_SS_BASE)+Var.VALUE(&__DDRSS_Data_Slice_2_REGISTER_BLOCK__OFFS))+Var.VALUE(&__DDRSS_PHY_517__SFR_OFFS)))) %Long Var.VALUE(&__DDRSS1_PHY_517_DATA)
	Data.Set D:((((Var.VALUE(&__J7_DDR1_SS_BASE)+Var.VALUE(&__DDRSS_Data_Slice_2_REGISTER_BLOCK__OFFS))+Var.VALUE(&__DDRSS_PHY_518__SFR_OFFS)))) %Long Var.VALUE(&__DDRSS1_PHY_518_DATA)
	Data.Set D:((((Var.VALUE(&__J7_DDR1_SS_BASE)+Var.VALUE(&__DDRSS_Data_Slice_2_REGISTER_BLOCK__OFFS))+Var.VALUE(&__DDRSS_PHY_519__SFR_OFFS)))) %Long Var.VALUE(&__DDRSS1_PHY_519_DATA)
	Data.Set D:((((Var.VALUE(&__J7_DDR1_SS_BASE)+Var.VALUE(&__DDRSS_Data_Slice_2_REGISTER_BLOCK__OFFS))+Var.VALUE(&__DDRSS_PHY_520__SFR_OFFS)))) %Long Var.VALUE(&__DDRSS1_PHY_520_DATA)
	Data.Set D:((((Var.VALUE(&__J7_DDR1_SS_BASE)+Var.VALUE(&__DDRSS_Data_Slice_2_REGISTER_BLOCK__OFFS))+Var.VALUE(&__DDRSS_PHY_521__SFR_OFFS)))) %Long Var.VALUE(&__DDRSS1_PHY_521_DATA)
	Data.Set D:((((Var.VALUE(&__J7_DDR1_SS_BASE)+Var.VALUE(&__DDRSS_Data_Slice_2_REGISTER_BLOCK__OFFS))+Var.VALUE(&__DDRSS_PHY_522__SFR_OFFS)))) %Long Var.VALUE(&__DDRSS1_PHY_522_DATA)
	Data.Set D:((((Var.VALUE(&__J7_DDR1_SS_BASE)+Var.VALUE(&__DDRSS_Data_Slice_2_REGISTER_BLOCK__OFFS))+Var.VALUE(&__DDRSS_PHY_523__SFR_OFFS)))) %Long Var.VALUE(&__DDRSS1_PHY_523_DATA)
	Data.Set D:((((Var.VALUE(&__J7_DDR1_SS_BASE)+Var.VALUE(&__DDRSS_Data_Slice_2_REGISTER_BLOCK__OFFS))+Var.VALUE(&__DDRSS_PHY_524__SFR_OFFS)))) %Long Var.VALUE(&__DDRSS1_PHY_524_DATA)
	Data.Set D:((((Var.VALUE(&__J7_DDR1_SS_BASE)+Var.VALUE(&__DDRSS_Data_Slice_2_REGISTER_BLOCK__OFFS))+Var.VALUE(&__DDRSS_PHY_525__SFR_OFFS)))) %Long Var.VALUE(&__DDRSS1_PHY_525_DATA)
	Data.Set D:((((Var.VALUE(&__J7_DDR1_SS_BASE)+Var.VALUE(&__DDRSS_Data_Slice_2_REGISTER_BLOCK__OFFS))+Var.VALUE(&__DDRSS_PHY_526__SFR_OFFS)))) %Long Var.VALUE(&__DDRSS1_PHY_526_DATA)
	Data.Set D:((((Var.VALUE(&__J7_DDR1_SS_BASE)+Var.VALUE(&__DDRSS_Data_Slice_2_REGISTER_BLOCK__OFFS))+Var.VALUE(&__DDRSS_PHY_527__SFR_OFFS)))) %Long Var.VALUE(&__DDRSS1_PHY_527_DATA)
	Data.Set D:((((Var.VALUE(&__J7_DDR1_SS_BASE)+Var.VALUE(&__DDRSS_Data_Slice_2_REGISTER_BLOCK__OFFS))+Var.VALUE(&__DDRSS_PHY_528__SFR_OFFS)))) %Long Var.VALUE(&__DDRSS1_PHY_528_DATA)
	Data.Set D:((((Var.VALUE(&__J7_DDR1_SS_BASE)+Var.VALUE(&__DDRSS_Data_Slice_2_REGISTER_BLOCK__OFFS))+Var.VALUE(&__DDRSS_PHY_529__SFR_OFFS)))) %Long Var.VALUE(&__DDRSS1_PHY_529_DATA)
	Data.Set D:((((Var.VALUE(&__J7_DDR1_SS_BASE)+Var.VALUE(&__DDRSS_Data_Slice_2_REGISTER_BLOCK__OFFS))+Var.VALUE(&__DDRSS_PHY_530__SFR_OFFS)))) %Long Var.VALUE(&__DDRSS1_PHY_530_DATA)
	Data.Set D:((((Var.VALUE(&__J7_DDR1_SS_BASE)+Var.VALUE(&__DDRSS_Data_Slice_2_REGISTER_BLOCK__OFFS))+Var.VALUE(&__DDRSS_PHY_531__SFR_OFFS)))) %Long Var.VALUE(&__DDRSS1_PHY_531_DATA)
	Data.Set D:((((Var.VALUE(&__J7_DDR1_SS_BASE)+Var.VALUE(&__DDRSS_Data_Slice_2_REGISTER_BLOCK__OFFS))+Var.VALUE(&__DDRSS_PHY_532__SFR_OFFS)))) %Long Var.VALUE(&__DDRSS1_PHY_532_DATA)
	Data.Set D:((((Var.VALUE(&__J7_DDR1_SS_BASE)+Var.VALUE(&__DDRSS_Data_Slice_2_REGISTER_BLOCK__OFFS))+Var.VALUE(&__DDRSS_PHY_533__SFR_OFFS)))) %Long Var.VALUE(&__DDRSS1_PHY_533_DATA)
	Data.Set D:((((Var.VALUE(&__J7_DDR1_SS_BASE)+Var.VALUE(&__DDRSS_Data_Slice_2_REGISTER_BLOCK__OFFS))+Var.VALUE(&__DDRSS_PHY_534__SFR_OFFS)))) %Long Var.VALUE(&__DDRSS1_PHY_534_DATA)
	Data.Set D:((((Var.VALUE(&__J7_DDR1_SS_BASE)+Var.VALUE(&__DDRSS_Data_Slice_2_REGISTER_BLOCK__OFFS))+Var.VALUE(&__DDRSS_PHY_535__SFR_OFFS)))) %Long Var.VALUE(&__DDRSS1_PHY_535_DATA)
	Data.Set D:((((Var.VALUE(&__J7_DDR1_SS_BASE)+Var.VALUE(&__DDRSS_Data_Slice_2_REGISTER_BLOCK__OFFS))+Var.VALUE(&__DDRSS_PHY_536__SFR_OFFS)))) %Long Var.VALUE(&__DDRSS1_PHY_536_DATA)
	Data.Set D:((((Var.VALUE(&__J7_DDR1_SS_BASE)+Var.VALUE(&__DDRSS_Data_Slice_2_REGISTER_BLOCK__OFFS))+Var.VALUE(&__DDRSS_PHY_537__SFR_OFFS)))) %Long Var.VALUE(&__DDRSS1_PHY_537_DATA)
	Data.Set D:((((Var.VALUE(&__J7_DDR1_SS_BASE)+Var.VALUE(&__DDRSS_Data_Slice_2_REGISTER_BLOCK__OFFS))+Var.VALUE(&__DDRSS_PHY_538__SFR_OFFS)))) %Long Var.VALUE(&__DDRSS1_PHY_538_DATA)
	Data.Set D:((((Var.VALUE(&__J7_DDR1_SS_BASE)+Var.VALUE(&__DDRSS_Data_Slice_2_REGISTER_BLOCK__OFFS))+Var.VALUE(&__DDRSS_PHY_539__SFR_OFFS)))) %Long Var.VALUE(&__DDRSS1_PHY_539_DATA)
	Data.Set D:((((Var.VALUE(&__J7_DDR1_SS_BASE)+Var.VALUE(&__DDRSS_Data_Slice_2_REGISTER_BLOCK__OFFS))+Var.VALUE(&__DDRSS_PHY_540__SFR_OFFS)))) %Long Var.VALUE(&__DDRSS1_PHY_540_DATA)
	Data.Set D:((((Var.VALUE(&__J7_DDR1_SS_BASE)+Var.VALUE(&__DDRSS_Data_Slice_2_REGISTER_BLOCK__OFFS))+Var.VALUE(&__DDRSS_PHY_541__SFR_OFFS)))) %Long Var.VALUE(&__DDRSS1_PHY_541_DATA)
	Data.Set D:((((Var.VALUE(&__J7_DDR1_SS_BASE)+Var.VALUE(&__DDRSS_Data_Slice_2_REGISTER_BLOCK__OFFS))+Var.VALUE(&__DDRSS_PHY_542__SFR_OFFS)))) %Long Var.VALUE(&__DDRSS1_PHY_542_DATA)
	Data.Set D:((((Var.VALUE(&__J7_DDR1_SS_BASE)+Var.VALUE(&__DDRSS_Data_Slice_2_REGISTER_BLOCK__OFFS))+Var.VALUE(&__DDRSS_PHY_543__SFR_OFFS)))) %Long Var.VALUE(&__DDRSS1_PHY_543_DATA)
	Data.Set D:((((Var.VALUE(&__J7_DDR1_SS_BASE)+Var.VALUE(&__DDRSS_Data_Slice_2_REGISTER_BLOCK__OFFS))+Var.VALUE(&__DDRSS_PHY_544__SFR_OFFS)))) %Long Var.VALUE(&__DDRSS1_PHY_544_DATA)
	Data.Set D:((((Var.VALUE(&__J7_DDR1_SS_BASE)+Var.VALUE(&__DDRSS_Data_Slice_2_REGISTER_BLOCK__OFFS))+Var.VALUE(&__DDRSS_PHY_545__SFR_OFFS)))) %Long Var.VALUE(&__DDRSS1_PHY_545_DATA)
	Data.Set D:((((Var.VALUE(&__J7_DDR1_SS_BASE)+Var.VALUE(&__DDRSS_Data_Slice_2_REGISTER_BLOCK__OFFS))+Var.VALUE(&__DDRSS_PHY_546__SFR_OFFS)))) %Long Var.VALUE(&__DDRSS1_PHY_546_DATA)
	Data.Set D:((((Var.VALUE(&__J7_DDR1_SS_BASE)+Var.VALUE(&__DDRSS_Data_Slice_2_REGISTER_BLOCK__OFFS))+Var.VALUE(&__DDRSS_PHY_547__SFR_OFFS)))) %Long Var.VALUE(&__DDRSS1_PHY_547_DATA)
	Data.Set D:((((Var.VALUE(&__J7_DDR1_SS_BASE)+Var.VALUE(&__DDRSS_Data_Slice_2_REGISTER_BLOCK__OFFS))+Var.VALUE(&__DDRSS_PHY_548__SFR_OFFS)))) %Long Var.VALUE(&__DDRSS1_PHY_548_DATA)
	Data.Set D:((((Var.VALUE(&__J7_DDR1_SS_BASE)+Var.VALUE(&__DDRSS_Data_Slice_2_REGISTER_BLOCK__OFFS))+Var.VALUE(&__DDRSS_PHY_549__SFR_OFFS)))) %Long Var.VALUE(&__DDRSS1_PHY_549_DATA)
	Data.Set D:((((Var.VALUE(&__J7_DDR1_SS_BASE)+Var.VALUE(&__DDRSS_Data_Slice_2_REGISTER_BLOCK__OFFS))+Var.VALUE(&__DDRSS_PHY_550__SFR_OFFS)))) %Long Var.VALUE(&__DDRSS1_PHY_550_DATA)
	Data.Set D:((((Var.VALUE(&__J7_DDR1_SS_BASE)+Var.VALUE(&__DDRSS_Data_Slice_2_REGISTER_BLOCK__OFFS))+Var.VALUE(&__DDRSS_PHY_551__SFR_OFFS)))) %Long Var.VALUE(&__DDRSS1_PHY_551_DATA)
	Data.Set D:((((Var.VALUE(&__J7_DDR1_SS_BASE)+Var.VALUE(&__DDRSS_Data_Slice_2_REGISTER_BLOCK__OFFS))+Var.VALUE(&__DDRSS_PHY_552__SFR_OFFS)))) %Long Var.VALUE(&__DDRSS1_PHY_552_DATA)
	Data.Set D:((((Var.VALUE(&__J7_DDR1_SS_BASE)+Var.VALUE(&__DDRSS_Data_Slice_2_REGISTER_BLOCK__OFFS))+Var.VALUE(&__DDRSS_PHY_553__SFR_OFFS)))) %Long Var.VALUE(&__DDRSS1_PHY_553_DATA)
	Data.Set D:((((Var.VALUE(&__J7_DDR1_SS_BASE)+Var.VALUE(&__DDRSS_Data_Slice_2_REGISTER_BLOCK__OFFS))+Var.VALUE(&__DDRSS_PHY_554__SFR_OFFS)))) %Long Var.VALUE(&__DDRSS1_PHY_554_DATA)
	Data.Set D:((((Var.VALUE(&__J7_DDR1_SS_BASE)+Var.VALUE(&__DDRSS_Data_Slice_2_REGISTER_BLOCK__OFFS))+Var.VALUE(&__DDRSS_PHY_555__SFR_OFFS)))) %Long Var.VALUE(&__DDRSS1_PHY_555_DATA)
	Data.Set D:((((Var.VALUE(&__J7_DDR1_SS_BASE)+Var.VALUE(&__DDRSS_Data_Slice_2_REGISTER_BLOCK__OFFS))+Var.VALUE(&__DDRSS_PHY_556__SFR_OFFS)))) %Long Var.VALUE(&__DDRSS1_PHY_556_DATA)
	Data.Set D:((((Var.VALUE(&__J7_DDR1_SS_BASE)+Var.VALUE(&__DDRSS_Data_Slice_2_REGISTER_BLOCK__OFFS))+Var.VALUE(&__DDRSS_PHY_557__SFR_OFFS)))) %Long Var.VALUE(&__DDRSS1_PHY_557_DATA)
	Data.Set D:((((Var.VALUE(&__J7_DDR1_SS_BASE)+Var.VALUE(&__DDRSS_Data_Slice_2_REGISTER_BLOCK__OFFS))+Var.VALUE(&__DDRSS_PHY_558__SFR_OFFS)))) %Long Var.VALUE(&__DDRSS1_PHY_558_DATA)
	Data.Set D:((((Var.VALUE(&__J7_DDR1_SS_BASE)+Var.VALUE(&__DDRSS_Data_Slice_2_REGISTER_BLOCK__OFFS))+Var.VALUE(&__DDRSS_PHY_559__SFR_OFFS)))) %Long Var.VALUE(&__DDRSS1_PHY_559_DATA)
	Data.Set D:((((Var.VALUE(&__J7_DDR1_SS_BASE)+Var.VALUE(&__DDRSS_Data_Slice_2_REGISTER_BLOCK__OFFS))+Var.VALUE(&__DDRSS_PHY_560__SFR_OFFS)))) %Long Var.VALUE(&__DDRSS1_PHY_560_DATA)
	Data.Set D:((((Var.VALUE(&__J7_DDR1_SS_BASE)+Var.VALUE(&__DDRSS_Data_Slice_2_REGISTER_BLOCK__OFFS))+Var.VALUE(&__DDRSS_PHY_561__SFR_OFFS)))) %Long Var.VALUE(&__DDRSS1_PHY_561_DATA)
	Data.Set D:((((Var.VALUE(&__J7_DDR1_SS_BASE)+Var.VALUE(&__DDRSS_Data_Slice_2_REGISTER_BLOCK__OFFS))+Var.VALUE(&__DDRSS_PHY_562__SFR_OFFS)))) %Long Var.VALUE(&__DDRSS1_PHY_562_DATA)
	Data.Set D:((((Var.VALUE(&__J7_DDR1_SS_BASE)+Var.VALUE(&__DDRSS_Data_Slice_2_REGISTER_BLOCK__OFFS))+Var.VALUE(&__DDRSS_PHY_563__SFR_OFFS)))) %Long Var.VALUE(&__DDRSS1_PHY_563_DATA)
	Data.Set D:((((Var.VALUE(&__J7_DDR1_SS_BASE)+Var.VALUE(&__DDRSS_Data_Slice_2_REGISTER_BLOCK__OFFS))+Var.VALUE(&__DDRSS_PHY_564__SFR_OFFS)))) %Long Var.VALUE(&__DDRSS1_PHY_564_DATA)
	Data.Set D:((((Var.VALUE(&__J7_DDR1_SS_BASE)+Var.VALUE(&__DDRSS_Data_Slice_2_REGISTER_BLOCK__OFFS))+Var.VALUE(&__DDRSS_PHY_565__SFR_OFFS)))) %Long Var.VALUE(&__DDRSS1_PHY_565_DATA)
	Data.Set D:((((Var.VALUE(&__J7_DDR1_SS_BASE)+Var.VALUE(&__DDRSS_Data_Slice_2_REGISTER_BLOCK__OFFS))+Var.VALUE(&__DDRSS_PHY_566__SFR_OFFS)))) %Long Var.VALUE(&__DDRSS1_PHY_566_DATA)
	Data.Set D:((((Var.VALUE(&__J7_DDR1_SS_BASE)+Var.VALUE(&__DDRSS_Data_Slice_2_REGISTER_BLOCK__OFFS))+Var.VALUE(&__DDRSS_PHY_567__SFR_OFFS)))) %Long Var.VALUE(&__DDRSS1_PHY_567_DATA)
	Data.Set D:((((Var.VALUE(&__J7_DDR1_SS_BASE)+Var.VALUE(&__DDRSS_Data_Slice_2_REGISTER_BLOCK__OFFS))+Var.VALUE(&__DDRSS_PHY_568__SFR_OFFS)))) %Long Var.VALUE(&__DDRSS1_PHY_568_DATA)
	Data.Set D:((((Var.VALUE(&__J7_DDR1_SS_BASE)+Var.VALUE(&__DDRSS_Data_Slice_2_REGISTER_BLOCK__OFFS))+Var.VALUE(&__DDRSS_PHY_569__SFR_OFFS)))) %Long Var.VALUE(&__DDRSS1_PHY_569_DATA)
	Data.Set D:((((Var.VALUE(&__J7_DDR1_SS_BASE)+Var.VALUE(&__DDRSS_Data_Slice_2_REGISTER_BLOCK__OFFS))+Var.VALUE(&__DDRSS_PHY_570__SFR_OFFS)))) %Long Var.VALUE(&__DDRSS1_PHY_570_DATA)
	Data.Set D:((((Var.VALUE(&__J7_DDR1_SS_BASE)+Var.VALUE(&__DDRSS_Data_Slice_2_REGISTER_BLOCK__OFFS))+Var.VALUE(&__DDRSS_PHY_571__SFR_OFFS)))) %Long Var.VALUE(&__DDRSS1_PHY_571_DATA)
	Data.Set D:((((Var.VALUE(&__J7_DDR1_SS_BASE)+Var.VALUE(&__DDRSS_Data_Slice_2_REGISTER_BLOCK__OFFS))+Var.VALUE(&__DDRSS_PHY_572__SFR_OFFS)))) %Long Var.VALUE(&__DDRSS1_PHY_572_DATA)
	Data.Set D:((((Var.VALUE(&__J7_DDR1_SS_BASE)+Var.VALUE(&__DDRSS_Data_Slice_2_REGISTER_BLOCK__OFFS))+Var.VALUE(&__DDRSS_PHY_573__SFR_OFFS)))) %Long Var.VALUE(&__DDRSS1_PHY_573_DATA)
	Data.Set D:((((Var.VALUE(&__J7_DDR1_SS_BASE)+Var.VALUE(&__DDRSS_Data_Slice_2_REGISTER_BLOCK__OFFS))+Var.VALUE(&__DDRSS_PHY_574__SFR_OFFS)))) %Long Var.VALUE(&__DDRSS1_PHY_574_DATA)
	Data.Set D:((((Var.VALUE(&__J7_DDR1_SS_BASE)+Var.VALUE(&__DDRSS_Data_Slice_2_REGISTER_BLOCK__OFFS))+Var.VALUE(&__DDRSS_PHY_575__SFR_OFFS)))) %Long Var.VALUE(&__DDRSS1_PHY_575_DATA)
	Data.Set D:((((Var.VALUE(&__J7_DDR1_SS_BASE)+Var.VALUE(&__DDRSS_Data_Slice_2_REGISTER_BLOCK__OFFS))+Var.VALUE(&__DDRSS_PHY_576__SFR_OFFS)))) %Long Var.VALUE(&__DDRSS1_PHY_576_DATA)
	Data.Set D:((((Var.VALUE(&__J7_DDR1_SS_BASE)+Var.VALUE(&__DDRSS_Data_Slice_2_REGISTER_BLOCK__OFFS))+Var.VALUE(&__DDRSS_PHY_577__SFR_OFFS)))) %Long Var.VALUE(&__DDRSS1_PHY_577_DATA)
	Data.Set D:((((Var.VALUE(&__J7_DDR1_SS_BASE)+Var.VALUE(&__DDRSS_Data_Slice_2_REGISTER_BLOCK__OFFS))+Var.VALUE(&__DDRSS_PHY_578__SFR_OFFS)))) %Long Var.VALUE(&__DDRSS1_PHY_578_DATA)
	Data.Set D:((((Var.VALUE(&__J7_DDR1_SS_BASE)+Var.VALUE(&__DDRSS_Data_Slice_2_REGISTER_BLOCK__OFFS))+Var.VALUE(&__DDRSS_PHY_579__SFR_OFFS)))) %Long Var.VALUE(&__DDRSS1_PHY_579_DATA)
	Data.Set D:((((Var.VALUE(&__J7_DDR1_SS_BASE)+Var.VALUE(&__DDRSS_Data_Slice_2_REGISTER_BLOCK__OFFS))+Var.VALUE(&__DDRSS_PHY_580__SFR_OFFS)))) %Long Var.VALUE(&__DDRSS1_PHY_580_DATA)
	Data.Set D:((((Var.VALUE(&__J7_DDR1_SS_BASE)+Var.VALUE(&__DDRSS_Data_Slice_2_REGISTER_BLOCK__OFFS))+Var.VALUE(&__DDRSS_PHY_581__SFR_OFFS)))) %Long Var.VALUE(&__DDRSS1_PHY_581_DATA)
	Data.Set D:((((Var.VALUE(&__J7_DDR1_SS_BASE)+Var.VALUE(&__DDRSS_Data_Slice_2_REGISTER_BLOCK__OFFS))+Var.VALUE(&__DDRSS_PHY_582__SFR_OFFS)))) %Long Var.VALUE(&__DDRSS1_PHY_582_DATA)
	Data.Set D:((((Var.VALUE(&__J7_DDR1_SS_BASE)+Var.VALUE(&__DDRSS_Data_Slice_2_REGISTER_BLOCK__OFFS))+Var.VALUE(&__DDRSS_PHY_583__SFR_OFFS)))) %Long Var.VALUE(&__DDRSS1_PHY_583_DATA)
	Data.Set D:((((Var.VALUE(&__J7_DDR1_SS_BASE)+Var.VALUE(&__DDRSS_Data_Slice_2_REGISTER_BLOCK__OFFS))+Var.VALUE(&__DDRSS_PHY_584__SFR_OFFS)))) %Long Var.VALUE(&__DDRSS1_PHY_584_DATA)
	Data.Set D:((((Var.VALUE(&__J7_DDR1_SS_BASE)+Var.VALUE(&__DDRSS_Data_Slice_2_REGISTER_BLOCK__OFFS))+Var.VALUE(&__DDRSS_PHY_585__SFR_OFFS)))) %Long Var.VALUE(&__DDRSS1_PHY_585_DATA)
	Data.Set D:((((Var.VALUE(&__J7_DDR1_SS_BASE)+Var.VALUE(&__DDRSS_Data_Slice_2_REGISTER_BLOCK__OFFS))+Var.VALUE(&__DDRSS_PHY_586__SFR_OFFS)))) %Long Var.VALUE(&__DDRSS1_PHY_586_DATA)
	Data.Set D:((((Var.VALUE(&__J7_DDR1_SS_BASE)+Var.VALUE(&__DDRSS_Data_Slice_2_REGISTER_BLOCK__OFFS))+Var.VALUE(&__DDRSS_PHY_587__SFR_OFFS)))) %Long Var.VALUE(&__DDRSS1_PHY_587_DATA)
	Data.Set D:((((Var.VALUE(&__J7_DDR1_SS_BASE)+Var.VALUE(&__DDRSS_Data_Slice_2_REGISTER_BLOCK__OFFS))+Var.VALUE(&__DDRSS_PHY_588__SFR_OFFS)))) %Long Var.VALUE(&__DDRSS1_PHY_588_DATA)
	Data.Set D:((((Var.VALUE(&__J7_DDR1_SS_BASE)+Var.VALUE(&__DDRSS_Data_Slice_2_REGISTER_BLOCK__OFFS))+Var.VALUE(&__DDRSS_PHY_589__SFR_OFFS)))) %Long Var.VALUE(&__DDRSS1_PHY_589_DATA)
	Data.Set D:((((Var.VALUE(&__J7_DDR1_SS_BASE)+Var.VALUE(&__DDRSS_Data_Slice_2_REGISTER_BLOCK__OFFS))+Var.VALUE(&__DDRSS_PHY_590__SFR_OFFS)))) %Long Var.VALUE(&__DDRSS1_PHY_590_DATA)
	Data.Set D:((((Var.VALUE(&__J7_DDR1_SS_BASE)+Var.VALUE(&__DDRSS_Data_Slice_2_REGISTER_BLOCK__OFFS))+Var.VALUE(&__DDRSS_PHY_591__SFR_OFFS)))) %Long Var.VALUE(&__DDRSS1_PHY_591_DATA)
	Data.Set D:((((Var.VALUE(&__J7_DDR1_SS_BASE)+Var.VALUE(&__DDRSS_Data_Slice_2_REGISTER_BLOCK__OFFS))+Var.VALUE(&__DDRSS_PHY_592__SFR_OFFS)))) %Long Var.VALUE(&__DDRSS1_PHY_592_DATA)
	Data.Set D:((((Var.VALUE(&__J7_DDR1_SS_BASE)+Var.VALUE(&__DDRSS_Data_Slice_2_REGISTER_BLOCK__OFFS))+Var.VALUE(&__DDRSS_PHY_593__SFR_OFFS)))) %Long Var.VALUE(&__DDRSS1_PHY_593_DATA)
	Data.Set D:((((Var.VALUE(&__J7_DDR1_SS_BASE)+Var.VALUE(&__DDRSS_Data_Slice_2_REGISTER_BLOCK__OFFS))+Var.VALUE(&__DDRSS_PHY_594__SFR_OFFS)))) %Long Var.VALUE(&__DDRSS1_PHY_594_DATA)
	Data.Set D:((((Var.VALUE(&__J7_DDR1_SS_BASE)+Var.VALUE(&__DDRSS_Data_Slice_2_REGISTER_BLOCK__OFFS))+Var.VALUE(&__DDRSS_PHY_595__SFR_OFFS)))) %Long Var.VALUE(&__DDRSS1_PHY_595_DATA)
	Data.Set D:((((Var.VALUE(&__J7_DDR1_SS_BASE)+Var.VALUE(&__DDRSS_Data_Slice_2_REGISTER_BLOCK__OFFS))+Var.VALUE(&__DDRSS_PHY_596__SFR_OFFS)))) %Long Var.VALUE(&__DDRSS1_PHY_596_DATA)
	Data.Set D:((((Var.VALUE(&__J7_DDR1_SS_BASE)+Var.VALUE(&__DDRSS_Data_Slice_2_REGISTER_BLOCK__OFFS))+Var.VALUE(&__DDRSS_PHY_597__SFR_OFFS)))) %Long Var.VALUE(&__DDRSS1_PHY_597_DATA)
	Data.Set D:((((Var.VALUE(&__J7_DDR1_SS_BASE)+Var.VALUE(&__DDRSS_Data_Slice_2_REGISTER_BLOCK__OFFS))+Var.VALUE(&__DDRSS_PHY_598__SFR_OFFS)))) %Long Var.VALUE(&__DDRSS1_PHY_598_DATA)
	Data.Set D:((((Var.VALUE(&__J7_DDR1_SS_BASE)+Var.VALUE(&__DDRSS_Data_Slice_2_REGISTER_BLOCK__OFFS))+Var.VALUE(&__DDRSS_PHY_599__SFR_OFFS)))) %Long Var.VALUE(&__DDRSS1_PHY_599_DATA)
	Data.Set D:((((Var.VALUE(&__J7_DDR1_SS_BASE)+Var.VALUE(&__DDRSS_Data_Slice_2_REGISTER_BLOCK__OFFS))+Var.VALUE(&__DDRSS_PHY_600__SFR_OFFS)))) %Long Var.VALUE(&__DDRSS1_PHY_600_DATA)
	Data.Set D:((((Var.VALUE(&__J7_DDR1_SS_BASE)+Var.VALUE(&__DDRSS_Data_Slice_2_REGISTER_BLOCK__OFFS))+Var.VALUE(&__DDRSS_PHY_601__SFR_OFFS)))) %Long Var.VALUE(&__DDRSS1_PHY_601_DATA)
	Data.Set D:((((Var.VALUE(&__J7_DDR1_SS_BASE)+Var.VALUE(&__DDRSS_Data_Slice_2_REGISTER_BLOCK__OFFS))+Var.VALUE(&__DDRSS_PHY_602__SFR_OFFS)))) %Long Var.VALUE(&__DDRSS1_PHY_602_DATA)
	Data.Set D:((((Var.VALUE(&__J7_DDR1_SS_BASE)+Var.VALUE(&__DDRSS_Data_Slice_2_REGISTER_BLOCK__OFFS))+Var.VALUE(&__DDRSS_PHY_603__SFR_OFFS)))) %Long Var.VALUE(&__DDRSS1_PHY_603_DATA)
	Data.Set D:((((Var.VALUE(&__J7_DDR1_SS_BASE)+Var.VALUE(&__DDRSS_Data_Slice_2_REGISTER_BLOCK__OFFS))+Var.VALUE(&__DDRSS_PHY_604__SFR_OFFS)))) %Long Var.VALUE(&__DDRSS1_PHY_604_DATA)
	Data.Set D:((((Var.VALUE(&__J7_DDR1_SS_BASE)+Var.VALUE(&__DDRSS_Data_Slice_2_REGISTER_BLOCK__OFFS))+Var.VALUE(&__DDRSS_PHY_605__SFR_OFFS)))) %Long Var.VALUE(&__DDRSS1_PHY_605_DATA)
	Data.Set D:((((Var.VALUE(&__J7_DDR1_SS_BASE)+Var.VALUE(&__DDRSS_Data_Slice_2_REGISTER_BLOCK__OFFS))+Var.VALUE(&__DDRSS_PHY_606__SFR_OFFS)))) %Long Var.VALUE(&__DDRSS1_PHY_606_DATA)
	Data.Set D:((((Var.VALUE(&__J7_DDR1_SS_BASE)+Var.VALUE(&__DDRSS_Data_Slice_2_REGISTER_BLOCK__OFFS))+Var.VALUE(&__DDRSS_PHY_607__SFR_OFFS)))) %Long Var.VALUE(&__DDRSS1_PHY_607_DATA)
	Data.Set D:((((Var.VALUE(&__J7_DDR1_SS_BASE)+Var.VALUE(&__DDRSS_Data_Slice_2_REGISTER_BLOCK__OFFS))+Var.VALUE(&__DDRSS_PHY_608__SFR_OFFS)))) %Long Var.VALUE(&__DDRSS1_PHY_608_DATA)
	Data.Set D:((((Var.VALUE(&__J7_DDR1_SS_BASE)+Var.VALUE(&__DDRSS_Data_Slice_2_REGISTER_BLOCK__OFFS))+Var.VALUE(&__DDRSS_PHY_609__SFR_OFFS)))) %Long Var.VALUE(&__DDRSS1_PHY_609_DATA)
	Data.Set D:((((Var.VALUE(&__J7_DDR1_SS_BASE)+Var.VALUE(&__DDRSS_Data_Slice_2_REGISTER_BLOCK__OFFS))+Var.VALUE(&__DDRSS_PHY_610__SFR_OFFS)))) %Long Var.VALUE(&__DDRSS1_PHY_610_DATA)
	Data.Set D:((((Var.VALUE(&__J7_DDR1_SS_BASE)+Var.VALUE(&__DDRSS_Data_Slice_2_REGISTER_BLOCK__OFFS))+Var.VALUE(&__DDRSS_PHY_611__SFR_OFFS)))) %Long Var.VALUE(&__DDRSS1_PHY_611_DATA)
	Data.Set D:((((Var.VALUE(&__J7_DDR1_SS_BASE)+Var.VALUE(&__DDRSS_Data_Slice_2_REGISTER_BLOCK__OFFS))+Var.VALUE(&__DDRSS_PHY_612__SFR_OFFS)))) %Long Var.VALUE(&__DDRSS1_PHY_612_DATA)
	Data.Set D:((((Var.VALUE(&__J7_DDR1_SS_BASE)+Var.VALUE(&__DDRSS_Data_Slice_2_REGISTER_BLOCK__OFFS))+Var.VALUE(&__DDRSS_PHY_613__SFR_OFFS)))) %Long Var.VALUE(&__DDRSS1_PHY_613_DATA)
	Data.Set D:((((Var.VALUE(&__J7_DDR1_SS_BASE)+Var.VALUE(&__DDRSS_Data_Slice_2_REGISTER_BLOCK__OFFS))+Var.VALUE(&__DDRSS_PHY_614__SFR_OFFS)))) %Long Var.VALUE(&__DDRSS1_PHY_614_DATA)
	Data.Set D:((((Var.VALUE(&__J7_DDR1_SS_BASE)+Var.VALUE(&__DDRSS_Data_Slice_2_REGISTER_BLOCK__OFFS))+Var.VALUE(&__DDRSS_PHY_615__SFR_OFFS)))) %Long Var.VALUE(&__DDRSS1_PHY_615_DATA)
	Data.Set D:((((Var.VALUE(&__J7_DDR1_SS_BASE)+Var.VALUE(&__DDRSS_Data_Slice_2_REGISTER_BLOCK__OFFS))+Var.VALUE(&__DDRSS_PHY_616__SFR_OFFS)))) %Long Var.VALUE(&__DDRSS1_PHY_616_DATA)
	Data.Set D:((((Var.VALUE(&__J7_DDR1_SS_BASE)+Var.VALUE(&__DDRSS_Data_Slice_2_REGISTER_BLOCK__OFFS))+Var.VALUE(&__DDRSS_PHY_617__SFR_OFFS)))) %Long Var.VALUE(&__DDRSS1_PHY_617_DATA)
	Data.Set D:((((Var.VALUE(&__J7_DDR1_SS_BASE)+Var.VALUE(&__DDRSS_Data_Slice_2_REGISTER_BLOCK__OFFS))+Var.VALUE(&__DDRSS_PHY_618__SFR_OFFS)))) %Long Var.VALUE(&__DDRSS1_PHY_618_DATA)
	Data.Set D:((((Var.VALUE(&__J7_DDR1_SS_BASE)+Var.VALUE(&__DDRSS_Data_Slice_2_REGISTER_BLOCK__OFFS))+Var.VALUE(&__DDRSS_PHY_619__SFR_OFFS)))) %Long Var.VALUE(&__DDRSS1_PHY_619_DATA)
	Data.Set D:((((Var.VALUE(&__J7_DDR1_SS_BASE)+Var.VALUE(&__DDRSS_Data_Slice_2_REGISTER_BLOCK__OFFS))+Var.VALUE(&__DDRSS_PHY_620__SFR_OFFS)))) %Long Var.VALUE(&__DDRSS1_PHY_620_DATA)
	Data.Set D:((((Var.VALUE(&__J7_DDR1_SS_BASE)+Var.VALUE(&__DDRSS_Data_Slice_2_REGISTER_BLOCK__OFFS))+Var.VALUE(&__DDRSS_PHY_621__SFR_OFFS)))) %Long Var.VALUE(&__DDRSS1_PHY_621_DATA)
	Data.Set D:((((Var.VALUE(&__J7_DDR1_SS_BASE)+Var.VALUE(&__DDRSS_Data_Slice_2_REGISTER_BLOCK__OFFS))+Var.VALUE(&__DDRSS_PHY_622__SFR_OFFS)))) %Long Var.VALUE(&__DDRSS1_PHY_622_DATA)
	Data.Set D:((((Var.VALUE(&__J7_DDR1_SS_BASE)+Var.VALUE(&__DDRSS_Data_Slice_2_REGISTER_BLOCK__OFFS))+Var.VALUE(&__DDRSS_PHY_623__SFR_OFFS)))) %Long Var.VALUE(&__DDRSS1_PHY_623_DATA)
	Data.Set D:((((Var.VALUE(&__J7_DDR1_SS_BASE)+Var.VALUE(&__DDRSS_Data_Slice_2_REGISTER_BLOCK__OFFS))+Var.VALUE(&__DDRSS_PHY_624__SFR_OFFS)))) %Long Var.VALUE(&__DDRSS1_PHY_624_DATA)
	Data.Set D:((((Var.VALUE(&__J7_DDR1_SS_BASE)+Var.VALUE(&__DDRSS_Data_Slice_2_REGISTER_BLOCK__OFFS))+Var.VALUE(&__DDRSS_PHY_625__SFR_OFFS)))) %Long Var.VALUE(&__DDRSS1_PHY_625_DATA)
	Data.Set D:((((Var.VALUE(&__J7_DDR1_SS_BASE)+Var.VALUE(&__DDRSS_Data_Slice_2_REGISTER_BLOCK__OFFS))+Var.VALUE(&__DDRSS_PHY_626__SFR_OFFS)))) %Long Var.VALUE(&__DDRSS1_PHY_626_DATA)
	Data.Set D:((((Var.VALUE(&__J7_DDR1_SS_BASE)+Var.VALUE(&__DDRSS_Data_Slice_2_REGISTER_BLOCK__OFFS))+Var.VALUE(&__DDRSS_PHY_627__SFR_OFFS)))) %Long Var.VALUE(&__DDRSS1_PHY_627_DATA)
	Data.Set D:((((Var.VALUE(&__J7_DDR1_SS_BASE)+Var.VALUE(&__DDRSS_Data_Slice_2_REGISTER_BLOCK__OFFS))+Var.VALUE(&__DDRSS_PHY_628__SFR_OFFS)))) %Long Var.VALUE(&__DDRSS1_PHY_628_DATA)
	Data.Set D:((((Var.VALUE(&__J7_DDR1_SS_BASE)+Var.VALUE(&__DDRSS_Data_Slice_2_REGISTER_BLOCK__OFFS))+Var.VALUE(&__DDRSS_PHY_629__SFR_OFFS)))) %Long Var.VALUE(&__DDRSS1_PHY_629_DATA)
	Data.Set D:((((Var.VALUE(&__J7_DDR1_SS_BASE)+Var.VALUE(&__DDRSS_Data_Slice_2_REGISTER_BLOCK__OFFS))+Var.VALUE(&__DDRSS_PHY_630__SFR_OFFS)))) %Long Var.VALUE(&__DDRSS1_PHY_630_DATA)
	Data.Set D:((((Var.VALUE(&__J7_DDR1_SS_BASE)+Var.VALUE(&__DDRSS_Data_Slice_2_REGISTER_BLOCK__OFFS))+Var.VALUE(&__DDRSS_PHY_631__SFR_OFFS)))) %Long Var.VALUE(&__DDRSS1_PHY_631_DATA)
	Data.Set D:((((Var.VALUE(&__J7_DDR1_SS_BASE)+Var.VALUE(&__DDRSS_Data_Slice_2_REGISTER_BLOCK__OFFS))+Var.VALUE(&__DDRSS_PHY_632__SFR_OFFS)))) %Long Var.VALUE(&__DDRSS1_PHY_632_DATA)
	Data.Set D:((((Var.VALUE(&__J7_DDR1_SS_BASE)+Var.VALUE(&__DDRSS_Data_Slice_2_REGISTER_BLOCK__OFFS))+Var.VALUE(&__DDRSS_PHY_633__SFR_OFFS)))) %Long Var.VALUE(&__DDRSS1_PHY_633_DATA)
	Data.Set D:((((Var.VALUE(&__J7_DDR1_SS_BASE)+Var.VALUE(&__DDRSS_Data_Slice_2_REGISTER_BLOCK__OFFS))+Var.VALUE(&__DDRSS_PHY_634__SFR_OFFS)))) %Long Var.VALUE(&__DDRSS1_PHY_634_DATA)
	Data.Set D:((((Var.VALUE(&__J7_DDR1_SS_BASE)+Var.VALUE(&__DDRSS_Data_Slice_2_REGISTER_BLOCK__OFFS))+Var.VALUE(&__DDRSS_PHY_635__SFR_OFFS)))) %Long Var.VALUE(&__DDRSS1_PHY_635_DATA)
	Data.Set D:((((Var.VALUE(&__J7_DDR1_SS_BASE)+Var.VALUE(&__DDRSS_Data_Slice_2_REGISTER_BLOCK__OFFS))+Var.VALUE(&__DDRSS_PHY_636__SFR_OFFS)))) %Long Var.VALUE(&__DDRSS1_PHY_636_DATA)
	Data.Set D:((((Var.VALUE(&__J7_DDR1_SS_BASE)+Var.VALUE(&__DDRSS_Data_Slice_2_REGISTER_BLOCK__OFFS))+Var.VALUE(&__DDRSS_PHY_637__SFR_OFFS)))) %Long Var.VALUE(&__DDRSS1_PHY_637_DATA)
	Data.Set D:((((Var.VALUE(&__J7_DDR1_SS_BASE)+Var.VALUE(&__DDRSS_Data_Slice_2_REGISTER_BLOCK__OFFS))+Var.VALUE(&__DDRSS_PHY_638__SFR_OFFS)))) %Long Var.VALUE(&__DDRSS1_PHY_638_DATA)
	Data.Set D:((((Var.VALUE(&__J7_DDR1_SS_BASE)+Var.VALUE(&__DDRSS_Data_Slice_2_REGISTER_BLOCK__OFFS))+Var.VALUE(&__DDRSS_PHY_639__SFR_OFFS)))) %Long Var.VALUE(&__DDRSS1_PHY_639_DATA)
	Data.Set D:((((Var.VALUE(&__J7_DDR1_SS_BASE)+Var.VALUE(&__DDRSS_Data_Slice_2_REGISTER_BLOCK__OFFS))+Var.VALUE(&__DDRSS_PHY_640__SFR_OFFS)))) %Long Var.VALUE(&__DDRSS1_PHY_640_DATA)
	Data.Set D:((((Var.VALUE(&__J7_DDR1_SS_BASE)+Var.VALUE(&__DDRSS_Data_Slice_2_REGISTER_BLOCK__OFFS))+Var.VALUE(&__DDRSS_PHY_641__SFR_OFFS)))) %Long Var.VALUE(&__DDRSS1_PHY_641_DATA)
	Data.Set D:((((Var.VALUE(&__J7_DDR1_SS_BASE)+Var.VALUE(&__DDRSS_Data_Slice_2_REGISTER_BLOCK__OFFS))+Var.VALUE(&__DDRSS_PHY_642__SFR_OFFS)))) %Long Var.VALUE(&__DDRSS1_PHY_642_DATA)
	Data.Set D:((((Var.VALUE(&__J7_DDR1_SS_BASE)+Var.VALUE(&__DDRSS_Data_Slice_2_REGISTER_BLOCK__OFFS))+Var.VALUE(&__DDRSS_PHY_643__SFR_OFFS)))) %Long Var.VALUE(&__DDRSS1_PHY_643_DATA)
	Data.Set D:((((Var.VALUE(&__J7_DDR1_SS_BASE)+Var.VALUE(&__DDRSS_Data_Slice_2_REGISTER_BLOCK__OFFS))+Var.VALUE(&__DDRSS_PHY_644__SFR_OFFS)))) %Long Var.VALUE(&__DDRSS1_PHY_644_DATA)
	Data.Set D:((((Var.VALUE(&__J7_DDR1_SS_BASE)+Var.VALUE(&__DDRSS_Data_Slice_2_REGISTER_BLOCK__OFFS))+Var.VALUE(&__DDRSS_PHY_645__SFR_OFFS)))) %Long Var.VALUE(&__DDRSS1_PHY_645_DATA)
	Data.Set D:((((Var.VALUE(&__J7_DDR1_SS_BASE)+Var.VALUE(&__DDRSS_Data_Slice_2_REGISTER_BLOCK__OFFS))+Var.VALUE(&__DDRSS_PHY_646__SFR_OFFS)))) %Long Var.VALUE(&__DDRSS1_PHY_646_DATA)
	Data.Set D:((((Var.VALUE(&__J7_DDR1_SS_BASE)+Var.VALUE(&__DDRSS_Data_Slice_2_REGISTER_BLOCK__OFFS))+Var.VALUE(&__DDRSS_PHY_647__SFR_OFFS)))) %Long Var.VALUE(&__DDRSS1_PHY_647_DATA)
	Data.Set D:((((Var.VALUE(&__J7_DDR1_SS_BASE)+Var.VALUE(&__DDRSS_Data_Slice_2_REGISTER_BLOCK__OFFS))+Var.VALUE(&__DDRSS_PHY_648__SFR_OFFS)))) %Long Var.VALUE(&__DDRSS1_PHY_648_DATA)
	Data.Set D:((((Var.VALUE(&__J7_DDR1_SS_BASE)+Var.VALUE(&__DDRSS_Data_Slice_2_REGISTER_BLOCK__OFFS))+Var.VALUE(&__DDRSS_PHY_649__SFR_OFFS)))) %Long Var.VALUE(&__DDRSS1_PHY_649_DATA)
	Data.Set D:((((Var.VALUE(&__J7_DDR1_SS_BASE)+Var.VALUE(&__DDRSS_Data_Slice_2_REGISTER_BLOCK__OFFS))+Var.VALUE(&__DDRSS_PHY_650__SFR_OFFS)))) %Long Var.VALUE(&__DDRSS1_PHY_650_DATA)
	Data.Set D:((((Var.VALUE(&__J7_DDR1_SS_BASE)+Var.VALUE(&__DDRSS_Data_Slice_2_REGISTER_BLOCK__OFFS))+Var.VALUE(&__DDRSS_PHY_651__SFR_OFFS)))) %Long Var.VALUE(&__DDRSS1_PHY_651_DATA)
	Var.NEWLOCAL char[128] \strtmp = "--->>> DDR1 PHY Data Slice 2 programming completed... <<<---\n"
	GOSUB printf Var.String(\strtmp)
	
	Var.NEWLOCAL char[128] \strtmp = "--->>> DDR1 PHY Data Slice 3 programming in progress.. <<<---\n"
	GOSUB printf Var.String(\strtmp)
	
	Data.Set D:((((Var.VALUE(&__J7_DDR1_SS_BASE)+Var.VALUE(&__DDRSS_Data_Slice_3_REGISTER_BLOCK__OFFS))+Var.VALUE(&__DDRSS_PHY_768__SFR_OFFS)))) %Long Var.VALUE(&__DDRSS1_PHY_768_DATA)
	Data.Set D:((((Var.VALUE(&__J7_DDR1_SS_BASE)+Var.VALUE(&__DDRSS_Data_Slice_3_REGISTER_BLOCK__OFFS))+Var.VALUE(&__DDRSS_PHY_769__SFR_OFFS)))) %Long Var.VALUE(&__DDRSS1_PHY_769_DATA)
	Data.Set D:((((Var.VALUE(&__J7_DDR1_SS_BASE)+Var.VALUE(&__DDRSS_Data_Slice_3_REGISTER_BLOCK__OFFS))+Var.VALUE(&__DDRSS_PHY_770__SFR_OFFS)))) %Long Var.VALUE(&__DDRSS1_PHY_770_DATA)
	Data.Set D:((((Var.VALUE(&__J7_DDR1_SS_BASE)+Var.VALUE(&__DDRSS_Data_Slice_3_REGISTER_BLOCK__OFFS))+Var.VALUE(&__DDRSS_PHY_771__SFR_OFFS)))) %Long Var.VALUE(&__DDRSS1_PHY_771_DATA)
	Data.Set D:((((Var.VALUE(&__J7_DDR1_SS_BASE)+Var.VALUE(&__DDRSS_Data_Slice_3_REGISTER_BLOCK__OFFS))+Var.VALUE(&__DDRSS_PHY_772__SFR_OFFS)))) %Long Var.VALUE(&__DDRSS1_PHY_772_DATA)
	Data.Set D:((((Var.VALUE(&__J7_DDR1_SS_BASE)+Var.VALUE(&__DDRSS_Data_Slice_3_REGISTER_BLOCK__OFFS))+Var.VALUE(&__DDRSS_PHY_773__SFR_OFFS)))) %Long Var.VALUE(&__DDRSS1_PHY_773_DATA)
	Data.Set D:((((Var.VALUE(&__J7_DDR1_SS_BASE)+Var.VALUE(&__DDRSS_Data_Slice_3_REGISTER_BLOCK__OFFS))+Var.VALUE(&__DDRSS_PHY_774__SFR_OFFS)))) %Long Var.VALUE(&__DDRSS1_PHY_774_DATA)
	Data.Set D:((((Var.VALUE(&__J7_DDR1_SS_BASE)+Var.VALUE(&__DDRSS_Data_Slice_3_REGISTER_BLOCK__OFFS))+Var.VALUE(&__DDRSS_PHY_775__SFR_OFFS)))) %Long Var.VALUE(&__DDRSS1_PHY_775_DATA)
	Data.Set D:((((Var.VALUE(&__J7_DDR1_SS_BASE)+Var.VALUE(&__DDRSS_Data_Slice_3_REGISTER_BLOCK__OFFS))+Var.VALUE(&__DDRSS_PHY_776__SFR_OFFS)))) %Long Var.VALUE(&__DDRSS1_PHY_776_DATA)
	Data.Set D:((((Var.VALUE(&__J7_DDR1_SS_BASE)+Var.VALUE(&__DDRSS_Data_Slice_3_REGISTER_BLOCK__OFFS))+Var.VALUE(&__DDRSS_PHY_777__SFR_OFFS)))) %Long Var.VALUE(&__DDRSS1_PHY_777_DATA)
	Data.Set D:((((Var.VALUE(&__J7_DDR1_SS_BASE)+Var.VALUE(&__DDRSS_Data_Slice_3_REGISTER_BLOCK__OFFS))+Var.VALUE(&__DDRSS_PHY_778__SFR_OFFS)))) %Long Var.VALUE(&__DDRSS1_PHY_778_DATA)
	Data.Set D:((((Var.VALUE(&__J7_DDR1_SS_BASE)+Var.VALUE(&__DDRSS_Data_Slice_3_REGISTER_BLOCK__OFFS))+Var.VALUE(&__DDRSS_PHY_779__SFR_OFFS)))) %Long Var.VALUE(&__DDRSS1_PHY_779_DATA)
	Data.Set D:((((Var.VALUE(&__J7_DDR1_SS_BASE)+Var.VALUE(&__DDRSS_Data_Slice_3_REGISTER_BLOCK__OFFS))+Var.VALUE(&__DDRSS_PHY_780__SFR_OFFS)))) %Long Var.VALUE(&__DDRSS1_PHY_780_DATA)
	Data.Set D:((((Var.VALUE(&__J7_DDR1_SS_BASE)+Var.VALUE(&__DDRSS_Data_Slice_3_REGISTER_BLOCK__OFFS))+Var.VALUE(&__DDRSS_PHY_781__SFR_OFFS)))) %Long Var.VALUE(&__DDRSS1_PHY_781_DATA)
	Data.Set D:((((Var.VALUE(&__J7_DDR1_SS_BASE)+Var.VALUE(&__DDRSS_Data_Slice_3_REGISTER_BLOCK__OFFS))+Var.VALUE(&__DDRSS_PHY_782__SFR_OFFS)))) %Long Var.VALUE(&__DDRSS1_PHY_782_DATA)
	Data.Set D:((((Var.VALUE(&__J7_DDR1_SS_BASE)+Var.VALUE(&__DDRSS_Data_Slice_3_REGISTER_BLOCK__OFFS))+Var.VALUE(&__DDRSS_PHY_783__SFR_OFFS)))) %Long Var.VALUE(&__DDRSS1_PHY_783_DATA)
	Data.Set D:((((Var.VALUE(&__J7_DDR1_SS_BASE)+Var.VALUE(&__DDRSS_Data_Slice_3_REGISTER_BLOCK__OFFS))+Var.VALUE(&__DDRSS_PHY_784__SFR_OFFS)))) %Long Var.VALUE(&__DDRSS1_PHY_784_DATA)
	Data.Set D:((((Var.VALUE(&__J7_DDR1_SS_BASE)+Var.VALUE(&__DDRSS_Data_Slice_3_REGISTER_BLOCK__OFFS))+Var.VALUE(&__DDRSS_PHY_785__SFR_OFFS)))) %Long Var.VALUE(&__DDRSS1_PHY_785_DATA)
	Data.Set D:((((Var.VALUE(&__J7_DDR1_SS_BASE)+Var.VALUE(&__DDRSS_Data_Slice_3_REGISTER_BLOCK__OFFS))+Var.VALUE(&__DDRSS_PHY_786__SFR_OFFS)))) %Long Var.VALUE(&__DDRSS1_PHY_786_DATA)
	Data.Set D:((((Var.VALUE(&__J7_DDR1_SS_BASE)+Var.VALUE(&__DDRSS_Data_Slice_3_REGISTER_BLOCK__OFFS))+Var.VALUE(&__DDRSS_PHY_787__SFR_OFFS)))) %Long Var.VALUE(&__DDRSS1_PHY_787_DATA)
	Data.Set D:((((Var.VALUE(&__J7_DDR1_SS_BASE)+Var.VALUE(&__DDRSS_Data_Slice_3_REGISTER_BLOCK__OFFS))+Var.VALUE(&__DDRSS_PHY_788__SFR_OFFS)))) %Long Var.VALUE(&__DDRSS1_PHY_788_DATA)
	Data.Set D:((((Var.VALUE(&__J7_DDR1_SS_BASE)+Var.VALUE(&__DDRSS_Data_Slice_3_REGISTER_BLOCK__OFFS))+Var.VALUE(&__DDRSS_PHY_789__SFR_OFFS)))) %Long Var.VALUE(&__DDRSS1_PHY_789_DATA)
	Data.Set D:((((Var.VALUE(&__J7_DDR1_SS_BASE)+Var.VALUE(&__DDRSS_Data_Slice_3_REGISTER_BLOCK__OFFS))+Var.VALUE(&__DDRSS_PHY_790__SFR_OFFS)))) %Long Var.VALUE(&__DDRSS1_PHY_790_DATA)
	Data.Set D:((((Var.VALUE(&__J7_DDR1_SS_BASE)+Var.VALUE(&__DDRSS_Data_Slice_3_REGISTER_BLOCK__OFFS))+Var.VALUE(&__DDRSS_PHY_791__SFR_OFFS)))) %Long Var.VALUE(&__DDRSS1_PHY_791_DATA)
	Data.Set D:((((Var.VALUE(&__J7_DDR1_SS_BASE)+Var.VALUE(&__DDRSS_Data_Slice_3_REGISTER_BLOCK__OFFS))+Var.VALUE(&__DDRSS_PHY_792__SFR_OFFS)))) %Long Var.VALUE(&__DDRSS1_PHY_792_DATA)
	Data.Set D:((((Var.VALUE(&__J7_DDR1_SS_BASE)+Var.VALUE(&__DDRSS_Data_Slice_3_REGISTER_BLOCK__OFFS))+Var.VALUE(&__DDRSS_PHY_793__SFR_OFFS)))) %Long Var.VALUE(&__DDRSS1_PHY_793_DATA)
	Data.Set D:((((Var.VALUE(&__J7_DDR1_SS_BASE)+Var.VALUE(&__DDRSS_Data_Slice_3_REGISTER_BLOCK__OFFS))+Var.VALUE(&__DDRSS_PHY_794__SFR_OFFS)))) %Long Var.VALUE(&__DDRSS1_PHY_794_DATA)
	Data.Set D:((((Var.VALUE(&__J7_DDR1_SS_BASE)+Var.VALUE(&__DDRSS_Data_Slice_3_REGISTER_BLOCK__OFFS))+Var.VALUE(&__DDRSS_PHY_795__SFR_OFFS)))) %Long Var.VALUE(&__DDRSS1_PHY_795_DATA)
	Data.Set D:((((Var.VALUE(&__J7_DDR1_SS_BASE)+Var.VALUE(&__DDRSS_Data_Slice_3_REGISTER_BLOCK__OFFS))+Var.VALUE(&__DDRSS_PHY_796__SFR_OFFS)))) %Long Var.VALUE(&__DDRSS1_PHY_796_DATA)
	Data.Set D:((((Var.VALUE(&__J7_DDR1_SS_BASE)+Var.VALUE(&__DDRSS_Data_Slice_3_REGISTER_BLOCK__OFFS))+Var.VALUE(&__DDRSS_PHY_797__SFR_OFFS)))) %Long Var.VALUE(&__DDRSS1_PHY_797_DATA)
	Data.Set D:((((Var.VALUE(&__J7_DDR1_SS_BASE)+Var.VALUE(&__DDRSS_Data_Slice_3_REGISTER_BLOCK__OFFS))+Var.VALUE(&__DDRSS_PHY_798__SFR_OFFS)))) %Long Var.VALUE(&__DDRSS1_PHY_798_DATA)
	Data.Set D:((((Var.VALUE(&__J7_DDR1_SS_BASE)+Var.VALUE(&__DDRSS_Data_Slice_3_REGISTER_BLOCK__OFFS))+Var.VALUE(&__DDRSS_PHY_799__SFR_OFFS)))) %Long Var.VALUE(&__DDRSS1_PHY_799_DATA)
	Data.Set D:((((Var.VALUE(&__J7_DDR1_SS_BASE)+Var.VALUE(&__DDRSS_Data_Slice_3_REGISTER_BLOCK__OFFS))+Var.VALUE(&__DDRSS_PHY_800__SFR_OFFS)))) %Long Var.VALUE(&__DDRSS1_PHY_800_DATA)
	Data.Set D:((((Var.VALUE(&__J7_DDR1_SS_BASE)+Var.VALUE(&__DDRSS_Data_Slice_3_REGISTER_BLOCK__OFFS))+Var.VALUE(&__DDRSS_PHY_801__SFR_OFFS)))) %Long Var.VALUE(&__DDRSS1_PHY_801_DATA)
	Data.Set D:((((Var.VALUE(&__J7_DDR1_SS_BASE)+Var.VALUE(&__DDRSS_Data_Slice_3_REGISTER_BLOCK__OFFS))+Var.VALUE(&__DDRSS_PHY_802__SFR_OFFS)))) %Long Var.VALUE(&__DDRSS1_PHY_802_DATA)
	Data.Set D:((((Var.VALUE(&__J7_DDR1_SS_BASE)+Var.VALUE(&__DDRSS_Data_Slice_3_REGISTER_BLOCK__OFFS))+Var.VALUE(&__DDRSS_PHY_803__SFR_OFFS)))) %Long Var.VALUE(&__DDRSS1_PHY_803_DATA)
	Data.Set D:((((Var.VALUE(&__J7_DDR1_SS_BASE)+Var.VALUE(&__DDRSS_Data_Slice_3_REGISTER_BLOCK__OFFS))+Var.VALUE(&__DDRSS_PHY_804__SFR_OFFS)))) %Long Var.VALUE(&__DDRSS1_PHY_804_DATA)
	Data.Set D:((((Var.VALUE(&__J7_DDR1_SS_BASE)+Var.VALUE(&__DDRSS_Data_Slice_3_REGISTER_BLOCK__OFFS))+Var.VALUE(&__DDRSS_PHY_805__SFR_OFFS)))) %Long Var.VALUE(&__DDRSS1_PHY_805_DATA)
	Data.Set D:((((Var.VALUE(&__J7_DDR1_SS_BASE)+Var.VALUE(&__DDRSS_Data_Slice_3_REGISTER_BLOCK__OFFS))+Var.VALUE(&__DDRSS_PHY_806__SFR_OFFS)))) %Long Var.VALUE(&__DDRSS1_PHY_806_DATA)
	Data.Set D:((((Var.VALUE(&__J7_DDR1_SS_BASE)+Var.VALUE(&__DDRSS_Data_Slice_3_REGISTER_BLOCK__OFFS))+Var.VALUE(&__DDRSS_PHY_807__SFR_OFFS)))) %Long Var.VALUE(&__DDRSS1_PHY_807_DATA)
	Data.Set D:((((Var.VALUE(&__J7_DDR1_SS_BASE)+Var.VALUE(&__DDRSS_Data_Slice_3_REGISTER_BLOCK__OFFS))+Var.VALUE(&__DDRSS_PHY_808__SFR_OFFS)))) %Long Var.VALUE(&__DDRSS1_PHY_808_DATA)
	Data.Set D:((((Var.VALUE(&__J7_DDR1_SS_BASE)+Var.VALUE(&__DDRSS_Data_Slice_3_REGISTER_BLOCK__OFFS))+Var.VALUE(&__DDRSS_PHY_809__SFR_OFFS)))) %Long Var.VALUE(&__DDRSS1_PHY_809_DATA)
	Data.Set D:((((Var.VALUE(&__J7_DDR1_SS_BASE)+Var.VALUE(&__DDRSS_Data_Slice_3_REGISTER_BLOCK__OFFS))+Var.VALUE(&__DDRSS_PHY_810__SFR_OFFS)))) %Long Var.VALUE(&__DDRSS1_PHY_810_DATA)
	Data.Set D:((((Var.VALUE(&__J7_DDR1_SS_BASE)+Var.VALUE(&__DDRSS_Data_Slice_3_REGISTER_BLOCK__OFFS))+Var.VALUE(&__DDRSS_PHY_811__SFR_OFFS)))) %Long Var.VALUE(&__DDRSS1_PHY_811_DATA)
	Data.Set D:((((Var.VALUE(&__J7_DDR1_SS_BASE)+Var.VALUE(&__DDRSS_Data_Slice_3_REGISTER_BLOCK__OFFS))+Var.VALUE(&__DDRSS_PHY_812__SFR_OFFS)))) %Long Var.VALUE(&__DDRSS1_PHY_812_DATA)
	Data.Set D:((((Var.VALUE(&__J7_DDR1_SS_BASE)+Var.VALUE(&__DDRSS_Data_Slice_3_REGISTER_BLOCK__OFFS))+Var.VALUE(&__DDRSS_PHY_813__SFR_OFFS)))) %Long Var.VALUE(&__DDRSS1_PHY_813_DATA)
	Data.Set D:((((Var.VALUE(&__J7_DDR1_SS_BASE)+Var.VALUE(&__DDRSS_Data_Slice_3_REGISTER_BLOCK__OFFS))+Var.VALUE(&__DDRSS_PHY_814__SFR_OFFS)))) %Long Var.VALUE(&__DDRSS1_PHY_814_DATA)
	Data.Set D:((((Var.VALUE(&__J7_DDR1_SS_BASE)+Var.VALUE(&__DDRSS_Data_Slice_3_REGISTER_BLOCK__OFFS))+Var.VALUE(&__DDRSS_PHY_815__SFR_OFFS)))) %Long Var.VALUE(&__DDRSS1_PHY_815_DATA)
	Data.Set D:((((Var.VALUE(&__J7_DDR1_SS_BASE)+Var.VALUE(&__DDRSS_Data_Slice_3_REGISTER_BLOCK__OFFS))+Var.VALUE(&__DDRSS_PHY_816__SFR_OFFS)))) %Long Var.VALUE(&__DDRSS1_PHY_816_DATA)
	Data.Set D:((((Var.VALUE(&__J7_DDR1_SS_BASE)+Var.VALUE(&__DDRSS_Data_Slice_3_REGISTER_BLOCK__OFFS))+Var.VALUE(&__DDRSS_PHY_817__SFR_OFFS)))) %Long Var.VALUE(&__DDRSS1_PHY_817_DATA)
	Data.Set D:((((Var.VALUE(&__J7_DDR1_SS_BASE)+Var.VALUE(&__DDRSS_Data_Slice_3_REGISTER_BLOCK__OFFS))+Var.VALUE(&__DDRSS_PHY_818__SFR_OFFS)))) %Long Var.VALUE(&__DDRSS1_PHY_818_DATA)
	Data.Set D:((((Var.VALUE(&__J7_DDR1_SS_BASE)+Var.VALUE(&__DDRSS_Data_Slice_3_REGISTER_BLOCK__OFFS))+Var.VALUE(&__DDRSS_PHY_819__SFR_OFFS)))) %Long Var.VALUE(&__DDRSS1_PHY_819_DATA)
	Data.Set D:((((Var.VALUE(&__J7_DDR1_SS_BASE)+Var.VALUE(&__DDRSS_Data_Slice_3_REGISTER_BLOCK__OFFS))+Var.VALUE(&__DDRSS_PHY_820__SFR_OFFS)))) %Long Var.VALUE(&__DDRSS1_PHY_820_DATA)
	Data.Set D:((((Var.VALUE(&__J7_DDR1_SS_BASE)+Var.VALUE(&__DDRSS_Data_Slice_3_REGISTER_BLOCK__OFFS))+Var.VALUE(&__DDRSS_PHY_821__SFR_OFFS)))) %Long Var.VALUE(&__DDRSS1_PHY_821_DATA)
	Data.Set D:((((Var.VALUE(&__J7_DDR1_SS_BASE)+Var.VALUE(&__DDRSS_Data_Slice_3_REGISTER_BLOCK__OFFS))+Var.VALUE(&__DDRSS_PHY_822__SFR_OFFS)))) %Long Var.VALUE(&__DDRSS1_PHY_822_DATA)
	Data.Set D:((((Var.VALUE(&__J7_DDR1_SS_BASE)+Var.VALUE(&__DDRSS_Data_Slice_3_REGISTER_BLOCK__OFFS))+Var.VALUE(&__DDRSS_PHY_823__SFR_OFFS)))) %Long Var.VALUE(&__DDRSS1_PHY_823_DATA)
	Data.Set D:((((Var.VALUE(&__J7_DDR1_SS_BASE)+Var.VALUE(&__DDRSS_Data_Slice_3_REGISTER_BLOCK__OFFS))+Var.VALUE(&__DDRSS_PHY_824__SFR_OFFS)))) %Long Var.VALUE(&__DDRSS1_PHY_824_DATA)
	Data.Set D:((((Var.VALUE(&__J7_DDR1_SS_BASE)+Var.VALUE(&__DDRSS_Data_Slice_3_REGISTER_BLOCK__OFFS))+Var.VALUE(&__DDRSS_PHY_825__SFR_OFFS)))) %Long Var.VALUE(&__DDRSS1_PHY_825_DATA)
	Data.Set D:((((Var.VALUE(&__J7_DDR1_SS_BASE)+Var.VALUE(&__DDRSS_Data_Slice_3_REGISTER_BLOCK__OFFS))+Var.VALUE(&__DDRSS_PHY_826__SFR_OFFS)))) %Long Var.VALUE(&__DDRSS1_PHY_826_DATA)
	Data.Set D:((((Var.VALUE(&__J7_DDR1_SS_BASE)+Var.VALUE(&__DDRSS_Data_Slice_3_REGISTER_BLOCK__OFFS))+Var.VALUE(&__DDRSS_PHY_827__SFR_OFFS)))) %Long Var.VALUE(&__DDRSS1_PHY_827_DATA)
	Data.Set D:((((Var.VALUE(&__J7_DDR1_SS_BASE)+Var.VALUE(&__DDRSS_Data_Slice_3_REGISTER_BLOCK__OFFS))+Var.VALUE(&__DDRSS_PHY_828__SFR_OFFS)))) %Long Var.VALUE(&__DDRSS1_PHY_828_DATA)
	Data.Set D:((((Var.VALUE(&__J7_DDR1_SS_BASE)+Var.VALUE(&__DDRSS_Data_Slice_3_REGISTER_BLOCK__OFFS))+Var.VALUE(&__DDRSS_PHY_829__SFR_OFFS)))) %Long Var.VALUE(&__DDRSS1_PHY_829_DATA)
	Data.Set D:((((Var.VALUE(&__J7_DDR1_SS_BASE)+Var.VALUE(&__DDRSS_Data_Slice_3_REGISTER_BLOCK__OFFS))+Var.VALUE(&__DDRSS_PHY_830__SFR_OFFS)))) %Long Var.VALUE(&__DDRSS1_PHY_830_DATA)
	Data.Set D:((((Var.VALUE(&__J7_DDR1_SS_BASE)+Var.VALUE(&__DDRSS_Data_Slice_3_REGISTER_BLOCK__OFFS))+Var.VALUE(&__DDRSS_PHY_831__SFR_OFFS)))) %Long Var.VALUE(&__DDRSS1_PHY_831_DATA)
	Data.Set D:((((Var.VALUE(&__J7_DDR1_SS_BASE)+Var.VALUE(&__DDRSS_Data_Slice_3_REGISTER_BLOCK__OFFS))+Var.VALUE(&__DDRSS_PHY_832__SFR_OFFS)))) %Long Var.VALUE(&__DDRSS1_PHY_832_DATA)
	Data.Set D:((((Var.VALUE(&__J7_DDR1_SS_BASE)+Var.VALUE(&__DDRSS_Data_Slice_3_REGISTER_BLOCK__OFFS))+Var.VALUE(&__DDRSS_PHY_833__SFR_OFFS)))) %Long Var.VALUE(&__DDRSS1_PHY_833_DATA)
	Data.Set D:((((Var.VALUE(&__J7_DDR1_SS_BASE)+Var.VALUE(&__DDRSS_Data_Slice_3_REGISTER_BLOCK__OFFS))+Var.VALUE(&__DDRSS_PHY_834__SFR_OFFS)))) %Long Var.VALUE(&__DDRSS1_PHY_834_DATA)
	Data.Set D:((((Var.VALUE(&__J7_DDR1_SS_BASE)+Var.VALUE(&__DDRSS_Data_Slice_3_REGISTER_BLOCK__OFFS))+Var.VALUE(&__DDRSS_PHY_835__SFR_OFFS)))) %Long Var.VALUE(&__DDRSS1_PHY_835_DATA)
	Data.Set D:((((Var.VALUE(&__J7_DDR1_SS_BASE)+Var.VALUE(&__DDRSS_Data_Slice_3_REGISTER_BLOCK__OFFS))+Var.VALUE(&__DDRSS_PHY_836__SFR_OFFS)))) %Long Var.VALUE(&__DDRSS1_PHY_836_DATA)
	Data.Set D:((((Var.VALUE(&__J7_DDR1_SS_BASE)+Var.VALUE(&__DDRSS_Data_Slice_3_REGISTER_BLOCK__OFFS))+Var.VALUE(&__DDRSS_PHY_837__SFR_OFFS)))) %Long Var.VALUE(&__DDRSS1_PHY_837_DATA)
	Data.Set D:((((Var.VALUE(&__J7_DDR1_SS_BASE)+Var.VALUE(&__DDRSS_Data_Slice_3_REGISTER_BLOCK__OFFS))+Var.VALUE(&__DDRSS_PHY_838__SFR_OFFS)))) %Long Var.VALUE(&__DDRSS1_PHY_838_DATA)
	Data.Set D:((((Var.VALUE(&__J7_DDR1_SS_BASE)+Var.VALUE(&__DDRSS_Data_Slice_3_REGISTER_BLOCK__OFFS))+Var.VALUE(&__DDRSS_PHY_839__SFR_OFFS)))) %Long Var.VALUE(&__DDRSS1_PHY_839_DATA)
	Data.Set D:((((Var.VALUE(&__J7_DDR1_SS_BASE)+Var.VALUE(&__DDRSS_Data_Slice_3_REGISTER_BLOCK__OFFS))+Var.VALUE(&__DDRSS_PHY_840__SFR_OFFS)))) %Long Var.VALUE(&__DDRSS1_PHY_840_DATA)
	Data.Set D:((((Var.VALUE(&__J7_DDR1_SS_BASE)+Var.VALUE(&__DDRSS_Data_Slice_3_REGISTER_BLOCK__OFFS))+Var.VALUE(&__DDRSS_PHY_841__SFR_OFFS)))) %Long Var.VALUE(&__DDRSS1_PHY_841_DATA)
	Data.Set D:((((Var.VALUE(&__J7_DDR1_SS_BASE)+Var.VALUE(&__DDRSS_Data_Slice_3_REGISTER_BLOCK__OFFS))+Var.VALUE(&__DDRSS_PHY_842__SFR_OFFS)))) %Long Var.VALUE(&__DDRSS1_PHY_842_DATA)
	Data.Set D:((((Var.VALUE(&__J7_DDR1_SS_BASE)+Var.VALUE(&__DDRSS_Data_Slice_3_REGISTER_BLOCK__OFFS))+Var.VALUE(&__DDRSS_PHY_843__SFR_OFFS)))) %Long Var.VALUE(&__DDRSS1_PHY_843_DATA)
	Data.Set D:((((Var.VALUE(&__J7_DDR1_SS_BASE)+Var.VALUE(&__DDRSS_Data_Slice_3_REGISTER_BLOCK__OFFS))+Var.VALUE(&__DDRSS_PHY_844__SFR_OFFS)))) %Long Var.VALUE(&__DDRSS1_PHY_844_DATA)
	Data.Set D:((((Var.VALUE(&__J7_DDR1_SS_BASE)+Var.VALUE(&__DDRSS_Data_Slice_3_REGISTER_BLOCK__OFFS))+Var.VALUE(&__DDRSS_PHY_845__SFR_OFFS)))) %Long Var.VALUE(&__DDRSS1_PHY_845_DATA)
	Data.Set D:((((Var.VALUE(&__J7_DDR1_SS_BASE)+Var.VALUE(&__DDRSS_Data_Slice_3_REGISTER_BLOCK__OFFS))+Var.VALUE(&__DDRSS_PHY_846__SFR_OFFS)))) %Long Var.VALUE(&__DDRSS1_PHY_846_DATA)
	Data.Set D:((((Var.VALUE(&__J7_DDR1_SS_BASE)+Var.VALUE(&__DDRSS_Data_Slice_3_REGISTER_BLOCK__OFFS))+Var.VALUE(&__DDRSS_PHY_847__SFR_OFFS)))) %Long Var.VALUE(&__DDRSS1_PHY_847_DATA)
	Data.Set D:((((Var.VALUE(&__J7_DDR1_SS_BASE)+Var.VALUE(&__DDRSS_Data_Slice_3_REGISTER_BLOCK__OFFS))+Var.VALUE(&__DDRSS_PHY_848__SFR_OFFS)))) %Long Var.VALUE(&__DDRSS1_PHY_848_DATA)
	Data.Set D:((((Var.VALUE(&__J7_DDR1_SS_BASE)+Var.VALUE(&__DDRSS_Data_Slice_3_REGISTER_BLOCK__OFFS))+Var.VALUE(&__DDRSS_PHY_849__SFR_OFFS)))) %Long Var.VALUE(&__DDRSS1_PHY_849_DATA)
	Data.Set D:((((Var.VALUE(&__J7_DDR1_SS_BASE)+Var.VALUE(&__DDRSS_Data_Slice_3_REGISTER_BLOCK__OFFS))+Var.VALUE(&__DDRSS_PHY_850__SFR_OFFS)))) %Long Var.VALUE(&__DDRSS1_PHY_850_DATA)
	Data.Set D:((((Var.VALUE(&__J7_DDR1_SS_BASE)+Var.VALUE(&__DDRSS_Data_Slice_3_REGISTER_BLOCK__OFFS))+Var.VALUE(&__DDRSS_PHY_851__SFR_OFFS)))) %Long Var.VALUE(&__DDRSS1_PHY_851_DATA)
	Data.Set D:((((Var.VALUE(&__J7_DDR1_SS_BASE)+Var.VALUE(&__DDRSS_Data_Slice_3_REGISTER_BLOCK__OFFS))+Var.VALUE(&__DDRSS_PHY_852__SFR_OFFS)))) %Long Var.VALUE(&__DDRSS1_PHY_852_DATA)
	Data.Set D:((((Var.VALUE(&__J7_DDR1_SS_BASE)+Var.VALUE(&__DDRSS_Data_Slice_3_REGISTER_BLOCK__OFFS))+Var.VALUE(&__DDRSS_PHY_853__SFR_OFFS)))) %Long Var.VALUE(&__DDRSS1_PHY_853_DATA)
	Data.Set D:((((Var.VALUE(&__J7_DDR1_SS_BASE)+Var.VALUE(&__DDRSS_Data_Slice_3_REGISTER_BLOCK__OFFS))+Var.VALUE(&__DDRSS_PHY_854__SFR_OFFS)))) %Long Var.VALUE(&__DDRSS1_PHY_854_DATA)
	Data.Set D:((((Var.VALUE(&__J7_DDR1_SS_BASE)+Var.VALUE(&__DDRSS_Data_Slice_3_REGISTER_BLOCK__OFFS))+Var.VALUE(&__DDRSS_PHY_855__SFR_OFFS)))) %Long Var.VALUE(&__DDRSS1_PHY_855_DATA)
	Data.Set D:((((Var.VALUE(&__J7_DDR1_SS_BASE)+Var.VALUE(&__DDRSS_Data_Slice_3_REGISTER_BLOCK__OFFS))+Var.VALUE(&__DDRSS_PHY_856__SFR_OFFS)))) %Long Var.VALUE(&__DDRSS1_PHY_856_DATA)
	Data.Set D:((((Var.VALUE(&__J7_DDR1_SS_BASE)+Var.VALUE(&__DDRSS_Data_Slice_3_REGISTER_BLOCK__OFFS))+Var.VALUE(&__DDRSS_PHY_857__SFR_OFFS)))) %Long Var.VALUE(&__DDRSS1_PHY_857_DATA)
	Data.Set D:((((Var.VALUE(&__J7_DDR1_SS_BASE)+Var.VALUE(&__DDRSS_Data_Slice_3_REGISTER_BLOCK__OFFS))+Var.VALUE(&__DDRSS_PHY_858__SFR_OFFS)))) %Long Var.VALUE(&__DDRSS1_PHY_858_DATA)
	Data.Set D:((((Var.VALUE(&__J7_DDR1_SS_BASE)+Var.VALUE(&__DDRSS_Data_Slice_3_REGISTER_BLOCK__OFFS))+Var.VALUE(&__DDRSS_PHY_859__SFR_OFFS)))) %Long Var.VALUE(&__DDRSS1_PHY_859_DATA)
	Data.Set D:((((Var.VALUE(&__J7_DDR1_SS_BASE)+Var.VALUE(&__DDRSS_Data_Slice_3_REGISTER_BLOCK__OFFS))+Var.VALUE(&__DDRSS_PHY_860__SFR_OFFS)))) %Long Var.VALUE(&__DDRSS1_PHY_860_DATA)
	Data.Set D:((((Var.VALUE(&__J7_DDR1_SS_BASE)+Var.VALUE(&__DDRSS_Data_Slice_3_REGISTER_BLOCK__OFFS))+Var.VALUE(&__DDRSS_PHY_861__SFR_OFFS)))) %Long Var.VALUE(&__DDRSS1_PHY_861_DATA)
	Data.Set D:((((Var.VALUE(&__J7_DDR1_SS_BASE)+Var.VALUE(&__DDRSS_Data_Slice_3_REGISTER_BLOCK__OFFS))+Var.VALUE(&__DDRSS_PHY_862__SFR_OFFS)))) %Long Var.VALUE(&__DDRSS1_PHY_862_DATA)
	Data.Set D:((((Var.VALUE(&__J7_DDR1_SS_BASE)+Var.VALUE(&__DDRSS_Data_Slice_3_REGISTER_BLOCK__OFFS))+Var.VALUE(&__DDRSS_PHY_863__SFR_OFFS)))) %Long Var.VALUE(&__DDRSS1_PHY_863_DATA)
	Data.Set D:((((Var.VALUE(&__J7_DDR1_SS_BASE)+Var.VALUE(&__DDRSS_Data_Slice_3_REGISTER_BLOCK__OFFS))+Var.VALUE(&__DDRSS_PHY_864__SFR_OFFS)))) %Long Var.VALUE(&__DDRSS1_PHY_864_DATA)
	Data.Set D:((((Var.VALUE(&__J7_DDR1_SS_BASE)+Var.VALUE(&__DDRSS_Data_Slice_3_REGISTER_BLOCK__OFFS))+Var.VALUE(&__DDRSS_PHY_865__SFR_OFFS)))) %Long Var.VALUE(&__DDRSS1_PHY_865_DATA)
	Data.Set D:((((Var.VALUE(&__J7_DDR1_SS_BASE)+Var.VALUE(&__DDRSS_Data_Slice_3_REGISTER_BLOCK__OFFS))+Var.VALUE(&__DDRSS_PHY_866__SFR_OFFS)))) %Long Var.VALUE(&__DDRSS1_PHY_866_DATA)
	Data.Set D:((((Var.VALUE(&__J7_DDR1_SS_BASE)+Var.VALUE(&__DDRSS_Data_Slice_3_REGISTER_BLOCK__OFFS))+Var.VALUE(&__DDRSS_PHY_867__SFR_OFFS)))) %Long Var.VALUE(&__DDRSS1_PHY_867_DATA)
	Data.Set D:((((Var.VALUE(&__J7_DDR1_SS_BASE)+Var.VALUE(&__DDRSS_Data_Slice_3_REGISTER_BLOCK__OFFS))+Var.VALUE(&__DDRSS_PHY_868__SFR_OFFS)))) %Long Var.VALUE(&__DDRSS1_PHY_868_DATA)
	Data.Set D:((((Var.VALUE(&__J7_DDR1_SS_BASE)+Var.VALUE(&__DDRSS_Data_Slice_3_REGISTER_BLOCK__OFFS))+Var.VALUE(&__DDRSS_PHY_869__SFR_OFFS)))) %Long Var.VALUE(&__DDRSS1_PHY_869_DATA)
	Data.Set D:((((Var.VALUE(&__J7_DDR1_SS_BASE)+Var.VALUE(&__DDRSS_Data_Slice_3_REGISTER_BLOCK__OFFS))+Var.VALUE(&__DDRSS_PHY_870__SFR_OFFS)))) %Long Var.VALUE(&__DDRSS1_PHY_870_DATA)
	Data.Set D:((((Var.VALUE(&__J7_DDR1_SS_BASE)+Var.VALUE(&__DDRSS_Data_Slice_3_REGISTER_BLOCK__OFFS))+Var.VALUE(&__DDRSS_PHY_871__SFR_OFFS)))) %Long Var.VALUE(&__DDRSS1_PHY_871_DATA)
	Data.Set D:((((Var.VALUE(&__J7_DDR1_SS_BASE)+Var.VALUE(&__DDRSS_Data_Slice_3_REGISTER_BLOCK__OFFS))+Var.VALUE(&__DDRSS_PHY_872__SFR_OFFS)))) %Long Var.VALUE(&__DDRSS1_PHY_872_DATA)
	Data.Set D:((((Var.VALUE(&__J7_DDR1_SS_BASE)+Var.VALUE(&__DDRSS_Data_Slice_3_REGISTER_BLOCK__OFFS))+Var.VALUE(&__DDRSS_PHY_873__SFR_OFFS)))) %Long Var.VALUE(&__DDRSS1_PHY_873_DATA)
	Data.Set D:((((Var.VALUE(&__J7_DDR1_SS_BASE)+Var.VALUE(&__DDRSS_Data_Slice_3_REGISTER_BLOCK__OFFS))+Var.VALUE(&__DDRSS_PHY_874__SFR_OFFS)))) %Long Var.VALUE(&__DDRSS1_PHY_874_DATA)
	Data.Set D:((((Var.VALUE(&__J7_DDR1_SS_BASE)+Var.VALUE(&__DDRSS_Data_Slice_3_REGISTER_BLOCK__OFFS))+Var.VALUE(&__DDRSS_PHY_875__SFR_OFFS)))) %Long Var.VALUE(&__DDRSS1_PHY_875_DATA)
	Data.Set D:((((Var.VALUE(&__J7_DDR1_SS_BASE)+Var.VALUE(&__DDRSS_Data_Slice_3_REGISTER_BLOCK__OFFS))+Var.VALUE(&__DDRSS_PHY_876__SFR_OFFS)))) %Long Var.VALUE(&__DDRSS1_PHY_876_DATA)
	Data.Set D:((((Var.VALUE(&__J7_DDR1_SS_BASE)+Var.VALUE(&__DDRSS_Data_Slice_3_REGISTER_BLOCK__OFFS))+Var.VALUE(&__DDRSS_PHY_877__SFR_OFFS)))) %Long Var.VALUE(&__DDRSS1_PHY_877_DATA)
	Data.Set D:((((Var.VALUE(&__J7_DDR1_SS_BASE)+Var.VALUE(&__DDRSS_Data_Slice_3_REGISTER_BLOCK__OFFS))+Var.VALUE(&__DDRSS_PHY_878__SFR_OFFS)))) %Long Var.VALUE(&__DDRSS1_PHY_878_DATA)
	Data.Set D:((((Var.VALUE(&__J7_DDR1_SS_BASE)+Var.VALUE(&__DDRSS_Data_Slice_3_REGISTER_BLOCK__OFFS))+Var.VALUE(&__DDRSS_PHY_879__SFR_OFFS)))) %Long Var.VALUE(&__DDRSS1_PHY_879_DATA)
	Data.Set D:((((Var.VALUE(&__J7_DDR1_SS_BASE)+Var.VALUE(&__DDRSS_Data_Slice_3_REGISTER_BLOCK__OFFS))+Var.VALUE(&__DDRSS_PHY_880__SFR_OFFS)))) %Long Var.VALUE(&__DDRSS1_PHY_880_DATA)
	Data.Set D:((((Var.VALUE(&__J7_DDR1_SS_BASE)+Var.VALUE(&__DDRSS_Data_Slice_3_REGISTER_BLOCK__OFFS))+Var.VALUE(&__DDRSS_PHY_881__SFR_OFFS)))) %Long Var.VALUE(&__DDRSS1_PHY_881_DATA)
	Data.Set D:((((Var.VALUE(&__J7_DDR1_SS_BASE)+Var.VALUE(&__DDRSS_Data_Slice_3_REGISTER_BLOCK__OFFS))+Var.VALUE(&__DDRSS_PHY_882__SFR_OFFS)))) %Long Var.VALUE(&__DDRSS1_PHY_882_DATA)
	Data.Set D:((((Var.VALUE(&__J7_DDR1_SS_BASE)+Var.VALUE(&__DDRSS_Data_Slice_3_REGISTER_BLOCK__OFFS))+Var.VALUE(&__DDRSS_PHY_883__SFR_OFFS)))) %Long Var.VALUE(&__DDRSS1_PHY_883_DATA)
	Data.Set D:((((Var.VALUE(&__J7_DDR1_SS_BASE)+Var.VALUE(&__DDRSS_Data_Slice_3_REGISTER_BLOCK__OFFS))+Var.VALUE(&__DDRSS_PHY_884__SFR_OFFS)))) %Long Var.VALUE(&__DDRSS1_PHY_884_DATA)
	Data.Set D:((((Var.VALUE(&__J7_DDR1_SS_BASE)+Var.VALUE(&__DDRSS_Data_Slice_3_REGISTER_BLOCK__OFFS))+Var.VALUE(&__DDRSS_PHY_885__SFR_OFFS)))) %Long Var.VALUE(&__DDRSS1_PHY_885_DATA)
	Data.Set D:((((Var.VALUE(&__J7_DDR1_SS_BASE)+Var.VALUE(&__DDRSS_Data_Slice_3_REGISTER_BLOCK__OFFS))+Var.VALUE(&__DDRSS_PHY_886__SFR_OFFS)))) %Long Var.VALUE(&__DDRSS1_PHY_886_DATA)
	Data.Set D:((((Var.VALUE(&__J7_DDR1_SS_BASE)+Var.VALUE(&__DDRSS_Data_Slice_3_REGISTER_BLOCK__OFFS))+Var.VALUE(&__DDRSS_PHY_887__SFR_OFFS)))) %Long Var.VALUE(&__DDRSS1_PHY_887_DATA)
	Data.Set D:((((Var.VALUE(&__J7_DDR1_SS_BASE)+Var.VALUE(&__DDRSS_Data_Slice_3_REGISTER_BLOCK__OFFS))+Var.VALUE(&__DDRSS_PHY_888__SFR_OFFS)))) %Long Var.VALUE(&__DDRSS1_PHY_888_DATA)
	Data.Set D:((((Var.VALUE(&__J7_DDR1_SS_BASE)+Var.VALUE(&__DDRSS_Data_Slice_3_REGISTER_BLOCK__OFFS))+Var.VALUE(&__DDRSS_PHY_889__SFR_OFFS)))) %Long Var.VALUE(&__DDRSS1_PHY_889_DATA)
	Data.Set D:((((Var.VALUE(&__J7_DDR1_SS_BASE)+Var.VALUE(&__DDRSS_Data_Slice_3_REGISTER_BLOCK__OFFS))+Var.VALUE(&__DDRSS_PHY_890__SFR_OFFS)))) %Long Var.VALUE(&__DDRSS1_PHY_890_DATA)
	Data.Set D:((((Var.VALUE(&__J7_DDR1_SS_BASE)+Var.VALUE(&__DDRSS_Data_Slice_3_REGISTER_BLOCK__OFFS))+Var.VALUE(&__DDRSS_PHY_891__SFR_OFFS)))) %Long Var.VALUE(&__DDRSS1_PHY_891_DATA)
	Data.Set D:((((Var.VALUE(&__J7_DDR1_SS_BASE)+Var.VALUE(&__DDRSS_Data_Slice_3_REGISTER_BLOCK__OFFS))+Var.VALUE(&__DDRSS_PHY_892__SFR_OFFS)))) %Long Var.VALUE(&__DDRSS1_PHY_892_DATA)
	Data.Set D:((((Var.VALUE(&__J7_DDR1_SS_BASE)+Var.VALUE(&__DDRSS_Data_Slice_3_REGISTER_BLOCK__OFFS))+Var.VALUE(&__DDRSS_PHY_893__SFR_OFFS)))) %Long Var.VALUE(&__DDRSS1_PHY_893_DATA)
	Data.Set D:((((Var.VALUE(&__J7_DDR1_SS_BASE)+Var.VALUE(&__DDRSS_Data_Slice_3_REGISTER_BLOCK__OFFS))+Var.VALUE(&__DDRSS_PHY_894__SFR_OFFS)))) %Long Var.VALUE(&__DDRSS1_PHY_894_DATA)
	Data.Set D:((((Var.VALUE(&__J7_DDR1_SS_BASE)+Var.VALUE(&__DDRSS_Data_Slice_3_REGISTER_BLOCK__OFFS))+Var.VALUE(&__DDRSS_PHY_895__SFR_OFFS)))) %Long Var.VALUE(&__DDRSS1_PHY_895_DATA)
	Data.Set D:((((Var.VALUE(&__J7_DDR1_SS_BASE)+Var.VALUE(&__DDRSS_Data_Slice_3_REGISTER_BLOCK__OFFS))+Var.VALUE(&__DDRSS_PHY_896__SFR_OFFS)))) %Long Var.VALUE(&__DDRSS1_PHY_896_DATA)
	Data.Set D:((((Var.VALUE(&__J7_DDR1_SS_BASE)+Var.VALUE(&__DDRSS_Data_Slice_3_REGISTER_BLOCK__OFFS))+Var.VALUE(&__DDRSS_PHY_897__SFR_OFFS)))) %Long Var.VALUE(&__DDRSS1_PHY_897_DATA)
	Data.Set D:((((Var.VALUE(&__J7_DDR1_SS_BASE)+Var.VALUE(&__DDRSS_Data_Slice_3_REGISTER_BLOCK__OFFS))+Var.VALUE(&__DDRSS_PHY_898__SFR_OFFS)))) %Long Var.VALUE(&__DDRSS1_PHY_898_DATA)
	Data.Set D:((((Var.VALUE(&__J7_DDR1_SS_BASE)+Var.VALUE(&__DDRSS_Data_Slice_3_REGISTER_BLOCK__OFFS))+Var.VALUE(&__DDRSS_PHY_899__SFR_OFFS)))) %Long Var.VALUE(&__DDRSS1_PHY_899_DATA)
	Data.Set D:((((Var.VALUE(&__J7_DDR1_SS_BASE)+Var.VALUE(&__DDRSS_Data_Slice_3_REGISTER_BLOCK__OFFS))+Var.VALUE(&__DDRSS_PHY_900__SFR_OFFS)))) %Long Var.VALUE(&__DDRSS1_PHY_900_DATA)
	Data.Set D:((((Var.VALUE(&__J7_DDR1_SS_BASE)+Var.VALUE(&__DDRSS_Data_Slice_3_REGISTER_BLOCK__OFFS))+Var.VALUE(&__DDRSS_PHY_901__SFR_OFFS)))) %Long Var.VALUE(&__DDRSS1_PHY_901_DATA)
	Data.Set D:((((Var.VALUE(&__J7_DDR1_SS_BASE)+Var.VALUE(&__DDRSS_Data_Slice_3_REGISTER_BLOCK__OFFS))+Var.VALUE(&__DDRSS_PHY_902__SFR_OFFS)))) %Long Var.VALUE(&__DDRSS1_PHY_902_DATA)
	Data.Set D:((((Var.VALUE(&__J7_DDR1_SS_BASE)+Var.VALUE(&__DDRSS_Data_Slice_3_REGISTER_BLOCK__OFFS))+Var.VALUE(&__DDRSS_PHY_903__SFR_OFFS)))) %Long Var.VALUE(&__DDRSS1_PHY_903_DATA)
	Data.Set D:((((Var.VALUE(&__J7_DDR1_SS_BASE)+Var.VALUE(&__DDRSS_Data_Slice_3_REGISTER_BLOCK__OFFS))+Var.VALUE(&__DDRSS_PHY_904__SFR_OFFS)))) %Long Var.VALUE(&__DDRSS1_PHY_904_DATA)
	Data.Set D:((((Var.VALUE(&__J7_DDR1_SS_BASE)+Var.VALUE(&__DDRSS_Data_Slice_3_REGISTER_BLOCK__OFFS))+Var.VALUE(&__DDRSS_PHY_905__SFR_OFFS)))) %Long Var.VALUE(&__DDRSS1_PHY_905_DATA)
	Data.Set D:((((Var.VALUE(&__J7_DDR1_SS_BASE)+Var.VALUE(&__DDRSS_Data_Slice_3_REGISTER_BLOCK__OFFS))+Var.VALUE(&__DDRSS_PHY_906__SFR_OFFS)))) %Long Var.VALUE(&__DDRSS1_PHY_906_DATA)
	Data.Set D:((((Var.VALUE(&__J7_DDR1_SS_BASE)+Var.VALUE(&__DDRSS_Data_Slice_3_REGISTER_BLOCK__OFFS))+Var.VALUE(&__DDRSS_PHY_907__SFR_OFFS)))) %Long Var.VALUE(&__DDRSS1_PHY_907_DATA)
	Var.NEWLOCAL char[128] \strtmp = "--->>> DDR1 PHY Data Slice 3 programming completed... <<<---\n"
	GOSUB printf Var.String(\strtmp)
	
	Var.NEWLOCAL char[128] \strtmp = "--->>> DDR1 PHY Address slice 0 programming in progress.. <<<---\n"
	GOSUB printf Var.String(\strtmp)
	
	Data.Set D:((((Var.VALUE(&__J7_DDR1_SS_BASE)+Var.VALUE(&__DDRSS_Address_Slice_0_REGISTER_BLOCK__OFFS))+Var.VALUE(&__DDRSS_PHY_1024__SFR_OFFS)))) %Long Var.VALUE(&__DDRSS1_PHY_1024_DATA)
	Data.Set D:((((Var.VALUE(&__J7_DDR1_SS_BASE)+Var.VALUE(&__DDRSS_Address_Slice_0_REGISTER_BLOCK__OFFS))+Var.VALUE(&__DDRSS_PHY_1025__SFR_OFFS)))) %Long Var.VALUE(&__DDRSS1_PHY_1025_DATA)
	Data.Set D:((((Var.VALUE(&__J7_DDR1_SS_BASE)+Var.VALUE(&__DDRSS_Address_Slice_0_REGISTER_BLOCK__OFFS))+Var.VALUE(&__DDRSS_PHY_1026__SFR_OFFS)))) %Long Var.VALUE(&__DDRSS1_PHY_1026_DATA)
	Data.Set D:((((Var.VALUE(&__J7_DDR1_SS_BASE)+Var.VALUE(&__DDRSS_Address_Slice_0_REGISTER_BLOCK__OFFS))+Var.VALUE(&__DDRSS_PHY_1027__SFR_OFFS)))) %Long Var.VALUE(&__DDRSS1_PHY_1027_DATA)
	Data.Set D:((((Var.VALUE(&__J7_DDR1_SS_BASE)+Var.VALUE(&__DDRSS_Address_Slice_0_REGISTER_BLOCK__OFFS))+Var.VALUE(&__DDRSS_PHY_1028__SFR_OFFS)))) %Long Var.VALUE(&__DDRSS1_PHY_1028_DATA)
	Data.Set D:((((Var.VALUE(&__J7_DDR1_SS_BASE)+Var.VALUE(&__DDRSS_Address_Slice_0_REGISTER_BLOCK__OFFS))+Var.VALUE(&__DDRSS_PHY_1029__SFR_OFFS)))) %Long Var.VALUE(&__DDRSS1_PHY_1029_DATA)
	Data.Set D:((((Var.VALUE(&__J7_DDR1_SS_BASE)+Var.VALUE(&__DDRSS_Address_Slice_0_REGISTER_BLOCK__OFFS))+Var.VALUE(&__DDRSS_PHY_1030__SFR_OFFS)))) %Long Var.VALUE(&__DDRSS1_PHY_1030_DATA)
	Data.Set D:((((Var.VALUE(&__J7_DDR1_SS_BASE)+Var.VALUE(&__DDRSS_Address_Slice_0_REGISTER_BLOCK__OFFS))+Var.VALUE(&__DDRSS_PHY_1031__SFR_OFFS)))) %Long Var.VALUE(&__DDRSS1_PHY_1031_DATA)
	Data.Set D:((((Var.VALUE(&__J7_DDR1_SS_BASE)+Var.VALUE(&__DDRSS_Address_Slice_0_REGISTER_BLOCK__OFFS))+Var.VALUE(&__DDRSS_PHY_1032__SFR_OFFS)))) %Long Var.VALUE(&__DDRSS1_PHY_1032_DATA)
	Data.Set D:((((Var.VALUE(&__J7_DDR1_SS_BASE)+Var.VALUE(&__DDRSS_Address_Slice_0_REGISTER_BLOCK__OFFS))+Var.VALUE(&__DDRSS_PHY_1033__SFR_OFFS)))) %Long Var.VALUE(&__DDRSS1_PHY_1033_DATA)
	Data.Set D:((((Var.VALUE(&__J7_DDR1_SS_BASE)+Var.VALUE(&__DDRSS_Address_Slice_0_REGISTER_BLOCK__OFFS))+Var.VALUE(&__DDRSS_PHY_1034__SFR_OFFS)))) %Long Var.VALUE(&__DDRSS1_PHY_1034_DATA)
	Data.Set D:((((Var.VALUE(&__J7_DDR1_SS_BASE)+Var.VALUE(&__DDRSS_Address_Slice_0_REGISTER_BLOCK__OFFS))+Var.VALUE(&__DDRSS_PHY_1035__SFR_OFFS)))) %Long Var.VALUE(&__DDRSS1_PHY_1035_DATA)
	Data.Set D:((((Var.VALUE(&__J7_DDR1_SS_BASE)+Var.VALUE(&__DDRSS_Address_Slice_0_REGISTER_BLOCK__OFFS))+Var.VALUE(&__DDRSS_PHY_1036__SFR_OFFS)))) %Long Var.VALUE(&__DDRSS1_PHY_1036_DATA)
	Data.Set D:((((Var.VALUE(&__J7_DDR1_SS_BASE)+Var.VALUE(&__DDRSS_Address_Slice_0_REGISTER_BLOCK__OFFS))+Var.VALUE(&__DDRSS_PHY_1037__SFR_OFFS)))) %Long Var.VALUE(&__DDRSS1_PHY_1037_DATA)
	Data.Set D:((((Var.VALUE(&__J7_DDR1_SS_BASE)+Var.VALUE(&__DDRSS_Address_Slice_0_REGISTER_BLOCK__OFFS))+Var.VALUE(&__DDRSS_PHY_1038__SFR_OFFS)))) %Long Var.VALUE(&__DDRSS1_PHY_1038_DATA)
	Data.Set D:((((Var.VALUE(&__J7_DDR1_SS_BASE)+Var.VALUE(&__DDRSS_Address_Slice_0_REGISTER_BLOCK__OFFS))+Var.VALUE(&__DDRSS_PHY_1039__SFR_OFFS)))) %Long Var.VALUE(&__DDRSS1_PHY_1039_DATA)
	Data.Set D:((((Var.VALUE(&__J7_DDR1_SS_BASE)+Var.VALUE(&__DDRSS_Address_Slice_0_REGISTER_BLOCK__OFFS))+Var.VALUE(&__DDRSS_PHY_1040__SFR_OFFS)))) %Long Var.VALUE(&__DDRSS1_PHY_1040_DATA)
	Data.Set D:((((Var.VALUE(&__J7_DDR1_SS_BASE)+Var.VALUE(&__DDRSS_Address_Slice_0_REGISTER_BLOCK__OFFS))+Var.VALUE(&__DDRSS_PHY_1041__SFR_OFFS)))) %Long Var.VALUE(&__DDRSS1_PHY_1041_DATA)
	Data.Set D:((((Var.VALUE(&__J7_DDR1_SS_BASE)+Var.VALUE(&__DDRSS_Address_Slice_0_REGISTER_BLOCK__OFFS))+Var.VALUE(&__DDRSS_PHY_1042__SFR_OFFS)))) %Long Var.VALUE(&__DDRSS1_PHY_1042_DATA)
	Data.Set D:((((Var.VALUE(&__J7_DDR1_SS_BASE)+Var.VALUE(&__DDRSS_Address_Slice_0_REGISTER_BLOCK__OFFS))+Var.VALUE(&__DDRSS_PHY_1043__SFR_OFFS)))) %Long Var.VALUE(&__DDRSS1_PHY_1043_DATA)
	Data.Set D:((((Var.VALUE(&__J7_DDR1_SS_BASE)+Var.VALUE(&__DDRSS_Address_Slice_0_REGISTER_BLOCK__OFFS))+Var.VALUE(&__DDRSS_PHY_1044__SFR_OFFS)))) %Long Var.VALUE(&__DDRSS1_PHY_1044_DATA)
	Data.Set D:((((Var.VALUE(&__J7_DDR1_SS_BASE)+Var.VALUE(&__DDRSS_Address_Slice_0_REGISTER_BLOCK__OFFS))+Var.VALUE(&__DDRSS_PHY_1045__SFR_OFFS)))) %Long Var.VALUE(&__DDRSS1_PHY_1045_DATA)
	Data.Set D:((((Var.VALUE(&__J7_DDR1_SS_BASE)+Var.VALUE(&__DDRSS_Address_Slice_0_REGISTER_BLOCK__OFFS))+Var.VALUE(&__DDRSS_PHY_1046__SFR_OFFS)))) %Long Var.VALUE(&__DDRSS1_PHY_1046_DATA)
	Data.Set D:((((Var.VALUE(&__J7_DDR1_SS_BASE)+Var.VALUE(&__DDRSS_Address_Slice_0_REGISTER_BLOCK__OFFS))+Var.VALUE(&__DDRSS_PHY_1047__SFR_OFFS)))) %Long Var.VALUE(&__DDRSS1_PHY_1047_DATA)
	Data.Set D:((((Var.VALUE(&__J7_DDR1_SS_BASE)+Var.VALUE(&__DDRSS_Address_Slice_0_REGISTER_BLOCK__OFFS))+Var.VALUE(&__DDRSS_PHY_1048__SFR_OFFS)))) %Long Var.VALUE(&__DDRSS1_PHY_1048_DATA)
	Data.Set D:((((Var.VALUE(&__J7_DDR1_SS_BASE)+Var.VALUE(&__DDRSS_Address_Slice_0_REGISTER_BLOCK__OFFS))+Var.VALUE(&__DDRSS_PHY_1049__SFR_OFFS)))) %Long Var.VALUE(&__DDRSS1_PHY_1049_DATA)
	Data.Set D:((((Var.VALUE(&__J7_DDR1_SS_BASE)+Var.VALUE(&__DDRSS_Address_Slice_0_REGISTER_BLOCK__OFFS))+Var.VALUE(&__DDRSS_PHY_1050__SFR_OFFS)))) %Long Var.VALUE(&__DDRSS1_PHY_1050_DATA)
	Data.Set D:((((Var.VALUE(&__J7_DDR1_SS_BASE)+Var.VALUE(&__DDRSS_Address_Slice_0_REGISTER_BLOCK__OFFS))+Var.VALUE(&__DDRSS_PHY_1051__SFR_OFFS)))) %Long Var.VALUE(&__DDRSS1_PHY_1051_DATA)
	Data.Set D:((((Var.VALUE(&__J7_DDR1_SS_BASE)+Var.VALUE(&__DDRSS_Address_Slice_0_REGISTER_BLOCK__OFFS))+Var.VALUE(&__DDRSS_PHY_1052__SFR_OFFS)))) %Long Var.VALUE(&__DDRSS1_PHY_1052_DATA)
	Data.Set D:((((Var.VALUE(&__J7_DDR1_SS_BASE)+Var.VALUE(&__DDRSS_Address_Slice_0_REGISTER_BLOCK__OFFS))+Var.VALUE(&__DDRSS_PHY_1053__SFR_OFFS)))) %Long Var.VALUE(&__DDRSS1_PHY_1053_DATA)
	Data.Set D:((((Var.VALUE(&__J7_DDR1_SS_BASE)+Var.VALUE(&__DDRSS_Address_Slice_0_REGISTER_BLOCK__OFFS))+Var.VALUE(&__DDRSS_PHY_1054__SFR_OFFS)))) %Long Var.VALUE(&__DDRSS1_PHY_1054_DATA)
	Data.Set D:((((Var.VALUE(&__J7_DDR1_SS_BASE)+Var.VALUE(&__DDRSS_Address_Slice_0_REGISTER_BLOCK__OFFS))+Var.VALUE(&__DDRSS_PHY_1055__SFR_OFFS)))) %Long Var.VALUE(&__DDRSS1_PHY_1055_DATA)
	Data.Set D:((((Var.VALUE(&__J7_DDR1_SS_BASE)+Var.VALUE(&__DDRSS_Address_Slice_0_REGISTER_BLOCK__OFFS))+Var.VALUE(&__DDRSS_PHY_1056__SFR_OFFS)))) %Long Var.VALUE(&__DDRSS1_PHY_1056_DATA)
	Data.Set D:((((Var.VALUE(&__J7_DDR1_SS_BASE)+Var.VALUE(&__DDRSS_Address_Slice_0_REGISTER_BLOCK__OFFS))+Var.VALUE(&__DDRSS_PHY_1057__SFR_OFFS)))) %Long Var.VALUE(&__DDRSS1_PHY_1057_DATA)
	Data.Set D:((((Var.VALUE(&__J7_DDR1_SS_BASE)+Var.VALUE(&__DDRSS_Address_Slice_0_REGISTER_BLOCK__OFFS))+Var.VALUE(&__DDRSS_PHY_1058__SFR_OFFS)))) %Long Var.VALUE(&__DDRSS1_PHY_1058_DATA)
	Data.Set D:((((Var.VALUE(&__J7_DDR1_SS_BASE)+Var.VALUE(&__DDRSS_Address_Slice_0_REGISTER_BLOCK__OFFS))+Var.VALUE(&__DDRSS_PHY_1059__SFR_OFFS)))) %Long Var.VALUE(&__DDRSS1_PHY_1059_DATA)
	Data.Set D:((((Var.VALUE(&__J7_DDR1_SS_BASE)+Var.VALUE(&__DDRSS_Address_Slice_0_REGISTER_BLOCK__OFFS))+Var.VALUE(&__DDRSS_PHY_1060__SFR_OFFS)))) %Long Var.VALUE(&__DDRSS1_PHY_1060_DATA)
	Data.Set D:((((Var.VALUE(&__J7_DDR1_SS_BASE)+Var.VALUE(&__DDRSS_Address_Slice_0_REGISTER_BLOCK__OFFS))+Var.VALUE(&__DDRSS_PHY_1061__SFR_OFFS)))) %Long Var.VALUE(&__DDRSS1_PHY_1061_DATA)
	Data.Set D:((((Var.VALUE(&__J7_DDR1_SS_BASE)+Var.VALUE(&__DDRSS_Address_Slice_0_REGISTER_BLOCK__OFFS))+Var.VALUE(&__DDRSS_PHY_1062__SFR_OFFS)))) %Long Var.VALUE(&__DDRSS1_PHY_1062_DATA)
	Data.Set D:((((Var.VALUE(&__J7_DDR1_SS_BASE)+Var.VALUE(&__DDRSS_Address_Slice_0_REGISTER_BLOCK__OFFS))+Var.VALUE(&__DDRSS_PHY_1063__SFR_OFFS)))) %Long Var.VALUE(&__DDRSS1_PHY_1063_DATA)
	Data.Set D:((((Var.VALUE(&__J7_DDR1_SS_BASE)+Var.VALUE(&__DDRSS_Address_Slice_0_REGISTER_BLOCK__OFFS))+Var.VALUE(&__DDRSS_PHY_1064__SFR_OFFS)))) %Long Var.VALUE(&__DDRSS1_PHY_1064_DATA)
	Data.Set D:((((Var.VALUE(&__J7_DDR1_SS_BASE)+Var.VALUE(&__DDRSS_Address_Slice_0_REGISTER_BLOCK__OFFS))+Var.VALUE(&__DDRSS_PHY_1065__SFR_OFFS)))) %Long Var.VALUE(&__DDRSS1_PHY_1065_DATA)
	Data.Set D:((((Var.VALUE(&__J7_DDR1_SS_BASE)+Var.VALUE(&__DDRSS_Address_Slice_0_REGISTER_BLOCK__OFFS))+Var.VALUE(&__DDRSS_PHY_1066__SFR_OFFS)))) %Long Var.VALUE(&__DDRSS1_PHY_1066_DATA)
	Data.Set D:((((Var.VALUE(&__J7_DDR1_SS_BASE)+Var.VALUE(&__DDRSS_Address_Slice_0_REGISTER_BLOCK__OFFS))+Var.VALUE(&__DDRSS_PHY_1067__SFR_OFFS)))) %Long Var.VALUE(&__DDRSS1_PHY_1067_DATA)
	Data.Set D:((((Var.VALUE(&__J7_DDR1_SS_BASE)+Var.VALUE(&__DDRSS_Address_Slice_0_REGISTER_BLOCK__OFFS))+Var.VALUE(&__DDRSS_PHY_1068__SFR_OFFS)))) %Long Var.VALUE(&__DDRSS1_PHY_1068_DATA)
	Data.Set D:((((Var.VALUE(&__J7_DDR1_SS_BASE)+Var.VALUE(&__DDRSS_Address_Slice_0_REGISTER_BLOCK__OFFS))+Var.VALUE(&__DDRSS_PHY_1069__SFR_OFFS)))) %Long Var.VALUE(&__DDRSS1_PHY_1069_DATA)
	Data.Set D:((((Var.VALUE(&__J7_DDR1_SS_BASE)+Var.VALUE(&__DDRSS_Address_Slice_0_REGISTER_BLOCK__OFFS))+Var.VALUE(&__DDRSS_PHY_1070__SFR_OFFS)))) %Long Var.VALUE(&__DDRSS1_PHY_1070_DATA)
	Data.Set D:((((Var.VALUE(&__J7_DDR1_SS_BASE)+Var.VALUE(&__DDRSS_Address_Slice_0_REGISTER_BLOCK__OFFS))+Var.VALUE(&__DDRSS_PHY_1071__SFR_OFFS)))) %Long Var.VALUE(&__DDRSS1_PHY_1071_DATA)
	Data.Set D:((((Var.VALUE(&__J7_DDR1_SS_BASE)+Var.VALUE(&__DDRSS_Address_Slice_0_REGISTER_BLOCK__OFFS))+Var.VALUE(&__DDRSS_PHY_1072__SFR_OFFS)))) %Long Var.VALUE(&__DDRSS1_PHY_1072_DATA)
	Data.Set D:((((Var.VALUE(&__J7_DDR1_SS_BASE)+Var.VALUE(&__DDRSS_Address_Slice_0_REGISTER_BLOCK__OFFS))+Var.VALUE(&__DDRSS_PHY_1073__SFR_OFFS)))) %Long Var.VALUE(&__DDRSS1_PHY_1073_DATA)
	Data.Set D:((((Var.VALUE(&__J7_DDR1_SS_BASE)+Var.VALUE(&__DDRSS_Address_Slice_0_REGISTER_BLOCK__OFFS))+Var.VALUE(&__DDRSS_PHY_1074__SFR_OFFS)))) %Long Var.VALUE(&__DDRSS1_PHY_1074_DATA)
	Data.Set D:((((Var.VALUE(&__J7_DDR1_SS_BASE)+Var.VALUE(&__DDRSS_Address_Slice_0_REGISTER_BLOCK__OFFS))+Var.VALUE(&__DDRSS_PHY_1075__SFR_OFFS)))) %Long Var.VALUE(&__DDRSS1_PHY_1075_DATA)
	Var.NEWLOCAL char[128] \strtmp = "--->>> DDR1 PHY Address Slice 0 programming completed... <<<---\n"
	GOSUB printf Var.String(\strtmp)
	
	Var.NEWLOCAL char[128] \strtmp = "--->>> DDR1 PHY programming in progress.. <<<---\n"
	GOSUB printf Var.String(\strtmp)
	
	Data.Set D:((((Var.VALUE(&__J7_DDR1_SS_BASE)+Var.VALUE(&__DDRSS_PHY_Core_REGISTER_BLOCK__OFFS))+Var.VALUE(&__DDRSS_PHY_1280__SFR_OFFS)))) %Long Var.VALUE(&__DDRSS1_PHY_1280_DATA)
	Data.Set D:((((Var.VALUE(&__J7_DDR1_SS_BASE)+Var.VALUE(&__DDRSS_PHY_Core_REGISTER_BLOCK__OFFS))+Var.VALUE(&__DDRSS_PHY_1281__SFR_OFFS)))) %Long Var.VALUE(&__DDRSS1_PHY_1281_DATA)
	Data.Set D:((((Var.VALUE(&__J7_DDR1_SS_BASE)+Var.VALUE(&__DDRSS_PHY_Core_REGISTER_BLOCK__OFFS))+Var.VALUE(&__DDRSS_PHY_1282__SFR_OFFS)))) %Long Var.VALUE(&__DDRSS1_PHY_1282_DATA)
	Data.Set D:((((Var.VALUE(&__J7_DDR1_SS_BASE)+Var.VALUE(&__DDRSS_PHY_Core_REGISTER_BLOCK__OFFS))+Var.VALUE(&__DDRSS_PHY_1283__SFR_OFFS)))) %Long Var.VALUE(&__DDRSS1_PHY_1283_DATA)
	Data.Set D:((((Var.VALUE(&__J7_DDR1_SS_BASE)+Var.VALUE(&__DDRSS_PHY_Core_REGISTER_BLOCK__OFFS))+Var.VALUE(&__DDRSS_PHY_1284__SFR_OFFS)))) %Long Var.VALUE(&__DDRSS1_PHY_1284_DATA)
	Data.Set D:((((Var.VALUE(&__J7_DDR1_SS_BASE)+Var.VALUE(&__DDRSS_PHY_Core_REGISTER_BLOCK__OFFS))+Var.VALUE(&__DDRSS_PHY_1285__SFR_OFFS)))) %Long Var.VALUE(&__DDRSS1_PHY_1285_DATA)
	Data.Set D:((((Var.VALUE(&__J7_DDR1_SS_BASE)+Var.VALUE(&__DDRSS_PHY_Core_REGISTER_BLOCK__OFFS))+Var.VALUE(&__DDRSS_PHY_1286__SFR_OFFS)))) %Long Var.VALUE(&__DDRSS1_PHY_1286_DATA)
	Data.Set D:((((Var.VALUE(&__J7_DDR1_SS_BASE)+Var.VALUE(&__DDRSS_PHY_Core_REGISTER_BLOCK__OFFS))+Var.VALUE(&__DDRSS_PHY_1287__SFR_OFFS)))) %Long Var.VALUE(&__DDRSS1_PHY_1287_DATA)
	Data.Set D:((((Var.VALUE(&__J7_DDR1_SS_BASE)+Var.VALUE(&__DDRSS_PHY_Core_REGISTER_BLOCK__OFFS))+Var.VALUE(&__DDRSS_PHY_1288__SFR_OFFS)))) %Long Var.VALUE(&__DDRSS1_PHY_1288_DATA)
	Data.Set D:((((Var.VALUE(&__J7_DDR1_SS_BASE)+Var.VALUE(&__DDRSS_PHY_Core_REGISTER_BLOCK__OFFS))+Var.VALUE(&__DDRSS_PHY_1289__SFR_OFFS)))) %Long Var.VALUE(&__DDRSS1_PHY_1289_DATA)
	Data.Set D:((((Var.VALUE(&__J7_DDR1_SS_BASE)+Var.VALUE(&__DDRSS_PHY_Core_REGISTER_BLOCK__OFFS))+Var.VALUE(&__DDRSS_PHY_1290__SFR_OFFS)))) %Long Var.VALUE(&__DDRSS1_PHY_1290_DATA)
	Data.Set D:((((Var.VALUE(&__J7_DDR1_SS_BASE)+Var.VALUE(&__DDRSS_PHY_Core_REGISTER_BLOCK__OFFS))+Var.VALUE(&__DDRSS_PHY_1291__SFR_OFFS)))) %Long Var.VALUE(&__DDRSS1_PHY_1291_DATA)
	Data.Set D:((((Var.VALUE(&__J7_DDR1_SS_BASE)+Var.VALUE(&__DDRSS_PHY_Core_REGISTER_BLOCK__OFFS))+Var.VALUE(&__DDRSS_PHY_1292__SFR_OFFS)))) %Long Var.VALUE(&__DDRSS1_PHY_1292_DATA)
	Data.Set D:((((Var.VALUE(&__J7_DDR1_SS_BASE)+Var.VALUE(&__DDRSS_PHY_Core_REGISTER_BLOCK__OFFS))+Var.VALUE(&__DDRSS_PHY_1293__SFR_OFFS)))) %Long Var.VALUE(&__DDRSS1_PHY_1293_DATA)
	Data.Set D:((((Var.VALUE(&__J7_DDR1_SS_BASE)+Var.VALUE(&__DDRSS_PHY_Core_REGISTER_BLOCK__OFFS))+Var.VALUE(&__DDRSS_PHY_1294__SFR_OFFS)))) %Long Var.VALUE(&__DDRSS1_PHY_1294_DATA)
	Data.Set D:((((Var.VALUE(&__J7_DDR1_SS_BASE)+Var.VALUE(&__DDRSS_PHY_Core_REGISTER_BLOCK__OFFS))+Var.VALUE(&__DDRSS_PHY_1295__SFR_OFFS)))) %Long Var.VALUE(&__DDRSS1_PHY_1295_DATA)
	Data.Set D:((((Var.VALUE(&__J7_DDR1_SS_BASE)+Var.VALUE(&__DDRSS_PHY_Core_REGISTER_BLOCK__OFFS))+Var.VALUE(&__DDRSS_PHY_1296__SFR_OFFS)))) %Long Var.VALUE(&__DDRSS1_PHY_1296_DATA)
	Data.Set D:((((Var.VALUE(&__J7_DDR1_SS_BASE)+Var.VALUE(&__DDRSS_PHY_Core_REGISTER_BLOCK__OFFS))+Var.VALUE(&__DDRSS_PHY_1297__SFR_OFFS)))) %Long Var.VALUE(&__DDRSS1_PHY_1297_DATA)
	Data.Set D:((((Var.VALUE(&__J7_DDR1_SS_BASE)+Var.VALUE(&__DDRSS_PHY_Core_REGISTER_BLOCK__OFFS))+Var.VALUE(&__DDRSS_PHY_1298__SFR_OFFS)))) %Long Var.VALUE(&__DDRSS1_PHY_1298_DATA)
	Data.Set D:((((Var.VALUE(&__J7_DDR1_SS_BASE)+Var.VALUE(&__DDRSS_PHY_Core_REGISTER_BLOCK__OFFS))+Var.VALUE(&__DDRSS_PHY_1299__SFR_OFFS)))) %Long Var.VALUE(&__DDRSS1_PHY_1299_DATA)
	Data.Set D:((((Var.VALUE(&__J7_DDR1_SS_BASE)+Var.VALUE(&__DDRSS_PHY_Core_REGISTER_BLOCK__OFFS))+Var.VALUE(&__DDRSS_PHY_1300__SFR_OFFS)))) %Long Var.VALUE(&__DDRSS1_PHY_1300_DATA)
	Data.Set D:((((Var.VALUE(&__J7_DDR1_SS_BASE)+Var.VALUE(&__DDRSS_PHY_Core_REGISTER_BLOCK__OFFS))+Var.VALUE(&__DDRSS_PHY_1301__SFR_OFFS)))) %Long Var.VALUE(&__DDRSS1_PHY_1301_DATA)
	Data.Set D:((((Var.VALUE(&__J7_DDR1_SS_BASE)+Var.VALUE(&__DDRSS_PHY_Core_REGISTER_BLOCK__OFFS))+Var.VALUE(&__DDRSS_PHY_1302__SFR_OFFS)))) %Long Var.VALUE(&__DDRSS1_PHY_1302_DATA)
	Data.Set D:((((Var.VALUE(&__J7_DDR1_SS_BASE)+Var.VALUE(&__DDRSS_PHY_Core_REGISTER_BLOCK__OFFS))+Var.VALUE(&__DDRSS_PHY_1303__SFR_OFFS)))) %Long Var.VALUE(&__DDRSS1_PHY_1303_DATA)
	Data.Set D:((((Var.VALUE(&__J7_DDR1_SS_BASE)+Var.VALUE(&__DDRSS_PHY_Core_REGISTER_BLOCK__OFFS))+Var.VALUE(&__DDRSS_PHY_1304__SFR_OFFS)))) %Long Var.VALUE(&__DDRSS1_PHY_1304_DATA)
	Data.Set D:((((Var.VALUE(&__J7_DDR1_SS_BASE)+Var.VALUE(&__DDRSS_PHY_Core_REGISTER_BLOCK__OFFS))+Var.VALUE(&__DDRSS_PHY_1305__SFR_OFFS)))) %Long Var.VALUE(&__DDRSS1_PHY_1305_DATA)
	Data.Set D:((((Var.VALUE(&__J7_DDR1_SS_BASE)+Var.VALUE(&__DDRSS_PHY_Core_REGISTER_BLOCK__OFFS))+Var.VALUE(&__DDRSS_PHY_1306__SFR_OFFS)))) %Long Var.VALUE(&__DDRSS1_PHY_1306_DATA)
	Data.Set D:((((Var.VALUE(&__J7_DDR1_SS_BASE)+Var.VALUE(&__DDRSS_PHY_Core_REGISTER_BLOCK__OFFS))+Var.VALUE(&__DDRSS_PHY_1307__SFR_OFFS)))) %Long Var.VALUE(&__DDRSS1_PHY_1307_DATA)
	Data.Set D:((((Var.VALUE(&__J7_DDR1_SS_BASE)+Var.VALUE(&__DDRSS_PHY_Core_REGISTER_BLOCK__OFFS))+Var.VALUE(&__DDRSS_PHY_1308__SFR_OFFS)))) %Long Var.VALUE(&__DDRSS1_PHY_1308_DATA)
	Data.Set D:((((Var.VALUE(&__J7_DDR1_SS_BASE)+Var.VALUE(&__DDRSS_PHY_Core_REGISTER_BLOCK__OFFS))+Var.VALUE(&__DDRSS_PHY_1309__SFR_OFFS)))) %Long Var.VALUE(&__DDRSS1_PHY_1309_DATA)
	Data.Set D:((((Var.VALUE(&__J7_DDR1_SS_BASE)+Var.VALUE(&__DDRSS_PHY_Core_REGISTER_BLOCK__OFFS))+Var.VALUE(&__DDRSS_PHY_1310__SFR_OFFS)))) %Long Var.VALUE(&__DDRSS1_PHY_1310_DATA)
	Data.Set D:((((Var.VALUE(&__J7_DDR1_SS_BASE)+Var.VALUE(&__DDRSS_PHY_Core_REGISTER_BLOCK__OFFS))+Var.VALUE(&__DDRSS_PHY_1311__SFR_OFFS)))) %Long Var.VALUE(&__DDRSS1_PHY_1311_DATA)
	Data.Set D:((((Var.VALUE(&__J7_DDR1_SS_BASE)+Var.VALUE(&__DDRSS_PHY_Core_REGISTER_BLOCK__OFFS))+Var.VALUE(&__DDRSS_PHY_1312__SFR_OFFS)))) %Long Var.VALUE(&__DDRSS1_PHY_1312_DATA)
	Data.Set D:((((Var.VALUE(&__J7_DDR1_SS_BASE)+Var.VALUE(&__DDRSS_PHY_Core_REGISTER_BLOCK__OFFS))+Var.VALUE(&__DDRSS_PHY_1313__SFR_OFFS)))) %Long Var.VALUE(&__DDRSS1_PHY_1313_DATA)
	Data.Set D:((((Var.VALUE(&__J7_DDR1_SS_BASE)+Var.VALUE(&__DDRSS_PHY_Core_REGISTER_BLOCK__OFFS))+Var.VALUE(&__DDRSS_PHY_1314__SFR_OFFS)))) %Long Var.VALUE(&__DDRSS1_PHY_1314_DATA)
	Data.Set D:((((Var.VALUE(&__J7_DDR1_SS_BASE)+Var.VALUE(&__DDRSS_PHY_Core_REGISTER_BLOCK__OFFS))+Var.VALUE(&__DDRSS_PHY_1315__SFR_OFFS)))) %Long Var.VALUE(&__DDRSS1_PHY_1315_DATA)
	Data.Set D:((((Var.VALUE(&__J7_DDR1_SS_BASE)+Var.VALUE(&__DDRSS_PHY_Core_REGISTER_BLOCK__OFFS))+Var.VALUE(&__DDRSS_PHY_1316__SFR_OFFS)))) %Long Var.VALUE(&__DDRSS1_PHY_1316_DATA)
	Data.Set D:((((Var.VALUE(&__J7_DDR1_SS_BASE)+Var.VALUE(&__DDRSS_PHY_Core_REGISTER_BLOCK__OFFS))+Var.VALUE(&__DDRSS_PHY_1317__SFR_OFFS)))) %Long Var.VALUE(&__DDRSS1_PHY_1317_DATA)
	Data.Set D:((((Var.VALUE(&__J7_DDR1_SS_BASE)+Var.VALUE(&__DDRSS_PHY_Core_REGISTER_BLOCK__OFFS))+Var.VALUE(&__DDRSS_PHY_1318__SFR_OFFS)))) %Long Var.VALUE(&__DDRSS1_PHY_1318_DATA)
	Data.Set D:((((Var.VALUE(&__J7_DDR1_SS_BASE)+Var.VALUE(&__DDRSS_PHY_Core_REGISTER_BLOCK__OFFS))+Var.VALUE(&__DDRSS_PHY_1319__SFR_OFFS)))) %Long Var.VALUE(&__DDRSS1_PHY_1319_DATA)
	Data.Set D:((((Var.VALUE(&__J7_DDR1_SS_BASE)+Var.VALUE(&__DDRSS_PHY_Core_REGISTER_BLOCK__OFFS))+Var.VALUE(&__DDRSS_PHY_1320__SFR_OFFS)))) %Long Var.VALUE(&__DDRSS1_PHY_1320_DATA)
	Data.Set D:((((Var.VALUE(&__J7_DDR1_SS_BASE)+Var.VALUE(&__DDRSS_PHY_Core_REGISTER_BLOCK__OFFS))+Var.VALUE(&__DDRSS_PHY_1321__SFR_OFFS)))) %Long Var.VALUE(&__DDRSS1_PHY_1321_DATA)
	Data.Set D:((((Var.VALUE(&__J7_DDR1_SS_BASE)+Var.VALUE(&__DDRSS_PHY_Core_REGISTER_BLOCK__OFFS))+Var.VALUE(&__DDRSS_PHY_1322__SFR_OFFS)))) %Long Var.VALUE(&__DDRSS1_PHY_1322_DATA)
	Data.Set D:((((Var.VALUE(&__J7_DDR1_SS_BASE)+Var.VALUE(&__DDRSS_PHY_Core_REGISTER_BLOCK__OFFS))+Var.VALUE(&__DDRSS_PHY_1323__SFR_OFFS)))) %Long Var.VALUE(&__DDRSS1_PHY_1323_DATA)
	Data.Set D:((((Var.VALUE(&__J7_DDR1_SS_BASE)+Var.VALUE(&__DDRSS_PHY_Core_REGISTER_BLOCK__OFFS))+Var.VALUE(&__DDRSS_PHY_1324__SFR_OFFS)))) %Long Var.VALUE(&__DDRSS1_PHY_1324_DATA)
	Data.Set D:((((Var.VALUE(&__J7_DDR1_SS_BASE)+Var.VALUE(&__DDRSS_PHY_Core_REGISTER_BLOCK__OFFS))+Var.VALUE(&__DDRSS_PHY_1325__SFR_OFFS)))) %Long Var.VALUE(&__DDRSS1_PHY_1325_DATA)
	Data.Set D:((((Var.VALUE(&__J7_DDR1_SS_BASE)+Var.VALUE(&__DDRSS_PHY_Core_REGISTER_BLOCK__OFFS))+Var.VALUE(&__DDRSS_PHY_1326__SFR_OFFS)))) %Long Var.VALUE(&__DDRSS1_PHY_1326_DATA)
	Data.Set D:((((Var.VALUE(&__J7_DDR1_SS_BASE)+Var.VALUE(&__DDRSS_PHY_Core_REGISTER_BLOCK__OFFS))+Var.VALUE(&__DDRSS_PHY_1327__SFR_OFFS)))) %Long Var.VALUE(&__DDRSS1_PHY_1327_DATA)
	Data.Set D:((((Var.VALUE(&__J7_DDR1_SS_BASE)+Var.VALUE(&__DDRSS_PHY_Core_REGISTER_BLOCK__OFFS))+Var.VALUE(&__DDRSS_PHY_1328__SFR_OFFS)))) %Long Var.VALUE(&__DDRSS1_PHY_1328_DATA)
	Data.Set D:((((Var.VALUE(&__J7_DDR1_SS_BASE)+Var.VALUE(&__DDRSS_PHY_Core_REGISTER_BLOCK__OFFS))+Var.VALUE(&__DDRSS_PHY_1329__SFR_OFFS)))) %Long Var.VALUE(&__DDRSS1_PHY_1329_DATA)
	Data.Set D:((((Var.VALUE(&__J7_DDR1_SS_BASE)+Var.VALUE(&__DDRSS_PHY_Core_REGISTER_BLOCK__OFFS))+Var.VALUE(&__DDRSS_PHY_1330__SFR_OFFS)))) %Long Var.VALUE(&__DDRSS1_PHY_1330_DATA)
	Data.Set D:((((Var.VALUE(&__J7_DDR1_SS_BASE)+Var.VALUE(&__DDRSS_PHY_Core_REGISTER_BLOCK__OFFS))+Var.VALUE(&__DDRSS_PHY_1331__SFR_OFFS)))) %Long Var.VALUE(&__DDRSS1_PHY_1331_DATA)
	Data.Set D:((((Var.VALUE(&__J7_DDR1_SS_BASE)+Var.VALUE(&__DDRSS_PHY_Core_REGISTER_BLOCK__OFFS))+Var.VALUE(&__DDRSS_PHY_1332__SFR_OFFS)))) %Long Var.VALUE(&__DDRSS1_PHY_1332_DATA)
	Data.Set D:((((Var.VALUE(&__J7_DDR1_SS_BASE)+Var.VALUE(&__DDRSS_PHY_Core_REGISTER_BLOCK__OFFS))+Var.VALUE(&__DDRSS_PHY_1333__SFR_OFFS)))) %Long Var.VALUE(&__DDRSS1_PHY_1333_DATA)
	Data.Set D:((((Var.VALUE(&__J7_DDR1_SS_BASE)+Var.VALUE(&__DDRSS_PHY_Core_REGISTER_BLOCK__OFFS))+Var.VALUE(&__DDRSS_PHY_1334__SFR_OFFS)))) %Long Var.VALUE(&__DDRSS1_PHY_1334_DATA)
	Data.Set D:((((Var.VALUE(&__J7_DDR1_SS_BASE)+Var.VALUE(&__DDRSS_PHY_Core_REGISTER_BLOCK__OFFS))+Var.VALUE(&__DDRSS_PHY_1335__SFR_OFFS)))) %Long Var.VALUE(&__DDRSS1_PHY_1335_DATA)
	Data.Set D:((((Var.VALUE(&__J7_DDR1_SS_BASE)+Var.VALUE(&__DDRSS_PHY_Core_REGISTER_BLOCK__OFFS))+Var.VALUE(&__DDRSS_PHY_1336__SFR_OFFS)))) %Long Var.VALUE(&__DDRSS1_PHY_1336_DATA)
	Data.Set D:((((Var.VALUE(&__J7_DDR1_SS_BASE)+Var.VALUE(&__DDRSS_PHY_Core_REGISTER_BLOCK__OFFS))+Var.VALUE(&__DDRSS_PHY_1337__SFR_OFFS)))) %Long Var.VALUE(&__DDRSS1_PHY_1337_DATA)
	Data.Set D:((((Var.VALUE(&__J7_DDR1_SS_BASE)+Var.VALUE(&__DDRSS_PHY_Core_REGISTER_BLOCK__OFFS))+Var.VALUE(&__DDRSS_PHY_1338__SFR_OFFS)))) %Long Var.VALUE(&__DDRSS1_PHY_1338_DATA)
	Data.Set D:((((Var.VALUE(&__J7_DDR1_SS_BASE)+Var.VALUE(&__DDRSS_PHY_Core_REGISTER_BLOCK__OFFS))+Var.VALUE(&__DDRSS_PHY_1339__SFR_OFFS)))) %Long Var.VALUE(&__DDRSS1_PHY_1339_DATA)
	Data.Set D:((((Var.VALUE(&__J7_DDR1_SS_BASE)+Var.VALUE(&__DDRSS_PHY_Core_REGISTER_BLOCK__OFFS))+Var.VALUE(&__DDRSS_PHY_1340__SFR_OFFS)))) %Long Var.VALUE(&__DDRSS1_PHY_1340_DATA)
	Data.Set D:((((Var.VALUE(&__J7_DDR1_SS_BASE)+Var.VALUE(&__DDRSS_PHY_Core_REGISTER_BLOCK__OFFS))+Var.VALUE(&__DDRSS_PHY_1341__SFR_OFFS)))) %Long Var.VALUE(&__DDRSS1_PHY_1341_DATA)
	Data.Set D:((((Var.VALUE(&__J7_DDR1_SS_BASE)+Var.VALUE(&__DDRSS_PHY_Core_REGISTER_BLOCK__OFFS))+Var.VALUE(&__DDRSS_PHY_1342__SFR_OFFS)))) %Long Var.VALUE(&__DDRSS1_PHY_1342_DATA)
	Data.Set D:((((Var.VALUE(&__J7_DDR1_SS_BASE)+Var.VALUE(&__DDRSS_PHY_Core_REGISTER_BLOCK__OFFS))+Var.VALUE(&__DDRSS_PHY_1343__SFR_OFFS)))) %Long Var.VALUE(&__DDRSS1_PHY_1343_DATA)
	Data.Set D:((((Var.VALUE(&__J7_DDR1_SS_BASE)+Var.VALUE(&__DDRSS_PHY_Core_REGISTER_BLOCK__OFFS))+Var.VALUE(&__DDRSS_PHY_1344__SFR_OFFS)))) %Long Var.VALUE(&__DDRSS1_PHY_1344_DATA)
	Data.Set D:((((Var.VALUE(&__J7_DDR1_SS_BASE)+Var.VALUE(&__DDRSS_PHY_Core_REGISTER_BLOCK__OFFS))+Var.VALUE(&__DDRSS_PHY_1345__SFR_OFFS)))) %Long Var.VALUE(&__DDRSS1_PHY_1345_DATA)
	Data.Set D:((((Var.VALUE(&__J7_DDR1_SS_BASE)+Var.VALUE(&__DDRSS_PHY_Core_REGISTER_BLOCK__OFFS))+Var.VALUE(&__DDRSS_PHY_1346__SFR_OFFS)))) %Long Var.VALUE(&__DDRSS1_PHY_1346_DATA)
	Data.Set D:((((Var.VALUE(&__J7_DDR1_SS_BASE)+Var.VALUE(&__DDRSS_PHY_Core_REGISTER_BLOCK__OFFS))+Var.VALUE(&__DDRSS_PHY_1347__SFR_OFFS)))) %Long Var.VALUE(&__DDRSS1_PHY_1347_DATA)
	Data.Set D:((((Var.VALUE(&__J7_DDR1_SS_BASE)+Var.VALUE(&__DDRSS_PHY_Core_REGISTER_BLOCK__OFFS))+Var.VALUE(&__DDRSS_PHY_1348__SFR_OFFS)))) %Long Var.VALUE(&__DDRSS1_PHY_1348_DATA)
	Data.Set D:((((Var.VALUE(&__J7_DDR1_SS_BASE)+Var.VALUE(&__DDRSS_PHY_Core_REGISTER_BLOCK__OFFS))+Var.VALUE(&__DDRSS_PHY_1349__SFR_OFFS)))) %Long Var.VALUE(&__DDRSS1_PHY_1349_DATA)
	Data.Set D:((((Var.VALUE(&__J7_DDR1_SS_BASE)+Var.VALUE(&__DDRSS_PHY_Core_REGISTER_BLOCK__OFFS))+Var.VALUE(&__DDRSS_PHY_1350__SFR_OFFS)))) %Long Var.VALUE(&__DDRSS1_PHY_1350_DATA)
	Data.Set D:((((Var.VALUE(&__J7_DDR1_SS_BASE)+Var.VALUE(&__DDRSS_PHY_Core_REGISTER_BLOCK__OFFS))+Var.VALUE(&__DDRSS_PHY_1351__SFR_OFFS)))) %Long Var.VALUE(&__DDRSS1_PHY_1351_DATA)
	Data.Set D:((((Var.VALUE(&__J7_DDR1_SS_BASE)+Var.VALUE(&__DDRSS_PHY_Core_REGISTER_BLOCK__OFFS))+Var.VALUE(&__DDRSS_PHY_1352__SFR_OFFS)))) %Long Var.VALUE(&__DDRSS1_PHY_1352_DATA)
	Data.Set D:((((Var.VALUE(&__J7_DDR1_SS_BASE)+Var.VALUE(&__DDRSS_PHY_Core_REGISTER_BLOCK__OFFS))+Var.VALUE(&__DDRSS_PHY_1353__SFR_OFFS)))) %Long Var.VALUE(&__DDRSS1_PHY_1353_DATA)
	Data.Set D:((((Var.VALUE(&__J7_DDR1_SS_BASE)+Var.VALUE(&__DDRSS_PHY_Core_REGISTER_BLOCK__OFFS))+Var.VALUE(&__DDRSS_PHY_1354__SFR_OFFS)))) %Long Var.VALUE(&__DDRSS1_PHY_1354_DATA)
	Data.Set D:((((Var.VALUE(&__J7_DDR1_SS_BASE)+Var.VALUE(&__DDRSS_PHY_Core_REGISTER_BLOCK__OFFS))+Var.VALUE(&__DDRSS_PHY_1355__SFR_OFFS)))) %Long Var.VALUE(&__DDRSS1_PHY_1355_DATA)
	Data.Set D:((((Var.VALUE(&__J7_DDR1_SS_BASE)+Var.VALUE(&__DDRSS_PHY_Core_REGISTER_BLOCK__OFFS))+Var.VALUE(&__DDRSS_PHY_1356__SFR_OFFS)))) %Long Var.VALUE(&__DDRSS1_PHY_1356_DATA)
	Data.Set D:((((Var.VALUE(&__J7_DDR1_SS_BASE)+Var.VALUE(&__DDRSS_PHY_Core_REGISTER_BLOCK__OFFS))+Var.VALUE(&__DDRSS_PHY_1357__SFR_OFFS)))) %Long Var.VALUE(&__DDRSS1_PHY_1357_DATA)
	Data.Set D:((((Var.VALUE(&__J7_DDR1_SS_BASE)+Var.VALUE(&__DDRSS_PHY_Core_REGISTER_BLOCK__OFFS))+Var.VALUE(&__DDRSS_PHY_1358__SFR_OFFS)))) %Long Var.VALUE(&__DDRSS1_PHY_1358_DATA)
	Data.Set D:((((Var.VALUE(&__J7_DDR1_SS_BASE)+Var.VALUE(&__DDRSS_PHY_Core_REGISTER_BLOCK__OFFS))+Var.VALUE(&__DDRSS_PHY_1359__SFR_OFFS)))) %Long Var.VALUE(&__DDRSS1_PHY_1359_DATA)
	Data.Set D:((((Var.VALUE(&__J7_DDR1_SS_BASE)+Var.VALUE(&__DDRSS_PHY_Core_REGISTER_BLOCK__OFFS))+Var.VALUE(&__DDRSS_PHY_1360__SFR_OFFS)))) %Long Var.VALUE(&__DDRSS1_PHY_1360_DATA)
	Data.Set D:((((Var.VALUE(&__J7_DDR1_SS_BASE)+Var.VALUE(&__DDRSS_PHY_Core_REGISTER_BLOCK__OFFS))+Var.VALUE(&__DDRSS_PHY_1361__SFR_OFFS)))) %Long Var.VALUE(&__DDRSS1_PHY_1361_DATA)
	Data.Set D:((((Var.VALUE(&__J7_DDR1_SS_BASE)+Var.VALUE(&__DDRSS_PHY_Core_REGISTER_BLOCK__OFFS))+Var.VALUE(&__DDRSS_PHY_1362__SFR_OFFS)))) %Long Var.VALUE(&__DDRSS1_PHY_1362_DATA)
	Data.Set D:((((Var.VALUE(&__J7_DDR1_SS_BASE)+Var.VALUE(&__DDRSS_PHY_Core_REGISTER_BLOCK__OFFS))+Var.VALUE(&__DDRSS_PHY_1363__SFR_OFFS)))) %Long Var.VALUE(&__DDRSS1_PHY_1363_DATA)
	Data.Set D:((((Var.VALUE(&__J7_DDR1_SS_BASE)+Var.VALUE(&__DDRSS_PHY_Core_REGISTER_BLOCK__OFFS))+Var.VALUE(&__DDRSS_PHY_1364__SFR_OFFS)))) %Long Var.VALUE(&__DDRSS1_PHY_1364_DATA)
	Data.Set D:((((Var.VALUE(&__J7_DDR1_SS_BASE)+Var.VALUE(&__DDRSS_PHY_Core_REGISTER_BLOCK__OFFS))+Var.VALUE(&__DDRSS_PHY_1365__SFR_OFFS)))) %Long Var.VALUE(&__DDRSS1_PHY_1365_DATA)
	Data.Set D:((((Var.VALUE(&__J7_DDR1_SS_BASE)+Var.VALUE(&__DDRSS_PHY_Core_REGISTER_BLOCK__OFFS))+Var.VALUE(&__DDRSS_PHY_1366__SFR_OFFS)))) %Long Var.VALUE(&__DDRSS1_PHY_1366_DATA)
	Data.Set D:((((Var.VALUE(&__J7_DDR1_SS_BASE)+Var.VALUE(&__DDRSS_PHY_Core_REGISTER_BLOCK__OFFS))+Var.VALUE(&__DDRSS_PHY_1367__SFR_OFFS)))) %Long Var.VALUE(&__DDRSS1_PHY_1367_DATA)
	Data.Set D:((((Var.VALUE(&__J7_DDR1_SS_BASE)+Var.VALUE(&__DDRSS_PHY_Core_REGISTER_BLOCK__OFFS))+Var.VALUE(&__DDRSS_PHY_1368__SFR_OFFS)))) %Long Var.VALUE(&__DDRSS1_PHY_1368_DATA)
	Data.Set D:((((Var.VALUE(&__J7_DDR1_SS_BASE)+Var.VALUE(&__DDRSS_PHY_Core_REGISTER_BLOCK__OFFS))+Var.VALUE(&__DDRSS_PHY_1369__SFR_OFFS)))) %Long Var.VALUE(&__DDRSS1_PHY_1369_DATA)
	Data.Set D:((((Var.VALUE(&__J7_DDR1_SS_BASE)+Var.VALUE(&__DDRSS_PHY_Core_REGISTER_BLOCK__OFFS))+Var.VALUE(&__DDRSS_PHY_1370__SFR_OFFS)))) %Long Var.VALUE(&__DDRSS1_PHY_1370_DATA)
	Data.Set D:((((Var.VALUE(&__J7_DDR1_SS_BASE)+Var.VALUE(&__DDRSS_PHY_Core_REGISTER_BLOCK__OFFS))+Var.VALUE(&__DDRSS_PHY_1371__SFR_OFFS)))) %Long Var.VALUE(&__DDRSS1_PHY_1371_DATA)
	Data.Set D:((((Var.VALUE(&__J7_DDR1_SS_BASE)+Var.VALUE(&__DDRSS_PHY_Core_REGISTER_BLOCK__OFFS))+Var.VALUE(&__DDRSS_PHY_1372__SFR_OFFS)))) %Long Var.VALUE(&__DDRSS1_PHY_1372_DATA)
	Data.Set D:((((Var.VALUE(&__J7_DDR1_SS_BASE)+Var.VALUE(&__DDRSS_PHY_Core_REGISTER_BLOCK__OFFS))+Var.VALUE(&__DDRSS_PHY_1373__SFR_OFFS)))) %Long Var.VALUE(&__DDRSS1_PHY_1373_DATA)
	Data.Set D:((((Var.VALUE(&__J7_DDR1_SS_BASE)+Var.VALUE(&__DDRSS_PHY_Core_REGISTER_BLOCK__OFFS))+Var.VALUE(&__DDRSS_PHY_1374__SFR_OFFS)))) %Long Var.VALUE(&__DDRSS1_PHY_1374_DATA)
	Data.Set D:((((Var.VALUE(&__J7_DDR1_SS_BASE)+Var.VALUE(&__DDRSS_PHY_Core_REGISTER_BLOCK__OFFS))+Var.VALUE(&__DDRSS_PHY_1375__SFR_OFFS)))) %Long Var.VALUE(&__DDRSS1_PHY_1375_DATA)
	Data.Set D:((((Var.VALUE(&__J7_DDR1_SS_BASE)+Var.VALUE(&__DDRSS_PHY_Core_REGISTER_BLOCK__OFFS))+Var.VALUE(&__DDRSS_PHY_1376__SFR_OFFS)))) %Long Var.VALUE(&__DDRSS1_PHY_1376_DATA)
	Data.Set D:((((Var.VALUE(&__J7_DDR1_SS_BASE)+Var.VALUE(&__DDRSS_PHY_Core_REGISTER_BLOCK__OFFS))+Var.VALUE(&__DDRSS_PHY_1377__SFR_OFFS)))) %Long Var.VALUE(&__DDRSS1_PHY_1377_DATA)
	Data.Set D:((((Var.VALUE(&__J7_DDR1_SS_BASE)+Var.VALUE(&__DDRSS_PHY_Core_REGISTER_BLOCK__OFFS))+Var.VALUE(&__DDRSS_PHY_1378__SFR_OFFS)))) %Long Var.VALUE(&__DDRSS1_PHY_1378_DATA)
	Data.Set D:((((Var.VALUE(&__J7_DDR1_SS_BASE)+Var.VALUE(&__DDRSS_PHY_Core_REGISTER_BLOCK__OFFS))+Var.VALUE(&__DDRSS_PHY_1379__SFR_OFFS)))) %Long Var.VALUE(&__DDRSS1_PHY_1379_DATA)
	Data.Set D:((((Var.VALUE(&__J7_DDR1_SS_BASE)+Var.VALUE(&__DDRSS_PHY_Core_REGISTER_BLOCK__OFFS))+Var.VALUE(&__DDRSS_PHY_1380__SFR_OFFS)))) %Long Var.VALUE(&__DDRSS1_PHY_1380_DATA)
	Data.Set D:((((Var.VALUE(&__J7_DDR1_SS_BASE)+Var.VALUE(&__DDRSS_PHY_Core_REGISTER_BLOCK__OFFS))+Var.VALUE(&__DDRSS_PHY_1381__SFR_OFFS)))) %Long Var.VALUE(&__DDRSS1_PHY_1381_DATA)
	Data.Set D:((((Var.VALUE(&__J7_DDR1_SS_BASE)+Var.VALUE(&__DDRSS_PHY_Core_REGISTER_BLOCK__OFFS))+Var.VALUE(&__DDRSS_PHY_1382__SFR_OFFS)))) %Long Var.VALUE(&__DDRSS1_PHY_1382_DATA)
	Data.Set D:((((Var.VALUE(&__J7_DDR1_SS_BASE)+Var.VALUE(&__DDRSS_PHY_Core_REGISTER_BLOCK__OFFS))+Var.VALUE(&__DDRSS_PHY_1383__SFR_OFFS)))) %Long Var.VALUE(&__DDRSS1_PHY_1383_DATA)
	Data.Set D:((((Var.VALUE(&__J7_DDR1_SS_BASE)+Var.VALUE(&__DDRSS_PHY_Core_REGISTER_BLOCK__OFFS))+Var.VALUE(&__DDRSS_PHY_1384__SFR_OFFS)))) %Long Var.VALUE(&__DDRSS1_PHY_1384_DATA)
	Data.Set D:((((Var.VALUE(&__J7_DDR1_SS_BASE)+Var.VALUE(&__DDRSS_PHY_Core_REGISTER_BLOCK__OFFS))+Var.VALUE(&__DDRSS_PHY_1385__SFR_OFFS)))) %Long Var.VALUE(&__DDRSS1_PHY_1385_DATA)
	Data.Set D:((((Var.VALUE(&__J7_DDR1_SS_BASE)+Var.VALUE(&__DDRSS_PHY_Core_REGISTER_BLOCK__OFFS))+Var.VALUE(&__DDRSS_PHY_1386__SFR_OFFS)))) %Long Var.VALUE(&__DDRSS1_PHY_1386_DATA)
	Data.Set D:((((Var.VALUE(&__J7_DDR1_SS_BASE)+Var.VALUE(&__DDRSS_PHY_Core_REGISTER_BLOCK__OFFS))+Var.VALUE(&__DDRSS_PHY_1387__SFR_OFFS)))) %Long Var.VALUE(&__DDRSS1_PHY_1387_DATA)
	Data.Set D:((((Var.VALUE(&__J7_DDR1_SS_BASE)+Var.VALUE(&__DDRSS_PHY_Core_REGISTER_BLOCK__OFFS))+Var.VALUE(&__DDRSS_PHY_1388__SFR_OFFS)))) %Long Var.VALUE(&__DDRSS1_PHY_1388_DATA)
	Data.Set D:((((Var.VALUE(&__J7_DDR1_SS_BASE)+Var.VALUE(&__DDRSS_PHY_Core_REGISTER_BLOCK__OFFS))+Var.VALUE(&__DDRSS_PHY_1389__SFR_OFFS)))) %Long Var.VALUE(&__DDRSS1_PHY_1389_DATA)
	Data.Set D:((((Var.VALUE(&__J7_DDR1_SS_BASE)+Var.VALUE(&__DDRSS_PHY_Core_REGISTER_BLOCK__OFFS))+Var.VALUE(&__DDRSS_PHY_1390__SFR_OFFS)))) %Long Var.VALUE(&__DDRSS1_PHY_1390_DATA)
	Data.Set D:((((Var.VALUE(&__J7_DDR1_SS_BASE)+Var.VALUE(&__DDRSS_PHY_Core_REGISTER_BLOCK__OFFS))+Var.VALUE(&__DDRSS_PHY_1391__SFR_OFFS)))) %Long Var.VALUE(&__DDRSS1_PHY_1391_DATA)
	Data.Set D:((((Var.VALUE(&__J7_DDR1_SS_BASE)+Var.VALUE(&__DDRSS_PHY_Core_REGISTER_BLOCK__OFFS))+Var.VALUE(&__DDRSS_PHY_1392__SFR_OFFS)))) %Long Var.VALUE(&__DDRSS1_PHY_1392_DATA)
	Data.Set D:((((Var.VALUE(&__J7_DDR1_SS_BASE)+Var.VALUE(&__DDRSS_PHY_Core_REGISTER_BLOCK__OFFS))+Var.VALUE(&__DDRSS_PHY_1393__SFR_OFFS)))) %Long Var.VALUE(&__DDRSS1_PHY_1393_DATA)
	Data.Set D:((((Var.VALUE(&__J7_DDR1_SS_BASE)+Var.VALUE(&__DDRSS_PHY_Core_REGISTER_BLOCK__OFFS))+Var.VALUE(&__DDRSS_PHY_1394__SFR_OFFS)))) %Long Var.VALUE(&__DDRSS1_PHY_1394_DATA)
	Data.Set D:((((Var.VALUE(&__J7_DDR1_SS_BASE)+Var.VALUE(&__DDRSS_PHY_Core_REGISTER_BLOCK__OFFS))+Var.VALUE(&__DDRSS_PHY_1395__SFR_OFFS)))) %Long Var.VALUE(&__DDRSS1_PHY_1395_DATA)
	Data.Set D:((((Var.VALUE(&__J7_DDR1_SS_BASE)+Var.VALUE(&__DDRSS_PHY_Core_REGISTER_BLOCK__OFFS))+Var.VALUE(&__DDRSS_PHY_1396__SFR_OFFS)))) %Long Var.VALUE(&__DDRSS1_PHY_1396_DATA)
	Data.Set D:((((Var.VALUE(&__J7_DDR1_SS_BASE)+Var.VALUE(&__DDRSS_PHY_Core_REGISTER_BLOCK__OFFS))+Var.VALUE(&__DDRSS_PHY_1397__SFR_OFFS)))) %Long Var.VALUE(&__DDRSS1_PHY_1397_DATA)
	Data.Set D:((((Var.VALUE(&__J7_DDR1_SS_BASE)+Var.VALUE(&__DDRSS_PHY_Core_REGISTER_BLOCK__OFFS))+Var.VALUE(&__DDRSS_PHY_1398__SFR_OFFS)))) %Long Var.VALUE(&__DDRSS1_PHY_1398_DATA)
	Data.Set D:((((Var.VALUE(&__J7_DDR1_SS_BASE)+Var.VALUE(&__DDRSS_PHY_Core_REGISTER_BLOCK__OFFS))+Var.VALUE(&__DDRSS_PHY_1399__SFR_OFFS)))) %Long Var.VALUE(&__DDRSS1_PHY_1399_DATA)
	Data.Set D:((((Var.VALUE(&__J7_DDR1_SS_BASE)+Var.VALUE(&__DDRSS_PHY_Core_REGISTER_BLOCK__OFFS))+Var.VALUE(&__DDRSS_PHY_1400__SFR_OFFS)))) %Long Var.VALUE(&__DDRSS1_PHY_1400_DATA)
	Data.Set D:((((Var.VALUE(&__J7_DDR1_SS_BASE)+Var.VALUE(&__DDRSS_PHY_Core_REGISTER_BLOCK__OFFS))+Var.VALUE(&__DDRSS_PHY_1401__SFR_OFFS)))) %Long Var.VALUE(&__DDRSS1_PHY_1401_DATA)
	Data.Set D:((((Var.VALUE(&__J7_DDR1_SS_BASE)+Var.VALUE(&__DDRSS_PHY_Core_REGISTER_BLOCK__OFFS))+Var.VALUE(&__DDRSS_PHY_1402__SFR_OFFS)))) %Long Var.VALUE(&__DDRSS1_PHY_1402_DATA)
	Data.Set D:((((Var.VALUE(&__J7_DDR1_SS_BASE)+Var.VALUE(&__DDRSS_PHY_Core_REGISTER_BLOCK__OFFS))+Var.VALUE(&__DDRSS_PHY_1403__SFR_OFFS)))) %Long Var.VALUE(&__DDRSS1_PHY_1403_DATA)
	Data.Set D:((((Var.VALUE(&__J7_DDR1_SS_BASE)+Var.VALUE(&__DDRSS_PHY_Core_REGISTER_BLOCK__OFFS))+Var.VALUE(&__DDRSS_PHY_1404__SFR_OFFS)))) %Long Var.VALUE(&__DDRSS1_PHY_1404_DATA)
	Data.Set D:((((Var.VALUE(&__J7_DDR1_SS_BASE)+Var.VALUE(&__DDRSS_PHY_Core_REGISTER_BLOCK__OFFS))+Var.VALUE(&__DDRSS_PHY_1405__SFR_OFFS)))) %Long Var.VALUE(&__DDRSS1_PHY_1405_DATA)
	Data.Set D:((((Var.VALUE(&__J7_DDR1_SS_BASE)+Var.VALUE(&__DDRSS_PHY_Core_REGISTER_BLOCK__OFFS))+Var.VALUE(&__DDRSS_PHY_1406__SFR_OFFS)))) %Long Var.VALUE(&__DDRSS1_PHY_1406_DATA)
	Data.Set D:((((Var.VALUE(&__J7_DDR1_SS_BASE)+Var.VALUE(&__DDRSS_PHY_Core_REGISTER_BLOCK__OFFS))+Var.VALUE(&__DDRSS_PHY_1407__SFR_OFFS)))) %Long Var.VALUE(&__DDRSS1_PHY_1407_DATA)
	Data.Set D:((((Var.VALUE(&__J7_DDR1_SS_BASE)+Var.VALUE(&__DDRSS_PHY_Core_REGISTER_BLOCK__OFFS))+Var.VALUE(&__DDRSS_PHY_1408__SFR_OFFS)))) %Long Var.VALUE(&__DDRSS1_PHY_1408_DATA)
	Data.Set D:((((Var.VALUE(&__J7_DDR1_SS_BASE)+Var.VALUE(&__DDRSS_PHY_Core_REGISTER_BLOCK__OFFS))+Var.VALUE(&__DDRSS_PHY_1409__SFR_OFFS)))) %Long Var.VALUE(&__DDRSS1_PHY_1409_DATA)
	Data.Set D:((((Var.VALUE(&__J7_DDR1_SS_BASE)+Var.VALUE(&__DDRSS_PHY_Core_REGISTER_BLOCK__OFFS))+Var.VALUE(&__DDRSS_PHY_1410__SFR_OFFS)))) %Long Var.VALUE(&__DDRSS1_PHY_1410_DATA)
	Data.Set D:((((Var.VALUE(&__J7_DDR1_SS_BASE)+Var.VALUE(&__DDRSS_PHY_Core_REGISTER_BLOCK__OFFS))+Var.VALUE(&__DDRSS_PHY_1411__SFR_OFFS)))) %Long Var.VALUE(&__DDRSS1_PHY_1411_DATA)
	Data.Set D:((((Var.VALUE(&__J7_DDR1_SS_BASE)+Var.VALUE(&__DDRSS_PHY_Core_REGISTER_BLOCK__OFFS))+Var.VALUE(&__DDRSS_PHY_1412__SFR_OFFS)))) %Long Var.VALUE(&__DDRSS1_PHY_1412_DATA)
	Data.Set D:((((Var.VALUE(&__J7_DDR1_SS_BASE)+Var.VALUE(&__DDRSS_PHY_Core_REGISTER_BLOCK__OFFS))+Var.VALUE(&__DDRSS_PHY_1413__SFR_OFFS)))) %Long Var.VALUE(&__DDRSS1_PHY_1413_DATA)
	Data.Set D:((((Var.VALUE(&__J7_DDR1_SS_BASE)+Var.VALUE(&__DDRSS_PHY_Core_REGISTER_BLOCK__OFFS))+Var.VALUE(&__DDRSS_PHY_1414__SFR_OFFS)))) %Long Var.VALUE(&__DDRSS1_PHY_1414_DATA)
	Data.Set D:((((Var.VALUE(&__J7_DDR1_SS_BASE)+Var.VALUE(&__DDRSS_PHY_Core_REGISTER_BLOCK__OFFS))+Var.VALUE(&__DDRSS_PHY_1415__SFR_OFFS)))) %Long Var.VALUE(&__DDRSS1_PHY_1415_DATA)
	Data.Set D:((((Var.VALUE(&__J7_DDR1_SS_BASE)+Var.VALUE(&__DDRSS_PHY_Core_REGISTER_BLOCK__OFFS))+Var.VALUE(&__DDRSS_PHY_1416__SFR_OFFS)))) %Long Var.VALUE(&__DDRSS1_PHY_1416_DATA)
	Data.Set D:((((Var.VALUE(&__J7_DDR1_SS_BASE)+Var.VALUE(&__DDRSS_PHY_Core_REGISTER_BLOCK__OFFS))+Var.VALUE(&__DDRSS_PHY_1417__SFR_OFFS)))) %Long Var.VALUE(&__DDRSS1_PHY_1417_DATA)
	Data.Set D:((((Var.VALUE(&__J7_DDR1_SS_BASE)+Var.VALUE(&__DDRSS_PHY_Core_REGISTER_BLOCK__OFFS))+Var.VALUE(&__DDRSS_PHY_1418__SFR_OFFS)))) %Long Var.VALUE(&__DDRSS1_PHY_1418_DATA)
	Data.Set D:((((Var.VALUE(&__J7_DDR1_SS_BASE)+Var.VALUE(&__DDRSS_PHY_Core_REGISTER_BLOCK__OFFS))+Var.VALUE(&__DDRSS_PHY_1419__SFR_OFFS)))) %Long Var.VALUE(&__DDRSS1_PHY_1419_DATA)
	Data.Set D:((((Var.VALUE(&__J7_DDR1_SS_BASE)+Var.VALUE(&__DDRSS_PHY_Core_REGISTER_BLOCK__OFFS))+Var.VALUE(&__DDRSS_PHY_1420__SFR_OFFS)))) %Long Var.VALUE(&__DDRSS1_PHY_1420_DATA)
	Data.Set D:((((Var.VALUE(&__J7_DDR1_SS_BASE)+Var.VALUE(&__DDRSS_PHY_Core_REGISTER_BLOCK__OFFS))+Var.VALUE(&__DDRSS_PHY_1421__SFR_OFFS)))) %Long Var.VALUE(&__DDRSS1_PHY_1421_DATA)
	Data.Set D:((((Var.VALUE(&__J7_DDR1_SS_BASE)+Var.VALUE(&__DDRSS_PHY_Core_REGISTER_BLOCK__OFFS))+Var.VALUE(&__DDRSS_PHY_1422__SFR_OFFS)))) %Long Var.VALUE(&__DDRSS1_PHY_1422_DATA)
	IF (&__PRE_SILICON!=0)
	(
		Var.NEWLOCAL char[128] \strtmp = "--->>> Pre-SILICON SIMULATION: Manual modification by Rajesh... <<<---\n"
		GOSUB printf Var.String(\strtmp)
		
		Data.Set D:(((Var.VALUE(&__J7_DDR1_SS_BASE)+Var.VALUE(&__DDRSS_CTL_139__SFR_OFFS)))) %Long ((Var.VALUE(&__DDRSS1_CTL_139_DATA)&0xFEFFFFFF))
		Data.Set D:(((Var.VALUE(&__J7_DDR1_SS_BASE)+Var.VALUE(&__DDRSS_CTL_140__SFR_OFFS)))) %Long ((Var.VALUE(&__DDRSS1_CTL_140_DATA)&0xFFFFFFFE))
		Data.Set D:(((Var.VALUE(&__J7_DDR1_SS_BASE)+Var.VALUE(&__DDRSS_CTL_148__SFR_OFFS)))) %Long ((Var.VALUE(&__DDRSS1_CTL_148_DATA)&0xFFFFFEFF))
		Data.Set D:(((Var.VALUE(&__J7_DDR1_SS_BASE)+Var.VALUE(&__DDRSS_CTL_227__SFR_OFFS)))) %Long (((Var.VALUE(&__DDRSS1_CTL_227_DATA)&0xFFE0FFFF)|0x00130000))
		Data.Set D:(((Var.VALUE(&__J7_DDR1_SS_BASE)+Var.VALUE(&__DDRSS_CTL_277__SFR_OFFS)))) %Long (((Var.VALUE(&__DDRSS1_CTL_277_DATA)&0xFFE0FFFF)|0x00140000))
		Data.Set D:(((Var.VALUE(&__J7_DDR1_SS_BASE)+Var.VALUE(&__DDRSS_CTL_377__SFR_OFFS)))) %Long ((Var.VALUE(&__DDRSS1_CTL_377_DATA)|0x00010000))
		Data.Set D:(((Var.VALUE(&__J7_DDR1_SS_BASE)+Var.VALUE(&__DDRSS_CTL_430__SFR_OFFS)))) %Long ((Var.VALUE(&__DDRSS1_CTL_430_DATA)&0xFFFEFFFF))
		Var.NEWLOCAL char[128] \strtmp = "--->>> Disable all trainig for pre-silicon simulation <<<---\n"
		GOSUB printf Var.String(\strtmp)
		
		Data.Set D:((((Var.VALUE(&__J7_DDR1_SS_BASE)+Var.VALUE(&__DDRSS_PI_REGISTER_BLOCK__OFFS))+Var.VALUE(&__DDRSS_PI_175__SFR_OFFS)))) %Long Var.VALUE(0x00000404)
		Data.Set D:((((Var.VALUE(&__J7_DDR1_SS_BASE)+Var.VALUE(&__DDRSS_PI_REGISTER_BLOCK__OFFS))+Var.VALUE(&__DDRSS_PI_176__SFR_OFFS)))) %Long Var.VALUE(0x00001500)
		Data.Set D:((((Var.VALUE(&__J7_DDR1_SS_BASE)+Var.VALUE(&__DDRSS_PI_REGISTER_BLOCK__OFFS))+Var.VALUE(&__DDRSS_PI_191__SFR_OFFS)))) %Long Var.VALUE(0x01000000)
		Data.Set D:((((Var.VALUE(&__J7_DDR1_SS_BASE)+Var.VALUE(&__DDRSS_PI_REGISTER_BLOCK__OFFS))+Var.VALUE(&__DDRSS_PI_212__SFR_OFFS)))) %Long Var.VALUE(0x00000001)
		Data.Set D:((((Var.VALUE(&__J7_DDR1_SS_BASE)+Var.VALUE(&__DDRSS_PI_REGISTER_BLOCK__OFFS))+Var.VALUE(&__DDRSS_PI_214__SFR_OFFS)))) %Long Var.VALUE(0x00011E1A)
		Data.Set D:((((Var.VALUE(&__J7_DDR1_SS_BASE)+Var.VALUE(&__DDRSS_PI_REGISTER_BLOCK__OFFS))+Var.VALUE(&__DDRSS_PI_217__SFR_OFFS)))) %Long Var.VALUE(0x09000001)
		Var.NEWLOCAL char[128] \strtmp = "--->>> Adjust the latencies for pre-silicon simulation <<<---\n"
		GOSUB printf Var.String(\strtmp)
		
		Data.Set D:((((Var.VALUE(&__J7_DDR1_SS_BASE)+Var.VALUE(&__DDRSS_Data_Slice_0_REGISTER_BLOCK__OFFS))+Var.VALUE(&__DDRSS_PHY_131__SFR_OFFS)))) %Long Var.VALUE(0x01A00000)
		Data.Set D:((((Var.VALUE(&__J7_DDR1_SS_BASE)+Var.VALUE(&__DDRSS_Data_Slice_1_REGISTER_BLOCK__OFFS))+Var.VALUE(&__DDRSS_PHY_387__SFR_OFFS)))) %Long Var.VALUE(0x01A00000)
		Data.Set D:((((Var.VALUE(&__J7_DDR1_SS_BASE)+Var.VALUE(&__DDRSS_Data_Slice_2_REGISTER_BLOCK__OFFS))+Var.VALUE(&__DDRSS_PHY_643__SFR_OFFS)))) %Long Var.VALUE(0x01A00000)
		Data.Set D:((((Var.VALUE(&__J7_DDR1_SS_BASE)+Var.VALUE(&__DDRSS_Data_Slice_3_REGISTER_BLOCK__OFFS))+Var.VALUE(&__DDRSS_PHY_899__SFR_OFFS)))) %Long Var.VALUE(0x01A00000)
	)
	Var.NEWLOCAL char[128] \strtmp = "--->>> DDR1 PHY programming completed... <<<---\n"
	GOSUB printf Var.String(\strtmp)
	
	RETURN
)

DDRSS0_Set_DDR_PLL:
(
	PRIVATE &__VF0
	ENTRY &__VF0
	
	&__VF0=&__VF0 // evaluation of passed expression 
	
	Var.NEWLOCAL unsigned int \frequency=&__VF0
	Var.IF ((\frequency)==0x3F917FA0)
	(
		DO "&path_J7AEP_PLL_MMR_PARAMS_PLL_cmm" Set_DDR0_PLL_1066MHz
		ENTRY &__V39
	)
	ELSE
	(
		Var.IF ((\frequency)==0x1FC4EF40)
		(
			DO "&path_J7AEP_PLL_MMR_PARAMS_PLL_cmm" Set_DDR0_PLL_533MHz
			ENTRY &__V40
		)
		ELSE
		(
			Var.NEWLOCAL char[128] \strtmp = "Frequency not supported by GEL\n"
			GOSUB printf Var.String(\strtmp)
			
		)
	)
	RETURN
)

DDRSS1_Set_DDR_PLL:
(
	PRIVATE &__VF0
	ENTRY &__VF0
	
	&__VF0=&__VF0 // evaluation of passed expression 
	
	Var.NEWLOCAL unsigned int \frequency=&__VF0
	Var.IF ((\frequency)==0x3F917FA0)
	(
		DO "&path_J7AEP_PLL_MMR_PARAMS_PLL_cmm" Set_DDR1_PLL_1066MHz
		ENTRY &__V42
	)
	ELSE
	(
		Var.IF ((\frequency)==0x1FC4EF40)
		(
			DO "&path_J7AEP_PLL_MMR_PARAMS_PLL_cmm" Set_DDR1_PLL_533MHz
			ENTRY &__V43
		)
		ELSE
		(
			Var.NEWLOCAL char[128] \strtmp = "Frequency not supported by GEL\n"
			GOSUB printf Var.String(\strtmp)
			
		)
	)
	RETURN
)

DDRSS_LPDDR4_Ack_Freq_Upd_Req:
(
	PRIVATE &__VF0
	ENTRY &__VF0
	
	&__VF0=&__VF0 // evaluation of passed expression 
	
	Var.NEWLOCAL unsigned int \ddrss_num=&__VF0
	Var.NEWLOCAL unsigned int \req_type
	Var.NEWLOCAL unsigned int \counter
	Var.NEWLOCAL unsigned int \fsp_clkchng_req_addr
	Var.Assign \fsp_clkchng_req_addr=0x0
	Var.NEWLOCAL unsigned int \fsp_clkchng_ack_addr
	Var.Assign \fsp_clkchng_ack_addr=0x0
	Var.NEWLOCAL unsigned int \ddrss_pll_fhs_cnt
	Var.Assign \ddrss_pll_fhs_cnt=&__DDRSS_PLL_FHS_CNT
	IF (&__PRE_SILICON!=0)
	(
		Var.Assign \ddrss_pll_fhs_cnt=0x2
	)
	Var.IF ((\ddrss_num)==0x0)
	(
		Var.Assign \fsp_clkchng_req_addr=&__CTRLMMR_DDR4_FSP_CLKCHNG_REQ_ADDR0
		Var.Assign \fsp_clkchng_ack_addr=&__CTRLMMR_DDR4_FSP_CLKCHNG_ACK_ADDR0
	)
	ELSE
	(
		Var.IF ((\ddrss_num)==0x1)
		(
			Var.Assign \fsp_clkchng_req_addr=&__CTRLMMR_DDR4_FSP_CLKCHNG_REQ_ADDR1
			Var.Assign \fsp_clkchng_ack_addr=&__CTRLMMR_DDR4_FSP_CLKCHNG_ACK_ADDR1
		)
	)
	// --  GEL_TextOut("Frequency change request addr %x \n",,,,, fsp_clkchng_req_addr);
	// --  GEL_TextOut("Frequency change ack addr %x \n",,,,, fsp_clkchng_ack_addr);
	Var.NEWLOCAL char[128] \strtmp = "--->>> Waiting for frequency change requests ... <<<---\n"
	GOSUB printf Var.String(\strtmp)
	
	Var.Assign \counter=0x0
	WHILE (Var.VALUE(\counter)<Var.VALUE(\ddrss_pll_fhs_cnt))
	(
		// -- wait for freq change request
		// --  while((HW_RD_REG32(fsp_clkchng_req_addr) & 0x80) == 0x0);
		WHILE ((Data.Long(D:((&__M4_RAT_OFFSET+(Var.VALUE(\fsp_clkchng_req_addr)))))&0x80)==0x0)
		(
		)
		Var.Assign \req_type=(\Data_Long(((&__M4_RAT_OFFSET+(\fsp_clkchng_req_addr))))&0x03)
		AREA.Select
		PRINT "Frequency change request type " %DECIMAL Var.VALUE(\req_type) " received from controller "
		PRINT ""
		Var.IF ((\req_type)==0x1)
		(
			Var.IF ((\ddrss_num)==0x0)
			(
				GOSUB DDRSS0_Set_DDR_PLL &__DDRSS_PLL_FREQUENCY_1
			)
			ELSE
			(
				Var.IF ((\ddrss_num)==0x1)
				(
					GOSUB DDRSS1_Set_DDR_PLL &__DDRSS_PLL_FREQUENCY_1
				)
			)
		)
		ELSE
		(
			Var.IF ((\req_type)==0x2)
			(
				Var.IF ((\ddrss_num)==0x0)
				(
					GOSUB DDRSS0_Set_DDR_PLL &__DDRSS_PLL_FREQUENCY_2
				)
				ELSE
				(
					Var.IF ((\ddrss_num)==0x1)
					(
						GOSUB DDRSS1_Set_DDR_PLL &__DDRSS_PLL_FREQUENCY_2
					)
				)
			)
			ELSE
			(
				Var.IF ((\req_type)==0x0)
				(
					Var.IF ((\ddrss_num)==0x0)
					(
						DO "&path_J7AEP_PLL_MMR_PARAMS_PLL_cmm" Set_DDR0_PLL_EXTBYPASS
						ENTRY &__V51
					)
					ELSE
					(
						Var.IF ((\ddrss_num)==0x1)
						(
							DO "&path_J7AEP_PLL_MMR_PARAMS_PLL_cmm" Set_DDR1_PLL_EXTBYPASS
							ENTRY &__V52
						)
					)
				)
				ELSE
				(
					AREA.Select
					PRINT "error"
					PRINT ""
				)
			)
		)
		// --  acknowledge freq change request
		Data.Set D:(((Var.VALUE(&__M4_RAT_OFFSET)+(Var.VALUE(\fsp_clkchng_ack_addr))))) %Long Var.VALUE(0x1)
		WHILE ((Data.Long(D:((&__M4_RAT_OFFSET+(Var.VALUE(\fsp_clkchng_req_addr)))))&0x80)==0x80)
		(
		)
		// --  clear acknowledge
		Data.Set D:(((Var.VALUE(&__M4_RAT_OFFSET)+(Var.VALUE(\fsp_clkchng_ack_addr))))) %Long Var.VALUE(0x0)
		Var.Assign \counter=\counter+1
	)
	Var.NEWLOCAL char[128] \strtmp = "--->>> All frequency change requests have completed... <<<---\n"
	GOSUB printf Var.String(\strtmp)
	
	RETURN
)
// --  hotmenu J7_LPDDR4_Config(void)

J7_LPDDR4_Config_Single:
(
	PRIVATE &__VF0
	ENTRY &__VF0
	
	&__VF0=&__VF0 // evaluation of passed expression 
	
	Var.NEWLOCAL unsigned int \ddrss_num=&__VF0
	Var.NEWLOCAL unsigned int \j7_ddr_ss_base
	Var.Assign \j7_ddr_ss_base=0x0
	Var.NEWLOCAL char[128] \strtmp = "--->>> LPDDR4 Initialization is in progress ... <<<---\n"
	GOSUB printf Var.String(\strtmp)
	
	Data.Set D:(((Var.VALUE(&__M4_RAT_OFFSET)+Var.VALUE(&__CTRLMMR_LOCK5_KICK0)))) %Long Var.VALUE(&__CTRLMMR_LOCK5_KICK0_KEY)
	Data.Set D:(((Var.VALUE(&__M4_RAT_OFFSET)+Var.VALUE(&__CTRLMMR_LOCK5_KICK1)))) %Long Var.VALUE(&__CTRLMMR_LOCK5_KICK1_KEY)
	IF (&__PRE_SILICON==0)
	(
		// --  Start with PLL in bypass mode 
		Var.IF ((\ddrss_num)==0x0)
		(
			DO "&path_J7AEP_PLL_MMR_PARAMS_PLL_cmm" Set_DDR0_PLL_EXTBYPASS
			ENTRY &__V55
		)
		ELSE
		(
			Var.IF ((\ddrss_num)==0x1)
			(
				DO "&path_J7AEP_PLL_MMR_PARAMS_PLL_cmm" Set_DDR1_PLL_EXTBYPASS
				ENTRY &__V56
			)
		)
	)
	Var.IF ((\ddrss_num)==0x0)
	(
		GOSUB DDRSS0_Register_Init
	)
	ELSE
	(
		Var.IF ((\ddrss_num)==0x1)
		(
			GOSUB DDRSS1_Register_Init
		)
	)
	Var.IF ((\ddrss_num)==0x0)
	(
		Var.Assign \j7_ddr_ss_base=&__J7_DDR0_SS_BASE
	)
	ELSE
	(
		Var.IF ((\ddrss_num)==0x1)
		(
			Var.Assign \j7_ddr_ss_base=&__J7_DDR1_SS_BASE
		)
	)
	// -- Trigger the DDR PI start bit
	Data.Set D:((((Var.VALUE(\j7_ddr_ss_base)+Var.VALUE(&__DDRSS_PI_REGISTER_BLOCK__OFFS))+Var.VALUE(&__DDRSS_PI_0__SFR_OFFS)))) %Long Var.VALUE(0x00000B01)
	Var.NEWLOCAL char[128] \strtmp = "--->>> DDR PI initialization started... <<<---\n"
	GOSUB printf Var.String(\strtmp)
	
	Data.Set D:(((Var.VALUE(\j7_ddr_ss_base)+Var.VALUE(&__DDRSS_CTL_0__SFR_OFFS)))) %Long Var.VALUE(0x00000B01)
	Var.NEWLOCAL char[128] \strtmp = "--->>> DDR Controller initialization started... <<<---\n"
	GOSUB printf Var.String(\strtmp)
	
	GOSUB DDRSS_LPDDR4_Ack_Freq_Upd_Req Var.VALUE(\ddrss_num)
	WHILE ((Data.Long(D:(((Var.VALUE(\j7_ddr_ss_base)+&__DDRSS_PI_REGISTER_BLOCK__OFFS)+&__DDRSS_PI_79__SFR_OFFS)))&0x1)!=0x1)
	(
	)
	Data.Set D:((((Var.VALUE(\j7_ddr_ss_base)+Var.VALUE(&__DDRSS_PI_REGISTER_BLOCK__OFFS))+Var.VALUE(&__DDRSS_PI_80__SFR_OFFS)))) %Long Var.VALUE(0x1)
//	WHILE (Data.Long(D:((Var.VALUE(\j7_ddr_ss_base)+&__DDRSS_CTL_293__SFR_OFFS)))!=0x200)
        IF (Data.Long(D:((Var.VALUE(\j7_ddr_ss_base)+&__DDRSS_CTL_293__SFR_OFFS)))!=0x200)	
        (
	   // Not needed for bare metal tests.  PDK board files have a conflict yet to be wroked out.
           wait 30.mS
        )
        
	Data.Set D:(((Var.VALUE(\j7_ddr_ss_base)+Var.VALUE(&__DDRSS_CTL_295__SFR_OFFS)))) %Long Var.VALUE(0x200)
	Var.NEWLOCAL char[128] \strtmp = "--->>> LPDDR4 Initialization is DONE! <<<---\n"
	GOSUB printf Var.String(\strtmp)
	
	RETURN
)
// --  J7_LPDDR4_DDR_0_Config(void)
// --  {
// --      J7_LPDDR4_Config_Single(0);
// --  }
// --  J7_LPDDR4_DDR_1_Config(void)
// --  {
// --      J7_LPDDR4_Config_Single(1);
// --  }
// --  J7_LPDDR4_DDR_0_1_Config(void)
// --  {
// --      J7_LPDDR4_Config_Single(0);
// --      J7_LPDDR4_Config_Single(1);
// --  }

Load_2132_Config:
(
	// --  GEL_UnloadGel("$(GEL_file_dir)/J721S2-DDR-EVM-LP4-4266.gel");
	// --  GEL_LoadGel("$(GEL_file_dir)/J721S2-DDR-EVM-LP4-2132.gel");
	// --  GEL_UnloadGel("$(GEL_file_dir)/J7_DDR_Config.gel");
	// --  GEL_LoadGel("$(GEL_file_dir)/J7_DDR_Config.gel");
	RETURN
)

Load_4266_Config:
(
	// --  GEL_UnloadGel("$(GEL_file_dir)/J721S2-DDR-EVM-LP4-2133.gel");
	// --  GEL_LoadGel("$(GEL_file_dir)/J721S2-DDR-EVM-LP4-4266.gel");
	// --  GEL_UnloadGel("$(GEL_file_dir)/J7_DDR_Config.gel");
	// --  GEL_LoadGel("$(GEL_file_dir)/J7_DDR_Config.gel");
	RETURN
)
// -- /////////////////////////////////////////////////////////////////////////////
// --  MULTI_DDR_CFG0
// --  [29:24]: ddr_intrlv_gran
// --  [21:16]: ddr_intrlv_size
// --  [ 4: 0]: heartbeat_per
// -- /////////////////////////////////////////////////////////////////////////////
// --  MULTI_DDR_CFG0
// --  [19:16]: ecc_enable
// --  [12: 8]: hybrid_select
// --  [ 3: 0]: emifs_active, 0x1: EMIF0 active, 0x2: EMIF1 active, 0x3: EMIF0,1 active
// -- /////////////////////////////////////////////////////////////////////////////
// --  DDR_CFG_LOAD
// -- [31:28]: ddr_cfgg_load, when set to 4b'0110
// -- [ 0: 0]: ddr_load_stat
// -- /////////////////////////////////////////////////////////////////////////////

Set_DDR_Interleave_Config:
(
	PRIVATE &__VF0 &__VF1
	ENTRY &__VF0 &__VF1
	
	&__VF0=&__VF0 // evaluation of passed expressions 
	&__VF1=&__VF1
	
	Var.NEWLOCAL unsigned int \multi_ddr_cfg0_val=&__VF0
	Var.NEWLOCAL unsigned int \multi_ddr_cfg1_val=&__VF1
	// -- unlock MMR reg 5
	// -- Partition5 lockkey0
	Data.Set D:(((Var.VALUE(&__M4_RAT_OFFSET)+0x115008))) %Long Var.VALUE(0x68EF3490)
	Data.Set D:(((Var.VALUE(&__M4_RAT_OFFSET)+0x11500C))) %Long Var.VALUE(0xD172BC5A)
	IF ((Data.Long(D:((&__M4_RAT_OFFSET+&__DDR_CFG_LOAD)))&0x1)!=0)
	(
		PRINT "--->>> ----------------------------------------------------------- <<<---"
		PRINT ""
		PRINT "--->>> ERROR: DDR Interelave Configuration has been done already.        <<<---"
		PRINT ""
		PRINT "--->>>        Need to reset system to change DDR Interleave Config <<<---"
		PRINT ""
		PRINT "--->>> ----------------------------------------------------------- <<<---"
		PRINT ""
		&__FUNCTION_RETURN_VALUE=Var.VALUE(0x1)
		RETURN &__FUNCTION_RETURN_VALUE
	)
	ELSE
	(
		Data.Set D:(((Var.VALUE(&__M4_RAT_OFFSET)+Var.VALUE(&__MULTI_DDR_CFG0)))) %Long Var.VALUE(\multi_ddr_cfg0_val)
		Data.Set D:(((Var.VALUE(&__M4_RAT_OFFSET)+Var.VALUE(&__MULTI_DDR_CFG1)))) %Long Var.VALUE(\multi_ddr_cfg1_val)
		Data.Set D:(((Var.VALUE(&__M4_RAT_OFFSET)+Var.VALUE(&__DDR_CFG_LOAD)))) %Long Var.VALUE(0x60000000)
		WHILE ((Data.Long(D:((&__M4_RAT_OFFSET+&__DDR_CFG_LOAD)))&0x1)==0x0)
		(
		)
		&__FUNCTION_RETURN_VALUE=Var.VALUE(0x0)
		RETURN &__FUNCTION_RETURN_VALUE
	)
	RETURN
)

Set_DDR_Interleave_DDR0_Only:
(
	Var.NEWLOCAL unsigned int \multi_ddr_cfg_val0
	Var.Assign \multi_ddr_cfg_val0=0x00000003
	Var.NEWLOCAL unsigned int \multi_ddr_cfg_val1
	Var.Assign \multi_ddr_cfg_val1=0x00000101
	// --  hybrid_select: 0x1, emifs_active: 0x1, 
	PRINT "--->>> ==================================================  <<<---"
	PRINT ""
	PRINT "--->>> Set DDR Interelave Configuration: Enable DDR0 only <<<---"
	PRINT ""
	PRINT "--->>> ====================================================  <<<---"
	PRINT ""
	GOSUB Set_DDR_Interleave_Config Var.VALUE(\multi_ddr_cfg_val0) Var.VALUE(\multi_ddr_cfg_val1)
	ENTRY &__V63
	RETURN &__V63
	RETURN
)

Set_DDR_Interleave_DDR1_Only:
(
	Var.NEWLOCAL unsigned int \multi_ddr_cfg_val0
	Var.Assign \multi_ddr_cfg_val0=0x00000003
	Var.NEWLOCAL unsigned int \multi_ddr_cfg_val1
	Var.Assign \multi_ddr_cfg_val1=0x00000202
	// --  hybrid_select: 0x2, emifs_active: 0x2, 
	PRINT "--->>> ==================================================  <<<---"
	PRINT ""
	PRINT "--->>> Set DDR Interelave Configuration: Enable DDR0 only <<<---"
	PRINT ""
	PRINT "--->>> ====================================================  <<<---"
	PRINT ""
	GOSUB Set_DDR_Interleave_Config Var.VALUE(\multi_ddr_cfg_val0) Var.VALUE(\multi_ddr_cfg_val1)
	ENTRY &__V64
	RETURN &__V64
	RETURN
)

Set_DDR_Interleave_128B_Granule:
(
	Var.NEWLOCAL unsigned int \multi_ddr_cfg_val0
	Var.Assign \multi_ddr_cfg_val0=0x000B0003
	Var.NEWLOCAL unsigned int \multi_ddr_cfg_val1
	Var.Assign \multi_ddr_cfg_val1=0x00000003
	// --  hybrid_select: 0x0, emifs_active: 0x3,  
	PRINT "--->>> ==================================================  <<<---"
	PRINT ""
	PRINT "--->>> Set DDR Interelave Configuration:                   <<<---"
	PRINT ""
	PRINT "--->>>  Interleaved with 128B Granule size, region: 16GB   <<<---"
	PRINT ""
	PRINT "--->>> ==================================================  <<<---"
	PRINT ""
	GOSUB Set_DDR_Interleave_Config Var.VALUE(\multi_ddr_cfg_val0) Var.VALUE(\multi_ddr_cfg_val1)
	ENTRY &__V65
	RETURN &__V65
	RETURN
)
// --  Set_DDR_Interleave_16KB_Granule()
// --  {
// --      uint32_t multi_ddr_cfg_val0 = 0x040B0003; // gran(16KB): 0x4, intrlv_size(16GB): 0xB,  heartbeat:0x3
// --      // hybrid_select, recommend to be non-zero    
// --      uint32_t multi_ddr_cfg_val1 = 0x00000003; // hybrid_select: 0x0, emifs_active: 0x3,  
// --      GEL_TextOut("--->>> ==================================================  <<<---\n");
// --      GEL_TextOut("--->>> Set DDR Interelave Configuration:                   <<<---\n");
// --      GEL_TextOut("--->>>  Interleaved with 16KB Granule size, region: 16GB   <<<---\n");
// --      GEL_TextOut("--->>> ==================================================  <<<---\n");
// --      return Set_DDR_Interleave_Config(multi_ddr_cfg_val0, multi_ddr_cfg_val1);
// --  }

Set_DDR_Interleave:
(
	Var.NEWLOCAL unsigned int \MULTI_DDR_CFG_INTRLV_HEARTBEAT
	Var.Assign \MULTI_DDR_CFG_INTRLV_HEARTBEAT=0x3
	Var.NEWLOCAL unsigned int \multi_ddr_cfg_val0
	Var.Assign \multi_ddr_cfg_val0=(((&__MULTI_DDR_CFG_INTRLV_GRAN<<0x18)|(&__MULTI_DDR_CFG_INTRLV_SIZE<<0x10))|((\MULTI_DDR_CFG_INTRLV_HEARTBEAT)<<0x0))
	Var.NEWLOCAL unsigned int \multi_ddr_cfg_val1
	Var.Assign \multi_ddr_cfg_val1=(((&__MULTI_DDR_CFG_ECC_ENABLE<<0x10)|(&__MULTI_DDR_CFG_HYBRID_SELECT<<0x8))|(&__MULTI_DDR_CFG_EMIFS_ACTIVE<<0x0))
	PRINT "--->>> ==================================================  <<<---"
	PRINT ""
	PRINT "--->>> Set DDR Interelave Configuration:                   <<<---"
	PRINT ""
	AREA.Select
	PRINT "--->>>  multi DDR config 0 : 0x" %HEX Var.VALUE(\multi_ddr_cfg_val0) "                 <<<---"
	PRINT ""
	AREA.Select
	PRINT "--->>>  multi DDR config 1 : 0x" %HEX Var.VALUE(\multi_ddr_cfg_val1) "                 <<<---"
	PRINT ""
	IF (&__MULTI_DDR_CFG_EMIFS_ACTIVE==0x3)
	(
		PRINT "--->>>    Dual DDR enabled                                 <<<---"
		PRINT ""
	)
	ELSE
	(
		Var.IF ((\MULTI_DDR_CFG_EMITS_ACTIVE)==0x1)
		(
			PRINT "--->>>    Single DDR 0 enabled                                 <<<---"
			PRINT ""
		)
		ELSE
		(
			Var.IF ((\MULTI_DDR_CFG_EMITS_ACTIVE)==0x2)
			(
				PRINT "--->>>    Single DDR 1 enabled                                 <<<---"
				PRINT ""
			)
		)
	)
	IF (&__MULTI_DDR_CFG_EMIFS_ACTIVE==0x3)
	(
		Var.IF (&__MULTI_DDR_CFG_INTRLV_GRAN==0x0)
		(
			PRINT "--->>>    128B Granule Size                                    <<<---"
			PRINT ""
		)
		ELSE
		(
			Var.IF (&__MULTI_DDR_CFG_INTRLV_GRAN==0x1)
			(
				PRINT "--->>>    512B Granule Size                                    <<<---"
				PRINT ""
			)
			ELSE
			(
				Var.IF (&__MULTI_DDR_CFG_INTRLV_GRAN==0x2)
				(
					PRINT "--->>>    2KB Granule Size                                     <<<---"
					PRINT ""
				)
				ELSE
				(
					Var.IF (&__MULTI_DDR_CFG_INTRLV_GRAN==0x3)
					(
						PRINT "--->>>    4KB Granule Size                                     <<<---"
						PRINT ""
					)
					ELSE
					(
						Var.IF (&__MULTI_DDR_CFG_INTRLV_GRAN==0x4)
						(
							PRINT "--->>>    16KB Granule Size                                    <<<---"
							PRINT ""
						)
						ELSE
						(
							Var.IF (&__MULTI_DDR_CFG_INTRLV_GRAN==0x5)
							(
								PRINT "--->>>    32KB Granule Size                                    <<<---"
								PRINT ""
							)
							ELSE
							(
								Var.IF (&__MULTI_DDR_CFG_INTRLV_GRAN==0x6)
								(
									PRINT "--->>>    512MB Granule Size                                   <<<---"
									PRINT ""
								)
								ELSE
								(
									Var.IF (&__MULTI_DDR_CFG_INTRLV_GRAN==0x7)
									(
										PRINT "--->>>    1GB Granule Size                                     <<<---"
										PRINT ""
									)
									ELSE
									(
										Var.IF (&__MULTI_DDR_CFG_INTRLV_GRAN==0x8)
										(
											PRINT "--->>>    1.5GB Granule Size                                   <<<---"
											PRINT ""
										)
										ELSE
										(
											Var.IF (&__MULTI_DDR_CFG_INTRLV_GRAN==0x9)
											(
												PRINT "--->>>    2GB Granule Size                                     <<<---"
												PRINT ""
											)
											ELSE
											(
												Var.IF (&__MULTI_DDR_CFG_INTRLV_GRAN==0xA)
												(
													PRINT "--->>>    3GB Granule Size                                     <<<---"
													PRINT ""
												)
												ELSE
												(
													Var.IF (&__MULTI_DDR_CFG_INTRLV_GRAN==0xB)
													(
														PRINT "--->>>    4GB Granule Size                                     <<<---"
														PRINT ""
													)
													ELSE
													(
														Var.IF (&__MULTI_DDR_CFG_INTRLV_GRAN==0xC)
														(
															PRINT "--->>>    6GB Granule Size                                     <<<---"
															PRINT ""
														)
														ELSE
														(
															Var.IF (&__MULTI_DDR_CFG_INTRLV_GRAN==0xD)
															(
																PRINT "--->>>    8GB Granule Size                                     <<<---"
																PRINT ""
															)
															ELSE
															(
																Var.IF (&__MULTI_DDR_CFG_INTRLV_GRAN==0xE)
																(
																	PRINT "--->>>    16GB Granule Size                                    <<<---"
																	PRINT ""
																)
															)
														)
													)
												)
											)
										)
									)
								)
							)
						)
					)
				)
			)
		)
	)
	PRINT "--->>> ==================================================  <<<---"
	PRINT ""
	GOSUB Set_DDR_Interleave_Config Var.VALUE(\multi_ddr_cfg_val0) Var.VALUE(\multi_ddr_cfg_val1)
	ENTRY &__V66
	RETURN &__V66
	RETURN
)

__GeL_MeNu_CrEaTe:
(
	MENU.ReProgram
	(
		ADD
		MENU
		(
			POPUP "GEL"
			(
				POPUP "J7 DDR Memory config"
				(
					MENUITEM "J7_LPDDR4_Config_DDR_0_2132MTs" 
					(
						DO "&path_J721S2_addr_map_offs_LP4_2132_DDR_config_cmm" J7_LPDDR4_Config_DDR_0_2132MTs
					)
					MENUITEM "J7_LPDDR4_Config_DDR_1_2132MTs" 
					(
						DO "&path_J721S2_addr_map_offs_LP4_2132_DDR_config_cmm" J7_LPDDR4_Config_DDR_1_2132MTs
					)
					MENUITEM "J7_LPDDR4_Config_Dual_DDR_Gran_128B_2132MTs" 
					(
						DO "&path_J721S2_addr_map_offs_LP4_2132_DDR_config_cmm" J7_LPDDR4_Config_Dual_DDR_Gran_128B_2132MTs
					)
					MENUITEM "J7_LPDDR4_Config_DDR_0_4266MTs" 
					(
						DO "&path_J721S2_addr_map_offs_LP4_2132_DDR_config_cmm" J7_LPDDR4_Config_DDR_0_4266MTs
					)
					MENUITEM "J7_LPDDR4_Config_DDR_1_4266MTs" 
					(
						DO "&path_J721S2_addr_map_offs_LP4_2132_DDR_config_cmm" J7_LPDDR4_Config_DDR_1_4266MTs
					)
					MENUITEM "J7_LPDDR4_Config_Dual_DDR_Gran_128B_4266MTs" 
					(
						DO "&path_J721S2_addr_map_offs_LP4_2132_DDR_config_cmm" J7_LPDDR4_Config_Dual_DDR_Gran_128B_4266MTs
					)
					MENUITEM "J7_LPDDR4_Config" 
					(
						DO "&path_J721S2_addr_map_offs_LP4_2132_DDR_config_cmm" J7_LPDDR4_Config
					)
					MENUITEM "J7_LPDDR4_Config_Late" 
					(
						DO "&path_J721S2_addr_map_offs_LP4_2132_DDR_config_cmm" J7_LPDDR4_Config_Late
					)
					MENUITEM "Enable_TI_InlineECC_for_DRU_Example" 
					(
						DO "&path_J721S2_addr_map_offs_LP4_2132_DDR_config_cmm" Enable_TI_InlineECC_for_DRU_Example
					)
					MENUITEM "Enable_TI_InlineECC_for_UDMA_example" 
					(
						DO "&path_J721S2_addr_map_offs_LP4_2132_DDR_config_cmm" Enable_TI_InlineECC_for_UDMA_example
					)
					MENUITEM "Enable_TI_InlineECC_for_DRU_Example2" 
					(
						DO "&path_J721S2_addr_map_offs_LP4_2132_DDR_config_cmm" Enable_TI_InlineECC_for_DRU_Example2
					)
				)
			)
		)
	)
	RETURN
)

J7_LPDDR4_Config_DDR_0_2132MTs:
(
	Var.NEWLOCAL unsigned int \ret
	Var.Assign \ret=0x0
	Var.NEWLOCAL char[128] \strtmp = "--->>> DDR 0 Only @ 2132MTs                                <<<---\n"
	GOSUB printf Var.String(\strtmp)
	
	GOSUB Load_2132_Config
	GOSUB Set_DDR_Interleave_DDR0_Only
	ENTRY &__V69
	Var.Assign \ret=&__V69
	Var.IF ((\ret)==0x1)
	(
		RETURN
	)
	GOSUB J7_LPDDR4_Config_Single 0x0
	RETURN
	
)

J7_LPDDR4_Config_DDR_1_2132MTs:
(
	Var.NEWLOCAL unsigned int \ret
	Var.Assign \ret=0x0
	Var.NEWLOCAL char[128] \strtmp = "--->>> DDR 1 Only @ 2132MTs                                <<<---\n"
	GOSUB printf Var.String(\strtmp)
	
	GOSUB Load_2132_Config
	GOSUB Set_DDR_Interleave_DDR1_Only
	ENTRY &__V73
	Var.Assign \ret=&__V73
	Var.IF ((\ret)==0x1)
	(
		RETURN
	)
	GOSUB J7_LPDDR4_Config_Single 0x1
	RETURN
	
)

J7_LPDDR4_Config_Dual_DDR_Gran_128B_2132MTs:
(
	Var.NEWLOCAL unsigned int \ret
	Var.Assign \ret=0x0
	Var.NEWLOCAL char[128] \strtmp = "--->>> Dual DDR interleaved with 128B Granule @ 2132MTs    <<<---\n"
	GOSUB printf Var.String(\strtmp)
	
	GOSUB Load_2132_Config
	GOSUB Set_DDR_Interleave_128B_Granule
	ENTRY &__V77
	Var.Assign \ret=&__V77
	Var.IF ((\ret)==0x1)
	(
		RETURN
	)
	GOSUB J7_LPDDR4_Config_Single 0x0
	GOSUB J7_LPDDR4_Config_Single 0x1
	RETURN
	
)

J7_LPDDR4_Config_DDR_0_4266MTs:
(
	Var.NEWLOCAL unsigned int \ret
	Var.Assign \ret=0x0
	Var.NEWLOCAL char[128] \strtmp = "--->>> DDR 0 Only @ 4266MTs                                <<<---\n"
	GOSUB printf Var.String(\strtmp)
	
	GOSUB Load_4266_Config
	GOSUB Set_DDR_Interleave_DDR0_Only
	ENTRY &__V82
	Var.Assign \ret=&__V82
	Var.IF ((\ret)==0x1)
	(
		RETURN
	)
	GOSUB J7_LPDDR4_Config_Single 0x0
	RETURN
	
)

J7_LPDDR4_Config_DDR_1_4266MTs:
(
	Var.NEWLOCAL unsigned int \ret
	Var.Assign \ret=0x0
	Var.NEWLOCAL char[128] \strtmp = "--->>> DDR 1 Only @ 4266MTs                                <<<---\n"
	GOSUB printf Var.String(\strtmp)
	
	GOSUB Load_4266_Config
	GOSUB Set_DDR_Interleave_DDR1_Only
	ENTRY &__V86
	Var.Assign \ret=&__V86
	Var.IF ((\ret)==0x1)
	(
		RETURN
	)
	GOSUB J7_LPDDR4_Config_Single 0x1
	RETURN
	
)

J7_LPDDR4_Config_Dual_DDR_Gran_128B_4266MTs:
(
	Var.NEWLOCAL unsigned int \ret
	Var.Assign \ret=0x0
	Var.NEWLOCAL char[128] \strtmp = "--->>> Dual DDR interleaved with 128B Granule @ 4266MTs    <<<---\n"
	GOSUB printf Var.String(\strtmp)
	
	GOSUB Load_4266_Config
	GOSUB Set_DDR_Interleave_128B_Granule
	ENTRY &__V90
	Var.Assign \ret=&__V90
	Var.IF ((\ret)==0x1)
	(
		RETURN
	)
	GOSUB J7_LPDDR4_Config_Single 0x0
	GOSUB J7_LPDDR4_Config_Single 0x1
	RETURN
	
)
// --  hotmenu J7_LPDDR4_Config_Dual_DDR_Gran_16KB_4266MTs(void)
// --  {
// --      uint32_t ret = 0;
// --      printf("--->>> Dual DDR interleaved with 16KB Granule @ 4266MTs    <<<---\n");
// --      Load_4266_Config();
// --      ret = Set_DDR_Interleave_16KB_Granule();
// --      if (ret == 1) return;
// --      J7_LPDDR4_Config_Single(0);
// --      J7_LPDDR4_Config_Single(1);
// --  }

J7_LPDDR4_Config:
(
	Var.NEWLOCAL unsigned int \ret
	Var.Assign \ret=0x0
	GOSUB Set_DDR_Interleave
	ENTRY &__V93
	Var.Assign \ret=&__V93
	Var.IF ((\ret)==0x1)
	(
		RETURN
	)
	GOSUB J7_LPDDR4_Config_Single 0x0
	GOSUB J7_LPDDR4_Config_Single 0x1
	RETURN
	
)
// --  This function is run when the DMSC firmware is loaded on to the device 

J7_LPDDR4_Config_Late:
(
	Var.NEWLOCAL int \status
	Var.Assign \status=0x1
	// --  Remap the RAT to the GEL Configuration 
	Data.Set D:((0x44200020)) %Long Var.VALUE(0x8000001D)
	Data.Set D:((0x44200024)) %Long Var.VALUE(0x80000000)
	Data.Set D:((0x44200028)) %Long Var.VALUE(0x00000000)
	Data.Set D:((0x4420002C)) %Long Var.VALUE(0x00000000)
	Data.Set D:((0x44200030)) %Long Var.VALUE(0x8000001D)
	Data.Set D:((0x44200034)) %Long Var.VALUE(0x60000000)
	Data.Set D:((0x44200038)) %Long Var.VALUE(0x40000000)
	Data.Set D:((0x4420003C)) %Long Var.VALUE(0x00000000)
	Data.Set D:((0x44200040)) %Long Var.VALUE(0x8000001A)
	Data.Set D:((0x44200044)) %Long Var.VALUE(0xA0000000)
	Data.Set D:((0x44200048)) %Long Var.VALUE(0x40000000)
	Data.Set D:((0x4420004C)) %Long Var.VALUE(0x00000000)
	Data.Set D:((0x44200050)) %Long Var.VALUE(0x80000019)
	Data.Set D:((0x44200054)) %Long Var.VALUE(0xA8000000)
	Data.Set D:((0x44200058)) %Long Var.VALUE(0x70000000)
	Data.Set D:((0x4420005C)) %Long Var.VALUE(0x00000000)
	Data.Set D:((0x44200060)) %Long Var.VALUE(0x8000001B)
	Data.Set D:((0x44200064)) %Long Var.VALUE(0xB0000000)
	Data.Set D:((0x44200068)) %Long Var.VALUE(0x50000000)
	Data.Set D:((0x4420006C)) %Long Var.VALUE(0x00000000)
	Data.Set D:((0x44200070)) %Long Var.VALUE(0x8000001B)
	Data.Set D:((0x44200074)) %Long Var.VALUE(0xB8000000)
	Data.Set D:((0x44200078)) %Long Var.VALUE(0x58000000)
	Data.Set D:((0x4420007C)) %Long Var.VALUE(0x00000000)
	
        GOSUB J7_LPDDR4_Config	

        // Early firmware + PDK board files conflicted.  With early images only use EMIF0.        
        //GOSUB J7_LPDDR4_Config_DDR_0_2132MTs        
	
	Data.Set D:((0x44200020)) %Long Var.VALUE(0x8000001D)
	Data.Set D:((0x44200024)) %Long Var.VALUE(0x60000000)
	Data.Set D:((0x44200028)) %Long Var.VALUE(0x00000000)
	Data.Set D:((0x4420002C)) %Long Var.VALUE(0x00000000)
	Data.Set D:((0x44200030)) %Long Var.VALUE(0x8000001D)
	Data.Set D:((0x44200034)) %Long Var.VALUE(0x80000000)
	Data.Set D:((0x44200038)) %Long Var.VALUE(0x20000000)
	Data.Set D:((0x4420003C)) %Long Var.VALUE(0x00000000)
	Data.Set D:((0x44200040)) %Long Var.VALUE(0x8000001D)
	Data.Set D:((0x44200044)) %Long Var.VALUE(0xA0000000)
	Data.Set D:((0x44200048)) %Long Var.VALUE(0x40000000)
	Data.Set D:((0x4420004C)) %Long Var.VALUE(0x00000000)
	Data.Set D:((0x44200050)) %Long Var.VALUE(0x00000000)
	Data.Set D:((0x44200054)) %Long Var.VALUE(0xA8000000)
	Data.Set D:((0x44200058)) %Long Var.VALUE(0x70000000)
	Data.Set D:((0x4420005C)) %Long Var.VALUE(0x00000000)
	Data.Set D:((0x44200060)) %Long Var.VALUE(0x00000000)
	Data.Set D:((0x44200064)) %Long Var.VALUE(0xB0000000)
	Data.Set D:((0x44200068)) %Long Var.VALUE(0x50000000)
	Data.Set D:((0x4420006C)) %Long Var.VALUE(0x00000000)
	Data.Set D:((0x44200070)) %Long Var.VALUE(0x00000000)
	Data.Set D:((0x44200074)) %Long Var.VALUE(0xB8000000)
	Data.Set D:((0x44200078)) %Long Var.VALUE(0x58000000)
	Data.Set D:((0x4420007C)) %Long Var.VALUE(0x00000000)
	RETURN
	
)

Enable_TI_InlineECC_for_DRU_Example:
(
	Var.NEWLOCAL unsigned int \i
	Var.Assign \i=0x0
	Data.Set D:(((Var.VALUE(&__M4_RAT_OFFSET)+0x2980120))) %Long Var.VALUE(0x17)
	Var.Assign \i=0x0
	WHILE (Var.VALUE(\i)<0x40)
	(
		Data.Set D:(((Var.VALUE(&__M4_RAT_OFFSET)+0x2980124))) %Long Var.VALUE(\i)
		Data.Set D:(((Var.VALUE(&__M4_RAT_OFFSET)+0x2980128))) %Long (((0x1<<0xF)|0x68))
		Var.Assign \i=\i+1
	)
	Var.Assign \i=0x40
	WHILE (Var.VALUE(\i)<0x80)
	(
		Data.Set D:(((Var.VALUE(&__M4_RAT_OFFSET)+0x2980124))) %Long Var.VALUE(\i)
		Data.Set D:(((Var.VALUE(&__M4_RAT_OFFSET)+0x2980128))) %Long (((0x1<<0xF)|0x69))
		Var.Assign \i=\i+1
	)
	Data.Set D:(((Var.VALUE(&__M4_RAT_OFFSET)+0x2980130))) %Long Var.VALUE(0x0)
	Data.Set D:(((Var.VALUE(&__M4_RAT_OFFSET)+0x2980134))) %Long Var.VALUE(0xFFFF)
	Var.NEWLOCAL char[128] \strtmp = "--->>> ECC region 0 enabled with all cache lines allocated for DRU.... <<<---\n"
	GOSUB printf Var.String(\strtmp)
	
	RETURN
	
)

Enable_TI_InlineECC_for_UDMA_example:
(
	Var.NEWLOCAL unsigned int \i
	Var.Assign \i=0x0
	Data.Set D:(((Var.VALUE(&__M4_RAT_OFFSET)+0x2980120))) %Long Var.VALUE(0x17)
	Var.Assign \i=0x0
	WHILE (Var.VALUE(\i)<0x20)
	(
		Data.Set D:(((Var.VALUE(&__M4_RAT_OFFSET)+0x2980124))) %Long Var.VALUE(\i)
		Data.Set D:(((Var.VALUE(&__M4_RAT_OFFSET)+0x2980128))) %Long (((0x1<<0xF)|0xC8))
		Var.Assign \i=\i+1
	)
	Var.Assign \i=0x20
	WHILE (Var.VALUE(\i)<0x40)
	(
		Data.Set D:(((Var.VALUE(&__M4_RAT_OFFSET)+0x2980124))) %Long Var.VALUE(\i)
		Data.Set D:(((Var.VALUE(&__M4_RAT_OFFSET)+0x2980128))) %Long (((0x1<<0xF)|0xA9))
		Var.Assign \i=\i+1
	)
	Var.Assign \i=0x40
	WHILE (Var.VALUE(\i)<0x60)
	(
		Data.Set D:(((Var.VALUE(&__M4_RAT_OFFSET)+0x2980124))) %Long Var.VALUE(\i)
		Data.Set D:(((Var.VALUE(&__M4_RAT_OFFSET)+0x2980128))) %Long (((0x1<<0xF)|0xAA))
		Var.Assign \i=\i+1
	)
	Var.Assign \i=0x60
	WHILE (Var.VALUE(\i)<0x80)
	(
		Data.Set D:(((Var.VALUE(&__M4_RAT_OFFSET)+0x2980124))) %Long Var.VALUE(\i)
		Data.Set D:(((Var.VALUE(&__M4_RAT_OFFSET)+0x2980128))) %Long (((0x1<<0xF)|0xAB))
		Var.Assign \i=\i+1
	)
	Data.Set D:(((Var.VALUE(&__M4_RAT_OFFSET)+0x2980130))) %Long Var.VALUE(0x0)
	Data.Set D:(((Var.VALUE(&__M4_RAT_OFFSET)+0x2980134))) %Long Var.VALUE(0xFFFF)
	Var.NEWLOCAL char[128] \strtmp = "--->>> ECC region 0 enabled with all cache lines allocated for UDMA.... <<<---\n"
	GOSUB printf Var.String(\strtmp)
	
	RETURN
	
)

Enable_TI_InlineECC_for_DRU_Example2:
(
	Var.NEWLOCAL unsigned int \i
	Var.Assign \i=0x0
	Data.Set D:(((Var.VALUE(&__M4_RAT_OFFSET)+0x2980120))) %Long Var.VALUE(0x17)
	Var.Assign \i=0x0
	WHILE (Var.VALUE(\i)<0x20)
	(
		Data.Set D:(((Var.VALUE(&__M4_RAT_OFFSET)+0x2980124))) %Long Var.VALUE(\i)
		Data.Set D:(((Var.VALUE(&__M4_RAT_OFFSET)+0x2980128))) %Long (((0x1<<0xF)|0x68))
		Var.Assign \i=\i+1
	)
	Var.Assign \i=0x20
	WHILE (Var.VALUE(\i)<0x40)
	(
		Data.Set D:(((Var.VALUE(&__M4_RAT_OFFSET)+0x2980124))) %Long Var.VALUE(\i)
		Data.Set D:(((Var.VALUE(&__M4_RAT_OFFSET)+0x2980128))) %Long (((0x1<<0xF)|0x69))
		Var.Assign \i=\i+1
	)
	Data.Set D:(((Var.VALUE(&__M4_RAT_OFFSET)+0x2980130))) %Long Var.VALUE(0x0)
	Data.Set D:(((Var.VALUE(&__M4_RAT_OFFSET)+0x2980134))) %Long Var.VALUE(0xFFFF)
	Var.NEWLOCAL char[128] \strtmp = "--->>> ECC region 0 enabled with partial cache lines allocated for DRU.... <<<---\n"
	GOSUB printf Var.String(\strtmp)
	
	RETURN
	
)
