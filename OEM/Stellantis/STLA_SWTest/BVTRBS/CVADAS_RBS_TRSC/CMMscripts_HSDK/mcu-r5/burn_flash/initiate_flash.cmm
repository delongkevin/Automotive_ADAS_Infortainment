; --------------------------------------------------------------------------------
; @Title: OSPI FLASH Program script for the j721e-evm (AM752X, DRA829, TDA4X)
; @Description:
; The MT35XU1G (Micron) is connected to the OSPI_CS0 controller
;
; SRAM:
; OSPI(controller) Base: 0x47040000
; OSPI memory mapped ADDRESS: 0x50000000
;
; Prerequisites: Switch Settings: CONFIG_SW[1] = OFF (SW3.1 on common board)
;
; @Chip: AM752X, DRA829, TDA4*
; @Board: J721E-EVM
; @Author: CMO
; @Keywords: Micron TD4*, Micron DRA829, Micron AM752X
; @Copyright: (C) 1989-2019 Lauterbach GmbH, licensed for use with TRACE32(R) only
; --------------------------------------------------------------------------------
;

; FLASH SNOR hyperflash driver (not flashfile xspi)
LOCAL &OSPI_BASE &OSPI_MEMORY_BASE &WDG_BASE &HS_device
&OSPI_BASE=0x47040000
&OSPI_MEMORY_BASE=0x60000000  ; flash contents memory mapped address
&WDG_BASE=0x44135100   ;TODO: check address
GLOBAL &DDR_2G
&DDR_2G="yes"
&HS_FStype="no"

&HS_device="FS"

DO "./CMMscripts_HSDK/x_gel_to_cmm/J721S2_secure_unlock.cmm"

DO "./CMMscripts_HSDK/mcu-r5/burn_flash/j721s2-spinand.cmm" &HS_device
ENDDO
ENDDO


WATCHDOG_DISABLE:
(
  ; Fill in if >3min burn time needed
  Data.Set EZAXI:&WDG_BASE+0x20  %LE %Long 0x4658fc21
  Data.Set EZAXI:&WDG_BASE+0x24  %LE %Long 0x3ac4f102
  Data.Set EZAXI:&WDG_BASE+0x50  %LE %Long 0xa
  Data.Set EZAXI:&WDG_BASE+0x20  %LE %Long 0x0
  Data.Set EZAXI:&WDG_BASE+0x24  %LE %Long 0x0

  RETURN
)
