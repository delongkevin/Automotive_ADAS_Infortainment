;;;;;;;;;;;;;;;;;;;;;;;;;;;;;;;;;;;;;;;;;;;;;;;;;;;;;;;;;;;;;;;;;;;;;;;;;;;;;;
; Basic CR5 connect for J721S2/TDA4VL
; 13 Oct 21 - Richard Woodruff - Adapt J7ES for J721S2.
;;;;;;;;;;;;;;;;;;;;;;;;;;;;;;;;;;;;;;;;;;;;;;;;;;;;;;;;;;;;;;;;;;;;;;;;;;;;;;
; INPUT PARMS: (R5-MCU, R5-MAIN0, R5-MAIN1) + (SMP, AMP1, AMP2)
;   {default=R5-MCU,AMP1}
; note: when setting lockstep AMP1 should be used 

 LOCAL &emulation
 &emulation="no"

 RESet
 SYStem.RESet
 area.create A000 100 1000
 area

 IF COMBIPROBE()||UTRACE()
    SYStem.CONFIG.CONNECTOR MIPI34 ; because of converter LA-3782

; CM4 (2x1)  : J721S2-CM4-0 J721S2-CM4-1
; A72 (1x2)  : J721S2 (core.assign 1 2)
; CR5 (3x2)  : J721S2-CR5-MCU J721S2-CR5-MAIN0 J721S2-CR5-MAIN1 (core.assign 1 2)
; C7x (2x1)  : J721S2-C71X (core.assign 1 2)

 ; Script parameters: clust, SMP or AMPx operation
 PRIVATE &parameters
 ENTRY %LINE &parameters
 &parameters=STRing.UPpeR("&parameters")

 LOCAL &param_core &param_smp &subnum &corenum
 &corenum=7
 &subnum=1
 
 SYStem.CPU J721S2-CR5-MAIN0
 SYStem.CONFIG CORE (&corenum+&subnum-1) 1.

 IF "&emulation"=="yes"
 (
  System.CONFIG DEBUGTIMESCALE 32.
  System.Option MemStatusCheck ON
  SYStem.POLLING OFF
  setup.urate 2500.ms           ; slow window updates, this can be bigger
  SYStem.polling slow           ; sparse pinging
  SYStem.JTAGCLOCK rtck 100Khz
 )
 ELSE
  system.JTAGCLOCK CTCK 25MHz

 SYStem.Option RESBREAK OFF
 SYStem.Option EnReset OFF
 
 core.assign (&subnum)

 SYStem.MemAccess.DAP
 SYStem.Option.imaskasm.on
 SYStem.Option.IMASKHLL.ON

 TPIU.PortMode.Continuous
 IF !SIMULATOR()
 (
   trace.method onchip
   trace.TraceCONNECT.tbr3
   onchip.off
 )
 break.select program onchip
 break.select read onchip
 break.select write onchip
 ;print "1\n"

 ;Data.LOAD.elf * /plusVM /NOCODE
 SYStem.Mode Attach
 Data.LOAD.elf C:/JS/ws/develop/sw/Release/NAND/hydra3_rtos_qnx_mcu2_0.out /NoCODE


 TASK.CONFIG "safertos.t32"
 MENU.ReProgram "safertos.men"
 HELP.FILTER.Add rtosfreertos

 ; Define Log File Path
 Printer.File "MCU2_0_CPU_Load.txt" ASCIIE /Append

 ON ERROR CONTinue

;Turn on Arm, PC Task window, list label for printing to file.
 SCREEN.ALways
 PERF.AutoArm ON
 PERF.Mode.PCTASK
 PERF.ListTASK 
 PERF.ListLABEL
 PERF.ARM
 WAIT 30s
 WinPRT W001 
 WinPRT W002
 QUIT


