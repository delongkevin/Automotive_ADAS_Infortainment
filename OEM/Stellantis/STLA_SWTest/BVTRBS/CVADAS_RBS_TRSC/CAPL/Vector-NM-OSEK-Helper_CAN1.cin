variables
{
  /* NM-IL Include for CAN Vector IL with OSEK NM
   *
   * This include file establishes the coupling between NM --> IL.
   *
   * The simulation node needs to load the components CANoeILNLVector.dll and OSEKNM01.dll.
   *
   * Call NMCAN1_OnInit() in "on preStart()" of the main program!
   * Call NMCAN1_OnStart() in "on start()" of the main program!
   *
   * Version 6.5, (c) 2016 Vector Informatik GmbH, Department for Networks and Distributed Systems
   */

  const dword cNMCAN1_NMIndDebug      = 0x0001;
  const dword cNMCAN1_NMInitDebug     = 0x0002;
  const dword cNMCAN1_ILControlDebug  = 0x0010;
  
  const double cNMCAN1_NS2S = 1000000000.0;

  // Internally used variables and timers:
  dword   gNMCAN1_BusContext = 0;
  long    gNMCAN1_CurrentNMState = cCAN1_OSEK_NM_STATE_UNDEFINED;
  long    gNMCAN1_CurrentNMInternalRequest = 0;
  long    gNMCAN1_CurrentLocalRequestState = 0;
  long    gNMCAN1_CurrentLocalRequestPending = 0;
  long    gNMCAN1_CurrentApplActivity = 0;
}

/*****************************************************************************
 * Include Initialization
 *****************************************************************************/

void NMCAN1_OnInit ()
{
  // This function must be called from the main program in "on preStart()"!

  //Nm_SetVerbosity(3);
  
  
  gNMCAN1_BusContext = GetBusNameContext(gCAN1BusName);

  if (strncmp("%NODE_NAME%", "_Gateway", 50) == 0)
  {
    gNMPCAN1_DebugFlags |= cNMCAN1_NMIndDebug;
    gNMPCAN1_DebugFlags |= cNMCAN1_NMInitDebug;
    gNMPCAN1_DebugFlags |= cNMPCAN1_NMControlDebug;
    gNMPCAN1_DebugFlags |= cNMCAN1_ILControlDebug;
  }

  SetBusContext(gNMCAN1_BusContext);
  NMConfigureILNotifications( 0, 1 ); // regardless of NM callbacks inform IL
}

void NMCAN1_OnStart ()
{
  // This function must be called from the main program in "on start()"!
  
  if (gNMPCAN1_DebugFlags & cNMCAN1_NMInitDebug)
  {
    write("+++++++++ %NODE_NAME%: CAN NM on start()");
  }
}

/*****************************************************************************
 * NM Control
 * These functions can be called from the main program or react on
 * panel controls in order to manipulate the NM status of the controlled node.
 *****************************************************************************/

void NMCAN1_Enable (int enable)
{
  /* void NMCAN1_Enable (int enable);
   *
   *  Function enables/disables the Network Management DLL.
   */
  int wasEnabled = -1;

  //if (enable == wasEnabled) return;

  if (gNMPCAN1_DebugFlags & cNMPCAN1_NMControlDebug)
  {
    write("[%.6f %NODE_NAME%] NMCAN1_Enable(%d) called ...", TimeNowNS()/cNMCAN1_NS2S, enable);
  }

  SetBusContext(gNMCAN1_BusContext);
  if (enable == 1)
  {
    NMCtrlSimulationOn();
  }
  else
  {
    NMCtrlSimulationOff();
  }

  wasEnabled = enable;
}

void NMCAN1_SetApplActivity (int activity)
{
  /* void NMCAN1_SetApplActivity (int activity);
   *
   *  Function sets the application activity at the Interaction Layer.
   */
  int wasActivity = -1;

  //if (activity == wasActivity) return;

  if (gNMPCAN1_DebugFlags & cNMPCAN1_NMControlDebug)
  {
    write("[%.6f %NODE_NAME%] NMCAN1_SetApplActivity(%d) called ...", TimeNowNS()/cNMCAN1_NS2S, activity);
  }

  SetBusContext(gNMCAN1_BusContext);
  if (activity > 0)
  {
    gNMCAN1_CurrentApplActivity = 1;
    NMSetApplicationActivity(1);
  }
  else
  {
    gNMCAN1_CurrentApplActivity = 0;
    NMSetApplicationActivity(0);
  }

  NMCAN1_StateChangeNotificationCalculateLocalRequestState();
  NMCAN1_StateChangeNotification( gNMCAN1_CurrentNMState, (gNMCAN1_CurrentLocalRequestState > 0) ? cCAN1_OSEK_NM_STATE_AWAKE : cCAN1_OSEK_NM_STATE_READY_SLEEP);
  wasActivity = activity;
}

NMCAN1_ReleaseBus()
{
  gNMCAN1_CurrentLocalRequestPending = 0;
  if (gNMPCAN1_DebugFlags & cNMPCAN1_NMControlDebug)
  {
    write("[%.6f %NODE_NAME%]: GotoMode_BusSleep()", TimeNowNS()/cNMCAN1_NS2S);
  }
  SetBusContext(gNMCAN1_BusContext);
  GotoMode_BusSleep();
  NMCAN1_StateChangeNotificationCalculateLocalRequestState();
  NMCAN1_StateChangeNotification( gNMCAN1_CurrentNMState, (gNMCAN1_CurrentLocalRequestState > 0) ? cCAN1_OSEK_NM_STATE_AWAKE : cCAN1_OSEK_NM_STATE_READY_SLEEP);
}

NMCAN1_RequestBus ()
{
  gNMCAN1_CurrentLocalRequestPending = 1;
  if (gNMPCAN1_DebugFlags & cNMPCAN1_NMControlDebug)
  {
    write("[%.6f %NODE_NAME%]: GotoMode_Awake()", TimeNowNS()/cNMCAN1_NS2S);
  }
  SetBusContext(gNMCAN1_BusContext);
  GotoMode_Awake();
  NMCAN1_StateChangeNotificationCalculateLocalRequestState();
  NMCAN1_StateChangeNotification( gNMCAN1_CurrentNMState, (gNMCAN1_CurrentLocalRequestState > 0) ? cCAN1_OSEK_NM_STATE_AWAKE : cCAN1_OSEK_NM_STATE_READY_SLEEP);
}

NMCAN1_PassiveBusStart ()
{
  SetBusContext(gNMCAN1_BusContext);
  GotoMode_Awake();
  if (gNMCAN1_CurrentLocalRequestState > 0)
  {
    if (gNMPCAN1_DebugFlags & cNMPCAN1_NMControlDebug)
    {
      write("[%.6f %NODE_NAME%]: GotoMode_Awake()", TimeNowNS()/cNMCAN1_NS2S);
    }
  }
  else
  {
    GotoMode_BusSleep();
    if (gNMPCAN1_DebugFlags & cNMPCAN1_NMControlDebug)
    {
      write("[%.6f %NODE_NAME%]: GotoMode_BusSleep()", TimeNowNS()/cNMCAN1_NS2S);
    }
  }
}

NMCAN1_PowerOnStart()
{
  //NMCAN1_PassiveBusStart();
}

on sysvar sysvar::NM_CAN1::StateControl::NmPduTxEnable
{
  SetBusContext(gNMCAN1_BusContext);
  /*
  if(@this == 1)
    Nm_DisablePassiveMode(); // NM PDU is transmitted after wake up, and in normal operation and repeat message state
  else 
    Nm_EnablePassiveMode(); // NM PDU is never transmitted
  */
}

/*****************************************************************************
 * NM Indications
 * They are called from the NM simulation in order to control the IL.
 *****************************************************************************/

void NMCAN1_IndCanWakeUp() // Nm_NetworkStartInd()
{
  if (gNMPCAN1_DebugFlags & cNMCAN1_NMIndDebug)
  {
    write("[%.6f %NODE_NAME%]: apCanWakeUp()", TimeNowNS()/cNMCAN1_NS2S);
  }
  NMCAN1_PassiveBusStart();
}

void NMCAN1_IndCanOn() // Nm_NetworkModeInd()
{
  if (gNMPCAN1_DebugFlags & cNMCAN1_NMIndDebug)
  {
    write("[%.6f %NODE_NAME%]: apCanOn()", TimeNowNS()/cNMCAN1_NS2S);
  }
  NMCAN1_StateChangeNotification( gNMCAN1_CurrentNMState, (gNMCAN1_CurrentLocalRequestState > 0) ? cCAN1_OSEK_NM_STATE_AWAKE : cCAN1_OSEK_NM_STATE_READY_SLEEP);
  StartSim(gNMCAN1_BusContext, 1, 4);
}

void NMCAN1_IndCanOff() // Nm_BusSleepModeInd()
{
  if (gNMPCAN1_DebugFlags & cNMCAN1_NMIndDebug)
  {
    write("[%.6f %NODE_NAME%]: apCanOff()", TimeNowNS()/cNMCAN1_NS2S);
  }
  StopSim(gNMCAN1_BusContext, 1, 4);
}

void NMCAN1_IndCanNormal()
{
  if (gNMPCAN1_DebugFlags & cNMCAN1_NMIndDebug)
  {
    write("[%.6f %NODE_NAME%]: apCanNormal()", TimeNowNS()/cNMCAN1_NS2S);
  }
}

void NMCAN1_IndCanSleep()
{
  if (gNMPCAN1_DebugFlags & cNMCAN1_NMIndDebug)
  {
    write("[%.6f %NODE_NAME%]: apCanSleep()", TimeNowNS()/cNMCAN1_NS2S);
  }
}

void NMCAN1_IndBusSleep()
{
  if (gNMPCAN1_DebugFlags & cNMCAN1_NMIndDebug)
  {
    write("[%.6f %NODE_NAME%]: apBusSleep()", TimeNowNS()/cNMCAN1_NS2S);
  }
  NMCAN1_StateChangeNotification( gNMCAN1_CurrentNMState, cCAN1_OSEK_NM_STATE_BUS_SLEEP);
}

long NMCAN1_IndPreSend(byte buf[], byte dlc[])
{
  dword NMStatus;
  long currentState;

  if ((gNMPCAN1_DebugFlags & cNMCAN1_NMIndDebug) && 0)
  {
    write("[%.6f %NODE_NAME%]: apIndPreSend()", TimeNowNS()/cNMCAN1_NS2S);
  }

  NMStatus = NMCAN1_ObserveNMStatus();
  if (NMStatus & 0x40)
  {
    // NM is on:
    currentState = gNMCAN1_CurrentNMState;
    if (currentState == cCAN1_OSEK_NM_STATE_UNDEFINED || currentState == cCAN1_OSEK_NM_STATE_BUS_SLEEP)
    {
      NMCAN1_StateChangeNotification( gNMCAN1_CurrentNMState, (gNMCAN1_CurrentLocalRequestState > 0) ? cCAN1_OSEK_NM_STATE_AWAKE : cCAN1_OSEK_NM_STATE_READY_SLEEP);
    }
  }

  return 1;
}

dword NMCAN1_ObserveNMStatus()
{
  dword NMStatus, NMOldStatus = 0;

  NMStatus = NMGetStatus();
  if ((gNMPCAN1_DebugFlags & cNMCAN1_NMIndDebug) && (NMStatus != NMOldStatus))
  {
    write("[%.6f %NODE_NAME%]: NM status:", TimeNowNS()/cNMCAN1_NS2S);
    write("[%.6f %NODE_NAME%]:   Stable         = %d", TimeNowNS()/cNMCAN1_NS2S, ((NMStatus & 0x01) ? 1 : 0));
    write("[%.6f %NODE_NAME%]:   CAN Drv        = %d", TimeNowNS()/cNMCAN1_NS2S, ((NMStatus & 0x02) ? 1 : 0));
    write("[%.6f %NODE_NAME%]:   Err PIN        = %d", TimeNowNS()/cNMCAN1_NS2S, ((NMStatus & 0x04) ? 1 : 0));
    write("[%.6f %NODE_NAME%]:   Bus Sleep      = %d", TimeNowNS()/cNMCAN1_NS2S, ((NMStatus & 0x10) ? 1 : 0));
    write("[%.6f %NODE_NAME%]:   Limp Home      = %d", TimeNowNS()/cNMCAN1_NS2S, ((NMStatus & 0x20) ? 1 : 0));
    write("[%.6f %NODE_NAME%]:   NM on          = %d", TimeNowNS()/cNMCAN1_NS2S, ((NMStatus & 0x40) ? 1 : 0));
    write("[%.6f %NODE_NAME%]:   Ready-to-sleep = %d", TimeNowNS()/cNMCAN1_NS2S, ((NMStatus & 0x80) ? 1 : 0));
  }
  
  NMOldStatus = NMStatus;
  return NMStatus;
}

void NMCAN1_StateChangeNotificationCalculateLocalRequestState()
{
  if (gNMCAN1_CurrentApplActivity <= 0)
  {
    gNMCAN1_CurrentLocalRequestState = gNMCAN1_CurrentLocalRequestPending;
  }
  else
  {
    if (gNMCAN1_CurrentLocalRequestPending > 0)
    {
      gNMCAN1_CurrentLocalRequestState = gNMCAN1_CurrentLocalRequestPending;
    }
  }
}

void NMCAN1_StateChangeNotification( long previousState, long currentState) 
{
  long mode;
  if ((previousState == cCAN1_OSEK_NM_STATE_UNDEFINED || previousState == cCAN1_OSEK_NM_STATE_BUS_SLEEP) && (currentState != cCAN1_OSEK_NM_STATE_BUS_SLEEP))
  { 
    @sysvar::NM_CAN1::StateControl::ActiveNodes += 1;
  }
  if ((previousState != cCAN1_OSEK_NM_STATE_UNDEFINED) && (currentState == cCAN1_OSEK_NM_STATE_BUS_SLEEP))
  { 
    @sysvar::NM_CAN1::StateControl::ActiveNodes -= 1;
  }

  gNMCAN1_CurrentNMState = currentState;

  if ((currentState <= cCAN1_OSEK_NM_STATE_BUS_SLEEP) || (currentState > cCAN1_OSEK_NM_STATE_AWAKE))
  {
    mode = cCAN1_NM_NODE_MODE_Sleep_Mode;
  }
  else
  {
    mode = cCAN1_NM_NODE_MODE_Network_Mode;
  }

  if (gNMPCAN1_DebugFlags & cNMCAN1_NMIndDebug)
  {
    write("[%.6f %NODE_NAME%]: NM currentState = %d, mode = %d", TimeNowNS()/cNMCAN1_NS2S, currentState, mode);
  }
}

/*****************************************************************************
 * EOF
 *****************************************************************************/
