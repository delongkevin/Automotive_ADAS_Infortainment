variables
{
  /* NM-IL Include for CAN Vector IL with OSEK NM
   *
   * This include file establishes the coupling between NM --> IL.
   *
   * The simulation node needs to load the components CANoeILNLVector.dll and OSEKNM01.dll.
   *
   * Call NMCAN2_OnInit() in "on preStart()" of the main program!
   * Call NMCAN2_OnStart() in "on start()" of the main program!
   *
   * Version 6.5, (c) 2016 Vector Informatik GmbH, Department for Networks and Distributed Systems
   */

  const dword cNMCAN2_NMIndDebug      = 0x0001;
  const dword cNMCAN2_NMInitDebug     = 0x0002;
  const dword cNMCAN2_ILControlDebug  = 0x0010;
  
  const double cNMCAN2_NS2S = 1000000000.0;

  // Internally used variables and timers:
  dword   gNMCAN2_BusContext = 0;
  long    gNMCAN2_CurrentNMState = cCAN2_OSEK_NM_STATE_UNDEFINED;
  long    gNMCAN2_CurrentNMInternalRequest = 0;
  long    gNMCAN2_CurrentLocalRequestState = 0;
  long    gNMCAN2_CurrentLocalRequestPending = 0;
  long    gNMCAN2_CurrentApplActivity = 0;
}

/*****************************************************************************
 * Include Initialization
 *****************************************************************************/

void NMCAN2_OnInit ()
{
  // This function must be called from the main program in "on preStart()"!

  //Nm_SetVerbosity(3);
  
  
  gNMCAN2_BusContext = GetBusNameContext(gCAN2BusName);

  if (strncmp("%NODE_NAME%", "_Gateway", 50) == 0)
  {
    gNMPCAN2_DebugFlags |= cNMCAN2_NMIndDebug;
    gNMPCAN2_DebugFlags |= cNMCAN2_NMInitDebug;
    gNMPCAN2_DebugFlags |= cNMPCAN2_NMControlDebug;
    gNMPCAN2_DebugFlags |= cNMCAN2_ILControlDebug;
  }

  SetBusContext(gNMCAN2_BusContext);
  NMConfigureILNotifications( 0, 1 ); // regardless of NM callbacks inform IL
}

void NMCAN2_OnStart ()
{
  // This function must be called from the main program in "on start()"!
  
  if (gNMPCAN2_DebugFlags & cNMCAN2_NMInitDebug)
  {
    write("+++++++++ %NODE_NAME%: CAN NM on start()");
  }
}

/*****************************************************************************
 * NM Control
 * These functions can be called from the main program or react on
 * panel controls in order to manipulate the NM status of the controlled node.
 *****************************************************************************/

void NMCAN2_Enable (int enable)
{
  /* void NMCAN2_Enable (int enable);
   *
   *  Function enables/disables the Network Management DLL.
   */
  int wasEnabled = -1;

  //if (enable == wasEnabled) return;

  if (gNMPCAN2_DebugFlags & cNMPCAN2_NMControlDebug)
  {
    write("[%.6f %NODE_NAME%] NMCAN2_Enable(%d) called ...", TimeNowNS()/cNMCAN2_NS2S, enable);
  }

  SetBusContext(gNMCAN2_BusContext);
  if (enable == 1)
  {
    NMCtrlSimulationOn();
  }
  else
  {
    NMCtrlSimulationOff();
  }

  wasEnabled = enable;
}

void NMCAN2_SetApplActivity (int activity)
{
  /* void NMCAN2_SetApplActivity (int activity);
   *
   *  Function sets the application activity at the Interaction Layer.
   */
  int wasActivity = -1;

  //if (activity == wasActivity) return;

  if (gNMPCAN2_DebugFlags & cNMPCAN2_NMControlDebug)
  {
    write("[%.6f %NODE_NAME%] NMCAN2_SetApplActivity(%d) called ...", TimeNowNS()/cNMCAN2_NS2S, activity);
  }

  SetBusContext(gNMCAN2_BusContext);
  if (activity > 0)
  {
    gNMCAN2_CurrentApplActivity = 1;
    NMSetApplicationActivity(1);
  }
  else
  {
    gNMCAN2_CurrentApplActivity = 0;
    NMSetApplicationActivity(0);
  }

  NMCAN2_StateChangeNotificationCalculateLocalRequestState();
  NMCAN2_StateChangeNotification( gNMCAN2_CurrentNMState, (gNMCAN2_CurrentLocalRequestState > 0) ? cCAN2_OSEK_NM_STATE_AWAKE : cCAN2_OSEK_NM_STATE_READY_SLEEP);
  wasActivity = activity;
}

NMCAN2_ReleaseBus()
{
  gNMCAN2_CurrentLocalRequestPending = 0;
  if (gNMPCAN2_DebugFlags & cNMPCAN2_NMControlDebug)
  {
    write("[%.6f %NODE_NAME%]: GotoMode_BusSleep()", TimeNowNS()/cNMCAN2_NS2S);
  }
  SetBusContext(gNMCAN2_BusContext);
  GotoMode_BusSleep();
  NMCAN2_StateChangeNotificationCalculateLocalRequestState();
  NMCAN2_StateChangeNotification( gNMCAN2_CurrentNMState, (gNMCAN2_CurrentLocalRequestState > 0) ? cCAN2_OSEK_NM_STATE_AWAKE : cCAN2_OSEK_NM_STATE_READY_SLEEP);
}

NMCAN2_RequestBus ()
{
  gNMCAN2_CurrentLocalRequestPending = 1;
  if (gNMPCAN2_DebugFlags & cNMPCAN2_NMControlDebug)
  {
    write("[%.6f %NODE_NAME%]: GotoMode_Awake()", TimeNowNS()/cNMCAN2_NS2S);
  }
  SetBusContext(gNMCAN2_BusContext);
  GotoMode_Awake();
  NMCAN2_StateChangeNotificationCalculateLocalRequestState();
  NMCAN2_StateChangeNotification( gNMCAN2_CurrentNMState, (gNMCAN2_CurrentLocalRequestState > 0) ? cCAN2_OSEK_NM_STATE_AWAKE : cCAN2_OSEK_NM_STATE_READY_SLEEP);
}

NMCAN2_PassiveBusStart ()
{
  SetBusContext(gNMCAN2_BusContext);
  GotoMode_Awake();
  if (gNMCAN2_CurrentLocalRequestState > 0)
  {
    if (gNMPCAN2_DebugFlags & cNMPCAN2_NMControlDebug)
    {
      write("[%.6f %NODE_NAME%]: GotoMode_Awake()", TimeNowNS()/cNMCAN2_NS2S);
    }
  }
  else
  {
    GotoMode_BusSleep();
    if (gNMPCAN2_DebugFlags & cNMPCAN2_NMControlDebug)
    {
      write("[%.6f %NODE_NAME%]: GotoMode_BusSleep()", TimeNowNS()/cNMCAN2_NS2S);
    }
  }
}

NMCAN2_PowerOnStart()
{
  //NMCAN2_PassiveBusStart();
}

on sysvar sysvar::NM_CAN2::StateControl::NmPduTxEnable
{
  SetBusContext(gNMCAN2_BusContext);
  /*
  if(@this == 1)
    Nm_DisablePassiveMode(); // NM PDU is transmitted after wake up, and in normal operation and repeat message state
  else 
    Nm_EnablePassiveMode(); // NM PDU is never transmitted
  */
}

/*****************************************************************************
 * NM Indications
 * They are called from the NM simulation in order to control the IL.
 *****************************************************************************/

void NMCAN2_IndCanWakeUp() // Nm_NetworkStartInd()
{
  if (gNMPCAN2_DebugFlags & cNMCAN2_NMIndDebug)
  {
    write("[%.6f %NODE_NAME%]: apCanWakeUp()", TimeNowNS()/cNMCAN2_NS2S);
  }
  NMCAN2_PassiveBusStart();
}

void NMCAN2_IndCanOn() // Nm_NetworkModeInd()
{
  if (gNMPCAN2_DebugFlags & cNMCAN2_NMIndDebug)
  {
    write("[%.6f %NODE_NAME%]: apCanOn()", TimeNowNS()/cNMCAN2_NS2S);
  }
  NMCAN2_StateChangeNotification( gNMCAN2_CurrentNMState, (gNMCAN2_CurrentLocalRequestState > 0) ? cCAN2_OSEK_NM_STATE_AWAKE : cCAN2_OSEK_NM_STATE_READY_SLEEP);
  StartSim(gNMCAN2_BusContext, 1, 4);
}

void NMCAN2_IndCanOff() // Nm_BusSleepModeInd()
{
  if (gNMPCAN2_DebugFlags & cNMCAN2_NMIndDebug)
  {
    write("[%.6f %NODE_NAME%]: apCanOff()", TimeNowNS()/cNMCAN2_NS2S);
  }
  StopSim(gNMCAN2_BusContext, 1, 4);
}

void NMCAN2_IndCanNormal()
{
  if (gNMPCAN2_DebugFlags & cNMCAN2_NMIndDebug)
  {
    write("[%.6f %NODE_NAME%]: apCanNormal()", TimeNowNS()/cNMCAN2_NS2S);
  }
}

void NMCAN2_IndCanSleep()
{
  if (gNMPCAN2_DebugFlags & cNMCAN2_NMIndDebug)
  {
    write("[%.6f %NODE_NAME%]: apCanSleep()", TimeNowNS()/cNMCAN2_NS2S);
  }
}

void NMCAN2_IndBusSleep()
{
  if (gNMPCAN2_DebugFlags & cNMCAN2_NMIndDebug)
  {
    write("[%.6f %NODE_NAME%]: apBusSleep()", TimeNowNS()/cNMCAN2_NS2S);
  }
  NMCAN2_StateChangeNotification( gNMCAN2_CurrentNMState, cCAN2_OSEK_NM_STATE_BUS_SLEEP);
}

long NMCAN2_IndPreSend(byte buf[], byte dlc[])
{
  dword NMStatus;
  long currentState;

  if ((gNMPCAN2_DebugFlags & cNMCAN2_NMIndDebug) && 0)
  {
    write("[%.6f %NODE_NAME%]: apIndPreSend()", TimeNowNS()/cNMCAN2_NS2S);
  }

  NMStatus = NMCAN2_ObserveNMStatus();
  if (NMStatus & 0x40)
  {
    // NM is on:
    currentState = gNMCAN2_CurrentNMState;
    if (currentState == cCAN2_OSEK_NM_STATE_UNDEFINED || currentState == cCAN2_OSEK_NM_STATE_BUS_SLEEP)
    {
      NMCAN2_StateChangeNotification( gNMCAN2_CurrentNMState, (gNMCAN2_CurrentLocalRequestState > 0) ? cCAN2_OSEK_NM_STATE_AWAKE : cCAN2_OSEK_NM_STATE_READY_SLEEP);
    }
  }

  return 1;
}

dword NMCAN2_ObserveNMStatus()
{
  dword NMStatus, NMOldStatus = 0;

  NMStatus = NMGetStatus();
  if ((gNMPCAN2_DebugFlags & cNMCAN2_NMIndDebug) && (NMStatus != NMOldStatus))
  {
    write("[%.6f %NODE_NAME%]: NM status:", TimeNowNS()/cNMCAN2_NS2S);
    write("[%.6f %NODE_NAME%]:   Stable         = %d", TimeNowNS()/cNMCAN2_NS2S, ((NMStatus & 0x01) ? 1 : 0));
    write("[%.6f %NODE_NAME%]:   CAN Drv        = %d", TimeNowNS()/cNMCAN2_NS2S, ((NMStatus & 0x02) ? 1 : 0));
    write("[%.6f %NODE_NAME%]:   Err PIN        = %d", TimeNowNS()/cNMCAN2_NS2S, ((NMStatus & 0x04) ? 1 : 0));
    write("[%.6f %NODE_NAME%]:   Bus Sleep      = %d", TimeNowNS()/cNMCAN2_NS2S, ((NMStatus & 0x10) ? 1 : 0));
    write("[%.6f %NODE_NAME%]:   Limp Home      = %d", TimeNowNS()/cNMCAN2_NS2S, ((NMStatus & 0x20) ? 1 : 0));
    write("[%.6f %NODE_NAME%]:   NM on          = %d", TimeNowNS()/cNMCAN2_NS2S, ((NMStatus & 0x40) ? 1 : 0));
    write("[%.6f %NODE_NAME%]:   Ready-to-sleep = %d", TimeNowNS()/cNMCAN2_NS2S, ((NMStatus & 0x80) ? 1 : 0));
  }
  
  NMOldStatus = NMStatus;
  return NMStatus;
}

void NMCAN2_StateChangeNotificationCalculateLocalRequestState()
{
  if (gNMCAN2_CurrentApplActivity <= 0)
  {
    gNMCAN2_CurrentLocalRequestState = gNMCAN2_CurrentLocalRequestPending;
  }
  else
  {
    if (gNMCAN2_CurrentLocalRequestPending > 0)
    {
      gNMCAN2_CurrentLocalRequestState = gNMCAN2_CurrentLocalRequestPending;
    }
  }
}

void NMCAN2_StateChangeNotification( long previousState, long currentState) 
{
  long mode;
  if ((previousState == cCAN2_OSEK_NM_STATE_UNDEFINED || previousState == cCAN2_OSEK_NM_STATE_BUS_SLEEP) && (currentState != cCAN2_OSEK_NM_STATE_BUS_SLEEP))
  { 
    @sysvar::NM_CAN2::StateControl::ActiveNodes += 1;
  }
  if ((previousState != cCAN2_OSEK_NM_STATE_UNDEFINED) && (currentState == cCAN2_OSEK_NM_STATE_BUS_SLEEP))
  { 
    @sysvar::NM_CAN2::StateControl::ActiveNodes -= 1;
  }

  gNMCAN2_CurrentNMState = currentState;

  if ((currentState <= cCAN2_OSEK_NM_STATE_BUS_SLEEP) || (currentState > cCAN2_OSEK_NM_STATE_AWAKE))
  {
    mode = cCAN2_NM_NODE_MODE_Sleep_Mode;
  }
  else
  {
    mode = cCAN2_NM_NODE_MODE_Network_Mode;
  }

  if (gNMPCAN2_DebugFlags & cNMCAN2_NMIndDebug)
  {
    write("[%.6f %NODE_NAME%]: NM currentState = %d, mode = %d", TimeNowNS()/cNMCAN2_NS2S, currentState, mode);
  }
}

/*****************************************************************************
 * EOF
 *****************************************************************************/
