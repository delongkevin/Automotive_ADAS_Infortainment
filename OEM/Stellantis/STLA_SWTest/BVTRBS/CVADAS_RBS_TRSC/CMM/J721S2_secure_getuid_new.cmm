;;;;;;;;;;;;;;;;;;;;;;;;;;;;;;;;;;;;;;;;;;;;;;;;;;;;;;;;;;;;;;;;;;;;;;;;;;;;;;
; GET Device UID via JTAG for HS_FS & HS_SE units
; 08 Oct 22 - Richard Woodruff - Add header and FW commands
;;;;;;;;;;;;;;;;;;;;;;;;;;;;;;;;;;;;;;;;;;;;;;;;;;;;;;;;;;;;;;;;;;;;;;;;;;;;;;
; Script INPUT PARMS: (DIAG, DEBUG)
;
; DIAG:
;  - diagnostic mode test mode to get ID. This is a non-booting state.
;  - mode entered by forcing EMU0=0,EMU1=1 via EVM DIP switches
; DEBUG
;  - mode where running TIFS handles commands.
;   --TIFS can be started via memory per peripherals like uart

 PRIVATE &parameters
 LOCAL &temp
 ENTRY %LINE &parameters
 &parameters=STRing.UPpeR("&parameters")

 &parameters="DIAG"

 PRIVATE &param_diag &param_debug
 &param_diag=(STRing.SCAN("&parameters","DIAG",0)!=-1)
 &param_debug=(STRing.SCAN("&parameters","DEBUG",0)!=-1)

 LOCAL &scmd

 IF (&param_diag)
 (
   JTAG.PIN ENable  ; output enable the LB driver
   DIAG 3403 3      ; Force DBGREQ (high) to set EMU0 Low on LB headers which invert
   ; Now Power the EVM
   &scmd=0x80B5729F ; WIR_COMMAND_SOCINFO_REQUEST
 )
 ELSE
 (
   &scmd=0x80B5AE71  ; FW_COMMAND_GET_UID
 )

 system.cpu J721S2-CM4-0
 SYStem.Option EnReset OFF 
 SYStem.Mode PREPARE
 data.Set EDBG:0x400003f0 %Long 0x00190000    ; Unlock APs

 area.view
 area.clear

 ; Indicate one word command length
 data.set EDBG:0x40000604 %Long 0x00010000
 ; Send SOC INFO request
 data.set EDBG:0x40000600 %Long &scmd

 REPEAT 42.
 (
  wait 5ms
  &temp=Data.Long.BE(EDBG:0x40000608)
 )

 REPEAT 8.
 (
   wait 5ms
   PRINT %CONTinue FORMAT.HEX(8.,Data.Long.BE(EDBG:0x40000608))
 )

 system.down
