/*@!Encoding:65001*/
includes
{
  
}

variables
{
  char homedir[50] = "";
  char command[5] = "4";
}

export testcase CDA_Unlock()
{
  long response;
  teststep("","Unlocking CVADAS ECU...");
  response = testWaitForSyscall(homedir,"python CDA_Unlock.py",1, 20000);
  
  if(response != 1)
  {
    testStepFail("","Failed to unlock CVADAS ECU!");
  }
  testStepPass("","Successfully Unlocked CVADAS ECU - 2711/2712!");
}

void MainTest ()
{
  CDA_Unlock();
}

