/*@!Encoding:1252*/
includes
{
  // Import required CAPL include files
  //--- begin generated part --- Block start #Hdr_Includes#; do not delete this line and do not add application code in this code block!
  /* #ChannelStart# |CAN1| #BusStart# |FDCAN2_1| */
  /* #ChannelEnd# |CAN1| #BusEnd# |FDCAN2_1| */
  //--- end generated part --- Block end #Hdr_Includes#; do not delete this line! Add application code below this line.
  //--- begin generated part --- Block start #Body_Includes#; do not delete this line and do not add application code in this code block!
  /* #ChannelStart# |CAN1| #BusStart# |FDCAN2_1| */
  #include "..\CAPL\Vector-IL-KL30-Helper_CAN1.cin"
  #include "..\CAPL\Vector-NM-Panel-Helper_CAN1.cin"
  #include "..\CAPL\Vector-NM-ASR-Helper_CAN1.cin"
  /* #ChannelEnd# |CAN1| #BusEnd# |FDCAN2_1| */
  //--- end generated part --- Block end #Body_Includes#; do not delete this line! Add application code below this line.
}

variables
{
  // Define global variables for this CAPL file

  /*--- #GenHeader Begin# --- begin generated comment ---
  | Generated on Tuesday, November 15, 2022, 19:51:27
  | By ModelGenerator for Vector 1.5.4.10, ModelGeneratorVectorDLL 1.5.4.41
  | Package Vector 4.0.21
  | Target Bus: FDCAN2_1; Channel: CAN1; DB Cluster: FDCAN2_1;
  | From Database: FDCAN2.dbc
  | CANoe Version 15.5.23.0
    --- #GenHeader End  # --- end generated comment --- */

  char gECU[256] = "BCM";
  //--- begin generated part --- Block start #Hdr_GlobalVariables#; do not delete this line and do not add application code in this code block!
  /* #ChannelStart# |CAN1| #BusStart# |FDCAN2_1| */
  /* #ChannelEnd# |CAN1| #BusEnd# |FDCAN2_1| */
  //--- end generated part --- Block end #Hdr_GlobalVariables#; do not delete this line! Add application code below this line.
  //--- begin generated part --- Block start #Body_GlobalVariables#; do not delete this line and do not add application code in this code block!
  /* #ChannelStart# |CAN1| #BusStart# |FDCAN2_1| */
  char gCAN1BusName[256] = "FDCAN2_1";
  int gCAN1Channel = 1; //// The channel the bus is attached to

  long gCAN1DisturbanceMode;
  long gCAN1DisturbanceCount;
  long gCAN1DisturbanceValue;
  long gCAN1DisturbanceContinueMode;
  double gCAN1DisturbancePeriod;
  /* #ChannelEnd# |CAN1| #BusEnd# |FDCAN2_1| */
  //--- end generated part --- Block end #Body_GlobalVariables#; do not delete this line! Add application code below this line.
}

on preStart
{
  // Initialize CAPL includes and node's modules/DLLs
  //--- begin generated part --- Block start #Hdr_OnInit#; do not delete this line and do not add application code in this code block!
  /* #ChannelStart# |CAN1| #BusStart# |FDCAN2_1| */
  /* #ChannelEnd# |CAN1| #BusEnd# |FDCAN2_1| */
  //--- end generated part --- Block end #Hdr_OnInit#; do not delete this line! Add application code below this line.
  //--- begin generated part --- Block start #Body_OnInit#; do not delete this line and do not add application code in this code block!
  /* #ChannelStart# |CAN1| #BusStart# |FDCAN2_1| */
  ILCAN1_OnInit();
  NMCAN1_OnInit();
  /* #ChannelEnd# |CAN1| #BusEnd# |FDCAN2_1| */
  //--- end generated part --- Block end #Body_OnInit#; do not delete this line! Add application code below this line.
}

on start
{
  // Start CAPL includes and node's modules/DLLs
  //--- begin generated part --- Block start #Hdr_OnStart#; do not delete this line and do not add application code in this code block!
  /* #ChannelStart# |CAN1| #BusStart# |FDCAN2_1| */
  /* #ChannelEnd# |CAN1| #BusEnd# |FDCAN2_1| */
  //--- end generated part --- Block end #Hdr_OnStart#; do not delete this line! Add application code below this line.
  //--- begin generated part --- Block start #Body_OnStart#; do not delete this line and do not add application code in this code block!
  /* #ChannelStart# |CAN1| #BusStart# |FDCAN2_1| */
  ILCAN1_OnStart();
  NMCAN1_OnStart();
  /* #ChannelEnd# |CAN1| #BusEnd# |FDCAN2_1| */
  //--- end generated part --- Block end #Body_OnStart#; do not delete this line! Add application code below this line.
}

on preStop
{
  // Prepare stopping
  //--- begin generated part --- Block start #Hdr_OnStopping#; do not delete this line and do not add application code in this code block!
  /* #ChannelStart# |CAN1| #BusStart# |FDCAN2_1| */
  /* #ChannelEnd# |CAN1| #BusEnd# |FDCAN2_1| */
  //--- end generated part --- Block end #Hdr_OnStopping#; do not delete this line! Add application code below this line.
  //--- begin generated part --- Block start #Body_OnStopping#; do not delete this line and do not add application code in this code block!
  /* #ChannelStart# |CAN1| #BusStart# |FDCAN2_1| */
  /* #ChannelEnd# |CAN1| #BusEnd# |FDCAN2_1| */
  //--- end generated part --- Block end #Body_OnStopping#; do not delete this line! Add application code below this line.
}

on stopMeasurement
{
  // Stop actions
  //--- begin generated part --- Block start #Hdr_OnStop#; do not delete this line and do not add application code in this code block!
  /* #ChannelStart# |CAN1| #BusStart# |FDCAN2_1| */
  /* #ChannelEnd# |CAN1| #BusEnd# |FDCAN2_1| */
  //--- end generated part --- Block end #Hdr_OnStop#; do not delete this line! Add application code below this line.
  //--- begin generated part --- Block start #Body_OnStop#; do not delete this line and do not add application code in this code block!
  /* #ChannelStart# |CAN1| #BusStart# |FDCAN2_1| */
  /* #ChannelEnd# |CAN1| #BusEnd# |FDCAN2_1| */
  //--- end generated part --- Block end #Body_OnStop#; do not delete this line! Add application code below this line.
}

void StartSim(dword busContext, int busActive, int mode)
{
  // Called when ... due to ...
  //   mode == 1: ILControlResume
  //   mode == 2: ILControlStart
  //   mode == 3: ILControlSimulationOn
  //--- begin generated part --- Block start #Hdr_StartSim#; do not delete this line and do not add application code in this code block!
  /* #ChannelStart# |CAN1| #BusStart# |FDCAN2_1| */
  /* #ChannelEnd# |CAN1| #BusEnd# |FDCAN2_1| */
  //--- end generated part --- Block end #Hdr_StartSim#; do not delete this line! Add application code below this line.
  //write("[%.6f %NODE_NAME%] StartSim(0x%X, %d, %d)", TimeNowNS()/1e9, busContext, busActive, mode);
  //--- begin generated part --- Block start #Body_StartSim#; do not delete this line and do not add application code in this code block!
  /* #ChannelStart# |CAN1| #BusStart# |FDCAN2_1| */
  /* #ChannelEnd# |CAN1| #BusEnd# |FDCAN2_1| */
  //--- end generated part --- Block end #Body_StartSim#; do not delete this line! Add application code below this line.
}

void StopSim(dword busContext, int busActive, int mode)
{
  // Called when ... due to ...
  //   mode == 1: ILControlWait
  //   mode == 2: ILControlStop
  //   mode == 3: ILControlSimulationOff
  //--- begin generated part --- Block start #Hdr_StopSim#; do not delete this line and do not add application code in this code block!
  /* #ChannelStart# |CAN1| #BusStart# |FDCAN2_1| */
  /* #ChannelEnd# |CAN1| #BusEnd# |FDCAN2_1| */
  //--- end generated part --- Block end #Hdr_StopSim#; do not delete this line! Add application code below this line.
  //write("[%.6f %NODE_NAME%] StopSim(0x%X, %d, %d)", TimeNowNS()/1e9, busContext, busActive, mode);
  //--- begin generated part --- Block start #Body_StopSim#; do not delete this line and do not add application code in this code block!
  /* #ChannelStart# |CAN1| #BusStart# |FDCAN2_1| */
  /* #ChannelEnd# |CAN1| #BusEnd# |FDCAN2_1| */
  //--- end generated part --- Block end #Body_StopSim#; do not delete this line! Add application code below this line.
}

on sysvar_update sysvar::IL::Klemme15
{
  // Handle system state variable
  //--- begin generated part --- Block start #Hdr_KL15_Klemme15#; do not delete this line and do not add application code in this code block!
  /* #ChannelStart# |CAN1| #BusStart# |FDCAN2_1| */
  /* #ChannelEnd# |CAN1| #BusEnd# |FDCAN2_1| */
  //--- end generated part --- Block end #Hdr_KL15_Klemme15#; do not delete this line! Add application code below this line.
  //--- begin generated part --- Block start #Body_KL15_Klemme15#; do not delete this line and do not add application code in this code block!
  /* #ChannelStart# |CAN1| #BusStart# |FDCAN2_1| */
  ILCAN1_OnEnvKlemme15(@this);
  /* #ChannelEnd# |CAN1| #BusEnd# |FDCAN2_1| */
  //--- end generated part --- Block end #Body_KL15_Klemme15#; do not delete this line! Add application code below this line.
}

on sysvar_update sysvar::IL::Klemme30
{
  // Handle system state variable
  //--- begin generated part --- Block start #Hdr_KL30_Klemme30#; do not delete this line and do not add application code in this code block!
  /* #ChannelStart# |CAN1| #BusStart# |FDCAN2_1| */
  /* #ChannelEnd# |CAN1| #BusEnd# |FDCAN2_1| */
  //--- end generated part --- Block end #Hdr_KL30_Klemme30#; do not delete this line! Add application code below this line.
  //--- begin generated part --- Block start #Body_KL30_Klemme30#; do not delete this line and do not add application code in this code block!
  /* #ChannelStart# |CAN1| #BusStart# |FDCAN2_1| */
  ILCAN1_OnEnvKlemme30(@this);
  /* #ChannelEnd# |CAN1| #BusEnd# |FDCAN2_1| */
  //--- end generated part --- Block end #Body_KL30_Klemme30#; do not delete this line! Add application code below this line.
}

dword applILTxPending(long aId, dword aDlc, byte data[])
{
  dword ret = 1;
  //--- begin generated part --- Block start #Hdr_applILTxPending#; do not delete this line and do not add application code in this code block!
  /* #ChannelStart# |CAN1| #BusStart# |FDCAN2_1| */
  /* #ChannelEnd# |CAN1| #BusEnd# |FDCAN2_1| */
  //--- end generated part --- Block end #Hdr_applILTxPending#; do not delete this line! Add application code below this line.
  //--- begin generated part --- Block start #Body_applILTxPending#; do not delete this line and do not add application code in this code block!
  /* #ChannelStart# |CAN1| #BusStart# |FDCAN2_1| */
  /* #ChannelEnd# |CAN1| #BusEnd# |FDCAN2_1| */
  //--- end generated part --- Block end #Body_applILTxPending#; do not delete this line! Add application code below this line.
  return ret;
}

void Nm_NetworkStartInd()
{
  // Callback of CAN AUTOSAR NM DLL
  dword lBusContext;
  //--- begin generated part --- Block start #Hdr_Nm_NetworkStartInd#; do not delete this line and do not add application code in this code block!
  /* #ChannelStart# |CAN1| #BusStart# |FDCAN2_1| */
  /* #ChannelEnd# |CAN1| #BusEnd# |FDCAN2_1| */
  //--- end generated part --- Block end #Hdr_Nm_NetworkStartInd#; do not delete this line! Add application code below this line.
  lBusContext = GetBusContext();
  //--- begin generated part --- Block start #Body_Nm_NetworkStartInd#; do not delete this line and do not add application code in this code block!
  /* #ChannelStart# |CAN1| #BusStart# |FDCAN2_1| */
  if (lBusContext == gNMCAN1_BusContext) NMCAN1_IndNetworkStart();
  /* #ChannelEnd# |CAN1| #BusEnd# |FDCAN2_1| */
  //--- end generated part --- Block end #Body_Nm_NetworkStartInd#; do not delete this line! Add application code below this line.
  SetBusContext(lBusContext);
}

void Nm_NetworkModeInd()
{
  // Callback of CAN AUTOSAR NM DLL
  dword lBusContext;
  //--- begin generated part --- Block start #Hdr_Nm_NetworkModeInd#; do not delete this line and do not add application code in this code block!
  /* #ChannelStart# |CAN1| #BusStart# |FDCAN2_1| */
  /* #ChannelEnd# |CAN1| #BusEnd# |FDCAN2_1| */
  //--- end generated part --- Block end #Hdr_Nm_NetworkModeInd#; do not delete this line! Add application code below this line.
  lBusContext = GetBusContext();
  //--- begin generated part --- Block start #Body_Nm_NetworkModeInd#; do not delete this line and do not add application code in this code block!
  /* #ChannelStart# |CAN1| #BusStart# |FDCAN2_1| */
  if (lBusContext == gNMCAN1_BusContext) NMCAN1_IndNetworkMode();
  /* #ChannelEnd# |CAN1| #BusEnd# |FDCAN2_1| */
  //--- end generated part --- Block end #Body_Nm_NetworkModeInd#; do not delete this line! Add application code below this line.
  SetBusContext(lBusContext);
}

void Nm_NetworkTimeoutInd()
{
  // Callback of CAN AUTOSAR NM DLL
  dword lBusContext;
  //--- begin generated part --- Block start #Hdr_Nm_NetworkTimeoutInd#; do not delete this line and do not add application code in this code block!
  /* #ChannelStart# |CAN1| #BusStart# |FDCAN2_1| */
  /* #ChannelEnd# |CAN1| #BusEnd# |FDCAN2_1| */
  //--- end generated part --- Block end #Hdr_Nm_NetworkTimeoutInd#; do not delete this line! Add application code below this line.
  lBusContext = GetBusContext();
  //--- begin generated part --- Block start #Body_Nm_NetworkTimeoutInd#; do not delete this line and do not add application code in this code block!
  /* #ChannelStart# |CAN1| #BusStart# |FDCAN2_1| */
  if (lBusContext == gNMCAN1_BusContext) NMCAN1_IndNetworkTimeout();
  /* #ChannelEnd# |CAN1| #BusEnd# |FDCAN2_1| */
  //--- end generated part --- Block end #Body_Nm_NetworkTimeoutInd#; do not delete this line! Add application code below this line.
  SetBusContext(lBusContext);
}

void Nm_PrepareBusSleepModeInd()
{
  // Callback of CAN AUTOSAR NM DLL
  dword lBusContext;
  //--- begin generated part --- Block start #Hdr_Nm_PrepareBusSleepModeInd#; do not delete this line and do not add application code in this code block!
  /* #ChannelStart# |CAN1| #BusStart# |FDCAN2_1| */
  /* #ChannelEnd# |CAN1| #BusEnd# |FDCAN2_1| */
  //--- end generated part --- Block end #Hdr_Nm_PrepareBusSleepModeInd#; do not delete this line! Add application code below this line.
  lBusContext = GetBusContext();
  //--- begin generated part --- Block start #Body_Nm_PrepareBusSleepModeInd#; do not delete this line and do not add application code in this code block!
  /* #ChannelStart# |CAN1| #BusStart# |FDCAN2_1| */
  if (lBusContext == gNMCAN1_BusContext) NMCAN1_IndPrepareBusSleepMode();
  /* #ChannelEnd# |CAN1| #BusEnd# |FDCAN2_1| */
  //--- end generated part --- Block end #Body_Nm_PrepareBusSleepModeInd#; do not delete this line! Add application code below this line.
  SetBusContext(lBusContext);
}

void Nm_BusSleepModeInd()
{
  // Callback of CAN AUTOSAR NM DLL
  dword lBusContext;
  //--- begin generated part --- Block start #Hdr_Nm_BusSleepModeInd#; do not delete this line and do not add application code in this code block!
  /* #ChannelStart# |CAN1| #BusStart# |FDCAN2_1| */
  /* #ChannelEnd# |CAN1| #BusEnd# |FDCAN2_1| */
  //--- end generated part --- Block end #Hdr_Nm_BusSleepModeInd#; do not delete this line! Add application code below this line.
  lBusContext = GetBusContext();
  //--- begin generated part --- Block start #Body_Nm_BusSleepModeInd#; do not delete this line and do not add application code in this code block!
  /* #ChannelStart# |CAN1| #BusStart# |FDCAN2_1| */
  if (lBusContext == gNMCAN1_BusContext) NMCAN1_IndBusSleepMode();
  /* #ChannelEnd# |CAN1| #BusEnd# |FDCAN2_1| */
  //--- end generated part --- Block end #Body_Nm_BusSleepModeInd#; do not delete this line! Add application code below this line.
  SetBusContext(lBusContext);
}

void Nm_StateChangeNotification(long previousState, long currentState)
{
  // Callback of CAN AUTOSAR NM DLL
  dword lBusContext;
  //--- begin generated part --- Block start #Hdr_Nm_StateChangeNotification#; do not delete this line and do not add application code in this code block!
  /* #ChannelStart# |CAN1| #BusStart# |FDCAN2_1| */
  /* #ChannelEnd# |CAN1| #BusEnd# |FDCAN2_1| */
  //--- end generated part --- Block end #Hdr_Nm_StateChangeNotification#; do not delete this line! Add application code below this line.
  lBusContext = GetBusContext();
  //--- begin generated part --- Block start #Body_Nm_StateChangeNotification#; do not delete this line and do not add application code in this code block!
  /* #ChannelStart# |CAN1| #BusStart# |FDCAN2_1| */
  if (lBusContext == gNMCAN1_BusContext) NMCAN1_IndStateChangeNotification(previousState, currentState);
  /* #ChannelEnd# |CAN1| #BusEnd# |FDCAN2_1| */
  //--- end generated part --- Block end #Body_Nm_StateChangeNotification#; do not delete this line! Add application code below this line.
  SetBusContext(lBusContext);
}

//--- begin generated part --- Block start <#Helper_Functions#> do not delete this line and do not add application code in this code block!
/* #ChannelStart# |CAN1| #BusStart# |FDCAN2_1| */
/* #ChannelEnd# |CAN1| #BusEnd# |FDCAN2_1| */
//--- end generated part --- Block end <#Helper_Functions#> do not delete this line! Add application code below this line.

//--- begin generated part --- Block start <#SysVar_Handler#> do not delete this line and do not add application code in this code block!
/* #ChannelStart# |CAN1| #BusStart# |FDCAN2_1| */
on sysvar_update sysvar::IL_CAN1::NODES::N_BCM::EnableNode
{
  ILCAN1_Enable(@this && @sysvar::IL_CAN1::enable_AllNodes);
}

on sysvar_update sysvar::IL_CAN1::enable_AllNodes
{
  ILCAN1_Enable(@this && @sysvar::IL_CAN1::NODES::N_BCM::EnableNode);
}

on sysvar_update sysvar::NM_CAN1::NODES::N_BCM::DeactivateNM
{
  if( @this == 1 || @sysvar::NM_CAN1::StateControl::DeactivateNM == 1)
  {
    NMCAN1_Enable(0);
  }
  else
  {
    NMCAN1_Enable(1);
  }
}

on sysvar_update sysvar::NM_CAN1::StateControl::DeactivateNM
{
  if( @this == 1 || @sysvar::NM_CAN1::NODES::N_BCM::DeactivateNM == 1)
  {
    NMCAN1_Enable(0);
  }
  else
  {
    NMCAN1_Enable(1);
  }
}

on sysvar_update sysvar::IL_CAN1::NODES::N_BCM::MESSAGES::ADAS_FD_INFO::TIMINGS::EnableCyclic
{
  if (@this == 1)
  {
    SetBusContext(gILCAN1_BusContext);
    ILFaultInjectionEnableMsg  (FDCAN2_1::BCM::ADAS_FD_INFO);
  }
  else
  {
    SetBusContext(gILCAN1_BusContext);
    ILFaultInjectionDisableMsg (FDCAN2_1::BCM::ADAS_FD_INFO);
  }
}

on sysvar_update sysvar::IL_CAN1::NODES::N_BCM::MESSAGES::ADAS_FD_INFO::TIMINGS::SetNormalCycle
{
  if (@this == 1 && @sysvar::IL_CAN1::NODES::N_BCM::MESSAGES::ADAS_FD_INFO::TIMINGS::EnableCyclic)
  {
    @sysvar::IL_CAN1::NODES::N_BCM::MESSAGES::ADAS_FD_INFO::TIMINGS::SelectedPeriod = 0;
  }
}

on sysvar_update sysvar::IL_CAN1::NODES::N_BCM::MESSAGES::ADAS_FD_INFO::TIMINGS::SetNewCycleContinously
{
  if (@this == 1 && @sysvar::IL_CAN1::NODES::N_BCM::MESSAGES::ADAS_FD_INFO::TIMINGS::EnableCyclic)
  {
    @sysvar::IL_CAN1::NODES::N_BCM::MESSAGES::ADAS_FD_INFO::TIMINGS::SelectedPeriod = -1;
  }
}

on sysvar_update sysvar::IL_CAN1::NODES::N_BCM::MESSAGES::ADAS_FD_INFO::TIMINGS::SelectedPeriod
{
  if (@this == 0 && @sysvar::IL_CAN1::NODES::N_BCM::MESSAGES::ADAS_FD_INFO::TIMINGS::EnableCyclic)
  {
    SetBusContext(gILCAN1_BusContext);
    gCAN1DisturbancePeriod = @sysvar::IL_CAN1::NODES::N_BCM::MESSAGES::ADAS_FD_INFO::TIMINGS::NormalCyclePeriod;
    ILFaultInjectionResetMsgCycleTime(FDCAN2_1::BCM::ADAS_FD_INFO);
  }
  else if (@this == 1 && @sysvar::IL_CAN1::NODES::N_BCM::MESSAGES::ADAS_FD_INFO::TIMINGS::EnableCyclic)
  {
    SetBusContext(gILCAN1_BusContext);
    gCAN1DisturbancePeriod = @sysvar::IL_CAN1::NODES::N_BCM::MESSAGES::ADAS_FD_INFO::TIMINGS::ActiveCyclePeriod;
    ILFaultInjectionSetMsgCycleTime(FDCAN2_1::BCM::ADAS_FD_INFO, gCAN1DisturbancePeriod);
  }
  else if (@this == -1 && @sysvar::IL_CAN1::NODES::N_BCM::MESSAGES::ADAS_FD_INFO::TIMINGS::EnableCyclic)
  {
    SetBusContext(gILCAN1_BusContext);
    gCAN1DisturbancePeriod = @sysvar::IL_CAN1::NODES::N_BCM::MESSAGES::ADAS_FD_INFO::TIMINGS::CyclePeriod;
    ILFaultInjectionSetMsgCycleTime(FDCAN2_1::BCM::ADAS_FD_INFO, gCAN1DisturbancePeriod);
  }
}

on sysvar_update sysvar::IL_CAN1::NODES::N_BCM::MESSAGES::ADAS_FD_INFO::TIMINGS::SendOnce
{
  if (@this == 1)
  {
    SetBusContext(gILCAN1_BusContext);
    ILSetMsgEvent(FDCAN2_1::BCM::ADAS_FD_INFO);
  }
}

on sysvar_update sysvar::IL_CAN1::NODES::N_BCM::MESSAGES::AGSM_FD_2::TIMINGS::EnableCyclic
{
  if (@this == 1)
  {
    SetBusContext(gILCAN1_BusContext);
    ILFaultInjectionEnableMsg  (FDCAN2_1::BCM::AGSM_FD_2);
  }
  else
  {
    SetBusContext(gILCAN1_BusContext);
    ILFaultInjectionDisableMsg (FDCAN2_1::BCM::AGSM_FD_2);
  }
}

on sysvar_update sysvar::IL_CAN1::NODES::N_BCM::MESSAGES::AGSM_FD_2::TIMINGS::SetNormalCycle
{
  if (@this == 1 && @sysvar::IL_CAN1::NODES::N_BCM::MESSAGES::AGSM_FD_2::TIMINGS::EnableCyclic)
  {
    @sysvar::IL_CAN1::NODES::N_BCM::MESSAGES::AGSM_FD_2::TIMINGS::SelectedPeriod = 0;
  }
}

on sysvar_update sysvar::IL_CAN1::NODES::N_BCM::MESSAGES::AGSM_FD_2::TIMINGS::SetNewCycleContinously
{
  if (@this == 1 && @sysvar::IL_CAN1::NODES::N_BCM::MESSAGES::AGSM_FD_2::TIMINGS::EnableCyclic)
  {
    @sysvar::IL_CAN1::NODES::N_BCM::MESSAGES::AGSM_FD_2::TIMINGS::SelectedPeriod = -1;
  }
}

on sysvar_update sysvar::IL_CAN1::NODES::N_BCM::MESSAGES::AGSM_FD_2::TIMINGS::SelectedPeriod
{
  if (@this == 0 && @sysvar::IL_CAN1::NODES::N_BCM::MESSAGES::AGSM_FD_2::TIMINGS::EnableCyclic)
  {
    SetBusContext(gILCAN1_BusContext);
    gCAN1DisturbancePeriod = @sysvar::IL_CAN1::NODES::N_BCM::MESSAGES::AGSM_FD_2::TIMINGS::NormalCyclePeriod;
    ILFaultInjectionResetMsgCycleTime(FDCAN2_1::BCM::AGSM_FD_2);
  }
  else if (@this == 1 && @sysvar::IL_CAN1::NODES::N_BCM::MESSAGES::AGSM_FD_2::TIMINGS::EnableCyclic)
  {
    SetBusContext(gILCAN1_BusContext);
    gCAN1DisturbancePeriod = @sysvar::IL_CAN1::NODES::N_BCM::MESSAGES::AGSM_FD_2::TIMINGS::ActiveCyclePeriod;
    ILFaultInjectionSetMsgCycleTime(FDCAN2_1::BCM::AGSM_FD_2, gCAN1DisturbancePeriod);
  }
  else if (@this == -1 && @sysvar::IL_CAN1::NODES::N_BCM::MESSAGES::AGSM_FD_2::TIMINGS::EnableCyclic)
  {
    SetBusContext(gILCAN1_BusContext);
    gCAN1DisturbancePeriod = @sysvar::IL_CAN1::NODES::N_BCM::MESSAGES::AGSM_FD_2::TIMINGS::CyclePeriod;
    ILFaultInjectionSetMsgCycleTime(FDCAN2_1::BCM::AGSM_FD_2, gCAN1DisturbancePeriod);
  }
}

on sysvar_update sysvar::IL_CAN1::NODES::N_BCM::MESSAGES::AGSM_FD_2::TIMINGS::SendOnce
{
  if (@this == 1)
  {
    SetBusContext(gILCAN1_BusContext);
    ILSetMsgEvent(FDCAN2_1::BCM::AGSM_FD_2);
  }
}

on sysvar_update sysvar::IL_CAN1::NODES::N_BCM::MESSAGES::ASCM_FD_1::TIMINGS::EnableCyclic
{
  if (@this == 1)
  {
    SetBusContext(gILCAN1_BusContext);
    ILFaultInjectionEnableMsg  (FDCAN2_1::BCM::ASCM_FD_1);
  }
  else
  {
    SetBusContext(gILCAN1_BusContext);
    ILFaultInjectionDisableMsg (FDCAN2_1::BCM::ASCM_FD_1);
  }
}

on sysvar_update sysvar::IL_CAN1::NODES::N_BCM::MESSAGES::ASCM_FD_1::TIMINGS::SetNormalCycle
{
  if (@this == 1 && @sysvar::IL_CAN1::NODES::N_BCM::MESSAGES::ASCM_FD_1::TIMINGS::EnableCyclic)
  {
    @sysvar::IL_CAN1::NODES::N_BCM::MESSAGES::ASCM_FD_1::TIMINGS::SelectedPeriod = 0;
  }
}

on sysvar_update sysvar::IL_CAN1::NODES::N_BCM::MESSAGES::ASCM_FD_1::TIMINGS::SetNewCycleContinously
{
  if (@this == 1 && @sysvar::IL_CAN1::NODES::N_BCM::MESSAGES::ASCM_FD_1::TIMINGS::EnableCyclic)
  {
    @sysvar::IL_CAN1::NODES::N_BCM::MESSAGES::ASCM_FD_1::TIMINGS::SelectedPeriod = -1;
  }
}

on sysvar_update sysvar::IL_CAN1::NODES::N_BCM::MESSAGES::ASCM_FD_1::TIMINGS::SelectedPeriod
{
  if (@this == 0 && @sysvar::IL_CAN1::NODES::N_BCM::MESSAGES::ASCM_FD_1::TIMINGS::EnableCyclic)
  {
    SetBusContext(gILCAN1_BusContext);
    gCAN1DisturbancePeriod = @sysvar::IL_CAN1::NODES::N_BCM::MESSAGES::ASCM_FD_1::TIMINGS::NormalCyclePeriod;
    ILFaultInjectionResetMsgCycleTime(FDCAN2_1::BCM::ASCM_FD_1);
  }
  else if (@this == 1 && @sysvar::IL_CAN1::NODES::N_BCM::MESSAGES::ASCM_FD_1::TIMINGS::EnableCyclic)
  {
    SetBusContext(gILCAN1_BusContext);
    gCAN1DisturbancePeriod = @sysvar::IL_CAN1::NODES::N_BCM::MESSAGES::ASCM_FD_1::TIMINGS::ActiveCyclePeriod;
    ILFaultInjectionSetMsgCycleTime(FDCAN2_1::BCM::ASCM_FD_1, gCAN1DisturbancePeriod);
  }
  else if (@this == -1 && @sysvar::IL_CAN1::NODES::N_BCM::MESSAGES::ASCM_FD_1::TIMINGS::EnableCyclic)
  {
    SetBusContext(gILCAN1_BusContext);
    gCAN1DisturbancePeriod = @sysvar::IL_CAN1::NODES::N_BCM::MESSAGES::ASCM_FD_1::TIMINGS::CyclePeriod;
    ILFaultInjectionSetMsgCycleTime(FDCAN2_1::BCM::ASCM_FD_1, gCAN1DisturbancePeriod);
  }
}

on sysvar_update sysvar::IL_CAN1::NODES::N_BCM::MESSAGES::ASCM_FD_1::TIMINGS::SendOnce
{
  if (@this == 1)
  {
    SetBusContext(gILCAN1_BusContext);
    ILSetMsgEvent(FDCAN2_1::BCM::ASCM_FD_1);
  }
}

on sysvar_update sysvar::IL_CAN1::NODES::N_BCM::MESSAGES::ASCM_FD_2::TIMINGS::EnableCyclic
{
  if (@this == 1)
  {
    SetBusContext(gILCAN1_BusContext);
    ILFaultInjectionEnableMsg  (FDCAN2_1::BCM::ASCM_FD_2);
  }
  else
  {
    SetBusContext(gILCAN1_BusContext);
    ILFaultInjectionDisableMsg (FDCAN2_1::BCM::ASCM_FD_2);
  }
}

on sysvar_update sysvar::IL_CAN1::NODES::N_BCM::MESSAGES::ASCM_FD_2::TIMINGS::SetNormalCycle
{
  if (@this == 1 && @sysvar::IL_CAN1::NODES::N_BCM::MESSAGES::ASCM_FD_2::TIMINGS::EnableCyclic)
  {
    @sysvar::IL_CAN1::NODES::N_BCM::MESSAGES::ASCM_FD_2::TIMINGS::SelectedPeriod = 0;
  }
}

on sysvar_update sysvar::IL_CAN1::NODES::N_BCM::MESSAGES::ASCM_FD_2::TIMINGS::SetNewCycleContinously
{
  if (@this == 1 && @sysvar::IL_CAN1::NODES::N_BCM::MESSAGES::ASCM_FD_2::TIMINGS::EnableCyclic)
  {
    @sysvar::IL_CAN1::NODES::N_BCM::MESSAGES::ASCM_FD_2::TIMINGS::SelectedPeriod = -1;
  }
}

on sysvar_update sysvar::IL_CAN1::NODES::N_BCM::MESSAGES::ASCM_FD_2::TIMINGS::SelectedPeriod
{
  if (@this == 0 && @sysvar::IL_CAN1::NODES::N_BCM::MESSAGES::ASCM_FD_2::TIMINGS::EnableCyclic)
  {
    SetBusContext(gILCAN1_BusContext);
    gCAN1DisturbancePeriod = @sysvar::IL_CAN1::NODES::N_BCM::MESSAGES::ASCM_FD_2::TIMINGS::NormalCyclePeriod;
    ILFaultInjectionResetMsgCycleTime(FDCAN2_1::BCM::ASCM_FD_2);
  }
  else if (@this == 1 && @sysvar::IL_CAN1::NODES::N_BCM::MESSAGES::ASCM_FD_2::TIMINGS::EnableCyclic)
  {
    SetBusContext(gILCAN1_BusContext);
    gCAN1DisturbancePeriod = @sysvar::IL_CAN1::NODES::N_BCM::MESSAGES::ASCM_FD_2::TIMINGS::ActiveCyclePeriod;
    ILFaultInjectionSetMsgCycleTime(FDCAN2_1::BCM::ASCM_FD_2, gCAN1DisturbancePeriod);
  }
  else if (@this == -1 && @sysvar::IL_CAN1::NODES::N_BCM::MESSAGES::ASCM_FD_2::TIMINGS::EnableCyclic)
  {
    SetBusContext(gILCAN1_BusContext);
    gCAN1DisturbancePeriod = @sysvar::IL_CAN1::NODES::N_BCM::MESSAGES::ASCM_FD_2::TIMINGS::CyclePeriod;
    ILFaultInjectionSetMsgCycleTime(FDCAN2_1::BCM::ASCM_FD_2, gCAN1DisturbancePeriod);
  }
}

on sysvar_update sysvar::IL_CAN1::NODES::N_BCM::MESSAGES::ASCM_FD_2::TIMINGS::SendOnce
{
  if (@this == 1)
  {
    SetBusContext(gILCAN1_BusContext);
    ILSetMsgEvent(FDCAN2_1::BCM::ASCM_FD_2);
  }
}

on sysvar_update sysvar::IL_CAN1::NODES::N_BCM::MESSAGES::BCM_FD_10::TIMINGS::EnableCyclic
{
  if (@this == 1)
  {
    SetBusContext(gILCAN1_BusContext);
    ILFaultInjectionEnableMsg  (FDCAN2_1::BCM::BCM_FD_10);
  }
  else
  {
    SetBusContext(gILCAN1_BusContext);
    ILFaultInjectionDisableMsg (FDCAN2_1::BCM::BCM_FD_10);
  }
}

on sysvar_update sysvar::IL_CAN1::NODES::N_BCM::MESSAGES::BCM_FD_10::TIMINGS::SetNormalCycle
{
  if (@this == 1 && @sysvar::IL_CAN1::NODES::N_BCM::MESSAGES::BCM_FD_10::TIMINGS::EnableCyclic)
  {
    @sysvar::IL_CAN1::NODES::N_BCM::MESSAGES::BCM_FD_10::TIMINGS::SelectedPeriod = 0;
  }
}

on sysvar_update sysvar::IL_CAN1::NODES::N_BCM::MESSAGES::BCM_FD_10::TIMINGS::SetNewCycleContinously
{
  if (@this == 1 && @sysvar::IL_CAN1::NODES::N_BCM::MESSAGES::BCM_FD_10::TIMINGS::EnableCyclic)
  {
    @sysvar::IL_CAN1::NODES::N_BCM::MESSAGES::BCM_FD_10::TIMINGS::SelectedPeriod = -1;
  }
}

on sysvar_update sysvar::IL_CAN1::NODES::N_BCM::MESSAGES::BCM_FD_10::TIMINGS::SelectedPeriod
{
  if (@this == 0 && @sysvar::IL_CAN1::NODES::N_BCM::MESSAGES::BCM_FD_10::TIMINGS::EnableCyclic)
  {
    SetBusContext(gILCAN1_BusContext);
    gCAN1DisturbancePeriod = @sysvar::IL_CAN1::NODES::N_BCM::MESSAGES::BCM_FD_10::TIMINGS::NormalCyclePeriod;
    ILFaultInjectionResetMsgCycleTime(FDCAN2_1::BCM::BCM_FD_10);
  }
  else if (@this == 1 && @sysvar::IL_CAN1::NODES::N_BCM::MESSAGES::BCM_FD_10::TIMINGS::EnableCyclic)
  {
    SetBusContext(gILCAN1_BusContext);
    gCAN1DisturbancePeriod = @sysvar::IL_CAN1::NODES::N_BCM::MESSAGES::BCM_FD_10::TIMINGS::ActiveCyclePeriod;
    ILFaultInjectionSetMsgCycleTime(FDCAN2_1::BCM::BCM_FD_10, gCAN1DisturbancePeriod);
  }
  else if (@this == -1 && @sysvar::IL_CAN1::NODES::N_BCM::MESSAGES::BCM_FD_10::TIMINGS::EnableCyclic)
  {
    SetBusContext(gILCAN1_BusContext);
    gCAN1DisturbancePeriod = @sysvar::IL_CAN1::NODES::N_BCM::MESSAGES::BCM_FD_10::TIMINGS::CyclePeriod;
    ILFaultInjectionSetMsgCycleTime(FDCAN2_1::BCM::BCM_FD_10, gCAN1DisturbancePeriod);
  }
}

on sysvar_update sysvar::IL_CAN1::NODES::N_BCM::MESSAGES::BCM_FD_10::TIMINGS::SendOnce
{
  if (@this == 1)
  {
    SetBusContext(gILCAN1_BusContext);
    ILSetMsgEvent(FDCAN2_1::BCM::BCM_FD_10);
  }
}

on sysvar_update sysvar::IL_CAN1::NODES::N_BCM::MESSAGES::BCM_FD_11::TIMINGS::EnableCyclic
{
  if (@this == 1)
  {
    SetBusContext(gILCAN1_BusContext);
    ILFaultInjectionEnableMsg  (FDCAN2_1::BCM::BCM_FD_11);
  }
  else
  {
    SetBusContext(gILCAN1_BusContext);
    ILFaultInjectionDisableMsg (FDCAN2_1::BCM::BCM_FD_11);
  }
}

on sysvar_update sysvar::IL_CAN1::NODES::N_BCM::MESSAGES::BCM_FD_11::TIMINGS::SetNormalCycle
{
  if (@this == 1 && @sysvar::IL_CAN1::NODES::N_BCM::MESSAGES::BCM_FD_11::TIMINGS::EnableCyclic)
  {
    @sysvar::IL_CAN1::NODES::N_BCM::MESSAGES::BCM_FD_11::TIMINGS::SelectedPeriod = 0;
  }
}

on sysvar_update sysvar::IL_CAN1::NODES::N_BCM::MESSAGES::BCM_FD_11::TIMINGS::SetNewCycleContinously
{
  if (@this == 1 && @sysvar::IL_CAN1::NODES::N_BCM::MESSAGES::BCM_FD_11::TIMINGS::EnableCyclic)
  {
    @sysvar::IL_CAN1::NODES::N_BCM::MESSAGES::BCM_FD_11::TIMINGS::SelectedPeriod = -1;
  }
}

on sysvar_update sysvar::IL_CAN1::NODES::N_BCM::MESSAGES::BCM_FD_11::TIMINGS::SelectedPeriod
{
  if (@this == 0 && @sysvar::IL_CAN1::NODES::N_BCM::MESSAGES::BCM_FD_11::TIMINGS::EnableCyclic)
  {
    SetBusContext(gILCAN1_BusContext);
    gCAN1DisturbancePeriod = @sysvar::IL_CAN1::NODES::N_BCM::MESSAGES::BCM_FD_11::TIMINGS::NormalCyclePeriod;
    ILFaultInjectionResetMsgCycleTime(FDCAN2_1::BCM::BCM_FD_11);
  }
  else if (@this == 1 && @sysvar::IL_CAN1::NODES::N_BCM::MESSAGES::BCM_FD_11::TIMINGS::EnableCyclic)
  {
    SetBusContext(gILCAN1_BusContext);
    gCAN1DisturbancePeriod = @sysvar::IL_CAN1::NODES::N_BCM::MESSAGES::BCM_FD_11::TIMINGS::ActiveCyclePeriod;
    ILFaultInjectionSetMsgCycleTime(FDCAN2_1::BCM::BCM_FD_11, gCAN1DisturbancePeriod);
  }
  else if (@this == -1 && @sysvar::IL_CAN1::NODES::N_BCM::MESSAGES::BCM_FD_11::TIMINGS::EnableCyclic)
  {
    SetBusContext(gILCAN1_BusContext);
    gCAN1DisturbancePeriod = @sysvar::IL_CAN1::NODES::N_BCM::MESSAGES::BCM_FD_11::TIMINGS::CyclePeriod;
    ILFaultInjectionSetMsgCycleTime(FDCAN2_1::BCM::BCM_FD_11, gCAN1DisturbancePeriod);
  }
}

on sysvar_update sysvar::IL_CAN1::NODES::N_BCM::MESSAGES::BCM_FD_11::TIMINGS::SendOnce
{
  if (@this == 1)
  {
    SetBusContext(gILCAN1_BusContext);
    ILSetMsgEvent(FDCAN2_1::BCM::BCM_FD_11);
  }
}

on sysvar_update sysvar::IL_CAN1::NODES::N_BCM::MESSAGES::BCM_FD_12::TIMINGS::EnableCyclic
{
  if (@this == 1)
  {
    SetBusContext(gILCAN1_BusContext);
    ILFaultInjectionEnableMsg  (FDCAN2_1::BCM::BCM_FD_12);
  }
  else
  {
    SetBusContext(gILCAN1_BusContext);
    ILFaultInjectionDisableMsg (FDCAN2_1::BCM::BCM_FD_12);
  }
}

on sysvar_update sysvar::IL_CAN1::NODES::N_BCM::MESSAGES::BCM_FD_12::TIMINGS::SetNormalCycle
{
  if (@this == 1 && @sysvar::IL_CAN1::NODES::N_BCM::MESSAGES::BCM_FD_12::TIMINGS::EnableCyclic)
  {
    @sysvar::IL_CAN1::NODES::N_BCM::MESSAGES::BCM_FD_12::TIMINGS::SelectedPeriod = 0;
  }
}

on sysvar_update sysvar::IL_CAN1::NODES::N_BCM::MESSAGES::BCM_FD_12::TIMINGS::SetNewCycleContinously
{
  if (@this == 1 && @sysvar::IL_CAN1::NODES::N_BCM::MESSAGES::BCM_FD_12::TIMINGS::EnableCyclic)
  {
    @sysvar::IL_CAN1::NODES::N_BCM::MESSAGES::BCM_FD_12::TIMINGS::SelectedPeriod = -1;
  }
}

on sysvar_update sysvar::IL_CAN1::NODES::N_BCM::MESSAGES::BCM_FD_12::TIMINGS::SelectedPeriod
{
  if (@this == 0 && @sysvar::IL_CAN1::NODES::N_BCM::MESSAGES::BCM_FD_12::TIMINGS::EnableCyclic)
  {
    SetBusContext(gILCAN1_BusContext);
    gCAN1DisturbancePeriod = @sysvar::IL_CAN1::NODES::N_BCM::MESSAGES::BCM_FD_12::TIMINGS::NormalCyclePeriod;
    ILFaultInjectionResetMsgCycleTime(FDCAN2_1::BCM::BCM_FD_12);
  }
  else if (@this == 1 && @sysvar::IL_CAN1::NODES::N_BCM::MESSAGES::BCM_FD_12::TIMINGS::EnableCyclic)
  {
    SetBusContext(gILCAN1_BusContext);
    gCAN1DisturbancePeriod = @sysvar::IL_CAN1::NODES::N_BCM::MESSAGES::BCM_FD_12::TIMINGS::ActiveCyclePeriod;
    ILFaultInjectionSetMsgCycleTime(FDCAN2_1::BCM::BCM_FD_12, gCAN1DisturbancePeriod);
  }
  else if (@this == -1 && @sysvar::IL_CAN1::NODES::N_BCM::MESSAGES::BCM_FD_12::TIMINGS::EnableCyclic)
  {
    SetBusContext(gILCAN1_BusContext);
    gCAN1DisturbancePeriod = @sysvar::IL_CAN1::NODES::N_BCM::MESSAGES::BCM_FD_12::TIMINGS::CyclePeriod;
    ILFaultInjectionSetMsgCycleTime(FDCAN2_1::BCM::BCM_FD_12, gCAN1DisturbancePeriod);
  }
}

on sysvar_update sysvar::IL_CAN1::NODES::N_BCM::MESSAGES::BCM_FD_12::TIMINGS::SendOnce
{
  if (@this == 1)
  {
    SetBusContext(gILCAN1_BusContext);
    ILSetMsgEvent(FDCAN2_1::BCM::BCM_FD_12);
  }
}

on sysvar_update sysvar::IL_CAN1::NODES::N_BCM::MESSAGES::BCM_FD_13::TIMINGS::EnableCyclic
{
  if (@this == 1)
  {
    SetBusContext(gILCAN1_BusContext);
    ILFaultInjectionEnableMsg  (FDCAN2_1::BCM::BCM_FD_13);
  }
  else
  {
    SetBusContext(gILCAN1_BusContext);
    ILFaultInjectionDisableMsg (FDCAN2_1::BCM::BCM_FD_13);
  }
}

on sysvar_update sysvar::IL_CAN1::NODES::N_BCM::MESSAGES::BCM_FD_13::TIMINGS::SetNormalCycle
{
  if (@this == 1 && @sysvar::IL_CAN1::NODES::N_BCM::MESSAGES::BCM_FD_13::TIMINGS::EnableCyclic)
  {
    @sysvar::IL_CAN1::NODES::N_BCM::MESSAGES::BCM_FD_13::TIMINGS::SelectedPeriod = 0;
  }
}

on sysvar_update sysvar::IL_CAN1::NODES::N_BCM::MESSAGES::BCM_FD_13::TIMINGS::SetNewCycleContinously
{
  if (@this == 1 && @sysvar::IL_CAN1::NODES::N_BCM::MESSAGES::BCM_FD_13::TIMINGS::EnableCyclic)
  {
    @sysvar::IL_CAN1::NODES::N_BCM::MESSAGES::BCM_FD_13::TIMINGS::SelectedPeriod = -1;
  }
}

on sysvar_update sysvar::IL_CAN1::NODES::N_BCM::MESSAGES::BCM_FD_13::TIMINGS::SelectedPeriod
{
  if (@this == 0 && @sysvar::IL_CAN1::NODES::N_BCM::MESSAGES::BCM_FD_13::TIMINGS::EnableCyclic)
  {
    SetBusContext(gILCAN1_BusContext);
    gCAN1DisturbancePeriod = @sysvar::IL_CAN1::NODES::N_BCM::MESSAGES::BCM_FD_13::TIMINGS::NormalCyclePeriod;
    ILFaultInjectionResetMsgCycleTime(FDCAN2_1::BCM::BCM_FD_13);
  }
  else if (@this == 1 && @sysvar::IL_CAN1::NODES::N_BCM::MESSAGES::BCM_FD_13::TIMINGS::EnableCyclic)
  {
    SetBusContext(gILCAN1_BusContext);
    gCAN1DisturbancePeriod = @sysvar::IL_CAN1::NODES::N_BCM::MESSAGES::BCM_FD_13::TIMINGS::ActiveCyclePeriod;
    ILFaultInjectionSetMsgCycleTime(FDCAN2_1::BCM::BCM_FD_13, gCAN1DisturbancePeriod);
  }
  else if (@this == -1 && @sysvar::IL_CAN1::NODES::N_BCM::MESSAGES::BCM_FD_13::TIMINGS::EnableCyclic)
  {
    SetBusContext(gILCAN1_BusContext);
    gCAN1DisturbancePeriod = @sysvar::IL_CAN1::NODES::N_BCM::MESSAGES::BCM_FD_13::TIMINGS::CyclePeriod;
    ILFaultInjectionSetMsgCycleTime(FDCAN2_1::BCM::BCM_FD_13, gCAN1DisturbancePeriod);
  }
}

on sysvar_update sysvar::IL_CAN1::NODES::N_BCM::MESSAGES::BCM_FD_13::TIMINGS::SendOnce
{
  if (@this == 1)
  {
    SetBusContext(gILCAN1_BusContext);
    ILSetMsgEvent(FDCAN2_1::BCM::BCM_FD_13);
  }
}

on sysvar_update sysvar::IL_CAN1::NODES::N_BCM::MESSAGES::BCM_FD_14::TIMINGS::EnableCyclic
{
  if (@this == 1)
  {
    SetBusContext(gILCAN1_BusContext);
    ILFaultInjectionEnableMsg  (FDCAN2_1::BCM::BCM_FD_14);
  }
  else
  {
    SetBusContext(gILCAN1_BusContext);
    ILFaultInjectionDisableMsg (FDCAN2_1::BCM::BCM_FD_14);
  }
}

on sysvar_update sysvar::IL_CAN1::NODES::N_BCM::MESSAGES::BCM_FD_14::TIMINGS::SetNormalCycle
{
  if (@this == 1 && @sysvar::IL_CAN1::NODES::N_BCM::MESSAGES::BCM_FD_14::TIMINGS::EnableCyclic)
  {
    @sysvar::IL_CAN1::NODES::N_BCM::MESSAGES::BCM_FD_14::TIMINGS::SelectedPeriod = 0;
  }
}

on sysvar_update sysvar::IL_CAN1::NODES::N_BCM::MESSAGES::BCM_FD_14::TIMINGS::SetNewCycleContinously
{
  if (@this == 1 && @sysvar::IL_CAN1::NODES::N_BCM::MESSAGES::BCM_FD_14::TIMINGS::EnableCyclic)
  {
    @sysvar::IL_CAN1::NODES::N_BCM::MESSAGES::BCM_FD_14::TIMINGS::SelectedPeriod = -1;
  }
}

on sysvar_update sysvar::IL_CAN1::NODES::N_BCM::MESSAGES::BCM_FD_14::TIMINGS::SelectedPeriod
{
  if (@this == 0 && @sysvar::IL_CAN1::NODES::N_BCM::MESSAGES::BCM_FD_14::TIMINGS::EnableCyclic)
  {
    SetBusContext(gILCAN1_BusContext);
    gCAN1DisturbancePeriod = @sysvar::IL_CAN1::NODES::N_BCM::MESSAGES::BCM_FD_14::TIMINGS::NormalCyclePeriod;
    ILFaultInjectionResetMsgCycleTime(FDCAN2_1::BCM::BCM_FD_14);
  }
  else if (@this == 1 && @sysvar::IL_CAN1::NODES::N_BCM::MESSAGES::BCM_FD_14::TIMINGS::EnableCyclic)
  {
    SetBusContext(gILCAN1_BusContext);
    gCAN1DisturbancePeriod = @sysvar::IL_CAN1::NODES::N_BCM::MESSAGES::BCM_FD_14::TIMINGS::ActiveCyclePeriod;
    ILFaultInjectionSetMsgCycleTime(FDCAN2_1::BCM::BCM_FD_14, gCAN1DisturbancePeriod);
  }
  else if (@this == -1 && @sysvar::IL_CAN1::NODES::N_BCM::MESSAGES::BCM_FD_14::TIMINGS::EnableCyclic)
  {
    SetBusContext(gILCAN1_BusContext);
    gCAN1DisturbancePeriod = @sysvar::IL_CAN1::NODES::N_BCM::MESSAGES::BCM_FD_14::TIMINGS::CyclePeriod;
    ILFaultInjectionSetMsgCycleTime(FDCAN2_1::BCM::BCM_FD_14, gCAN1DisturbancePeriod);
  }
}

on sysvar_update sysvar::IL_CAN1::NODES::N_BCM::MESSAGES::BCM_FD_14::TIMINGS::SendOnce
{
  if (@this == 1)
  {
    SetBusContext(gILCAN1_BusContext);
    ILSetMsgEvent(FDCAN2_1::BCM::BCM_FD_14);
  }
}

on sysvar_update sysvar::IL_CAN1::NODES::N_BCM::MESSAGES::BCM_FD_18::TIMINGS::EnableCyclic
{
  if (@this == 1)
  {
    SetBusContext(gILCAN1_BusContext);
    ILFaultInjectionEnableMsg  (FDCAN2_1::BCM::BCM_FD_18);
  }
  else
  {
    SetBusContext(gILCAN1_BusContext);
    ILFaultInjectionDisableMsg (FDCAN2_1::BCM::BCM_FD_18);
  }
}

on sysvar_update sysvar::IL_CAN1::NODES::N_BCM::MESSAGES::BCM_FD_18::TIMINGS::SetNormalCycle
{
  if (@this == 1 && @sysvar::IL_CAN1::NODES::N_BCM::MESSAGES::BCM_FD_18::TIMINGS::EnableCyclic)
  {
    @sysvar::IL_CAN1::NODES::N_BCM::MESSAGES::BCM_FD_18::TIMINGS::SelectedPeriod = 0;
  }
}

on sysvar_update sysvar::IL_CAN1::NODES::N_BCM::MESSAGES::BCM_FD_18::TIMINGS::SetNewCycleContinously
{
  if (@this == 1 && @sysvar::IL_CAN1::NODES::N_BCM::MESSAGES::BCM_FD_18::TIMINGS::EnableCyclic)
  {
    @sysvar::IL_CAN1::NODES::N_BCM::MESSAGES::BCM_FD_18::TIMINGS::SelectedPeriod = -1;
  }
}

on sysvar_update sysvar::IL_CAN1::NODES::N_BCM::MESSAGES::BCM_FD_18::TIMINGS::SelectedPeriod
{
  if (@this == 0 && @sysvar::IL_CAN1::NODES::N_BCM::MESSAGES::BCM_FD_18::TIMINGS::EnableCyclic)
  {
    SetBusContext(gILCAN1_BusContext);
    gCAN1DisturbancePeriod = @sysvar::IL_CAN1::NODES::N_BCM::MESSAGES::BCM_FD_18::TIMINGS::NormalCyclePeriod;
    ILFaultInjectionResetMsgCycleTime(FDCAN2_1::BCM::BCM_FD_18);
  }
  else if (@this == 1 && @sysvar::IL_CAN1::NODES::N_BCM::MESSAGES::BCM_FD_18::TIMINGS::EnableCyclic)
  {
    SetBusContext(gILCAN1_BusContext);
    gCAN1DisturbancePeriod = @sysvar::IL_CAN1::NODES::N_BCM::MESSAGES::BCM_FD_18::TIMINGS::ActiveCyclePeriod;
    ILFaultInjectionSetMsgCycleTime(FDCAN2_1::BCM::BCM_FD_18, gCAN1DisturbancePeriod);
  }
  else if (@this == -1 && @sysvar::IL_CAN1::NODES::N_BCM::MESSAGES::BCM_FD_18::TIMINGS::EnableCyclic)
  {
    SetBusContext(gILCAN1_BusContext);
    gCAN1DisturbancePeriod = @sysvar::IL_CAN1::NODES::N_BCM::MESSAGES::BCM_FD_18::TIMINGS::CyclePeriod;
    ILFaultInjectionSetMsgCycleTime(FDCAN2_1::BCM::BCM_FD_18, gCAN1DisturbancePeriod);
  }
}

on sysvar_update sysvar::IL_CAN1::NODES::N_BCM::MESSAGES::BCM_FD_18::TIMINGS::SendOnce
{
  if (@this == 1)
  {
    SetBusContext(gILCAN1_BusContext);
    ILSetMsgEvent(FDCAN2_1::BCM::BCM_FD_18);
  }
}

on sysvar_update sysvar::IL_CAN1::NODES::N_BCM::MESSAGES::BCM_FD_2::TIMINGS::EnableCyclic
{
  if (@this == 1)
  {
    SetBusContext(gILCAN1_BusContext);
    ILFaultInjectionEnableMsg  (FDCAN2_1::BCM::BCM_FD_2);
  }
  else
  {
    SetBusContext(gILCAN1_BusContext);
    ILFaultInjectionDisableMsg (FDCAN2_1::BCM::BCM_FD_2);
  }
}

on sysvar_update sysvar::IL_CAN1::NODES::N_BCM::MESSAGES::BCM_FD_2::TIMINGS::SetNormalCycle
{
  if (@this == 1 && @sysvar::IL_CAN1::NODES::N_BCM::MESSAGES::BCM_FD_2::TIMINGS::EnableCyclic)
  {
    @sysvar::IL_CAN1::NODES::N_BCM::MESSAGES::BCM_FD_2::TIMINGS::SelectedPeriod = 0;
  }
}

on sysvar_update sysvar::IL_CAN1::NODES::N_BCM::MESSAGES::BCM_FD_2::TIMINGS::SetNewCycleContinously
{
  if (@this == 1 && @sysvar::IL_CAN1::NODES::N_BCM::MESSAGES::BCM_FD_2::TIMINGS::EnableCyclic)
  {
    @sysvar::IL_CAN1::NODES::N_BCM::MESSAGES::BCM_FD_2::TIMINGS::SelectedPeriod = -1;
  }
}

on sysvar_update sysvar::IL_CAN1::NODES::N_BCM::MESSAGES::BCM_FD_2::TIMINGS::SelectedPeriod
{
  if (@this == 0 && @sysvar::IL_CAN1::NODES::N_BCM::MESSAGES::BCM_FD_2::TIMINGS::EnableCyclic)
  {
    SetBusContext(gILCAN1_BusContext);
    gCAN1DisturbancePeriod = @sysvar::IL_CAN1::NODES::N_BCM::MESSAGES::BCM_FD_2::TIMINGS::NormalCyclePeriod;
    ILFaultInjectionResetMsgCycleTime(FDCAN2_1::BCM::BCM_FD_2);
  }
  else if (@this == 1 && @sysvar::IL_CAN1::NODES::N_BCM::MESSAGES::BCM_FD_2::TIMINGS::EnableCyclic)
  {
    SetBusContext(gILCAN1_BusContext);
    gCAN1DisturbancePeriod = @sysvar::IL_CAN1::NODES::N_BCM::MESSAGES::BCM_FD_2::TIMINGS::ActiveCyclePeriod;
    ILFaultInjectionSetMsgCycleTime(FDCAN2_1::BCM::BCM_FD_2, gCAN1DisturbancePeriod);
  }
  else if (@this == -1 && @sysvar::IL_CAN1::NODES::N_BCM::MESSAGES::BCM_FD_2::TIMINGS::EnableCyclic)
  {
    SetBusContext(gILCAN1_BusContext);
    gCAN1DisturbancePeriod = @sysvar::IL_CAN1::NODES::N_BCM::MESSAGES::BCM_FD_2::TIMINGS::CyclePeriod;
    ILFaultInjectionSetMsgCycleTime(FDCAN2_1::BCM::BCM_FD_2, gCAN1DisturbancePeriod);
  }
}

on sysvar_update sysvar::IL_CAN1::NODES::N_BCM::MESSAGES::BCM_FD_2::TIMINGS::SendOnce
{
  if (@this == 1)
  {
    SetBusContext(gILCAN1_BusContext);
    ILSetMsgEvent(FDCAN2_1::BCM::BCM_FD_2);
  }
}

on sysvar_update sysvar::IL_CAN1::NODES::N_BCM::MESSAGES::BCM_FD_21::TIMINGS::EnableCyclic
{
  if (@this == 1)
  {
    SetBusContext(gILCAN1_BusContext);
    ILFaultInjectionEnableMsg  (FDCAN2_1::BCM::BCM_FD_21);
  }
  else
  {
    SetBusContext(gILCAN1_BusContext);
    ILFaultInjectionDisableMsg (FDCAN2_1::BCM::BCM_FD_21);
  }
}

on sysvar_update sysvar::IL_CAN1::NODES::N_BCM::MESSAGES::BCM_FD_21::TIMINGS::SetNormalCycle
{
  if (@this == 1 && @sysvar::IL_CAN1::NODES::N_BCM::MESSAGES::BCM_FD_21::TIMINGS::EnableCyclic)
  {
    @sysvar::IL_CAN1::NODES::N_BCM::MESSAGES::BCM_FD_21::TIMINGS::SelectedPeriod = 0;
  }
}

on sysvar_update sysvar::IL_CAN1::NODES::N_BCM::MESSAGES::BCM_FD_21::TIMINGS::SetNewCycleContinously
{
  if (@this == 1 && @sysvar::IL_CAN1::NODES::N_BCM::MESSAGES::BCM_FD_21::TIMINGS::EnableCyclic)
  {
    @sysvar::IL_CAN1::NODES::N_BCM::MESSAGES::BCM_FD_21::TIMINGS::SelectedPeriod = -1;
  }
}

on sysvar_update sysvar::IL_CAN1::NODES::N_BCM::MESSAGES::BCM_FD_21::TIMINGS::SelectedPeriod
{
  if (@this == 0 && @sysvar::IL_CAN1::NODES::N_BCM::MESSAGES::BCM_FD_21::TIMINGS::EnableCyclic)
  {
    SetBusContext(gILCAN1_BusContext);
    gCAN1DisturbancePeriod = @sysvar::IL_CAN1::NODES::N_BCM::MESSAGES::BCM_FD_21::TIMINGS::NormalCyclePeriod;
    ILFaultInjectionResetMsgCycleTime(FDCAN2_1::BCM::BCM_FD_21);
  }
  else if (@this == 1 && @sysvar::IL_CAN1::NODES::N_BCM::MESSAGES::BCM_FD_21::TIMINGS::EnableCyclic)
  {
    SetBusContext(gILCAN1_BusContext);
    gCAN1DisturbancePeriod = @sysvar::IL_CAN1::NODES::N_BCM::MESSAGES::BCM_FD_21::TIMINGS::ActiveCyclePeriod;
    ILFaultInjectionSetMsgCycleTime(FDCAN2_1::BCM::BCM_FD_21, gCAN1DisturbancePeriod);
  }
  else if (@this == -1 && @sysvar::IL_CAN1::NODES::N_BCM::MESSAGES::BCM_FD_21::TIMINGS::EnableCyclic)
  {
    SetBusContext(gILCAN1_BusContext);
    gCAN1DisturbancePeriod = @sysvar::IL_CAN1::NODES::N_BCM::MESSAGES::BCM_FD_21::TIMINGS::CyclePeriod;
    ILFaultInjectionSetMsgCycleTime(FDCAN2_1::BCM::BCM_FD_21, gCAN1DisturbancePeriod);
  }
}

on sysvar_update sysvar::IL_CAN1::NODES::N_BCM::MESSAGES::BCM_FD_21::TIMINGS::SendOnce
{
  if (@this == 1)
  {
    SetBusContext(gILCAN1_BusContext);
    ILSetMsgEvent(FDCAN2_1::BCM::BCM_FD_21);
  }
}

on sysvar_update sysvar::IL_CAN1::NODES::N_BCM::MESSAGES::BCM_FD_22::TIMINGS::EnableCyclic
{
  if (@this == 1)
  {
    SetBusContext(gILCAN1_BusContext);
    ILFaultInjectionEnableMsg  (FDCAN2_1::BCM::BCM_FD_22);
  }
  else
  {
    SetBusContext(gILCAN1_BusContext);
    ILFaultInjectionDisableMsg (FDCAN2_1::BCM::BCM_FD_22);
  }
}

on sysvar_update sysvar::IL_CAN1::NODES::N_BCM::MESSAGES::BCM_FD_22::TIMINGS::SetNormalCycle
{
  if (@this == 1 && @sysvar::IL_CAN1::NODES::N_BCM::MESSAGES::BCM_FD_22::TIMINGS::EnableCyclic)
  {
    @sysvar::IL_CAN1::NODES::N_BCM::MESSAGES::BCM_FD_22::TIMINGS::SelectedPeriod = 0;
  }
}

on sysvar_update sysvar::IL_CAN1::NODES::N_BCM::MESSAGES::BCM_FD_22::TIMINGS::SetNewCycleContinously
{
  if (@this == 1 && @sysvar::IL_CAN1::NODES::N_BCM::MESSAGES::BCM_FD_22::TIMINGS::EnableCyclic)
  {
    @sysvar::IL_CAN1::NODES::N_BCM::MESSAGES::BCM_FD_22::TIMINGS::SelectedPeriod = -1;
  }
}

on sysvar_update sysvar::IL_CAN1::NODES::N_BCM::MESSAGES::BCM_FD_22::TIMINGS::SelectedPeriod
{
  if (@this == 0 && @sysvar::IL_CAN1::NODES::N_BCM::MESSAGES::BCM_FD_22::TIMINGS::EnableCyclic)
  {
    SetBusContext(gILCAN1_BusContext);
    gCAN1DisturbancePeriod = @sysvar::IL_CAN1::NODES::N_BCM::MESSAGES::BCM_FD_22::TIMINGS::NormalCyclePeriod;
    ILFaultInjectionResetMsgCycleTime(FDCAN2_1::BCM::BCM_FD_22);
  }
  else if (@this == 1 && @sysvar::IL_CAN1::NODES::N_BCM::MESSAGES::BCM_FD_22::TIMINGS::EnableCyclic)
  {
    SetBusContext(gILCAN1_BusContext);
    gCAN1DisturbancePeriod = @sysvar::IL_CAN1::NODES::N_BCM::MESSAGES::BCM_FD_22::TIMINGS::ActiveCyclePeriod;
    ILFaultInjectionSetMsgCycleTime(FDCAN2_1::BCM::BCM_FD_22, gCAN1DisturbancePeriod);
  }
  else if (@this == -1 && @sysvar::IL_CAN1::NODES::N_BCM::MESSAGES::BCM_FD_22::TIMINGS::EnableCyclic)
  {
    SetBusContext(gILCAN1_BusContext);
    gCAN1DisturbancePeriod = @sysvar::IL_CAN1::NODES::N_BCM::MESSAGES::BCM_FD_22::TIMINGS::CyclePeriod;
    ILFaultInjectionSetMsgCycleTime(FDCAN2_1::BCM::BCM_FD_22, gCAN1DisturbancePeriod);
  }
}

on sysvar_update sysvar::IL_CAN1::NODES::N_BCM::MESSAGES::BCM_FD_22::TIMINGS::SendOnce
{
  if (@this == 1)
  {
    SetBusContext(gILCAN1_BusContext);
    ILSetMsgEvent(FDCAN2_1::BCM::BCM_FD_22);
  }
}

on sysvar_update sysvar::IL_CAN1::NODES::N_BCM::MESSAGES::BCM_FD_23::TIMINGS::EnableCyclic
{
  if (@this == 1)
  {
    SetBusContext(gILCAN1_BusContext);
    ILFaultInjectionEnableMsg  (FDCAN2_1::BCM::BCM_FD_23);
  }
  else
  {
    SetBusContext(gILCAN1_BusContext);
    ILFaultInjectionDisableMsg (FDCAN2_1::BCM::BCM_FD_23);
  }
}

on sysvar_update sysvar::IL_CAN1::NODES::N_BCM::MESSAGES::BCM_FD_23::TIMINGS::SetNormalCycle
{
  if (@this == 1 && @sysvar::IL_CAN1::NODES::N_BCM::MESSAGES::BCM_FD_23::TIMINGS::EnableCyclic)
  {
    @sysvar::IL_CAN1::NODES::N_BCM::MESSAGES::BCM_FD_23::TIMINGS::SelectedPeriod = 0;
  }
}

on sysvar_update sysvar::IL_CAN1::NODES::N_BCM::MESSAGES::BCM_FD_23::TIMINGS::SetNewCycleContinously
{
  if (@this == 1 && @sysvar::IL_CAN1::NODES::N_BCM::MESSAGES::BCM_FD_23::TIMINGS::EnableCyclic)
  {
    @sysvar::IL_CAN1::NODES::N_BCM::MESSAGES::BCM_FD_23::TIMINGS::SelectedPeriod = -1;
  }
}

on sysvar_update sysvar::IL_CAN1::NODES::N_BCM::MESSAGES::BCM_FD_23::TIMINGS::SelectedPeriod
{
  if (@this == 0 && @sysvar::IL_CAN1::NODES::N_BCM::MESSAGES::BCM_FD_23::TIMINGS::EnableCyclic)
  {
    SetBusContext(gILCAN1_BusContext);
    gCAN1DisturbancePeriod = @sysvar::IL_CAN1::NODES::N_BCM::MESSAGES::BCM_FD_23::TIMINGS::NormalCyclePeriod;
    ILFaultInjectionResetMsgCycleTime(FDCAN2_1::BCM::BCM_FD_23);
  }
  else if (@this == 1 && @sysvar::IL_CAN1::NODES::N_BCM::MESSAGES::BCM_FD_23::TIMINGS::EnableCyclic)
  {
    SetBusContext(gILCAN1_BusContext);
    gCAN1DisturbancePeriod = @sysvar::IL_CAN1::NODES::N_BCM::MESSAGES::BCM_FD_23::TIMINGS::ActiveCyclePeriod;
    ILFaultInjectionSetMsgCycleTime(FDCAN2_1::BCM::BCM_FD_23, gCAN1DisturbancePeriod);
  }
  else if (@this == -1 && @sysvar::IL_CAN1::NODES::N_BCM::MESSAGES::BCM_FD_23::TIMINGS::EnableCyclic)
  {
    SetBusContext(gILCAN1_BusContext);
    gCAN1DisturbancePeriod = @sysvar::IL_CAN1::NODES::N_BCM::MESSAGES::BCM_FD_23::TIMINGS::CyclePeriod;
    ILFaultInjectionSetMsgCycleTime(FDCAN2_1::BCM::BCM_FD_23, gCAN1DisturbancePeriod);
  }
}

on sysvar_update sysvar::IL_CAN1::NODES::N_BCM::MESSAGES::BCM_FD_23::TIMINGS::SendOnce
{
  if (@this == 1)
  {
    SetBusContext(gILCAN1_BusContext);
    ILSetMsgEvent(FDCAN2_1::BCM::BCM_FD_23);
  }
}

on sysvar_update sysvar::IL_CAN1::NODES::N_BCM::MESSAGES::BCM_FD_24::TIMINGS::EnableCyclic
{
  if (@this == 1)
  {
    SetBusContext(gILCAN1_BusContext);
    ILFaultInjectionEnableMsg  (FDCAN2_1::BCM::BCM_FD_24);
  }
  else
  {
    SetBusContext(gILCAN1_BusContext);
    ILFaultInjectionDisableMsg (FDCAN2_1::BCM::BCM_FD_24);
  }
}

on sysvar_update sysvar::IL_CAN1::NODES::N_BCM::MESSAGES::BCM_FD_24::TIMINGS::SetNormalCycle
{
  if (@this == 1 && @sysvar::IL_CAN1::NODES::N_BCM::MESSAGES::BCM_FD_24::TIMINGS::EnableCyclic)
  {
    @sysvar::IL_CAN1::NODES::N_BCM::MESSAGES::BCM_FD_24::TIMINGS::SelectedPeriod = 0;
  }
}

on sysvar_update sysvar::IL_CAN1::NODES::N_BCM::MESSAGES::BCM_FD_24::TIMINGS::SetNewCycleContinously
{
  if (@this == 1 && @sysvar::IL_CAN1::NODES::N_BCM::MESSAGES::BCM_FD_24::TIMINGS::EnableCyclic)
  {
    @sysvar::IL_CAN1::NODES::N_BCM::MESSAGES::BCM_FD_24::TIMINGS::SelectedPeriod = -1;
  }
}

on sysvar_update sysvar::IL_CAN1::NODES::N_BCM::MESSAGES::BCM_FD_24::TIMINGS::SelectedPeriod
{
  if (@this == 0 && @sysvar::IL_CAN1::NODES::N_BCM::MESSAGES::BCM_FD_24::TIMINGS::EnableCyclic)
  {
    SetBusContext(gILCAN1_BusContext);
    gCAN1DisturbancePeriod = @sysvar::IL_CAN1::NODES::N_BCM::MESSAGES::BCM_FD_24::TIMINGS::NormalCyclePeriod;
    ILFaultInjectionResetMsgCycleTime(FDCAN2_1::BCM::BCM_FD_24);
  }
  else if (@this == 1 && @sysvar::IL_CAN1::NODES::N_BCM::MESSAGES::BCM_FD_24::TIMINGS::EnableCyclic)
  {
    SetBusContext(gILCAN1_BusContext);
    gCAN1DisturbancePeriod = @sysvar::IL_CAN1::NODES::N_BCM::MESSAGES::BCM_FD_24::TIMINGS::ActiveCyclePeriod;
    ILFaultInjectionSetMsgCycleTime(FDCAN2_1::BCM::BCM_FD_24, gCAN1DisturbancePeriod);
  }
  else if (@this == -1 && @sysvar::IL_CAN1::NODES::N_BCM::MESSAGES::BCM_FD_24::TIMINGS::EnableCyclic)
  {
    SetBusContext(gILCAN1_BusContext);
    gCAN1DisturbancePeriod = @sysvar::IL_CAN1::NODES::N_BCM::MESSAGES::BCM_FD_24::TIMINGS::CyclePeriod;
    ILFaultInjectionSetMsgCycleTime(FDCAN2_1::BCM::BCM_FD_24, gCAN1DisturbancePeriod);
  }
}

on sysvar_update sysvar::IL_CAN1::NODES::N_BCM::MESSAGES::BCM_FD_24::TIMINGS::SendOnce
{
  if (@this == 1)
  {
    SetBusContext(gILCAN1_BusContext);
    ILSetMsgEvent(FDCAN2_1::BCM::BCM_FD_24);
  }
}

on sysvar_update sysvar::IL_CAN1::NODES::N_BCM::MESSAGES::BCM_FD_26::TIMINGS::EnableCyclic
{
  if (@this == 1)
  {
    SetBusContext(gILCAN1_BusContext);
    ILFaultInjectionEnableMsg  (FDCAN2_1::BCM::BCM_FD_26);
  }
  else
  {
    SetBusContext(gILCAN1_BusContext);
    ILFaultInjectionDisableMsg (FDCAN2_1::BCM::BCM_FD_26);
  }
}

on sysvar_update sysvar::IL_CAN1::NODES::N_BCM::MESSAGES::BCM_FD_26::TIMINGS::SetNormalCycle
{
  if (@this == 1 && @sysvar::IL_CAN1::NODES::N_BCM::MESSAGES::BCM_FD_26::TIMINGS::EnableCyclic)
  {
    @sysvar::IL_CAN1::NODES::N_BCM::MESSAGES::BCM_FD_26::TIMINGS::SelectedPeriod = 0;
  }
}

on sysvar_update sysvar::IL_CAN1::NODES::N_BCM::MESSAGES::BCM_FD_26::TIMINGS::SetNewCycleContinously
{
  if (@this == 1 && @sysvar::IL_CAN1::NODES::N_BCM::MESSAGES::BCM_FD_26::TIMINGS::EnableCyclic)
  {
    @sysvar::IL_CAN1::NODES::N_BCM::MESSAGES::BCM_FD_26::TIMINGS::SelectedPeriod = -1;
  }
}

on sysvar_update sysvar::IL_CAN1::NODES::N_BCM::MESSAGES::BCM_FD_26::TIMINGS::SelectedPeriod
{
  if (@this == 0 && @sysvar::IL_CAN1::NODES::N_BCM::MESSAGES::BCM_FD_26::TIMINGS::EnableCyclic)
  {
    SetBusContext(gILCAN1_BusContext);
    gCAN1DisturbancePeriod = @sysvar::IL_CAN1::NODES::N_BCM::MESSAGES::BCM_FD_26::TIMINGS::NormalCyclePeriod;
    ILFaultInjectionResetMsgCycleTime(FDCAN2_1::BCM::BCM_FD_26);
  }
  else if (@this == 1 && @sysvar::IL_CAN1::NODES::N_BCM::MESSAGES::BCM_FD_26::TIMINGS::EnableCyclic)
  {
    SetBusContext(gILCAN1_BusContext);
    gCAN1DisturbancePeriod = @sysvar::IL_CAN1::NODES::N_BCM::MESSAGES::BCM_FD_26::TIMINGS::ActiveCyclePeriod;
    ILFaultInjectionSetMsgCycleTime(FDCAN2_1::BCM::BCM_FD_26, gCAN1DisturbancePeriod);
  }
  else if (@this == -1 && @sysvar::IL_CAN1::NODES::N_BCM::MESSAGES::BCM_FD_26::TIMINGS::EnableCyclic)
  {
    SetBusContext(gILCAN1_BusContext);
    gCAN1DisturbancePeriod = @sysvar::IL_CAN1::NODES::N_BCM::MESSAGES::BCM_FD_26::TIMINGS::CyclePeriod;
    ILFaultInjectionSetMsgCycleTime(FDCAN2_1::BCM::BCM_FD_26, gCAN1DisturbancePeriod);
  }
}

on sysvar_update sysvar::IL_CAN1::NODES::N_BCM::MESSAGES::BCM_FD_26::TIMINGS::SendOnce
{
  if (@this == 1)
  {
    SetBusContext(gILCAN1_BusContext);
    ILSetMsgEvent(FDCAN2_1::BCM::BCM_FD_26);
  }
}

on sysvar_update sysvar::IL_CAN1::NODES::N_BCM::MESSAGES::BCM_FD_27::TIMINGS::EnableCyclic
{
  if (@this == 1)
  {
    SetBusContext(gILCAN1_BusContext);
    ILFaultInjectionEnableMsg  (FDCAN2_1::BCM::BCM_FD_27);
  }
  else
  {
    SetBusContext(gILCAN1_BusContext);
    ILFaultInjectionDisableMsg (FDCAN2_1::BCM::BCM_FD_27);
  }
}

on sysvar_update sysvar::IL_CAN1::NODES::N_BCM::MESSAGES::BCM_FD_27::TIMINGS::SetNormalCycle
{
  if (@this == 1 && @sysvar::IL_CAN1::NODES::N_BCM::MESSAGES::BCM_FD_27::TIMINGS::EnableCyclic)
  {
    @sysvar::IL_CAN1::NODES::N_BCM::MESSAGES::BCM_FD_27::TIMINGS::SelectedPeriod = 0;
  }
}

on sysvar_update sysvar::IL_CAN1::NODES::N_BCM::MESSAGES::BCM_FD_27::TIMINGS::SetNewCycleContinously
{
  if (@this == 1 && @sysvar::IL_CAN1::NODES::N_BCM::MESSAGES::BCM_FD_27::TIMINGS::EnableCyclic)
  {
    @sysvar::IL_CAN1::NODES::N_BCM::MESSAGES::BCM_FD_27::TIMINGS::SelectedPeriod = -1;
  }
}

on sysvar_update sysvar::IL_CAN1::NODES::N_BCM::MESSAGES::BCM_FD_27::TIMINGS::SelectedPeriod
{
  if (@this == 0 && @sysvar::IL_CAN1::NODES::N_BCM::MESSAGES::BCM_FD_27::TIMINGS::EnableCyclic)
  {
    SetBusContext(gILCAN1_BusContext);
    gCAN1DisturbancePeriod = @sysvar::IL_CAN1::NODES::N_BCM::MESSAGES::BCM_FD_27::TIMINGS::NormalCyclePeriod;
    ILFaultInjectionResetMsgCycleTime(FDCAN2_1::BCM::BCM_FD_27);
  }
  else if (@this == 1 && @sysvar::IL_CAN1::NODES::N_BCM::MESSAGES::BCM_FD_27::TIMINGS::EnableCyclic)
  {
    SetBusContext(gILCAN1_BusContext);
    gCAN1DisturbancePeriod = @sysvar::IL_CAN1::NODES::N_BCM::MESSAGES::BCM_FD_27::TIMINGS::ActiveCyclePeriod;
    ILFaultInjectionSetMsgCycleTime(FDCAN2_1::BCM::BCM_FD_27, gCAN1DisturbancePeriod);
  }
  else if (@this == -1 && @sysvar::IL_CAN1::NODES::N_BCM::MESSAGES::BCM_FD_27::TIMINGS::EnableCyclic)
  {
    SetBusContext(gILCAN1_BusContext);
    gCAN1DisturbancePeriod = @sysvar::IL_CAN1::NODES::N_BCM::MESSAGES::BCM_FD_27::TIMINGS::CyclePeriod;
    ILFaultInjectionSetMsgCycleTime(FDCAN2_1::BCM::BCM_FD_27, gCAN1DisturbancePeriod);
  }
}

on sysvar_update sysvar::IL_CAN1::NODES::N_BCM::MESSAGES::BCM_FD_27::TIMINGS::SendOnce
{
  if (@this == 1)
  {
    SetBusContext(gILCAN1_BusContext);
    ILSetMsgEvent(FDCAN2_1::BCM::BCM_FD_27);
  }
}

on sysvar_update sysvar::IL_CAN1::NODES::N_BCM::MESSAGES::BCM_FD_29::TIMINGS::EnableCyclic
{
  if (@this == 1)
  {
    SetBusContext(gILCAN1_BusContext);
    ILFaultInjectionEnableMsg  (FDCAN2_1::BCM::BCM_FD_29);
  }
  else
  {
    SetBusContext(gILCAN1_BusContext);
    ILFaultInjectionDisableMsg (FDCAN2_1::BCM::BCM_FD_29);
  }
}

on sysvar_update sysvar::IL_CAN1::NODES::N_BCM::MESSAGES::BCM_FD_29::TIMINGS::SetNormalCycle
{
  if (@this == 1 && @sysvar::IL_CAN1::NODES::N_BCM::MESSAGES::BCM_FD_29::TIMINGS::EnableCyclic)
  {
    @sysvar::IL_CAN1::NODES::N_BCM::MESSAGES::BCM_FD_29::TIMINGS::SelectedPeriod = 0;
  }
}

on sysvar_update sysvar::IL_CAN1::NODES::N_BCM::MESSAGES::BCM_FD_29::TIMINGS::SetNewCycleContinously
{
  if (@this == 1 && @sysvar::IL_CAN1::NODES::N_BCM::MESSAGES::BCM_FD_29::TIMINGS::EnableCyclic)
  {
    @sysvar::IL_CAN1::NODES::N_BCM::MESSAGES::BCM_FD_29::TIMINGS::SelectedPeriod = -1;
  }
}

on sysvar_update sysvar::IL_CAN1::NODES::N_BCM::MESSAGES::BCM_FD_29::TIMINGS::SelectedPeriod
{
  if (@this == 0 && @sysvar::IL_CAN1::NODES::N_BCM::MESSAGES::BCM_FD_29::TIMINGS::EnableCyclic)
  {
    SetBusContext(gILCAN1_BusContext);
    gCAN1DisturbancePeriod = @sysvar::IL_CAN1::NODES::N_BCM::MESSAGES::BCM_FD_29::TIMINGS::NormalCyclePeriod;
    ILFaultInjectionResetMsgCycleTime(FDCAN2_1::BCM::BCM_FD_29);
  }
  else if (@this == 1 && @sysvar::IL_CAN1::NODES::N_BCM::MESSAGES::BCM_FD_29::TIMINGS::EnableCyclic)
  {
    SetBusContext(gILCAN1_BusContext);
    gCAN1DisturbancePeriod = @sysvar::IL_CAN1::NODES::N_BCM::MESSAGES::BCM_FD_29::TIMINGS::ActiveCyclePeriod;
    ILFaultInjectionSetMsgCycleTime(FDCAN2_1::BCM::BCM_FD_29, gCAN1DisturbancePeriod);
  }
  else if (@this == -1 && @sysvar::IL_CAN1::NODES::N_BCM::MESSAGES::BCM_FD_29::TIMINGS::EnableCyclic)
  {
    SetBusContext(gILCAN1_BusContext);
    gCAN1DisturbancePeriod = @sysvar::IL_CAN1::NODES::N_BCM::MESSAGES::BCM_FD_29::TIMINGS::CyclePeriod;
    ILFaultInjectionSetMsgCycleTime(FDCAN2_1::BCM::BCM_FD_29, gCAN1DisturbancePeriod);
  }
}

on sysvar_update sysvar::IL_CAN1::NODES::N_BCM::MESSAGES::BCM_FD_29::TIMINGS::SendOnce
{
  if (@this == 1)
  {
    SetBusContext(gILCAN1_BusContext);
    ILSetMsgEvent(FDCAN2_1::BCM::BCM_FD_29);
  }
}

on sysvar_update sysvar::IL_CAN1::NODES::N_BCM::MESSAGES::BCM_FD_3::TIMINGS::EnableCyclic
{
  if (@this == 1)
  {
    SetBusContext(gILCAN1_BusContext);
    ILFaultInjectionEnableMsg  (FDCAN2_1::BCM::BCM_FD_3);
  }
  else
  {
    SetBusContext(gILCAN1_BusContext);
    ILFaultInjectionDisableMsg (FDCAN2_1::BCM::BCM_FD_3);
  }
}

on sysvar_update sysvar::IL_CAN1::NODES::N_BCM::MESSAGES::BCM_FD_3::TIMINGS::SetNormalCycle
{
  if (@this == 1 && @sysvar::IL_CAN1::NODES::N_BCM::MESSAGES::BCM_FD_3::TIMINGS::EnableCyclic)
  {
    @sysvar::IL_CAN1::NODES::N_BCM::MESSAGES::BCM_FD_3::TIMINGS::SelectedPeriod = 0;
  }
}

on sysvar_update sysvar::IL_CAN1::NODES::N_BCM::MESSAGES::BCM_FD_3::TIMINGS::SetNewCycleContinously
{
  if (@this == 1 && @sysvar::IL_CAN1::NODES::N_BCM::MESSAGES::BCM_FD_3::TIMINGS::EnableCyclic)
  {
    @sysvar::IL_CAN1::NODES::N_BCM::MESSAGES::BCM_FD_3::TIMINGS::SelectedPeriod = -1;
  }
}

on sysvar_update sysvar::IL_CAN1::NODES::N_BCM::MESSAGES::BCM_FD_3::TIMINGS::SelectedPeriod
{
  if (@this == 0 && @sysvar::IL_CAN1::NODES::N_BCM::MESSAGES::BCM_FD_3::TIMINGS::EnableCyclic)
  {
    SetBusContext(gILCAN1_BusContext);
    gCAN1DisturbancePeriod = @sysvar::IL_CAN1::NODES::N_BCM::MESSAGES::BCM_FD_3::TIMINGS::NormalCyclePeriod;
    ILFaultInjectionResetMsgCycleTime(FDCAN2_1::BCM::BCM_FD_3);
  }
  else if (@this == 1 && @sysvar::IL_CAN1::NODES::N_BCM::MESSAGES::BCM_FD_3::TIMINGS::EnableCyclic)
  {
    SetBusContext(gILCAN1_BusContext);
    gCAN1DisturbancePeriod = @sysvar::IL_CAN1::NODES::N_BCM::MESSAGES::BCM_FD_3::TIMINGS::ActiveCyclePeriod;
    ILFaultInjectionSetMsgCycleTime(FDCAN2_1::BCM::BCM_FD_3, gCAN1DisturbancePeriod);
  }
  else if (@this == -1 && @sysvar::IL_CAN1::NODES::N_BCM::MESSAGES::BCM_FD_3::TIMINGS::EnableCyclic)
  {
    SetBusContext(gILCAN1_BusContext);
    gCAN1DisturbancePeriod = @sysvar::IL_CAN1::NODES::N_BCM::MESSAGES::BCM_FD_3::TIMINGS::CyclePeriod;
    ILFaultInjectionSetMsgCycleTime(FDCAN2_1::BCM::BCM_FD_3, gCAN1DisturbancePeriod);
  }
}

on sysvar_update sysvar::IL_CAN1::NODES::N_BCM::MESSAGES::BCM_FD_3::TIMINGS::SendOnce
{
  if (@this == 1)
  {
    SetBusContext(gILCAN1_BusContext);
    ILSetMsgEvent(FDCAN2_1::BCM::BCM_FD_3);
  }
}

on sysvar_update sysvar::IL_CAN1::NODES::N_BCM::MESSAGES::BCM_FD_4::TIMINGS::EnableCyclic
{
  if (@this == 1)
  {
    SetBusContext(gILCAN1_BusContext);
    ILFaultInjectionEnableMsg  (FDCAN2_1::BCM::BCM_FD_4);
  }
  else
  {
    SetBusContext(gILCAN1_BusContext);
    ILFaultInjectionDisableMsg (FDCAN2_1::BCM::BCM_FD_4);
  }
}

on sysvar_update sysvar::IL_CAN1::NODES::N_BCM::MESSAGES::BCM_FD_4::TIMINGS::SetNormalCycle
{
  if (@this == 1 && @sysvar::IL_CAN1::NODES::N_BCM::MESSAGES::BCM_FD_4::TIMINGS::EnableCyclic)
  {
    @sysvar::IL_CAN1::NODES::N_BCM::MESSAGES::BCM_FD_4::TIMINGS::SelectedPeriod = 0;
  }
}

on sysvar_update sysvar::IL_CAN1::NODES::N_BCM::MESSAGES::BCM_FD_4::TIMINGS::SetNewCycleContinously
{
  if (@this == 1 && @sysvar::IL_CAN1::NODES::N_BCM::MESSAGES::BCM_FD_4::TIMINGS::EnableCyclic)
  {
    @sysvar::IL_CAN1::NODES::N_BCM::MESSAGES::BCM_FD_4::TIMINGS::SelectedPeriod = -1;
  }
}

on sysvar_update sysvar::IL_CAN1::NODES::N_BCM::MESSAGES::BCM_FD_4::TIMINGS::SelectedPeriod
{
  if (@this == 0 && @sysvar::IL_CAN1::NODES::N_BCM::MESSAGES::BCM_FD_4::TIMINGS::EnableCyclic)
  {
    SetBusContext(gILCAN1_BusContext);
    gCAN1DisturbancePeriod = @sysvar::IL_CAN1::NODES::N_BCM::MESSAGES::BCM_FD_4::TIMINGS::NormalCyclePeriod;
    ILFaultInjectionResetMsgCycleTime(FDCAN2_1::BCM::BCM_FD_4);
  }
  else if (@this == 1 && @sysvar::IL_CAN1::NODES::N_BCM::MESSAGES::BCM_FD_4::TIMINGS::EnableCyclic)
  {
    SetBusContext(gILCAN1_BusContext);
    gCAN1DisturbancePeriod = @sysvar::IL_CAN1::NODES::N_BCM::MESSAGES::BCM_FD_4::TIMINGS::ActiveCyclePeriod;
    ILFaultInjectionSetMsgCycleTime(FDCAN2_1::BCM::BCM_FD_4, gCAN1DisturbancePeriod);
  }
  else if (@this == -1 && @sysvar::IL_CAN1::NODES::N_BCM::MESSAGES::BCM_FD_4::TIMINGS::EnableCyclic)
  {
    SetBusContext(gILCAN1_BusContext);
    gCAN1DisturbancePeriod = @sysvar::IL_CAN1::NODES::N_BCM::MESSAGES::BCM_FD_4::TIMINGS::CyclePeriod;
    ILFaultInjectionSetMsgCycleTime(FDCAN2_1::BCM::BCM_FD_4, gCAN1DisturbancePeriod);
  }
}

on sysvar_update sysvar::IL_CAN1::NODES::N_BCM::MESSAGES::BCM_FD_4::TIMINGS::SendOnce
{
  if (@this == 1)
  {
    SetBusContext(gILCAN1_BusContext);
    ILSetMsgEvent(FDCAN2_1::BCM::BCM_FD_4);
  }
}

on sysvar_update sysvar::IL_CAN1::NODES::N_BCM::MESSAGES::BCM_FD_6::TIMINGS::EnableCyclic
{
  if (@this == 1)
  {
    SetBusContext(gILCAN1_BusContext);
    ILFaultInjectionEnableMsg  (FDCAN2_1::BCM::BCM_FD_6);
  }
  else
  {
    SetBusContext(gILCAN1_BusContext);
    ILFaultInjectionDisableMsg (FDCAN2_1::BCM::BCM_FD_6);
  }
}

on sysvar_update sysvar::IL_CAN1::NODES::N_BCM::MESSAGES::BCM_FD_6::TIMINGS::SetNormalCycle
{
  if (@this == 1 && @sysvar::IL_CAN1::NODES::N_BCM::MESSAGES::BCM_FD_6::TIMINGS::EnableCyclic)
  {
    @sysvar::IL_CAN1::NODES::N_BCM::MESSAGES::BCM_FD_6::TIMINGS::SelectedPeriod = 0;
  }
}

on sysvar_update sysvar::IL_CAN1::NODES::N_BCM::MESSAGES::BCM_FD_6::TIMINGS::SetNewCycleContinously
{
  if (@this == 1 && @sysvar::IL_CAN1::NODES::N_BCM::MESSAGES::BCM_FD_6::TIMINGS::EnableCyclic)
  {
    @sysvar::IL_CAN1::NODES::N_BCM::MESSAGES::BCM_FD_6::TIMINGS::SelectedPeriod = -1;
  }
}

on sysvar_update sysvar::IL_CAN1::NODES::N_BCM::MESSAGES::BCM_FD_6::TIMINGS::SelectedPeriod
{
  if (@this == 0 && @sysvar::IL_CAN1::NODES::N_BCM::MESSAGES::BCM_FD_6::TIMINGS::EnableCyclic)
  {
    SetBusContext(gILCAN1_BusContext);
    gCAN1DisturbancePeriod = @sysvar::IL_CAN1::NODES::N_BCM::MESSAGES::BCM_FD_6::TIMINGS::NormalCyclePeriod;
    ILFaultInjectionResetMsgCycleTime(FDCAN2_1::BCM::BCM_FD_6);
  }
  else if (@this == 1 && @sysvar::IL_CAN1::NODES::N_BCM::MESSAGES::BCM_FD_6::TIMINGS::EnableCyclic)
  {
    SetBusContext(gILCAN1_BusContext);
    gCAN1DisturbancePeriod = @sysvar::IL_CAN1::NODES::N_BCM::MESSAGES::BCM_FD_6::TIMINGS::ActiveCyclePeriod;
    ILFaultInjectionSetMsgCycleTime(FDCAN2_1::BCM::BCM_FD_6, gCAN1DisturbancePeriod);
  }
  else if (@this == -1 && @sysvar::IL_CAN1::NODES::N_BCM::MESSAGES::BCM_FD_6::TIMINGS::EnableCyclic)
  {
    SetBusContext(gILCAN1_BusContext);
    gCAN1DisturbancePeriod = @sysvar::IL_CAN1::NODES::N_BCM::MESSAGES::BCM_FD_6::TIMINGS::CyclePeriod;
    ILFaultInjectionSetMsgCycleTime(FDCAN2_1::BCM::BCM_FD_6, gCAN1DisturbancePeriod);
  }
}

on sysvar_update sysvar::IL_CAN1::NODES::N_BCM::MESSAGES::BCM_FD_6::TIMINGS::SendOnce
{
  if (@this == 1)
  {
    SetBusContext(gILCAN1_BusContext);
    ILSetMsgEvent(FDCAN2_1::BCM::BCM_FD_6);
  }
}

on sysvar_update sysvar::IL_CAN1::NODES::N_BCM::MESSAGES::BCM_FD_7::TIMINGS::EnableCyclic
{
  if (@this == 1)
  {
    SetBusContext(gILCAN1_BusContext);
    ILFaultInjectionEnableMsg  (FDCAN2_1::BCM::BCM_FD_7);
  }
  else
  {
    SetBusContext(gILCAN1_BusContext);
    ILFaultInjectionDisableMsg (FDCAN2_1::BCM::BCM_FD_7);
  }
}

on sysvar_update sysvar::IL_CAN1::NODES::N_BCM::MESSAGES::BCM_FD_7::TIMINGS::SetNormalCycle
{
  if (@this == 1 && @sysvar::IL_CAN1::NODES::N_BCM::MESSAGES::BCM_FD_7::TIMINGS::EnableCyclic)
  {
    @sysvar::IL_CAN1::NODES::N_BCM::MESSAGES::BCM_FD_7::TIMINGS::SelectedPeriod = 0;
  }
}

on sysvar_update sysvar::IL_CAN1::NODES::N_BCM::MESSAGES::BCM_FD_7::TIMINGS::SetNewCycleContinously
{
  if (@this == 1 && @sysvar::IL_CAN1::NODES::N_BCM::MESSAGES::BCM_FD_7::TIMINGS::EnableCyclic)
  {
    @sysvar::IL_CAN1::NODES::N_BCM::MESSAGES::BCM_FD_7::TIMINGS::SelectedPeriod = -1;
  }
}

on sysvar_update sysvar::IL_CAN1::NODES::N_BCM::MESSAGES::BCM_FD_7::TIMINGS::SelectedPeriod
{
  if (@this == 0 && @sysvar::IL_CAN1::NODES::N_BCM::MESSAGES::BCM_FD_7::TIMINGS::EnableCyclic)
  {
    SetBusContext(gILCAN1_BusContext);
    gCAN1DisturbancePeriod = @sysvar::IL_CAN1::NODES::N_BCM::MESSAGES::BCM_FD_7::TIMINGS::NormalCyclePeriod;
    ILFaultInjectionResetMsgCycleTime(FDCAN2_1::BCM::BCM_FD_7);
  }
  else if (@this == 1 && @sysvar::IL_CAN1::NODES::N_BCM::MESSAGES::BCM_FD_7::TIMINGS::EnableCyclic)
  {
    SetBusContext(gILCAN1_BusContext);
    gCAN1DisturbancePeriod = @sysvar::IL_CAN1::NODES::N_BCM::MESSAGES::BCM_FD_7::TIMINGS::ActiveCyclePeriod;
    ILFaultInjectionSetMsgCycleTime(FDCAN2_1::BCM::BCM_FD_7, gCAN1DisturbancePeriod);
  }
  else if (@this == -1 && @sysvar::IL_CAN1::NODES::N_BCM::MESSAGES::BCM_FD_7::TIMINGS::EnableCyclic)
  {
    SetBusContext(gILCAN1_BusContext);
    gCAN1DisturbancePeriod = @sysvar::IL_CAN1::NODES::N_BCM::MESSAGES::BCM_FD_7::TIMINGS::CyclePeriod;
    ILFaultInjectionSetMsgCycleTime(FDCAN2_1::BCM::BCM_FD_7, gCAN1DisturbancePeriod);
  }
}

on sysvar_update sysvar::IL_CAN1::NODES::N_BCM::MESSAGES::BCM_FD_7::TIMINGS::SendOnce
{
  if (@this == 1)
  {
    SetBusContext(gILCAN1_BusContext);
    ILSetMsgEvent(FDCAN2_1::BCM::BCM_FD_7);
  }
}

on sysvar_update sysvar::IL_CAN1::NODES::N_BCM::MESSAGES::BCM_FD_9::TIMINGS::EnableCyclic
{
  if (@this == 1)
  {
    SetBusContext(gILCAN1_BusContext);
    ILFaultInjectionEnableMsg  (FDCAN2_1::BCM::BCM_FD_9);
  }
  else
  {
    SetBusContext(gILCAN1_BusContext);
    ILFaultInjectionDisableMsg (FDCAN2_1::BCM::BCM_FD_9);
  }
}

on sysvar_update sysvar::IL_CAN1::NODES::N_BCM::MESSAGES::BCM_FD_9::TIMINGS::SetNormalCycle
{
  if (@this == 1 && @sysvar::IL_CAN1::NODES::N_BCM::MESSAGES::BCM_FD_9::TIMINGS::EnableCyclic)
  {
    @sysvar::IL_CAN1::NODES::N_BCM::MESSAGES::BCM_FD_9::TIMINGS::SelectedPeriod = 0;
  }
}

on sysvar_update sysvar::IL_CAN1::NODES::N_BCM::MESSAGES::BCM_FD_9::TIMINGS::SetNewCycleContinously
{
  if (@this == 1 && @sysvar::IL_CAN1::NODES::N_BCM::MESSAGES::BCM_FD_9::TIMINGS::EnableCyclic)
  {
    @sysvar::IL_CAN1::NODES::N_BCM::MESSAGES::BCM_FD_9::TIMINGS::SelectedPeriod = -1;
  }
}

on sysvar_update sysvar::IL_CAN1::NODES::N_BCM::MESSAGES::BCM_FD_9::TIMINGS::SelectedPeriod
{
  if (@this == 0 && @sysvar::IL_CAN1::NODES::N_BCM::MESSAGES::BCM_FD_9::TIMINGS::EnableCyclic)
  {
    SetBusContext(gILCAN1_BusContext);
    gCAN1DisturbancePeriod = @sysvar::IL_CAN1::NODES::N_BCM::MESSAGES::BCM_FD_9::TIMINGS::NormalCyclePeriod;
    ILFaultInjectionResetMsgCycleTime(FDCAN2_1::BCM::BCM_FD_9);
  }
  else if (@this == 1 && @sysvar::IL_CAN1::NODES::N_BCM::MESSAGES::BCM_FD_9::TIMINGS::EnableCyclic)
  {
    SetBusContext(gILCAN1_BusContext);
    gCAN1DisturbancePeriod = @sysvar::IL_CAN1::NODES::N_BCM::MESSAGES::BCM_FD_9::TIMINGS::ActiveCyclePeriod;
    ILFaultInjectionSetMsgCycleTime(FDCAN2_1::BCM::BCM_FD_9, gCAN1DisturbancePeriod);
  }
  else if (@this == -1 && @sysvar::IL_CAN1::NODES::N_BCM::MESSAGES::BCM_FD_9::TIMINGS::EnableCyclic)
  {
    SetBusContext(gILCAN1_BusContext);
    gCAN1DisturbancePeriod = @sysvar::IL_CAN1::NODES::N_BCM::MESSAGES::BCM_FD_9::TIMINGS::CyclePeriod;
    ILFaultInjectionSetMsgCycleTime(FDCAN2_1::BCM::BCM_FD_9, gCAN1DisturbancePeriod);
  }
}

on sysvar_update sysvar::IL_CAN1::NODES::N_BCM::MESSAGES::BCM_FD_9::TIMINGS::SendOnce
{
  if (@this == 1)
  {
    SetBusContext(gILCAN1_BusContext);
    ILSetMsgEvent(FDCAN2_1::BCM::BCM_FD_9);
  }
}

on sysvar_update sysvar::IL_CAN1::NODES::N_BCM::MESSAGES::BRAKE_FD_1::TIMINGS::EnableCyclic
{
  if (@this == 1)
  {
    SetBusContext(gILCAN1_BusContext);
    ILFaultInjectionEnableMsg  (FDCAN2_1::BCM::BRAKE_FD_1);
  }
  else
  {
    SetBusContext(gILCAN1_BusContext);
    ILFaultInjectionDisableMsg (FDCAN2_1::BCM::BRAKE_FD_1);
  }
}

on sysvar_update sysvar::IL_CAN1::NODES::N_BCM::MESSAGES::BRAKE_FD_1::TIMINGS::SetNormalCycle
{
  if (@this == 1 && @sysvar::IL_CAN1::NODES::N_BCM::MESSAGES::BRAKE_FD_1::TIMINGS::EnableCyclic)
  {
    @sysvar::IL_CAN1::NODES::N_BCM::MESSAGES::BRAKE_FD_1::TIMINGS::SelectedPeriod = 0;
  }
}

on sysvar_update sysvar::IL_CAN1::NODES::N_BCM::MESSAGES::BRAKE_FD_1::TIMINGS::SetNewCycleContinously
{
  if (@this == 1 && @sysvar::IL_CAN1::NODES::N_BCM::MESSAGES::BRAKE_FD_1::TIMINGS::EnableCyclic)
  {
    @sysvar::IL_CAN1::NODES::N_BCM::MESSAGES::BRAKE_FD_1::TIMINGS::SelectedPeriod = -1;
  }
}

on sysvar_update sysvar::IL_CAN1::NODES::N_BCM::MESSAGES::BRAKE_FD_1::TIMINGS::SelectedPeriod
{
  if (@this == 0 && @sysvar::IL_CAN1::NODES::N_BCM::MESSAGES::BRAKE_FD_1::TIMINGS::EnableCyclic)
  {
    SetBusContext(gILCAN1_BusContext);
    gCAN1DisturbancePeriod = @sysvar::IL_CAN1::NODES::N_BCM::MESSAGES::BRAKE_FD_1::TIMINGS::NormalCyclePeriod;
    ILFaultInjectionResetMsgCycleTime(FDCAN2_1::BCM::BRAKE_FD_1);
  }
  else if (@this == 1 && @sysvar::IL_CAN1::NODES::N_BCM::MESSAGES::BRAKE_FD_1::TIMINGS::EnableCyclic)
  {
    SetBusContext(gILCAN1_BusContext);
    gCAN1DisturbancePeriod = @sysvar::IL_CAN1::NODES::N_BCM::MESSAGES::BRAKE_FD_1::TIMINGS::ActiveCyclePeriod;
    ILFaultInjectionSetMsgCycleTime(FDCAN2_1::BCM::BRAKE_FD_1, gCAN1DisturbancePeriod);
  }
  else if (@this == -1 && @sysvar::IL_CAN1::NODES::N_BCM::MESSAGES::BRAKE_FD_1::TIMINGS::EnableCyclic)
  {
    SetBusContext(gILCAN1_BusContext);
    gCAN1DisturbancePeriod = @sysvar::IL_CAN1::NODES::N_BCM::MESSAGES::BRAKE_FD_1::TIMINGS::CyclePeriod;
    ILFaultInjectionSetMsgCycleTime(FDCAN2_1::BCM::BRAKE_FD_1, gCAN1DisturbancePeriod);
  }
}

on sysvar_update sysvar::IL_CAN1::NODES::N_BCM::MESSAGES::BRAKE_FD_1::TIMINGS::SendOnce
{
  if (@this == 1)
  {
    SetBusContext(gILCAN1_BusContext);
    ILSetMsgEvent(FDCAN2_1::BCM::BRAKE_FD_1);
  }
}

on sysvar_update sysvar::IL_CAN1::NODES::N_BCM::MESSAGES::BRAKE_FD_2::TIMINGS::EnableCyclic
{
  if (@this == 1)
  {
    SetBusContext(gILCAN1_BusContext);
    ILFaultInjectionEnableMsg  (FDCAN2_1::BCM::BRAKE_FD_2);
  }
  else
  {
    SetBusContext(gILCAN1_BusContext);
    ILFaultInjectionDisableMsg (FDCAN2_1::BCM::BRAKE_FD_2);
  }
}

on sysvar_update sysvar::IL_CAN1::NODES::N_BCM::MESSAGES::BRAKE_FD_2::TIMINGS::SetNormalCycle
{
  if (@this == 1 && @sysvar::IL_CAN1::NODES::N_BCM::MESSAGES::BRAKE_FD_2::TIMINGS::EnableCyclic)
  {
    @sysvar::IL_CAN1::NODES::N_BCM::MESSAGES::BRAKE_FD_2::TIMINGS::SelectedPeriod = 0;
  }
}

on sysvar_update sysvar::IL_CAN1::NODES::N_BCM::MESSAGES::BRAKE_FD_2::TIMINGS::SetNewCycleContinously
{
  if (@this == 1 && @sysvar::IL_CAN1::NODES::N_BCM::MESSAGES::BRAKE_FD_2::TIMINGS::EnableCyclic)
  {
    @sysvar::IL_CAN1::NODES::N_BCM::MESSAGES::BRAKE_FD_2::TIMINGS::SelectedPeriod = -1;
  }
}

on sysvar_update sysvar::IL_CAN1::NODES::N_BCM::MESSAGES::BRAKE_FD_2::TIMINGS::SelectedPeriod
{
  if (@this == 0 && @sysvar::IL_CAN1::NODES::N_BCM::MESSAGES::BRAKE_FD_2::TIMINGS::EnableCyclic)
  {
    SetBusContext(gILCAN1_BusContext);
    gCAN1DisturbancePeriod = @sysvar::IL_CAN1::NODES::N_BCM::MESSAGES::BRAKE_FD_2::TIMINGS::NormalCyclePeriod;
    ILFaultInjectionResetMsgCycleTime(FDCAN2_1::BCM::BRAKE_FD_2);
  }
  else if (@this == 1 && @sysvar::IL_CAN1::NODES::N_BCM::MESSAGES::BRAKE_FD_2::TIMINGS::EnableCyclic)
  {
    SetBusContext(gILCAN1_BusContext);
    gCAN1DisturbancePeriod = @sysvar::IL_CAN1::NODES::N_BCM::MESSAGES::BRAKE_FD_2::TIMINGS::ActiveCyclePeriod;
    ILFaultInjectionSetMsgCycleTime(FDCAN2_1::BCM::BRAKE_FD_2, gCAN1DisturbancePeriod);
  }
  else if (@this == -1 && @sysvar::IL_CAN1::NODES::N_BCM::MESSAGES::BRAKE_FD_2::TIMINGS::EnableCyclic)
  {
    SetBusContext(gILCAN1_BusContext);
    gCAN1DisturbancePeriod = @sysvar::IL_CAN1::NODES::N_BCM::MESSAGES::BRAKE_FD_2::TIMINGS::CyclePeriod;
    ILFaultInjectionSetMsgCycleTime(FDCAN2_1::BCM::BRAKE_FD_2, gCAN1DisturbancePeriod);
  }
}

on sysvar_update sysvar::IL_CAN1::NODES::N_BCM::MESSAGES::BRAKE_FD_2::TIMINGS::SendOnce
{
  if (@this == 1)
  {
    SetBusContext(gILCAN1_BusContext);
    ILSetMsgEvent(FDCAN2_1::BCM::BRAKE_FD_2);
  }
}

on sysvar_update sysvar::IL_CAN1::NODES::N_BCM::MESSAGES::BRAKE_FD_3::TIMINGS::EnableCyclic
{
  if (@this == 1)
  {
    SetBusContext(gILCAN1_BusContext);
    ILFaultInjectionEnableMsg  (FDCAN2_1::BCM::BRAKE_FD_3);
  }
  else
  {
    SetBusContext(gILCAN1_BusContext);
    ILFaultInjectionDisableMsg (FDCAN2_1::BCM::BRAKE_FD_3);
  }
}

on sysvar_update sysvar::IL_CAN1::NODES::N_BCM::MESSAGES::BRAKE_FD_3::TIMINGS::SetNormalCycle
{
  if (@this == 1 && @sysvar::IL_CAN1::NODES::N_BCM::MESSAGES::BRAKE_FD_3::TIMINGS::EnableCyclic)
  {
    @sysvar::IL_CAN1::NODES::N_BCM::MESSAGES::BRAKE_FD_3::TIMINGS::SelectedPeriod = 0;
  }
}

on sysvar_update sysvar::IL_CAN1::NODES::N_BCM::MESSAGES::BRAKE_FD_3::TIMINGS::SetNewCycleContinously
{
  if (@this == 1 && @sysvar::IL_CAN1::NODES::N_BCM::MESSAGES::BRAKE_FD_3::TIMINGS::EnableCyclic)
  {
    @sysvar::IL_CAN1::NODES::N_BCM::MESSAGES::BRAKE_FD_3::TIMINGS::SelectedPeriod = -1;
  }
}

on sysvar_update sysvar::IL_CAN1::NODES::N_BCM::MESSAGES::BRAKE_FD_3::TIMINGS::SelectedPeriod
{
  if (@this == 0 && @sysvar::IL_CAN1::NODES::N_BCM::MESSAGES::BRAKE_FD_3::TIMINGS::EnableCyclic)
  {
    SetBusContext(gILCAN1_BusContext);
    gCAN1DisturbancePeriod = @sysvar::IL_CAN1::NODES::N_BCM::MESSAGES::BRAKE_FD_3::TIMINGS::NormalCyclePeriod;
    ILFaultInjectionResetMsgCycleTime(FDCAN2_1::BCM::BRAKE_FD_3);
  }
  else if (@this == 1 && @sysvar::IL_CAN1::NODES::N_BCM::MESSAGES::BRAKE_FD_3::TIMINGS::EnableCyclic)
  {
    SetBusContext(gILCAN1_BusContext);
    gCAN1DisturbancePeriod = @sysvar::IL_CAN1::NODES::N_BCM::MESSAGES::BRAKE_FD_3::TIMINGS::ActiveCyclePeriod;
    ILFaultInjectionSetMsgCycleTime(FDCAN2_1::BCM::BRAKE_FD_3, gCAN1DisturbancePeriod);
  }
  else if (@this == -1 && @sysvar::IL_CAN1::NODES::N_BCM::MESSAGES::BRAKE_FD_3::TIMINGS::EnableCyclic)
  {
    SetBusContext(gILCAN1_BusContext);
    gCAN1DisturbancePeriod = @sysvar::IL_CAN1::NODES::N_BCM::MESSAGES::BRAKE_FD_3::TIMINGS::CyclePeriod;
    ILFaultInjectionSetMsgCycleTime(FDCAN2_1::BCM::BRAKE_FD_3, gCAN1DisturbancePeriod);
  }
}

on sysvar_update sysvar::IL_CAN1::NODES::N_BCM::MESSAGES::BRAKE_FD_3::TIMINGS::SendOnce
{
  if (@this == 1)
  {
    SetBusContext(gILCAN1_BusContext);
    ILSetMsgEvent(FDCAN2_1::BCM::BRAKE_FD_3);
  }
}

on sysvar_update sysvar::IL_CAN1::NODES::N_BCM::MESSAGES::BRAKE_FD_4::TIMINGS::EnableCyclic
{
  if (@this == 1)
  {
    SetBusContext(gILCAN1_BusContext);
    ILFaultInjectionEnableMsg  (FDCAN2_1::BCM::BRAKE_FD_4);
  }
  else
  {
    SetBusContext(gILCAN1_BusContext);
    ILFaultInjectionDisableMsg (FDCAN2_1::BCM::BRAKE_FD_4);
  }
}

on sysvar_update sysvar::IL_CAN1::NODES::N_BCM::MESSAGES::BRAKE_FD_4::TIMINGS::SetNormalCycle
{
  if (@this == 1 && @sysvar::IL_CAN1::NODES::N_BCM::MESSAGES::BRAKE_FD_4::TIMINGS::EnableCyclic)
  {
    @sysvar::IL_CAN1::NODES::N_BCM::MESSAGES::BRAKE_FD_4::TIMINGS::SelectedPeriod = 0;
  }
}

on sysvar_update sysvar::IL_CAN1::NODES::N_BCM::MESSAGES::BRAKE_FD_4::TIMINGS::SetNewCycleContinously
{
  if (@this == 1 && @sysvar::IL_CAN1::NODES::N_BCM::MESSAGES::BRAKE_FD_4::TIMINGS::EnableCyclic)
  {
    @sysvar::IL_CAN1::NODES::N_BCM::MESSAGES::BRAKE_FD_4::TIMINGS::SelectedPeriod = -1;
  }
}

on sysvar_update sysvar::IL_CAN1::NODES::N_BCM::MESSAGES::BRAKE_FD_4::TIMINGS::SelectedPeriod
{
  if (@this == 0 && @sysvar::IL_CAN1::NODES::N_BCM::MESSAGES::BRAKE_FD_4::TIMINGS::EnableCyclic)
  {
    SetBusContext(gILCAN1_BusContext);
    gCAN1DisturbancePeriod = @sysvar::IL_CAN1::NODES::N_BCM::MESSAGES::BRAKE_FD_4::TIMINGS::NormalCyclePeriod;
    ILFaultInjectionResetMsgCycleTime(FDCAN2_1::BCM::BRAKE_FD_4);
  }
  else if (@this == 1 && @sysvar::IL_CAN1::NODES::N_BCM::MESSAGES::BRAKE_FD_4::TIMINGS::EnableCyclic)
  {
    SetBusContext(gILCAN1_BusContext);
    gCAN1DisturbancePeriod = @sysvar::IL_CAN1::NODES::N_BCM::MESSAGES::BRAKE_FD_4::TIMINGS::ActiveCyclePeriod;
    ILFaultInjectionSetMsgCycleTime(FDCAN2_1::BCM::BRAKE_FD_4, gCAN1DisturbancePeriod);
  }
  else if (@this == -1 && @sysvar::IL_CAN1::NODES::N_BCM::MESSAGES::BRAKE_FD_4::TIMINGS::EnableCyclic)
  {
    SetBusContext(gILCAN1_BusContext);
    gCAN1DisturbancePeriod = @sysvar::IL_CAN1::NODES::N_BCM::MESSAGES::BRAKE_FD_4::TIMINGS::CyclePeriod;
    ILFaultInjectionSetMsgCycleTime(FDCAN2_1::BCM::BRAKE_FD_4, gCAN1DisturbancePeriod);
  }
}

on sysvar_update sysvar::IL_CAN1::NODES::N_BCM::MESSAGES::BRAKE_FD_4::TIMINGS::SendOnce
{
  if (@this == 1)
  {
    SetBusContext(gILCAN1_BusContext);
    ILSetMsgEvent(FDCAN2_1::BCM::BRAKE_FD_4);
  }
}

on sysvar_update sysvar::IL_CAN1::NODES::N_BCM::MESSAGES::BRAKE_FD_5::TIMINGS::EnableCyclic
{
  if (@this == 1)
  {
    SetBusContext(gILCAN1_BusContext);
    ILFaultInjectionEnableMsg  (FDCAN2_1::BCM::BRAKE_FD_5);
  }
  else
  {
    SetBusContext(gILCAN1_BusContext);
    ILFaultInjectionDisableMsg (FDCAN2_1::BCM::BRAKE_FD_5);
  }
}

on sysvar_update sysvar::IL_CAN1::NODES::N_BCM::MESSAGES::BRAKE_FD_5::TIMINGS::SetNormalCycle
{
  if (@this == 1 && @sysvar::IL_CAN1::NODES::N_BCM::MESSAGES::BRAKE_FD_5::TIMINGS::EnableCyclic)
  {
    @sysvar::IL_CAN1::NODES::N_BCM::MESSAGES::BRAKE_FD_5::TIMINGS::SelectedPeriod = 0;
  }
}

on sysvar_update sysvar::IL_CAN1::NODES::N_BCM::MESSAGES::BRAKE_FD_5::TIMINGS::SetNewCycleContinously
{
  if (@this == 1 && @sysvar::IL_CAN1::NODES::N_BCM::MESSAGES::BRAKE_FD_5::TIMINGS::EnableCyclic)
  {
    @sysvar::IL_CAN1::NODES::N_BCM::MESSAGES::BRAKE_FD_5::TIMINGS::SelectedPeriod = -1;
  }
}

on sysvar_update sysvar::IL_CAN1::NODES::N_BCM::MESSAGES::BRAKE_FD_5::TIMINGS::SelectedPeriod
{
  if (@this == 0 && @sysvar::IL_CAN1::NODES::N_BCM::MESSAGES::BRAKE_FD_5::TIMINGS::EnableCyclic)
  {
    SetBusContext(gILCAN1_BusContext);
    gCAN1DisturbancePeriod = @sysvar::IL_CAN1::NODES::N_BCM::MESSAGES::BRAKE_FD_5::TIMINGS::NormalCyclePeriod;
    ILFaultInjectionResetMsgCycleTime(FDCAN2_1::BCM::BRAKE_FD_5);
  }
  else if (@this == 1 && @sysvar::IL_CAN1::NODES::N_BCM::MESSAGES::BRAKE_FD_5::TIMINGS::EnableCyclic)
  {
    SetBusContext(gILCAN1_BusContext);
    gCAN1DisturbancePeriod = @sysvar::IL_CAN1::NODES::N_BCM::MESSAGES::BRAKE_FD_5::TIMINGS::ActiveCyclePeriod;
    ILFaultInjectionSetMsgCycleTime(FDCAN2_1::BCM::BRAKE_FD_5, gCAN1DisturbancePeriod);
  }
  else if (@this == -1 && @sysvar::IL_CAN1::NODES::N_BCM::MESSAGES::BRAKE_FD_5::TIMINGS::EnableCyclic)
  {
    SetBusContext(gILCAN1_BusContext);
    gCAN1DisturbancePeriod = @sysvar::IL_CAN1::NODES::N_BCM::MESSAGES::BRAKE_FD_5::TIMINGS::CyclePeriod;
    ILFaultInjectionSetMsgCycleTime(FDCAN2_1::BCM::BRAKE_FD_5, gCAN1DisturbancePeriod);
  }
}

on sysvar_update sysvar::IL_CAN1::NODES::N_BCM::MESSAGES::BRAKE_FD_5::TIMINGS::SendOnce
{
  if (@this == 1)
  {
    SetBusContext(gILCAN1_BusContext);
    ILSetMsgEvent(FDCAN2_1::BCM::BRAKE_FD_5);
  }
}

on sysvar_update sysvar::IL_CAN1::NODES::N_BCM::MESSAGES::BRAKE_FD_7::TIMINGS::EnableCyclic
{
  if (@this == 1)
  {
    SetBusContext(gILCAN1_BusContext);
    ILFaultInjectionEnableMsg  (FDCAN2_1::BCM::BRAKE_FD_7);
  }
  else
  {
    SetBusContext(gILCAN1_BusContext);
    ILFaultInjectionDisableMsg (FDCAN2_1::BCM::BRAKE_FD_7);
  }
}

on sysvar_update sysvar::IL_CAN1::NODES::N_BCM::MESSAGES::BRAKE_FD_7::TIMINGS::SetNormalCycle
{
  if (@this == 1 && @sysvar::IL_CAN1::NODES::N_BCM::MESSAGES::BRAKE_FD_7::TIMINGS::EnableCyclic)
  {
    @sysvar::IL_CAN1::NODES::N_BCM::MESSAGES::BRAKE_FD_7::TIMINGS::SelectedPeriod = 0;
  }
}

on sysvar_update sysvar::IL_CAN1::NODES::N_BCM::MESSAGES::BRAKE_FD_7::TIMINGS::SetNewCycleContinously
{
  if (@this == 1 && @sysvar::IL_CAN1::NODES::N_BCM::MESSAGES::BRAKE_FD_7::TIMINGS::EnableCyclic)
  {
    @sysvar::IL_CAN1::NODES::N_BCM::MESSAGES::BRAKE_FD_7::TIMINGS::SelectedPeriod = -1;
  }
}

on sysvar_update sysvar::IL_CAN1::NODES::N_BCM::MESSAGES::BRAKE_FD_7::TIMINGS::SelectedPeriod
{
  if (@this == 0 && @sysvar::IL_CAN1::NODES::N_BCM::MESSAGES::BRAKE_FD_7::TIMINGS::EnableCyclic)
  {
    SetBusContext(gILCAN1_BusContext);
    gCAN1DisturbancePeriod = @sysvar::IL_CAN1::NODES::N_BCM::MESSAGES::BRAKE_FD_7::TIMINGS::NormalCyclePeriod;
    ILFaultInjectionResetMsgCycleTime(FDCAN2_1::BCM::BRAKE_FD_7);
  }
  else if (@this == 1 && @sysvar::IL_CAN1::NODES::N_BCM::MESSAGES::BRAKE_FD_7::TIMINGS::EnableCyclic)
  {
    SetBusContext(gILCAN1_BusContext);
    gCAN1DisturbancePeriod = @sysvar::IL_CAN1::NODES::N_BCM::MESSAGES::BRAKE_FD_7::TIMINGS::ActiveCyclePeriod;
    ILFaultInjectionSetMsgCycleTime(FDCAN2_1::BCM::BRAKE_FD_7, gCAN1DisturbancePeriod);
  }
  else if (@this == -1 && @sysvar::IL_CAN1::NODES::N_BCM::MESSAGES::BRAKE_FD_7::TIMINGS::EnableCyclic)
  {
    SetBusContext(gILCAN1_BusContext);
    gCAN1DisturbancePeriod = @sysvar::IL_CAN1::NODES::N_BCM::MESSAGES::BRAKE_FD_7::TIMINGS::CyclePeriod;
    ILFaultInjectionSetMsgCycleTime(FDCAN2_1::BCM::BRAKE_FD_7, gCAN1DisturbancePeriod);
  }
}

on sysvar_update sysvar::IL_CAN1::NODES::N_BCM::MESSAGES::BRAKE_FD_7::TIMINGS::SendOnce
{
  if (@this == 1)
  {
    SetBusContext(gILCAN1_BusContext);
    ILSetMsgEvent(FDCAN2_1::BCM::BRAKE_FD_7);
  }
}

on sysvar_update sysvar::IL_CAN1::NODES::N_BCM::MESSAGES::CFG_DATA_CODE_REQUEST::TIMINGS::EnableCyclic
{
  if (@this == 1)
  {
    SetBusContext(gILCAN1_BusContext);
    ILFaultInjectionEnableMsg  (FDCAN2_1::BCM::CFG_DATA_CODE_REQUEST);
  }
  else
  {
    SetBusContext(gILCAN1_BusContext);
    ILFaultInjectionDisableMsg (FDCAN2_1::BCM::CFG_DATA_CODE_REQUEST);
  }
}

on sysvar_update sysvar::IL_CAN1::NODES::N_BCM::MESSAGES::CFG_DATA_CODE_REQUEST::TIMINGS::SetNormalCycle
{
  if (@this == 1 && @sysvar::IL_CAN1::NODES::N_BCM::MESSAGES::CFG_DATA_CODE_REQUEST::TIMINGS::EnableCyclic)
  {
    @sysvar::IL_CAN1::NODES::N_BCM::MESSAGES::CFG_DATA_CODE_REQUEST::TIMINGS::SelectedPeriod = 0;
  }
}

on sysvar_update sysvar::IL_CAN1::NODES::N_BCM::MESSAGES::CFG_DATA_CODE_REQUEST::TIMINGS::SetNewCycleContinously
{
  if (@this == 1 && @sysvar::IL_CAN1::NODES::N_BCM::MESSAGES::CFG_DATA_CODE_REQUEST::TIMINGS::EnableCyclic)
  {
    @sysvar::IL_CAN1::NODES::N_BCM::MESSAGES::CFG_DATA_CODE_REQUEST::TIMINGS::SelectedPeriod = -1;
  }
}

on sysvar_update sysvar::IL_CAN1::NODES::N_BCM::MESSAGES::CFG_DATA_CODE_REQUEST::TIMINGS::SelectedPeriod
{
  if (@this == 0 && @sysvar::IL_CAN1::NODES::N_BCM::MESSAGES::CFG_DATA_CODE_REQUEST::TIMINGS::EnableCyclic)
  {
    SetBusContext(gILCAN1_BusContext);
    gCAN1DisturbancePeriod = @sysvar::IL_CAN1::NODES::N_BCM::MESSAGES::CFG_DATA_CODE_REQUEST::TIMINGS::NormalCyclePeriod;
    ILFaultInjectionResetMsgCycleTime(FDCAN2_1::BCM::CFG_DATA_CODE_REQUEST);
  }
  else if (@this == 1 && @sysvar::IL_CAN1::NODES::N_BCM::MESSAGES::CFG_DATA_CODE_REQUEST::TIMINGS::EnableCyclic)
  {
    SetBusContext(gILCAN1_BusContext);
    gCAN1DisturbancePeriod = @sysvar::IL_CAN1::NODES::N_BCM::MESSAGES::CFG_DATA_CODE_REQUEST::TIMINGS::ActiveCyclePeriod;
    ILFaultInjectionSetMsgCycleTime(FDCAN2_1::BCM::CFG_DATA_CODE_REQUEST, gCAN1DisturbancePeriod);
  }
  else if (@this == -1 && @sysvar::IL_CAN1::NODES::N_BCM::MESSAGES::CFG_DATA_CODE_REQUEST::TIMINGS::EnableCyclic)
  {
    SetBusContext(gILCAN1_BusContext);
    gCAN1DisturbancePeriod = @sysvar::IL_CAN1::NODES::N_BCM::MESSAGES::CFG_DATA_CODE_REQUEST::TIMINGS::CyclePeriod;
    ILFaultInjectionSetMsgCycleTime(FDCAN2_1::BCM::CFG_DATA_CODE_REQUEST, gCAN1DisturbancePeriod);
  }
}

on sysvar_update sysvar::IL_CAN1::NODES::N_BCM::MESSAGES::CFG_DATA_CODE_REQUEST::TIMINGS::SendOnce
{
  if (@this == 1)
  {
    SetBusContext(gILCAN1_BusContext);
    ILSetMsgEvent(FDCAN2_1::BCM::CFG_DATA_CODE_REQUEST);
  }
}

on sysvar_update sysvar::IL_CAN1::NODES::N_BCM::MESSAGES::DBSM2_A1::TIMINGS::EnableCyclic
{
  if (@this == 1)
  {
    SetBusContext(gILCAN1_BusContext);
    ILFaultInjectionEnableMsg  (FDCAN2_1::BCM::DBSM2_A1);
  }
  else
  {
    SetBusContext(gILCAN1_BusContext);
    ILFaultInjectionDisableMsg (FDCAN2_1::BCM::DBSM2_A1);
  }
}

on sysvar_update sysvar::IL_CAN1::NODES::N_BCM::MESSAGES::DBSM2_A1::TIMINGS::SetNormalCycle
{
  if (@this == 1 && @sysvar::IL_CAN1::NODES::N_BCM::MESSAGES::DBSM2_A1::TIMINGS::EnableCyclic)
  {
    @sysvar::IL_CAN1::NODES::N_BCM::MESSAGES::DBSM2_A1::TIMINGS::SelectedPeriod = 0;
  }
}

on sysvar_update sysvar::IL_CAN1::NODES::N_BCM::MESSAGES::DBSM2_A1::TIMINGS::SetNewCycleContinously
{
  if (@this == 1 && @sysvar::IL_CAN1::NODES::N_BCM::MESSAGES::DBSM2_A1::TIMINGS::EnableCyclic)
  {
    @sysvar::IL_CAN1::NODES::N_BCM::MESSAGES::DBSM2_A1::TIMINGS::SelectedPeriod = -1;
  }
}

on sysvar_update sysvar::IL_CAN1::NODES::N_BCM::MESSAGES::DBSM2_A1::TIMINGS::SelectedPeriod
{
  if (@this == 0 && @sysvar::IL_CAN1::NODES::N_BCM::MESSAGES::DBSM2_A1::TIMINGS::EnableCyclic)
  {
    SetBusContext(gILCAN1_BusContext);
    gCAN1DisturbancePeriod = @sysvar::IL_CAN1::NODES::N_BCM::MESSAGES::DBSM2_A1::TIMINGS::NormalCyclePeriod;
    ILFaultInjectionResetMsgCycleTime(FDCAN2_1::BCM::DBSM2_A1);
  }
  else if (@this == 1 && @sysvar::IL_CAN1::NODES::N_BCM::MESSAGES::DBSM2_A1::TIMINGS::EnableCyclic)
  {
    SetBusContext(gILCAN1_BusContext);
    gCAN1DisturbancePeriod = @sysvar::IL_CAN1::NODES::N_BCM::MESSAGES::DBSM2_A1::TIMINGS::ActiveCyclePeriod;
    ILFaultInjectionSetMsgCycleTime(FDCAN2_1::BCM::DBSM2_A1, gCAN1DisturbancePeriod);
  }
  else if (@this == -1 && @sysvar::IL_CAN1::NODES::N_BCM::MESSAGES::DBSM2_A1::TIMINGS::EnableCyclic)
  {
    SetBusContext(gILCAN1_BusContext);
    gCAN1DisturbancePeriod = @sysvar::IL_CAN1::NODES::N_BCM::MESSAGES::DBSM2_A1::TIMINGS::CyclePeriod;
    ILFaultInjectionSetMsgCycleTime(FDCAN2_1::BCM::DBSM2_A1, gCAN1DisturbancePeriod);
  }
}

on sysvar_update sysvar::IL_CAN1::NODES::N_BCM::MESSAGES::DBSM2_A1::TIMINGS::SendOnce
{
  if (@this == 1)
  {
    SetBusContext(gILCAN1_BusContext);
    ILSetMsgEvent(FDCAN2_1::BCM::DBSM2_A1);
  }
}

on sysvar_update sysvar::IL_CAN1::NODES::N_BCM::MESSAGES::DRIVETRAIN_FD_1::TIMINGS::EnableCyclic
{
  if (@this == 1)
  {
    SetBusContext(gILCAN1_BusContext);
    ILFaultInjectionEnableMsg  (FDCAN2_1::BCM::DRIVETRAIN_FD_1);
  }
  else
  {
    SetBusContext(gILCAN1_BusContext);
    ILFaultInjectionDisableMsg (FDCAN2_1::BCM::DRIVETRAIN_FD_1);
  }
}

on sysvar_update sysvar::IL_CAN1::NODES::N_BCM::MESSAGES::DRIVETRAIN_FD_1::TIMINGS::SetNormalCycle
{
  if (@this == 1 && @sysvar::IL_CAN1::NODES::N_BCM::MESSAGES::DRIVETRAIN_FD_1::TIMINGS::EnableCyclic)
  {
    @sysvar::IL_CAN1::NODES::N_BCM::MESSAGES::DRIVETRAIN_FD_1::TIMINGS::SelectedPeriod = 0;
  }
}

on sysvar_update sysvar::IL_CAN1::NODES::N_BCM::MESSAGES::DRIVETRAIN_FD_1::TIMINGS::SetNewCycleContinously
{
  if (@this == 1 && @sysvar::IL_CAN1::NODES::N_BCM::MESSAGES::DRIVETRAIN_FD_1::TIMINGS::EnableCyclic)
  {
    @sysvar::IL_CAN1::NODES::N_BCM::MESSAGES::DRIVETRAIN_FD_1::TIMINGS::SelectedPeriod = -1;
  }
}

on sysvar_update sysvar::IL_CAN1::NODES::N_BCM::MESSAGES::DRIVETRAIN_FD_1::TIMINGS::SelectedPeriod
{
  if (@this == 0 && @sysvar::IL_CAN1::NODES::N_BCM::MESSAGES::DRIVETRAIN_FD_1::TIMINGS::EnableCyclic)
  {
    SetBusContext(gILCAN1_BusContext);
    gCAN1DisturbancePeriod = @sysvar::IL_CAN1::NODES::N_BCM::MESSAGES::DRIVETRAIN_FD_1::TIMINGS::NormalCyclePeriod;
    ILFaultInjectionResetMsgCycleTime(FDCAN2_1::BCM::DRIVETRAIN_FD_1);
  }
  else if (@this == 1 && @sysvar::IL_CAN1::NODES::N_BCM::MESSAGES::DRIVETRAIN_FD_1::TIMINGS::EnableCyclic)
  {
    SetBusContext(gILCAN1_BusContext);
    gCAN1DisturbancePeriod = @sysvar::IL_CAN1::NODES::N_BCM::MESSAGES::DRIVETRAIN_FD_1::TIMINGS::ActiveCyclePeriod;
    ILFaultInjectionSetMsgCycleTime(FDCAN2_1::BCM::DRIVETRAIN_FD_1, gCAN1DisturbancePeriod);
  }
  else if (@this == -1 && @sysvar::IL_CAN1::NODES::N_BCM::MESSAGES::DRIVETRAIN_FD_1::TIMINGS::EnableCyclic)
  {
    SetBusContext(gILCAN1_BusContext);
    gCAN1DisturbancePeriod = @sysvar::IL_CAN1::NODES::N_BCM::MESSAGES::DRIVETRAIN_FD_1::TIMINGS::CyclePeriod;
    ILFaultInjectionSetMsgCycleTime(FDCAN2_1::BCM::DRIVETRAIN_FD_1, gCAN1DisturbancePeriod);
  }
}

on sysvar_update sysvar::IL_CAN1::NODES::N_BCM::MESSAGES::DRIVETRAIN_FD_1::TIMINGS::SendOnce
{
  if (@this == 1)
  {
    SetBusContext(gILCAN1_BusContext);
    ILSetMsgEvent(FDCAN2_1::BCM::DRIVETRAIN_FD_1);
  }
}

on sysvar_update sysvar::IL_CAN1::NODES::N_BCM::MESSAGES::DRIVETRAIN_FD_3::TIMINGS::EnableCyclic
{
  if (@this == 1)
  {
    SetBusContext(gILCAN1_BusContext);
    ILFaultInjectionEnableMsg  (FDCAN2_1::BCM::DRIVETRAIN_FD_3);
  }
  else
  {
    SetBusContext(gILCAN1_BusContext);
    ILFaultInjectionDisableMsg (FDCAN2_1::BCM::DRIVETRAIN_FD_3);
  }
}

on sysvar_update sysvar::IL_CAN1::NODES::N_BCM::MESSAGES::DRIVETRAIN_FD_3::TIMINGS::SetNormalCycle
{
  if (@this == 1 && @sysvar::IL_CAN1::NODES::N_BCM::MESSAGES::DRIVETRAIN_FD_3::TIMINGS::EnableCyclic)
  {
    @sysvar::IL_CAN1::NODES::N_BCM::MESSAGES::DRIVETRAIN_FD_3::TIMINGS::SelectedPeriod = 0;
  }
}

on sysvar_update sysvar::IL_CAN1::NODES::N_BCM::MESSAGES::DRIVETRAIN_FD_3::TIMINGS::SetNewCycleContinously
{
  if (@this == 1 && @sysvar::IL_CAN1::NODES::N_BCM::MESSAGES::DRIVETRAIN_FD_3::TIMINGS::EnableCyclic)
  {
    @sysvar::IL_CAN1::NODES::N_BCM::MESSAGES::DRIVETRAIN_FD_3::TIMINGS::SelectedPeriod = -1;
  }
}

on sysvar_update sysvar::IL_CAN1::NODES::N_BCM::MESSAGES::DRIVETRAIN_FD_3::TIMINGS::SelectedPeriod
{
  if (@this == 0 && @sysvar::IL_CAN1::NODES::N_BCM::MESSAGES::DRIVETRAIN_FD_3::TIMINGS::EnableCyclic)
  {
    SetBusContext(gILCAN1_BusContext);
    gCAN1DisturbancePeriod = @sysvar::IL_CAN1::NODES::N_BCM::MESSAGES::DRIVETRAIN_FD_3::TIMINGS::NormalCyclePeriod;
    ILFaultInjectionResetMsgCycleTime(FDCAN2_1::BCM::DRIVETRAIN_FD_3);
  }
  else if (@this == 1 && @sysvar::IL_CAN1::NODES::N_BCM::MESSAGES::DRIVETRAIN_FD_3::TIMINGS::EnableCyclic)
  {
    SetBusContext(gILCAN1_BusContext);
    gCAN1DisturbancePeriod = @sysvar::IL_CAN1::NODES::N_BCM::MESSAGES::DRIVETRAIN_FD_3::TIMINGS::ActiveCyclePeriod;
    ILFaultInjectionSetMsgCycleTime(FDCAN2_1::BCM::DRIVETRAIN_FD_3, gCAN1DisturbancePeriod);
  }
  else if (@this == -1 && @sysvar::IL_CAN1::NODES::N_BCM::MESSAGES::DRIVETRAIN_FD_3::TIMINGS::EnableCyclic)
  {
    SetBusContext(gILCAN1_BusContext);
    gCAN1DisturbancePeriod = @sysvar::IL_CAN1::NODES::N_BCM::MESSAGES::DRIVETRAIN_FD_3::TIMINGS::CyclePeriod;
    ILFaultInjectionSetMsgCycleTime(FDCAN2_1::BCM::DRIVETRAIN_FD_3, gCAN1DisturbancePeriod);
  }
}

on sysvar_update sysvar::IL_CAN1::NODES::N_BCM::MESSAGES::DRIVETRAIN_FD_3::TIMINGS::SendOnce
{
  if (@this == 1)
  {
    SetBusContext(gILCAN1_BusContext);
    ILSetMsgEvent(FDCAN2_1::BCM::DRIVETRAIN_FD_3);
  }
}

on sysvar_update sysvar::IL_CAN1::NODES::N_BCM::MESSAGES::ELATCH1::TIMINGS::EnableCyclic
{
  if (@this == 1)
  {
    SetBusContext(gILCAN1_BusContext);
    ILFaultInjectionEnableMsg  (FDCAN2_1::BCM::ELATCH1);
  }
  else
  {
    SetBusContext(gILCAN1_BusContext);
    ILFaultInjectionDisableMsg (FDCAN2_1::BCM::ELATCH1);
  }
}

on sysvar_update sysvar::IL_CAN1::NODES::N_BCM::MESSAGES::ELATCH1::TIMINGS::SetNormalCycle
{
  if (@this == 1 && @sysvar::IL_CAN1::NODES::N_BCM::MESSAGES::ELATCH1::TIMINGS::EnableCyclic)
  {
    @sysvar::IL_CAN1::NODES::N_BCM::MESSAGES::ELATCH1::TIMINGS::SelectedPeriod = 0;
  }
}

on sysvar_update sysvar::IL_CAN1::NODES::N_BCM::MESSAGES::ELATCH1::TIMINGS::SetNewCycleContinously
{
  if (@this == 1 && @sysvar::IL_CAN1::NODES::N_BCM::MESSAGES::ELATCH1::TIMINGS::EnableCyclic)
  {
    @sysvar::IL_CAN1::NODES::N_BCM::MESSAGES::ELATCH1::TIMINGS::SelectedPeriod = -1;
  }
}

on sysvar_update sysvar::IL_CAN1::NODES::N_BCM::MESSAGES::ELATCH1::TIMINGS::SelectedPeriod
{
  if (@this == 0 && @sysvar::IL_CAN1::NODES::N_BCM::MESSAGES::ELATCH1::TIMINGS::EnableCyclic)
  {
    SetBusContext(gILCAN1_BusContext);
    gCAN1DisturbancePeriod = @sysvar::IL_CAN1::NODES::N_BCM::MESSAGES::ELATCH1::TIMINGS::NormalCyclePeriod;
    ILFaultInjectionResetMsgCycleTime(FDCAN2_1::BCM::ELATCH1);
  }
  else if (@this == 1 && @sysvar::IL_CAN1::NODES::N_BCM::MESSAGES::ELATCH1::TIMINGS::EnableCyclic)
  {
    SetBusContext(gILCAN1_BusContext);
    gCAN1DisturbancePeriod = @sysvar::IL_CAN1::NODES::N_BCM::MESSAGES::ELATCH1::TIMINGS::ActiveCyclePeriod;
    ILFaultInjectionSetMsgCycleTime(FDCAN2_1::BCM::ELATCH1, gCAN1DisturbancePeriod);
  }
  else if (@this == -1 && @sysvar::IL_CAN1::NODES::N_BCM::MESSAGES::ELATCH1::TIMINGS::EnableCyclic)
  {
    SetBusContext(gILCAN1_BusContext);
    gCAN1DisturbancePeriod = @sysvar::IL_CAN1::NODES::N_BCM::MESSAGES::ELATCH1::TIMINGS::CyclePeriod;
    ILFaultInjectionSetMsgCycleTime(FDCAN2_1::BCM::ELATCH1, gCAN1DisturbancePeriod);
  }
}

on sysvar_update sysvar::IL_CAN1::NODES::N_BCM::MESSAGES::ELATCH1::TIMINGS::SendOnce
{
  if (@this == 1)
  {
    SetBusContext(gILCAN1_BusContext);
    ILSetMsgEvent(FDCAN2_1::BCM::ELATCH1);
  }
}

on sysvar_update sysvar::IL_CAN1::NODES::N_BCM::MESSAGES::ENGINE_FD_1::TIMINGS::EnableCyclic
{
  if (@this == 1)
  {
    SetBusContext(gILCAN1_BusContext);
    ILFaultInjectionEnableMsg  (FDCAN2_1::BCM::ENGINE_FD_1);
  }
  else
  {
    SetBusContext(gILCAN1_BusContext);
    ILFaultInjectionDisableMsg (FDCAN2_1::BCM::ENGINE_FD_1);
  }
}

on sysvar_update sysvar::IL_CAN1::NODES::N_BCM::MESSAGES::ENGINE_FD_1::TIMINGS::SetNormalCycle
{
  if (@this == 1 && @sysvar::IL_CAN1::NODES::N_BCM::MESSAGES::ENGINE_FD_1::TIMINGS::EnableCyclic)
  {
    @sysvar::IL_CAN1::NODES::N_BCM::MESSAGES::ENGINE_FD_1::TIMINGS::SelectedPeriod = 0;
  }
}

on sysvar_update sysvar::IL_CAN1::NODES::N_BCM::MESSAGES::ENGINE_FD_1::TIMINGS::SetNewCycleContinously
{
  if (@this == 1 && @sysvar::IL_CAN1::NODES::N_BCM::MESSAGES::ENGINE_FD_1::TIMINGS::EnableCyclic)
  {
    @sysvar::IL_CAN1::NODES::N_BCM::MESSAGES::ENGINE_FD_1::TIMINGS::SelectedPeriod = -1;
  }
}

on sysvar_update sysvar::IL_CAN1::NODES::N_BCM::MESSAGES::ENGINE_FD_1::TIMINGS::SelectedPeriod
{
  if (@this == 0 && @sysvar::IL_CAN1::NODES::N_BCM::MESSAGES::ENGINE_FD_1::TIMINGS::EnableCyclic)
  {
    SetBusContext(gILCAN1_BusContext);
    gCAN1DisturbancePeriod = @sysvar::IL_CAN1::NODES::N_BCM::MESSAGES::ENGINE_FD_1::TIMINGS::NormalCyclePeriod;
    ILFaultInjectionResetMsgCycleTime(FDCAN2_1::BCM::ENGINE_FD_1);
  }
  else if (@this == 1 && @sysvar::IL_CAN1::NODES::N_BCM::MESSAGES::ENGINE_FD_1::TIMINGS::EnableCyclic)
  {
    SetBusContext(gILCAN1_BusContext);
    gCAN1DisturbancePeriod = @sysvar::IL_CAN1::NODES::N_BCM::MESSAGES::ENGINE_FD_1::TIMINGS::ActiveCyclePeriod;
    ILFaultInjectionSetMsgCycleTime(FDCAN2_1::BCM::ENGINE_FD_1, gCAN1DisturbancePeriod);
  }
  else if (@this == -1 && @sysvar::IL_CAN1::NODES::N_BCM::MESSAGES::ENGINE_FD_1::TIMINGS::EnableCyclic)
  {
    SetBusContext(gILCAN1_BusContext);
    gCAN1DisturbancePeriod = @sysvar::IL_CAN1::NODES::N_BCM::MESSAGES::ENGINE_FD_1::TIMINGS::CyclePeriod;
    ILFaultInjectionSetMsgCycleTime(FDCAN2_1::BCM::ENGINE_FD_1, gCAN1DisturbancePeriod);
  }
}

on sysvar_update sysvar::IL_CAN1::NODES::N_BCM::MESSAGES::ENGINE_FD_1::TIMINGS::SendOnce
{
  if (@this == 1)
  {
    SetBusContext(gILCAN1_BusContext);
    ILSetMsgEvent(FDCAN2_1::BCM::ENGINE_FD_1);
  }
}

on sysvar_update sysvar::IL_CAN1::NODES::N_BCM::MESSAGES::ENGINE_FD_2::TIMINGS::EnableCyclic
{
  if (@this == 1)
  {
    SetBusContext(gILCAN1_BusContext);
    ILFaultInjectionEnableMsg  (FDCAN2_1::BCM::ENGINE_FD_2);
  }
  else
  {
    SetBusContext(gILCAN1_BusContext);
    ILFaultInjectionDisableMsg (FDCAN2_1::BCM::ENGINE_FD_2);
  }
}

on sysvar_update sysvar::IL_CAN1::NODES::N_BCM::MESSAGES::ENGINE_FD_2::TIMINGS::SetNormalCycle
{
  if (@this == 1 && @sysvar::IL_CAN1::NODES::N_BCM::MESSAGES::ENGINE_FD_2::TIMINGS::EnableCyclic)
  {
    @sysvar::IL_CAN1::NODES::N_BCM::MESSAGES::ENGINE_FD_2::TIMINGS::SelectedPeriod = 0;
  }
}

on sysvar_update sysvar::IL_CAN1::NODES::N_BCM::MESSAGES::ENGINE_FD_2::TIMINGS::SetNewCycleContinously
{
  if (@this == 1 && @sysvar::IL_CAN1::NODES::N_BCM::MESSAGES::ENGINE_FD_2::TIMINGS::EnableCyclic)
  {
    @sysvar::IL_CAN1::NODES::N_BCM::MESSAGES::ENGINE_FD_2::TIMINGS::SelectedPeriod = -1;
  }
}

on sysvar_update sysvar::IL_CAN1::NODES::N_BCM::MESSAGES::ENGINE_FD_2::TIMINGS::SelectedPeriod
{
  if (@this == 0 && @sysvar::IL_CAN1::NODES::N_BCM::MESSAGES::ENGINE_FD_2::TIMINGS::EnableCyclic)
  {
    SetBusContext(gILCAN1_BusContext);
    gCAN1DisturbancePeriod = @sysvar::IL_CAN1::NODES::N_BCM::MESSAGES::ENGINE_FD_2::TIMINGS::NormalCyclePeriod;
    ILFaultInjectionResetMsgCycleTime(FDCAN2_1::BCM::ENGINE_FD_2);
  }
  else if (@this == 1 && @sysvar::IL_CAN1::NODES::N_BCM::MESSAGES::ENGINE_FD_2::TIMINGS::EnableCyclic)
  {
    SetBusContext(gILCAN1_BusContext);
    gCAN1DisturbancePeriod = @sysvar::IL_CAN1::NODES::N_BCM::MESSAGES::ENGINE_FD_2::TIMINGS::ActiveCyclePeriod;
    ILFaultInjectionSetMsgCycleTime(FDCAN2_1::BCM::ENGINE_FD_2, gCAN1DisturbancePeriod);
  }
  else if (@this == -1 && @sysvar::IL_CAN1::NODES::N_BCM::MESSAGES::ENGINE_FD_2::TIMINGS::EnableCyclic)
  {
    SetBusContext(gILCAN1_BusContext);
    gCAN1DisturbancePeriod = @sysvar::IL_CAN1::NODES::N_BCM::MESSAGES::ENGINE_FD_2::TIMINGS::CyclePeriod;
    ILFaultInjectionSetMsgCycleTime(FDCAN2_1::BCM::ENGINE_FD_2, gCAN1DisturbancePeriod);
  }
}

on sysvar_update sysvar::IL_CAN1::NODES::N_BCM::MESSAGES::ENGINE_FD_2::TIMINGS::SendOnce
{
  if (@this == 1)
  {
    SetBusContext(gILCAN1_BusContext);
    ILSetMsgEvent(FDCAN2_1::BCM::ENGINE_FD_2);
  }
}

on sysvar_update sysvar::IL_CAN1::NODES::N_BCM::MESSAGES::ENGINE_FD_3::TIMINGS::EnableCyclic
{
  if (@this == 1)
  {
    SetBusContext(gILCAN1_BusContext);
    ILFaultInjectionEnableMsg  (FDCAN2_1::BCM::ENGINE_FD_3);
  }
  else
  {
    SetBusContext(gILCAN1_BusContext);
    ILFaultInjectionDisableMsg (FDCAN2_1::BCM::ENGINE_FD_3);
  }
}

on sysvar_update sysvar::IL_CAN1::NODES::N_BCM::MESSAGES::ENGINE_FD_3::TIMINGS::SetNormalCycle
{
  if (@this == 1 && @sysvar::IL_CAN1::NODES::N_BCM::MESSAGES::ENGINE_FD_3::TIMINGS::EnableCyclic)
  {
    @sysvar::IL_CAN1::NODES::N_BCM::MESSAGES::ENGINE_FD_3::TIMINGS::SelectedPeriod = 0;
  }
}

on sysvar_update sysvar::IL_CAN1::NODES::N_BCM::MESSAGES::ENGINE_FD_3::TIMINGS::SetNewCycleContinously
{
  if (@this == 1 && @sysvar::IL_CAN1::NODES::N_BCM::MESSAGES::ENGINE_FD_3::TIMINGS::EnableCyclic)
  {
    @sysvar::IL_CAN1::NODES::N_BCM::MESSAGES::ENGINE_FD_3::TIMINGS::SelectedPeriod = -1;
  }
}

on sysvar_update sysvar::IL_CAN1::NODES::N_BCM::MESSAGES::ENGINE_FD_3::TIMINGS::SelectedPeriod
{
  if (@this == 0 && @sysvar::IL_CAN1::NODES::N_BCM::MESSAGES::ENGINE_FD_3::TIMINGS::EnableCyclic)
  {
    SetBusContext(gILCAN1_BusContext);
    gCAN1DisturbancePeriod = @sysvar::IL_CAN1::NODES::N_BCM::MESSAGES::ENGINE_FD_3::TIMINGS::NormalCyclePeriod;
    ILFaultInjectionResetMsgCycleTime(FDCAN2_1::BCM::ENGINE_FD_3);
  }
  else if (@this == 1 && @sysvar::IL_CAN1::NODES::N_BCM::MESSAGES::ENGINE_FD_3::TIMINGS::EnableCyclic)
  {
    SetBusContext(gILCAN1_BusContext);
    gCAN1DisturbancePeriod = @sysvar::IL_CAN1::NODES::N_BCM::MESSAGES::ENGINE_FD_3::TIMINGS::ActiveCyclePeriod;
    ILFaultInjectionSetMsgCycleTime(FDCAN2_1::BCM::ENGINE_FD_3, gCAN1DisturbancePeriod);
  }
  else if (@this == -1 && @sysvar::IL_CAN1::NODES::N_BCM::MESSAGES::ENGINE_FD_3::TIMINGS::EnableCyclic)
  {
    SetBusContext(gILCAN1_BusContext);
    gCAN1DisturbancePeriod = @sysvar::IL_CAN1::NODES::N_BCM::MESSAGES::ENGINE_FD_3::TIMINGS::CyclePeriod;
    ILFaultInjectionSetMsgCycleTime(FDCAN2_1::BCM::ENGINE_FD_3, gCAN1DisturbancePeriod);
  }
}

on sysvar_update sysvar::IL_CAN1::NODES::N_BCM::MESSAGES::ENGINE_FD_3::TIMINGS::SendOnce
{
  if (@this == 1)
  {
    SetBusContext(gILCAN1_BusContext);
    ILSetMsgEvent(FDCAN2_1::BCM::ENGINE_FD_3);
  }
}

on sysvar_update sysvar::IL_CAN1::NODES::N_BCM::MESSAGES::ENGINE_FD_5::TIMINGS::EnableCyclic
{
  if (@this == 1)
  {
    SetBusContext(gILCAN1_BusContext);
    ILFaultInjectionEnableMsg  (FDCAN2_1::BCM::ENGINE_FD_5);
  }
  else
  {
    SetBusContext(gILCAN1_BusContext);
    ILFaultInjectionDisableMsg (FDCAN2_1::BCM::ENGINE_FD_5);
  }
}

on sysvar_update sysvar::IL_CAN1::NODES::N_BCM::MESSAGES::ENGINE_FD_5::TIMINGS::SetNormalCycle
{
  if (@this == 1 && @sysvar::IL_CAN1::NODES::N_BCM::MESSAGES::ENGINE_FD_5::TIMINGS::EnableCyclic)
  {
    @sysvar::IL_CAN1::NODES::N_BCM::MESSAGES::ENGINE_FD_5::TIMINGS::SelectedPeriod = 0;
  }
}

on sysvar_update sysvar::IL_CAN1::NODES::N_BCM::MESSAGES::ENGINE_FD_5::TIMINGS::SetNewCycleContinously
{
  if (@this == 1 && @sysvar::IL_CAN1::NODES::N_BCM::MESSAGES::ENGINE_FD_5::TIMINGS::EnableCyclic)
  {
    @sysvar::IL_CAN1::NODES::N_BCM::MESSAGES::ENGINE_FD_5::TIMINGS::SelectedPeriod = -1;
  }
}

on sysvar_update sysvar::IL_CAN1::NODES::N_BCM::MESSAGES::ENGINE_FD_5::TIMINGS::SelectedPeriod
{
  if (@this == 0 && @sysvar::IL_CAN1::NODES::N_BCM::MESSAGES::ENGINE_FD_5::TIMINGS::EnableCyclic)
  {
    SetBusContext(gILCAN1_BusContext);
    gCAN1DisturbancePeriod = @sysvar::IL_CAN1::NODES::N_BCM::MESSAGES::ENGINE_FD_5::TIMINGS::NormalCyclePeriod;
    ILFaultInjectionResetMsgCycleTime(FDCAN2_1::BCM::ENGINE_FD_5);
  }
  else if (@this == 1 && @sysvar::IL_CAN1::NODES::N_BCM::MESSAGES::ENGINE_FD_5::TIMINGS::EnableCyclic)
  {
    SetBusContext(gILCAN1_BusContext);
    gCAN1DisturbancePeriod = @sysvar::IL_CAN1::NODES::N_BCM::MESSAGES::ENGINE_FD_5::TIMINGS::ActiveCyclePeriod;
    ILFaultInjectionSetMsgCycleTime(FDCAN2_1::BCM::ENGINE_FD_5, gCAN1DisturbancePeriod);
  }
  else if (@this == -1 && @sysvar::IL_CAN1::NODES::N_BCM::MESSAGES::ENGINE_FD_5::TIMINGS::EnableCyclic)
  {
    SetBusContext(gILCAN1_BusContext);
    gCAN1DisturbancePeriod = @sysvar::IL_CAN1::NODES::N_BCM::MESSAGES::ENGINE_FD_5::TIMINGS::CyclePeriod;
    ILFaultInjectionSetMsgCycleTime(FDCAN2_1::BCM::ENGINE_FD_5, gCAN1DisturbancePeriod);
  }
}

on sysvar_update sysvar::IL_CAN1::NODES::N_BCM::MESSAGES::ENGINE_FD_5::TIMINGS::SendOnce
{
  if (@this == 1)
  {
    SetBusContext(gILCAN1_BusContext);
    ILSetMsgEvent(FDCAN2_1::BCM::ENGINE_FD_5);
  }
}

on sysvar_update sysvar::IL_CAN1::NODES::N_BCM::MESSAGES::ENGINE_FD_6::TIMINGS::EnableCyclic
{
  if (@this == 1)
  {
    SetBusContext(gILCAN1_BusContext);
    ILFaultInjectionEnableMsg  (FDCAN2_1::BCM::ENGINE_FD_6);
  }
  else
  {
    SetBusContext(gILCAN1_BusContext);
    ILFaultInjectionDisableMsg (FDCAN2_1::BCM::ENGINE_FD_6);
  }
}

on sysvar_update sysvar::IL_CAN1::NODES::N_BCM::MESSAGES::ENGINE_FD_6::TIMINGS::SetNormalCycle
{
  if (@this == 1 && @sysvar::IL_CAN1::NODES::N_BCM::MESSAGES::ENGINE_FD_6::TIMINGS::EnableCyclic)
  {
    @sysvar::IL_CAN1::NODES::N_BCM::MESSAGES::ENGINE_FD_6::TIMINGS::SelectedPeriod = 0;
  }
}

on sysvar_update sysvar::IL_CAN1::NODES::N_BCM::MESSAGES::ENGINE_FD_6::TIMINGS::SetNewCycleContinously
{
  if (@this == 1 && @sysvar::IL_CAN1::NODES::N_BCM::MESSAGES::ENGINE_FD_6::TIMINGS::EnableCyclic)
  {
    @sysvar::IL_CAN1::NODES::N_BCM::MESSAGES::ENGINE_FD_6::TIMINGS::SelectedPeriod = -1;
  }
}

on sysvar_update sysvar::IL_CAN1::NODES::N_BCM::MESSAGES::ENGINE_FD_6::TIMINGS::SelectedPeriod
{
  if (@this == 0 && @sysvar::IL_CAN1::NODES::N_BCM::MESSAGES::ENGINE_FD_6::TIMINGS::EnableCyclic)
  {
    SetBusContext(gILCAN1_BusContext);
    gCAN1DisturbancePeriod = @sysvar::IL_CAN1::NODES::N_BCM::MESSAGES::ENGINE_FD_6::TIMINGS::NormalCyclePeriod;
    ILFaultInjectionResetMsgCycleTime(FDCAN2_1::BCM::ENGINE_FD_6);
  }
  else if (@this == 1 && @sysvar::IL_CAN1::NODES::N_BCM::MESSAGES::ENGINE_FD_6::TIMINGS::EnableCyclic)
  {
    SetBusContext(gILCAN1_BusContext);
    gCAN1DisturbancePeriod = @sysvar::IL_CAN1::NODES::N_BCM::MESSAGES::ENGINE_FD_6::TIMINGS::ActiveCyclePeriod;
    ILFaultInjectionSetMsgCycleTime(FDCAN2_1::BCM::ENGINE_FD_6, gCAN1DisturbancePeriod);
  }
  else if (@this == -1 && @sysvar::IL_CAN1::NODES::N_BCM::MESSAGES::ENGINE_FD_6::TIMINGS::EnableCyclic)
  {
    SetBusContext(gILCAN1_BusContext);
    gCAN1DisturbancePeriod = @sysvar::IL_CAN1::NODES::N_BCM::MESSAGES::ENGINE_FD_6::TIMINGS::CyclePeriod;
    ILFaultInjectionSetMsgCycleTime(FDCAN2_1::BCM::ENGINE_FD_6, gCAN1DisturbancePeriod);
  }
}

on sysvar_update sysvar::IL_CAN1::NODES::N_BCM::MESSAGES::ENGINE_FD_6::TIMINGS::SendOnce
{
  if (@this == 1)
  {
    SetBusContext(gILCAN1_BusContext);
    ILSetMsgEvent(FDCAN2_1::BCM::ENGINE_FD_6);
  }
}

on sysvar_update sysvar::IL_CAN1::NODES::N_BCM::MESSAGES::ENGINE_FD_7::TIMINGS::EnableCyclic
{
  if (@this == 1)
  {
    SetBusContext(gILCAN1_BusContext);
    ILFaultInjectionEnableMsg  (FDCAN2_1::BCM::ENGINE_FD_7);
  }
  else
  {
    SetBusContext(gILCAN1_BusContext);
    ILFaultInjectionDisableMsg (FDCAN2_1::BCM::ENGINE_FD_7);
  }
}

on sysvar_update sysvar::IL_CAN1::NODES::N_BCM::MESSAGES::ENGINE_FD_7::TIMINGS::SetNormalCycle
{
  if (@this == 1 && @sysvar::IL_CAN1::NODES::N_BCM::MESSAGES::ENGINE_FD_7::TIMINGS::EnableCyclic)
  {
    @sysvar::IL_CAN1::NODES::N_BCM::MESSAGES::ENGINE_FD_7::TIMINGS::SelectedPeriod = 0;
  }
}

on sysvar_update sysvar::IL_CAN1::NODES::N_BCM::MESSAGES::ENGINE_FD_7::TIMINGS::SetNewCycleContinously
{
  if (@this == 1 && @sysvar::IL_CAN1::NODES::N_BCM::MESSAGES::ENGINE_FD_7::TIMINGS::EnableCyclic)
  {
    @sysvar::IL_CAN1::NODES::N_BCM::MESSAGES::ENGINE_FD_7::TIMINGS::SelectedPeriod = -1;
  }
}

on sysvar_update sysvar::IL_CAN1::NODES::N_BCM::MESSAGES::ENGINE_FD_7::TIMINGS::SelectedPeriod
{
  if (@this == 0 && @sysvar::IL_CAN1::NODES::N_BCM::MESSAGES::ENGINE_FD_7::TIMINGS::EnableCyclic)
  {
    SetBusContext(gILCAN1_BusContext);
    gCAN1DisturbancePeriod = @sysvar::IL_CAN1::NODES::N_BCM::MESSAGES::ENGINE_FD_7::TIMINGS::NormalCyclePeriod;
    ILFaultInjectionResetMsgCycleTime(FDCAN2_1::BCM::ENGINE_FD_7);
  }
  else if (@this == 1 && @sysvar::IL_CAN1::NODES::N_BCM::MESSAGES::ENGINE_FD_7::TIMINGS::EnableCyclic)
  {
    SetBusContext(gILCAN1_BusContext);
    gCAN1DisturbancePeriod = @sysvar::IL_CAN1::NODES::N_BCM::MESSAGES::ENGINE_FD_7::TIMINGS::ActiveCyclePeriod;
    ILFaultInjectionSetMsgCycleTime(FDCAN2_1::BCM::ENGINE_FD_7, gCAN1DisturbancePeriod);
  }
  else if (@this == -1 && @sysvar::IL_CAN1::NODES::N_BCM::MESSAGES::ENGINE_FD_7::TIMINGS::EnableCyclic)
  {
    SetBusContext(gILCAN1_BusContext);
    gCAN1DisturbancePeriod = @sysvar::IL_CAN1::NODES::N_BCM::MESSAGES::ENGINE_FD_7::TIMINGS::CyclePeriod;
    ILFaultInjectionSetMsgCycleTime(FDCAN2_1::BCM::ENGINE_FD_7, gCAN1DisturbancePeriod);
  }
}

on sysvar_update sysvar::IL_CAN1::NODES::N_BCM::MESSAGES::ENGINE_FD_7::TIMINGS::SendOnce
{
  if (@this == 1)
  {
    SetBusContext(gILCAN1_BusContext);
    ILSetMsgEvent(FDCAN2_1::BCM::ENGINE_FD_7);
  }
}

on sysvar_update sysvar::IL_CAN1::NODES::N_BCM::MESSAGES::ENGINE_FD_8::TIMINGS::EnableCyclic
{
  if (@this == 1)
  {
    SetBusContext(gILCAN1_BusContext);
    ILFaultInjectionEnableMsg  (FDCAN2_1::BCM::ENGINE_FD_8);
  }
  else
  {
    SetBusContext(gILCAN1_BusContext);
    ILFaultInjectionDisableMsg (FDCAN2_1::BCM::ENGINE_FD_8);
  }
}

on sysvar_update sysvar::IL_CAN1::NODES::N_BCM::MESSAGES::ENGINE_FD_8::TIMINGS::SetNormalCycle
{
  if (@this == 1 && @sysvar::IL_CAN1::NODES::N_BCM::MESSAGES::ENGINE_FD_8::TIMINGS::EnableCyclic)
  {
    @sysvar::IL_CAN1::NODES::N_BCM::MESSAGES::ENGINE_FD_8::TIMINGS::SelectedPeriod = 0;
  }
}

on sysvar_update sysvar::IL_CAN1::NODES::N_BCM::MESSAGES::ENGINE_FD_8::TIMINGS::SetNewCycleContinously
{
  if (@this == 1 && @sysvar::IL_CAN1::NODES::N_BCM::MESSAGES::ENGINE_FD_8::TIMINGS::EnableCyclic)
  {
    @sysvar::IL_CAN1::NODES::N_BCM::MESSAGES::ENGINE_FD_8::TIMINGS::SelectedPeriod = -1;
  }
}

on sysvar_update sysvar::IL_CAN1::NODES::N_BCM::MESSAGES::ENGINE_FD_8::TIMINGS::SelectedPeriod
{
  if (@this == 0 && @sysvar::IL_CAN1::NODES::N_BCM::MESSAGES::ENGINE_FD_8::TIMINGS::EnableCyclic)
  {
    SetBusContext(gILCAN1_BusContext);
    gCAN1DisturbancePeriod = @sysvar::IL_CAN1::NODES::N_BCM::MESSAGES::ENGINE_FD_8::TIMINGS::NormalCyclePeriod;
    ILFaultInjectionResetMsgCycleTime(FDCAN2_1::BCM::ENGINE_FD_8);
  }
  else if (@this == 1 && @sysvar::IL_CAN1::NODES::N_BCM::MESSAGES::ENGINE_FD_8::TIMINGS::EnableCyclic)
  {
    SetBusContext(gILCAN1_BusContext);
    gCAN1DisturbancePeriod = @sysvar::IL_CAN1::NODES::N_BCM::MESSAGES::ENGINE_FD_8::TIMINGS::ActiveCyclePeriod;
    ILFaultInjectionSetMsgCycleTime(FDCAN2_1::BCM::ENGINE_FD_8, gCAN1DisturbancePeriod);
  }
  else if (@this == -1 && @sysvar::IL_CAN1::NODES::N_BCM::MESSAGES::ENGINE_FD_8::TIMINGS::EnableCyclic)
  {
    SetBusContext(gILCAN1_BusContext);
    gCAN1DisturbancePeriod = @sysvar::IL_CAN1::NODES::N_BCM::MESSAGES::ENGINE_FD_8::TIMINGS::CyclePeriod;
    ILFaultInjectionSetMsgCycleTime(FDCAN2_1::BCM::ENGINE_FD_8, gCAN1DisturbancePeriod);
  }
}

on sysvar_update sysvar::IL_CAN1::NODES::N_BCM::MESSAGES::ENGINE_FD_8::TIMINGS::SendOnce
{
  if (@this == 1)
  {
    SetBusContext(gILCAN1_BusContext);
    ILSetMsgEvent(FDCAN2_1::BCM::ENGINE_FD_8);
  }
}

on sysvar_update sysvar::IL_CAN1::NODES::N_BCM::MESSAGES::GLOB_NAV_FD::TIMINGS::EnableCyclic
{
  if (@this == 1)
  {
    SetBusContext(gILCAN1_BusContext);
    ILFaultInjectionEnableMsg  (FDCAN2_1::BCM::GLOB_NAV_FD);
  }
  else
  {
    SetBusContext(gILCAN1_BusContext);
    ILFaultInjectionDisableMsg (FDCAN2_1::BCM::GLOB_NAV_FD);
  }
}

on sysvar_update sysvar::IL_CAN1::NODES::N_BCM::MESSAGES::GLOB_NAV_FD::TIMINGS::SetNormalCycle
{
  if (@this == 1 && @sysvar::IL_CAN1::NODES::N_BCM::MESSAGES::GLOB_NAV_FD::TIMINGS::EnableCyclic)
  {
    @sysvar::IL_CAN1::NODES::N_BCM::MESSAGES::GLOB_NAV_FD::TIMINGS::SelectedPeriod = 0;
  }
}

on sysvar_update sysvar::IL_CAN1::NODES::N_BCM::MESSAGES::GLOB_NAV_FD::TIMINGS::SetNewCycleContinously
{
  if (@this == 1 && @sysvar::IL_CAN1::NODES::N_BCM::MESSAGES::GLOB_NAV_FD::TIMINGS::EnableCyclic)
  {
    @sysvar::IL_CAN1::NODES::N_BCM::MESSAGES::GLOB_NAV_FD::TIMINGS::SelectedPeriod = -1;
  }
}

on sysvar_update sysvar::IL_CAN1::NODES::N_BCM::MESSAGES::GLOB_NAV_FD::TIMINGS::SelectedPeriod
{
  if (@this == 0 && @sysvar::IL_CAN1::NODES::N_BCM::MESSAGES::GLOB_NAV_FD::TIMINGS::EnableCyclic)
  {
    SetBusContext(gILCAN1_BusContext);
    gCAN1DisturbancePeriod = @sysvar::IL_CAN1::NODES::N_BCM::MESSAGES::GLOB_NAV_FD::TIMINGS::NormalCyclePeriod;
    ILFaultInjectionResetMsgCycleTime(FDCAN2_1::BCM::GLOB_NAV_FD);
  }
  else if (@this == 1 && @sysvar::IL_CAN1::NODES::N_BCM::MESSAGES::GLOB_NAV_FD::TIMINGS::EnableCyclic)
  {
    SetBusContext(gILCAN1_BusContext);
    gCAN1DisturbancePeriod = @sysvar::IL_CAN1::NODES::N_BCM::MESSAGES::GLOB_NAV_FD::TIMINGS::ActiveCyclePeriod;
    ILFaultInjectionSetMsgCycleTime(FDCAN2_1::BCM::GLOB_NAV_FD, gCAN1DisturbancePeriod);
  }
  else if (@this == -1 && @sysvar::IL_CAN1::NODES::N_BCM::MESSAGES::GLOB_NAV_FD::TIMINGS::EnableCyclic)
  {
    SetBusContext(gILCAN1_BusContext);
    gCAN1DisturbancePeriod = @sysvar::IL_CAN1::NODES::N_BCM::MESSAGES::GLOB_NAV_FD::TIMINGS::CyclePeriod;
    ILFaultInjectionSetMsgCycleTime(FDCAN2_1::BCM::GLOB_NAV_FD, gCAN1DisturbancePeriod);
  }
}

on sysvar_update sysvar::IL_CAN1::NODES::N_BCM::MESSAGES::GLOB_NAV_FD::TIMINGS::SendOnce
{
  if (@this == 1)
  {
    SetBusContext(gILCAN1_BusContext);
    ILSetMsgEvent(FDCAN2_1::BCM::GLOB_NAV_FD);
  }
}

on sysvar_update sysvar::IL_CAN1::NODES::N_BCM::MESSAGES::HVBATTERY1::TIMINGS::EnableCyclic
{
  if (@this == 1)
  {
    SetBusContext(gILCAN1_BusContext);
    ILFaultInjectionEnableMsg  (FDCAN2_1::BCM::HVBATTERY1);
  }
  else
  {
    SetBusContext(gILCAN1_BusContext);
    ILFaultInjectionDisableMsg (FDCAN2_1::BCM::HVBATTERY1);
  }
}

on sysvar_update sysvar::IL_CAN1::NODES::N_BCM::MESSAGES::HVBATTERY1::TIMINGS::SetNormalCycle
{
  if (@this == 1 && @sysvar::IL_CAN1::NODES::N_BCM::MESSAGES::HVBATTERY1::TIMINGS::EnableCyclic)
  {
    @sysvar::IL_CAN1::NODES::N_BCM::MESSAGES::HVBATTERY1::TIMINGS::SelectedPeriod = 0;
  }
}

on sysvar_update sysvar::IL_CAN1::NODES::N_BCM::MESSAGES::HVBATTERY1::TIMINGS::SetNewCycleContinously
{
  if (@this == 1 && @sysvar::IL_CAN1::NODES::N_BCM::MESSAGES::HVBATTERY1::TIMINGS::EnableCyclic)
  {
    @sysvar::IL_CAN1::NODES::N_BCM::MESSAGES::HVBATTERY1::TIMINGS::SelectedPeriod = -1;
  }
}

on sysvar_update sysvar::IL_CAN1::NODES::N_BCM::MESSAGES::HVBATTERY1::TIMINGS::SelectedPeriod
{
  if (@this == 0 && @sysvar::IL_CAN1::NODES::N_BCM::MESSAGES::HVBATTERY1::TIMINGS::EnableCyclic)
  {
    SetBusContext(gILCAN1_BusContext);
    gCAN1DisturbancePeriod = @sysvar::IL_CAN1::NODES::N_BCM::MESSAGES::HVBATTERY1::TIMINGS::NormalCyclePeriod;
    ILFaultInjectionResetMsgCycleTime(FDCAN2_1::BCM::HVBATTERY1);
  }
  else if (@this == 1 && @sysvar::IL_CAN1::NODES::N_BCM::MESSAGES::HVBATTERY1::TIMINGS::EnableCyclic)
  {
    SetBusContext(gILCAN1_BusContext);
    gCAN1DisturbancePeriod = @sysvar::IL_CAN1::NODES::N_BCM::MESSAGES::HVBATTERY1::TIMINGS::ActiveCyclePeriod;
    ILFaultInjectionSetMsgCycleTime(FDCAN2_1::BCM::HVBATTERY1, gCAN1DisturbancePeriod);
  }
  else if (@this == -1 && @sysvar::IL_CAN1::NODES::N_BCM::MESSAGES::HVBATTERY1::TIMINGS::EnableCyclic)
  {
    SetBusContext(gILCAN1_BusContext);
    gCAN1DisturbancePeriod = @sysvar::IL_CAN1::NODES::N_BCM::MESSAGES::HVBATTERY1::TIMINGS::CyclePeriod;
    ILFaultInjectionSetMsgCycleTime(FDCAN2_1::BCM::HVBATTERY1, gCAN1DisturbancePeriod);
  }
}

on sysvar_update sysvar::IL_CAN1::NODES::N_BCM::MESSAGES::HVBATTERY1::TIMINGS::SendOnce
{
  if (@this == 1)
  {
    SetBusContext(gILCAN1_BusContext);
    ILSetMsgEvent(FDCAN2_1::BCM::HVBATTERY1);
  }
}

on sysvar_update sysvar::IL_CAN1::NODES::N_BCM::MESSAGES::HYBRID_DISPLAY::TIMINGS::EnableCyclic
{
  if (@this == 1)
  {
    SetBusContext(gILCAN1_BusContext);
    ILFaultInjectionEnableMsg  (FDCAN2_1::BCM::HYBRID_DISPLAY);
  }
  else
  {
    SetBusContext(gILCAN1_BusContext);
    ILFaultInjectionDisableMsg (FDCAN2_1::BCM::HYBRID_DISPLAY);
  }
}

on sysvar_update sysvar::IL_CAN1::NODES::N_BCM::MESSAGES::HYBRID_DISPLAY::TIMINGS::SetNormalCycle
{
  if (@this == 1 && @sysvar::IL_CAN1::NODES::N_BCM::MESSAGES::HYBRID_DISPLAY::TIMINGS::EnableCyclic)
  {
    @sysvar::IL_CAN1::NODES::N_BCM::MESSAGES::HYBRID_DISPLAY::TIMINGS::SelectedPeriod = 0;
  }
}

on sysvar_update sysvar::IL_CAN1::NODES::N_BCM::MESSAGES::HYBRID_DISPLAY::TIMINGS::SetNewCycleContinously
{
  if (@this == 1 && @sysvar::IL_CAN1::NODES::N_BCM::MESSAGES::HYBRID_DISPLAY::TIMINGS::EnableCyclic)
  {
    @sysvar::IL_CAN1::NODES::N_BCM::MESSAGES::HYBRID_DISPLAY::TIMINGS::SelectedPeriod = -1;
  }
}

on sysvar_update sysvar::IL_CAN1::NODES::N_BCM::MESSAGES::HYBRID_DISPLAY::TIMINGS::SelectedPeriod
{
  if (@this == 0 && @sysvar::IL_CAN1::NODES::N_BCM::MESSAGES::HYBRID_DISPLAY::TIMINGS::EnableCyclic)
  {
    SetBusContext(gILCAN1_BusContext);
    gCAN1DisturbancePeriod = @sysvar::IL_CAN1::NODES::N_BCM::MESSAGES::HYBRID_DISPLAY::TIMINGS::NormalCyclePeriod;
    ILFaultInjectionResetMsgCycleTime(FDCAN2_1::BCM::HYBRID_DISPLAY);
  }
  else if (@this == 1 && @sysvar::IL_CAN1::NODES::N_BCM::MESSAGES::HYBRID_DISPLAY::TIMINGS::EnableCyclic)
  {
    SetBusContext(gILCAN1_BusContext);
    gCAN1DisturbancePeriod = @sysvar::IL_CAN1::NODES::N_BCM::MESSAGES::HYBRID_DISPLAY::TIMINGS::ActiveCyclePeriod;
    ILFaultInjectionSetMsgCycleTime(FDCAN2_1::BCM::HYBRID_DISPLAY, gCAN1DisturbancePeriod);
  }
  else if (@this == -1 && @sysvar::IL_CAN1::NODES::N_BCM::MESSAGES::HYBRID_DISPLAY::TIMINGS::EnableCyclic)
  {
    SetBusContext(gILCAN1_BusContext);
    gCAN1DisturbancePeriod = @sysvar::IL_CAN1::NODES::N_BCM::MESSAGES::HYBRID_DISPLAY::TIMINGS::CyclePeriod;
    ILFaultInjectionSetMsgCycleTime(FDCAN2_1::BCM::HYBRID_DISPLAY, gCAN1DisturbancePeriod);
  }
}

on sysvar_update sysvar::IL_CAN1::NODES::N_BCM::MESSAGES::HYBRID_DISPLAY::TIMINGS::SendOnce
{
  if (@this == 1)
  {
    SetBusContext(gILCAN1_BusContext);
    ILSetMsgEvent(FDCAN2_1::BCM::HYBRID_DISPLAY);
  }
}

on sysvar_update sysvar::IL_CAN1::NODES::N_BCM::MESSAGES::HYBRID_POWERTRAIN1::TIMINGS::EnableCyclic
{
  if (@this == 1)
  {
    SetBusContext(gILCAN1_BusContext);
    ILFaultInjectionEnableMsg  (FDCAN2_1::BCM::HYBRID_POWERTRAIN1);
  }
  else
  {
    SetBusContext(gILCAN1_BusContext);
    ILFaultInjectionDisableMsg (FDCAN2_1::BCM::HYBRID_POWERTRAIN1);
  }
}

on sysvar_update sysvar::IL_CAN1::NODES::N_BCM::MESSAGES::HYBRID_POWERTRAIN1::TIMINGS::SetNormalCycle
{
  if (@this == 1 && @sysvar::IL_CAN1::NODES::N_BCM::MESSAGES::HYBRID_POWERTRAIN1::TIMINGS::EnableCyclic)
  {
    @sysvar::IL_CAN1::NODES::N_BCM::MESSAGES::HYBRID_POWERTRAIN1::TIMINGS::SelectedPeriod = 0;
  }
}

on sysvar_update sysvar::IL_CAN1::NODES::N_BCM::MESSAGES::HYBRID_POWERTRAIN1::TIMINGS::SetNewCycleContinously
{
  if (@this == 1 && @sysvar::IL_CAN1::NODES::N_BCM::MESSAGES::HYBRID_POWERTRAIN1::TIMINGS::EnableCyclic)
  {
    @sysvar::IL_CAN1::NODES::N_BCM::MESSAGES::HYBRID_POWERTRAIN1::TIMINGS::SelectedPeriod = -1;
  }
}

on sysvar_update sysvar::IL_CAN1::NODES::N_BCM::MESSAGES::HYBRID_POWERTRAIN1::TIMINGS::SelectedPeriod
{
  if (@this == 0 && @sysvar::IL_CAN1::NODES::N_BCM::MESSAGES::HYBRID_POWERTRAIN1::TIMINGS::EnableCyclic)
  {
    SetBusContext(gILCAN1_BusContext);
    gCAN1DisturbancePeriod = @sysvar::IL_CAN1::NODES::N_BCM::MESSAGES::HYBRID_POWERTRAIN1::TIMINGS::NormalCyclePeriod;
    ILFaultInjectionResetMsgCycleTime(FDCAN2_1::BCM::HYBRID_POWERTRAIN1);
  }
  else if (@this == 1 && @sysvar::IL_CAN1::NODES::N_BCM::MESSAGES::HYBRID_POWERTRAIN1::TIMINGS::EnableCyclic)
  {
    SetBusContext(gILCAN1_BusContext);
    gCAN1DisturbancePeriod = @sysvar::IL_CAN1::NODES::N_BCM::MESSAGES::HYBRID_POWERTRAIN1::TIMINGS::ActiveCyclePeriod;
    ILFaultInjectionSetMsgCycleTime(FDCAN2_1::BCM::HYBRID_POWERTRAIN1, gCAN1DisturbancePeriod);
  }
  else if (@this == -1 && @sysvar::IL_CAN1::NODES::N_BCM::MESSAGES::HYBRID_POWERTRAIN1::TIMINGS::EnableCyclic)
  {
    SetBusContext(gILCAN1_BusContext);
    gCAN1DisturbancePeriod = @sysvar::IL_CAN1::NODES::N_BCM::MESSAGES::HYBRID_POWERTRAIN1::TIMINGS::CyclePeriod;
    ILFaultInjectionSetMsgCycleTime(FDCAN2_1::BCM::HYBRID_POWERTRAIN1, gCAN1DisturbancePeriod);
  }
}

on sysvar_update sysvar::IL_CAN1::NODES::N_BCM::MESSAGES::HYBRID_POWERTRAIN1::TIMINGS::SendOnce
{
  if (@this == 1)
  {
    SetBusContext(gILCAN1_BusContext);
    ILSetMsgEvent(FDCAN2_1::BCM::HYBRID_POWERTRAIN1);
  }
}

on sysvar_update sysvar::IL_CAN1::NODES::N_BCM::MESSAGES::HYBRID_POWERTRAIN2::TIMINGS::EnableCyclic
{
  if (@this == 1)
  {
    SetBusContext(gILCAN1_BusContext);
    ILFaultInjectionEnableMsg  (FDCAN2_1::BCM::HYBRID_POWERTRAIN2);
  }
  else
  {
    SetBusContext(gILCAN1_BusContext);
    ILFaultInjectionDisableMsg (FDCAN2_1::BCM::HYBRID_POWERTRAIN2);
  }
}

on sysvar_update sysvar::IL_CAN1::NODES::N_BCM::MESSAGES::HYBRID_POWERTRAIN2::TIMINGS::SetNormalCycle
{
  if (@this == 1 && @sysvar::IL_CAN1::NODES::N_BCM::MESSAGES::HYBRID_POWERTRAIN2::TIMINGS::EnableCyclic)
  {
    @sysvar::IL_CAN1::NODES::N_BCM::MESSAGES::HYBRID_POWERTRAIN2::TIMINGS::SelectedPeriod = 0;
  }
}

on sysvar_update sysvar::IL_CAN1::NODES::N_BCM::MESSAGES::HYBRID_POWERTRAIN2::TIMINGS::SetNewCycleContinously
{
  if (@this == 1 && @sysvar::IL_CAN1::NODES::N_BCM::MESSAGES::HYBRID_POWERTRAIN2::TIMINGS::EnableCyclic)
  {
    @sysvar::IL_CAN1::NODES::N_BCM::MESSAGES::HYBRID_POWERTRAIN2::TIMINGS::SelectedPeriod = -1;
  }
}

on sysvar_update sysvar::IL_CAN1::NODES::N_BCM::MESSAGES::HYBRID_POWERTRAIN2::TIMINGS::SelectedPeriod
{
  if (@this == 0 && @sysvar::IL_CAN1::NODES::N_BCM::MESSAGES::HYBRID_POWERTRAIN2::TIMINGS::EnableCyclic)
  {
    SetBusContext(gILCAN1_BusContext);
    gCAN1DisturbancePeriod = @sysvar::IL_CAN1::NODES::N_BCM::MESSAGES::HYBRID_POWERTRAIN2::TIMINGS::NormalCyclePeriod;
    ILFaultInjectionResetMsgCycleTime(FDCAN2_1::BCM::HYBRID_POWERTRAIN2);
  }
  else if (@this == 1 && @sysvar::IL_CAN1::NODES::N_BCM::MESSAGES::HYBRID_POWERTRAIN2::TIMINGS::EnableCyclic)
  {
    SetBusContext(gILCAN1_BusContext);
    gCAN1DisturbancePeriod = @sysvar::IL_CAN1::NODES::N_BCM::MESSAGES::HYBRID_POWERTRAIN2::TIMINGS::ActiveCyclePeriod;
    ILFaultInjectionSetMsgCycleTime(FDCAN2_1::BCM::HYBRID_POWERTRAIN2, gCAN1DisturbancePeriod);
  }
  else if (@this == -1 && @sysvar::IL_CAN1::NODES::N_BCM::MESSAGES::HYBRID_POWERTRAIN2::TIMINGS::EnableCyclic)
  {
    SetBusContext(gILCAN1_BusContext);
    gCAN1DisturbancePeriod = @sysvar::IL_CAN1::NODES::N_BCM::MESSAGES::HYBRID_POWERTRAIN2::TIMINGS::CyclePeriod;
    ILFaultInjectionSetMsgCycleTime(FDCAN2_1::BCM::HYBRID_POWERTRAIN2, gCAN1DisturbancePeriod);
  }
}

on sysvar_update sysvar::IL_CAN1::NODES::N_BCM::MESSAGES::HYBRID_POWERTRAIN2::TIMINGS::SendOnce
{
  if (@this == 1)
  {
    SetBusContext(gILCAN1_BusContext);
    ILSetMsgEvent(FDCAN2_1::BCM::HYBRID_POWERTRAIN2);
  }
}

on sysvar_update sysvar::IL_CAN1::NODES::N_BCM::MESSAGES::IBS3_DATA_1::TIMINGS::EnableCyclic
{
  if (@this == 1)
  {
    SetBusContext(gILCAN1_BusContext);
    ILFaultInjectionEnableMsg  (FDCAN2_1::BCM::IBS3_DATA_1);
  }
  else
  {
    SetBusContext(gILCAN1_BusContext);
    ILFaultInjectionDisableMsg (FDCAN2_1::BCM::IBS3_DATA_1);
  }
}

on sysvar_update sysvar::IL_CAN1::NODES::N_BCM::MESSAGES::IBS3_DATA_1::TIMINGS::SetNormalCycle
{
  if (@this == 1 && @sysvar::IL_CAN1::NODES::N_BCM::MESSAGES::IBS3_DATA_1::TIMINGS::EnableCyclic)
  {
    @sysvar::IL_CAN1::NODES::N_BCM::MESSAGES::IBS3_DATA_1::TIMINGS::SelectedPeriod = 0;
  }
}

on sysvar_update sysvar::IL_CAN1::NODES::N_BCM::MESSAGES::IBS3_DATA_1::TIMINGS::SetNewCycleContinously
{
  if (@this == 1 && @sysvar::IL_CAN1::NODES::N_BCM::MESSAGES::IBS3_DATA_1::TIMINGS::EnableCyclic)
  {
    @sysvar::IL_CAN1::NODES::N_BCM::MESSAGES::IBS3_DATA_1::TIMINGS::SelectedPeriod = -1;
  }
}

on sysvar_update sysvar::IL_CAN1::NODES::N_BCM::MESSAGES::IBS3_DATA_1::TIMINGS::SelectedPeriod
{
  if (@this == 0 && @sysvar::IL_CAN1::NODES::N_BCM::MESSAGES::IBS3_DATA_1::TIMINGS::EnableCyclic)
  {
    SetBusContext(gILCAN1_BusContext);
    gCAN1DisturbancePeriod = @sysvar::IL_CAN1::NODES::N_BCM::MESSAGES::IBS3_DATA_1::TIMINGS::NormalCyclePeriod;
    ILFaultInjectionResetMsgCycleTime(FDCAN2_1::BCM::IBS3_DATA_1);
  }
  else if (@this == 1 && @sysvar::IL_CAN1::NODES::N_BCM::MESSAGES::IBS3_DATA_1::TIMINGS::EnableCyclic)
  {
    SetBusContext(gILCAN1_BusContext);
    gCAN1DisturbancePeriod = @sysvar::IL_CAN1::NODES::N_BCM::MESSAGES::IBS3_DATA_1::TIMINGS::ActiveCyclePeriod;
    ILFaultInjectionSetMsgCycleTime(FDCAN2_1::BCM::IBS3_DATA_1, gCAN1DisturbancePeriod);
  }
  else if (@this == -1 && @sysvar::IL_CAN1::NODES::N_BCM::MESSAGES::IBS3_DATA_1::TIMINGS::EnableCyclic)
  {
    SetBusContext(gILCAN1_BusContext);
    gCAN1DisturbancePeriod = @sysvar::IL_CAN1::NODES::N_BCM::MESSAGES::IBS3_DATA_1::TIMINGS::CyclePeriod;
    ILFaultInjectionSetMsgCycleTime(FDCAN2_1::BCM::IBS3_DATA_1, gCAN1DisturbancePeriod);
  }
}

on sysvar_update sysvar::IL_CAN1::NODES::N_BCM::MESSAGES::IBS3_DATA_1::TIMINGS::SendOnce
{
  if (@this == 1)
  {
    SetBusContext(gILCAN1_BusContext);
    ILSetMsgEvent(FDCAN2_1::BCM::IBS3_DATA_1);
  }
}

on sysvar_update sysvar::IL_CAN1::NODES::N_BCM::MESSAGES::IBS3_DATA_1_2::TIMINGS::EnableCyclic
{
  if (@this == 1)
  {
    SetBusContext(gILCAN1_BusContext);
    ILFaultInjectionEnableMsg  (FDCAN2_1::BCM::IBS3_DATA_1_2);
  }
  else
  {
    SetBusContext(gILCAN1_BusContext);
    ILFaultInjectionDisableMsg (FDCAN2_1::BCM::IBS3_DATA_1_2);
  }
}

on sysvar_update sysvar::IL_CAN1::NODES::N_BCM::MESSAGES::IBS3_DATA_1_2::TIMINGS::SetNormalCycle
{
  if (@this == 1 && @sysvar::IL_CAN1::NODES::N_BCM::MESSAGES::IBS3_DATA_1_2::TIMINGS::EnableCyclic)
  {
    @sysvar::IL_CAN1::NODES::N_BCM::MESSAGES::IBS3_DATA_1_2::TIMINGS::SelectedPeriod = 0;
  }
}

on sysvar_update sysvar::IL_CAN1::NODES::N_BCM::MESSAGES::IBS3_DATA_1_2::TIMINGS::SetNewCycleContinously
{
  if (@this == 1 && @sysvar::IL_CAN1::NODES::N_BCM::MESSAGES::IBS3_DATA_1_2::TIMINGS::EnableCyclic)
  {
    @sysvar::IL_CAN1::NODES::N_BCM::MESSAGES::IBS3_DATA_1_2::TIMINGS::SelectedPeriod = -1;
  }
}

on sysvar_update sysvar::IL_CAN1::NODES::N_BCM::MESSAGES::IBS3_DATA_1_2::TIMINGS::SelectedPeriod
{
  if (@this == 0 && @sysvar::IL_CAN1::NODES::N_BCM::MESSAGES::IBS3_DATA_1_2::TIMINGS::EnableCyclic)
  {
    SetBusContext(gILCAN1_BusContext);
    gCAN1DisturbancePeriod = @sysvar::IL_CAN1::NODES::N_BCM::MESSAGES::IBS3_DATA_1_2::TIMINGS::NormalCyclePeriod;
    ILFaultInjectionResetMsgCycleTime(FDCAN2_1::BCM::IBS3_DATA_1_2);
  }
  else if (@this == 1 && @sysvar::IL_CAN1::NODES::N_BCM::MESSAGES::IBS3_DATA_1_2::TIMINGS::EnableCyclic)
  {
    SetBusContext(gILCAN1_BusContext);
    gCAN1DisturbancePeriod = @sysvar::IL_CAN1::NODES::N_BCM::MESSAGES::IBS3_DATA_1_2::TIMINGS::ActiveCyclePeriod;
    ILFaultInjectionSetMsgCycleTime(FDCAN2_1::BCM::IBS3_DATA_1_2, gCAN1DisturbancePeriod);
  }
  else if (@this == -1 && @sysvar::IL_CAN1::NODES::N_BCM::MESSAGES::IBS3_DATA_1_2::TIMINGS::EnableCyclic)
  {
    SetBusContext(gILCAN1_BusContext);
    gCAN1DisturbancePeriod = @sysvar::IL_CAN1::NODES::N_BCM::MESSAGES::IBS3_DATA_1_2::TIMINGS::CyclePeriod;
    ILFaultInjectionSetMsgCycleTime(FDCAN2_1::BCM::IBS3_DATA_1_2, gCAN1DisturbancePeriod);
  }
}

on sysvar_update sysvar::IL_CAN1::NODES::N_BCM::MESSAGES::IBS3_DATA_1_2::TIMINGS::SendOnce
{
  if (@this == 1)
  {
    SetBusContext(gILCAN1_BusContext);
    ILSetMsgEvent(FDCAN2_1::BCM::IBS3_DATA_1_2);
  }
}

on sysvar_update sysvar::IL_CAN1::NODES::N_BCM::MESSAGES::IBS3_DATA_2::TIMINGS::EnableCyclic
{
  if (@this == 1)
  {
    SetBusContext(gILCAN1_BusContext);
    ILFaultInjectionEnableMsg  (FDCAN2_1::BCM::IBS3_DATA_2);
  }
  else
  {
    SetBusContext(gILCAN1_BusContext);
    ILFaultInjectionDisableMsg (FDCAN2_1::BCM::IBS3_DATA_2);
  }
}

on sysvar_update sysvar::IL_CAN1::NODES::N_BCM::MESSAGES::IBS3_DATA_2::TIMINGS::SetNormalCycle
{
  if (@this == 1 && @sysvar::IL_CAN1::NODES::N_BCM::MESSAGES::IBS3_DATA_2::TIMINGS::EnableCyclic)
  {
    @sysvar::IL_CAN1::NODES::N_BCM::MESSAGES::IBS3_DATA_2::TIMINGS::SelectedPeriod = 0;
  }
}

on sysvar_update sysvar::IL_CAN1::NODES::N_BCM::MESSAGES::IBS3_DATA_2::TIMINGS::SetNewCycleContinously
{
  if (@this == 1 && @sysvar::IL_CAN1::NODES::N_BCM::MESSAGES::IBS3_DATA_2::TIMINGS::EnableCyclic)
  {
    @sysvar::IL_CAN1::NODES::N_BCM::MESSAGES::IBS3_DATA_2::TIMINGS::SelectedPeriod = -1;
  }
}

on sysvar_update sysvar::IL_CAN1::NODES::N_BCM::MESSAGES::IBS3_DATA_2::TIMINGS::SelectedPeriod
{
  if (@this == 0 && @sysvar::IL_CAN1::NODES::N_BCM::MESSAGES::IBS3_DATA_2::TIMINGS::EnableCyclic)
  {
    SetBusContext(gILCAN1_BusContext);
    gCAN1DisturbancePeriod = @sysvar::IL_CAN1::NODES::N_BCM::MESSAGES::IBS3_DATA_2::TIMINGS::NormalCyclePeriod;
    ILFaultInjectionResetMsgCycleTime(FDCAN2_1::BCM::IBS3_DATA_2);
  }
  else if (@this == 1 && @sysvar::IL_CAN1::NODES::N_BCM::MESSAGES::IBS3_DATA_2::TIMINGS::EnableCyclic)
  {
    SetBusContext(gILCAN1_BusContext);
    gCAN1DisturbancePeriod = @sysvar::IL_CAN1::NODES::N_BCM::MESSAGES::IBS3_DATA_2::TIMINGS::ActiveCyclePeriod;
    ILFaultInjectionSetMsgCycleTime(FDCAN2_1::BCM::IBS3_DATA_2, gCAN1DisturbancePeriod);
  }
  else if (@this == -1 && @sysvar::IL_CAN1::NODES::N_BCM::MESSAGES::IBS3_DATA_2::TIMINGS::EnableCyclic)
  {
    SetBusContext(gILCAN1_BusContext);
    gCAN1DisturbancePeriod = @sysvar::IL_CAN1::NODES::N_BCM::MESSAGES::IBS3_DATA_2::TIMINGS::CyclePeriod;
    ILFaultInjectionSetMsgCycleTime(FDCAN2_1::BCM::IBS3_DATA_2, gCAN1DisturbancePeriod);
  }
}

on sysvar_update sysvar::IL_CAN1::NODES::N_BCM::MESSAGES::IBS3_DATA_2::TIMINGS::SendOnce
{
  if (@this == 1)
  {
    SetBusContext(gILCAN1_BusContext);
    ILSetMsgEvent(FDCAN2_1::BCM::IBS3_DATA_2);
  }
}

on sysvar_update sysvar::IL_CAN1::NODES::N_BCM::MESSAGES::IBS3_DATA_2_2::TIMINGS::EnableCyclic
{
  if (@this == 1)
  {
    SetBusContext(gILCAN1_BusContext);
    ILFaultInjectionEnableMsg  (FDCAN2_1::BCM::IBS3_DATA_2_2);
  }
  else
  {
    SetBusContext(gILCAN1_BusContext);
    ILFaultInjectionDisableMsg (FDCAN2_1::BCM::IBS3_DATA_2_2);
  }
}

on sysvar_update sysvar::IL_CAN1::NODES::N_BCM::MESSAGES::IBS3_DATA_2_2::TIMINGS::SetNormalCycle
{
  if (@this == 1 && @sysvar::IL_CAN1::NODES::N_BCM::MESSAGES::IBS3_DATA_2_2::TIMINGS::EnableCyclic)
  {
    @sysvar::IL_CAN1::NODES::N_BCM::MESSAGES::IBS3_DATA_2_2::TIMINGS::SelectedPeriod = 0;
  }
}

on sysvar_update sysvar::IL_CAN1::NODES::N_BCM::MESSAGES::IBS3_DATA_2_2::TIMINGS::SetNewCycleContinously
{
  if (@this == 1 && @sysvar::IL_CAN1::NODES::N_BCM::MESSAGES::IBS3_DATA_2_2::TIMINGS::EnableCyclic)
  {
    @sysvar::IL_CAN1::NODES::N_BCM::MESSAGES::IBS3_DATA_2_2::TIMINGS::SelectedPeriod = -1;
  }
}

on sysvar_update sysvar::IL_CAN1::NODES::N_BCM::MESSAGES::IBS3_DATA_2_2::TIMINGS::SelectedPeriod
{
  if (@this == 0 && @sysvar::IL_CAN1::NODES::N_BCM::MESSAGES::IBS3_DATA_2_2::TIMINGS::EnableCyclic)
  {
    SetBusContext(gILCAN1_BusContext);
    gCAN1DisturbancePeriod = @sysvar::IL_CAN1::NODES::N_BCM::MESSAGES::IBS3_DATA_2_2::TIMINGS::NormalCyclePeriod;
    ILFaultInjectionResetMsgCycleTime(FDCAN2_1::BCM::IBS3_DATA_2_2);
  }
  else if (@this == 1 && @sysvar::IL_CAN1::NODES::N_BCM::MESSAGES::IBS3_DATA_2_2::TIMINGS::EnableCyclic)
  {
    SetBusContext(gILCAN1_BusContext);
    gCAN1DisturbancePeriod = @sysvar::IL_CAN1::NODES::N_BCM::MESSAGES::IBS3_DATA_2_2::TIMINGS::ActiveCyclePeriod;
    ILFaultInjectionSetMsgCycleTime(FDCAN2_1::BCM::IBS3_DATA_2_2, gCAN1DisturbancePeriod);
  }
  else if (@this == -1 && @sysvar::IL_CAN1::NODES::N_BCM::MESSAGES::IBS3_DATA_2_2::TIMINGS::EnableCyclic)
  {
    SetBusContext(gILCAN1_BusContext);
    gCAN1DisturbancePeriod = @sysvar::IL_CAN1::NODES::N_BCM::MESSAGES::IBS3_DATA_2_2::TIMINGS::CyclePeriod;
    ILFaultInjectionSetMsgCycleTime(FDCAN2_1::BCM::IBS3_DATA_2_2, gCAN1DisturbancePeriod);
  }
}

on sysvar_update sysvar::IL_CAN1::NODES::N_BCM::MESSAGES::IBS3_DATA_2_2::TIMINGS::SendOnce
{
  if (@this == 1)
  {
    SetBusContext(gILCAN1_BusContext);
    ILSetMsgEvent(FDCAN2_1::BCM::IBS3_DATA_2_2);
  }
}

on sysvar_update sysvar::IL_CAN1::NODES::N_BCM::MESSAGES::IPC_FD_1::TIMINGS::EnableCyclic
{
  if (@this == 1)
  {
    SetBusContext(gILCAN1_BusContext);
    ILFaultInjectionEnableMsg  (FDCAN2_1::BCM::IPC_FD_1);
  }
  else
  {
    SetBusContext(gILCAN1_BusContext);
    ILFaultInjectionDisableMsg (FDCAN2_1::BCM::IPC_FD_1);
  }
}

on sysvar_update sysvar::IL_CAN1::NODES::N_BCM::MESSAGES::IPC_FD_1::TIMINGS::SetNormalCycle
{
  if (@this == 1 && @sysvar::IL_CAN1::NODES::N_BCM::MESSAGES::IPC_FD_1::TIMINGS::EnableCyclic)
  {
    @sysvar::IL_CAN1::NODES::N_BCM::MESSAGES::IPC_FD_1::TIMINGS::SelectedPeriod = 0;
  }
}

on sysvar_update sysvar::IL_CAN1::NODES::N_BCM::MESSAGES::IPC_FD_1::TIMINGS::SetNewCycleContinously
{
  if (@this == 1 && @sysvar::IL_CAN1::NODES::N_BCM::MESSAGES::IPC_FD_1::TIMINGS::EnableCyclic)
  {
    @sysvar::IL_CAN1::NODES::N_BCM::MESSAGES::IPC_FD_1::TIMINGS::SelectedPeriod = -1;
  }
}

on sysvar_update sysvar::IL_CAN1::NODES::N_BCM::MESSAGES::IPC_FD_1::TIMINGS::SelectedPeriod
{
  if (@this == 0 && @sysvar::IL_CAN1::NODES::N_BCM::MESSAGES::IPC_FD_1::TIMINGS::EnableCyclic)
  {
    SetBusContext(gILCAN1_BusContext);
    gCAN1DisturbancePeriod = @sysvar::IL_CAN1::NODES::N_BCM::MESSAGES::IPC_FD_1::TIMINGS::NormalCyclePeriod;
    ILFaultInjectionResetMsgCycleTime(FDCAN2_1::BCM::IPC_FD_1);
  }
  else if (@this == 1 && @sysvar::IL_CAN1::NODES::N_BCM::MESSAGES::IPC_FD_1::TIMINGS::EnableCyclic)
  {
    SetBusContext(gILCAN1_BusContext);
    gCAN1DisturbancePeriod = @sysvar::IL_CAN1::NODES::N_BCM::MESSAGES::IPC_FD_1::TIMINGS::ActiveCyclePeriod;
    ILFaultInjectionSetMsgCycleTime(FDCAN2_1::BCM::IPC_FD_1, gCAN1DisturbancePeriod);
  }
  else if (@this == -1 && @sysvar::IL_CAN1::NODES::N_BCM::MESSAGES::IPC_FD_1::TIMINGS::EnableCyclic)
  {
    SetBusContext(gILCAN1_BusContext);
    gCAN1DisturbancePeriod = @sysvar::IL_CAN1::NODES::N_BCM::MESSAGES::IPC_FD_1::TIMINGS::CyclePeriod;
    ILFaultInjectionSetMsgCycleTime(FDCAN2_1::BCM::IPC_FD_1, gCAN1DisturbancePeriod);
  }
}

on sysvar_update sysvar::IL_CAN1::NODES::N_BCM::MESSAGES::IPC_FD_1::TIMINGS::SendOnce
{
  if (@this == 1)
  {
    SetBusContext(gILCAN1_BusContext);
    ILSetMsgEvent(FDCAN2_1::BCM::IPC_FD_1);
  }
}

on sysvar_update sysvar::IL_CAN1::NODES::N_BCM::MESSAGES::IPC_FD_4::TIMINGS::EnableCyclic
{
  if (@this == 1)
  {
    SetBusContext(gILCAN1_BusContext);
    ILFaultInjectionEnableMsg  (FDCAN2_1::BCM::IPC_FD_4);
  }
  else
  {
    SetBusContext(gILCAN1_BusContext);
    ILFaultInjectionDisableMsg (FDCAN2_1::BCM::IPC_FD_4);
  }
}

on sysvar_update sysvar::IL_CAN1::NODES::N_BCM::MESSAGES::IPC_FD_4::TIMINGS::SetNormalCycle
{
  if (@this == 1 && @sysvar::IL_CAN1::NODES::N_BCM::MESSAGES::IPC_FD_4::TIMINGS::EnableCyclic)
  {
    @sysvar::IL_CAN1::NODES::N_BCM::MESSAGES::IPC_FD_4::TIMINGS::SelectedPeriod = 0;
  }
}

on sysvar_update sysvar::IL_CAN1::NODES::N_BCM::MESSAGES::IPC_FD_4::TIMINGS::SetNewCycleContinously
{
  if (@this == 1 && @sysvar::IL_CAN1::NODES::N_BCM::MESSAGES::IPC_FD_4::TIMINGS::EnableCyclic)
  {
    @sysvar::IL_CAN1::NODES::N_BCM::MESSAGES::IPC_FD_4::TIMINGS::SelectedPeriod = -1;
  }
}

on sysvar_update sysvar::IL_CAN1::NODES::N_BCM::MESSAGES::IPC_FD_4::TIMINGS::SelectedPeriod
{
  if (@this == 0 && @sysvar::IL_CAN1::NODES::N_BCM::MESSAGES::IPC_FD_4::TIMINGS::EnableCyclic)
  {
    SetBusContext(gILCAN1_BusContext);
    gCAN1DisturbancePeriod = @sysvar::IL_CAN1::NODES::N_BCM::MESSAGES::IPC_FD_4::TIMINGS::NormalCyclePeriod;
    ILFaultInjectionResetMsgCycleTime(FDCAN2_1::BCM::IPC_FD_4);
  }
  else if (@this == 1 && @sysvar::IL_CAN1::NODES::N_BCM::MESSAGES::IPC_FD_4::TIMINGS::EnableCyclic)
  {
    SetBusContext(gILCAN1_BusContext);
    gCAN1DisturbancePeriod = @sysvar::IL_CAN1::NODES::N_BCM::MESSAGES::IPC_FD_4::TIMINGS::ActiveCyclePeriod;
    ILFaultInjectionSetMsgCycleTime(FDCAN2_1::BCM::IPC_FD_4, gCAN1DisturbancePeriod);
  }
  else if (@this == -1 && @sysvar::IL_CAN1::NODES::N_BCM::MESSAGES::IPC_FD_4::TIMINGS::EnableCyclic)
  {
    SetBusContext(gILCAN1_BusContext);
    gCAN1DisturbancePeriod = @sysvar::IL_CAN1::NODES::N_BCM::MESSAGES::IPC_FD_4::TIMINGS::CyclePeriod;
    ILFaultInjectionSetMsgCycleTime(FDCAN2_1::BCM::IPC_FD_4, gCAN1DisturbancePeriod);
  }
}

on sysvar_update sysvar::IL_CAN1::NODES::N_BCM::MESSAGES::IPC_FD_4::TIMINGS::SendOnce
{
  if (@this == 1)
  {
    SetBusContext(gILCAN1_BusContext);
    ILSetMsgEvent(FDCAN2_1::BCM::IPC_FD_4);
  }
}

on sysvar_update sysvar::IL_CAN1::NODES::N_BCM::MESSAGES::IPC_FD_6::TIMINGS::EnableCyclic
{
  if (@this == 1)
  {
    SetBusContext(gILCAN1_BusContext);
    ILFaultInjectionEnableMsg  (FDCAN2_1::BCM::IPC_FD_6);
  }
  else
  {
    SetBusContext(gILCAN1_BusContext);
    ILFaultInjectionDisableMsg (FDCAN2_1::BCM::IPC_FD_6);
  }
}

on sysvar_update sysvar::IL_CAN1::NODES::N_BCM::MESSAGES::IPC_FD_6::TIMINGS::SetNormalCycle
{
  if (@this == 1 && @sysvar::IL_CAN1::NODES::N_BCM::MESSAGES::IPC_FD_6::TIMINGS::EnableCyclic)
  {
    @sysvar::IL_CAN1::NODES::N_BCM::MESSAGES::IPC_FD_6::TIMINGS::SelectedPeriod = 0;
  }
}

on sysvar_update sysvar::IL_CAN1::NODES::N_BCM::MESSAGES::IPC_FD_6::TIMINGS::SetNewCycleContinously
{
  if (@this == 1 && @sysvar::IL_CAN1::NODES::N_BCM::MESSAGES::IPC_FD_6::TIMINGS::EnableCyclic)
  {
    @sysvar::IL_CAN1::NODES::N_BCM::MESSAGES::IPC_FD_6::TIMINGS::SelectedPeriod = -1;
  }
}

on sysvar_update sysvar::IL_CAN1::NODES::N_BCM::MESSAGES::IPC_FD_6::TIMINGS::SelectedPeriod
{
  if (@this == 0 && @sysvar::IL_CAN1::NODES::N_BCM::MESSAGES::IPC_FD_6::TIMINGS::EnableCyclic)
  {
    SetBusContext(gILCAN1_BusContext);
    gCAN1DisturbancePeriod = @sysvar::IL_CAN1::NODES::N_BCM::MESSAGES::IPC_FD_6::TIMINGS::NormalCyclePeriod;
    ILFaultInjectionResetMsgCycleTime(FDCAN2_1::BCM::IPC_FD_6);
  }
  else if (@this == 1 && @sysvar::IL_CAN1::NODES::N_BCM::MESSAGES::IPC_FD_6::TIMINGS::EnableCyclic)
  {
    SetBusContext(gILCAN1_BusContext);
    gCAN1DisturbancePeriod = @sysvar::IL_CAN1::NODES::N_BCM::MESSAGES::IPC_FD_6::TIMINGS::ActiveCyclePeriod;
    ILFaultInjectionSetMsgCycleTime(FDCAN2_1::BCM::IPC_FD_6, gCAN1DisturbancePeriod);
  }
  else if (@this == -1 && @sysvar::IL_CAN1::NODES::N_BCM::MESSAGES::IPC_FD_6::TIMINGS::EnableCyclic)
  {
    SetBusContext(gILCAN1_BusContext);
    gCAN1DisturbancePeriod = @sysvar::IL_CAN1::NODES::N_BCM::MESSAGES::IPC_FD_6::TIMINGS::CyclePeriod;
    ILFaultInjectionSetMsgCycleTime(FDCAN2_1::BCM::IPC_FD_6, gCAN1DisturbancePeriod);
  }
}

on sysvar_update sysvar::IL_CAN1::NODES::N_BCM::MESSAGES::IPC_FD_6::TIMINGS::SendOnce
{
  if (@this == 1)
  {
    SetBusContext(gILCAN1_BusContext);
    ILSetMsgEvent(FDCAN2_1::BCM::IPC_FD_6);
  }
}

on sysvar_update sysvar::IL_CAN1::NODES::N_BCM::MESSAGES::IPC_VEHICLE_SETUP::TIMINGS::EnableCyclic
{
  if (@this == 1)
  {
    SetBusContext(gILCAN1_BusContext);
    ILFaultInjectionEnableMsg  (FDCAN2_1::BCM::IPC_VEHICLE_SETUP);
  }
  else
  {
    SetBusContext(gILCAN1_BusContext);
    ILFaultInjectionDisableMsg (FDCAN2_1::BCM::IPC_VEHICLE_SETUP);
  }
}

on sysvar_update sysvar::IL_CAN1::NODES::N_BCM::MESSAGES::IPC_VEHICLE_SETUP::TIMINGS::SetNormalCycle
{
  if (@this == 1 && @sysvar::IL_CAN1::NODES::N_BCM::MESSAGES::IPC_VEHICLE_SETUP::TIMINGS::EnableCyclic)
  {
    @sysvar::IL_CAN1::NODES::N_BCM::MESSAGES::IPC_VEHICLE_SETUP::TIMINGS::SelectedPeriod = 0;
  }
}

on sysvar_update sysvar::IL_CAN1::NODES::N_BCM::MESSAGES::IPC_VEHICLE_SETUP::TIMINGS::SetNewCycleContinously
{
  if (@this == 1 && @sysvar::IL_CAN1::NODES::N_BCM::MESSAGES::IPC_VEHICLE_SETUP::TIMINGS::EnableCyclic)
  {
    @sysvar::IL_CAN1::NODES::N_BCM::MESSAGES::IPC_VEHICLE_SETUP::TIMINGS::SelectedPeriod = -1;
  }
}

on sysvar_update sysvar::IL_CAN1::NODES::N_BCM::MESSAGES::IPC_VEHICLE_SETUP::TIMINGS::SelectedPeriod
{
  if (@this == 0 && @sysvar::IL_CAN1::NODES::N_BCM::MESSAGES::IPC_VEHICLE_SETUP::TIMINGS::EnableCyclic)
  {
    SetBusContext(gILCAN1_BusContext);
    gCAN1DisturbancePeriod = @sysvar::IL_CAN1::NODES::N_BCM::MESSAGES::IPC_VEHICLE_SETUP::TIMINGS::NormalCyclePeriod;
    ILFaultInjectionResetMsgCycleTime(FDCAN2_1::BCM::IPC_VEHICLE_SETUP);
  }
  else if (@this == 1 && @sysvar::IL_CAN1::NODES::N_BCM::MESSAGES::IPC_VEHICLE_SETUP::TIMINGS::EnableCyclic)
  {
    SetBusContext(gILCAN1_BusContext);
    gCAN1DisturbancePeriod = @sysvar::IL_CAN1::NODES::N_BCM::MESSAGES::IPC_VEHICLE_SETUP::TIMINGS::ActiveCyclePeriod;
    ILFaultInjectionSetMsgCycleTime(FDCAN2_1::BCM::IPC_VEHICLE_SETUP, gCAN1DisturbancePeriod);
  }
  else if (@this == -1 && @sysvar::IL_CAN1::NODES::N_BCM::MESSAGES::IPC_VEHICLE_SETUP::TIMINGS::EnableCyclic)
  {
    SetBusContext(gILCAN1_BusContext);
    gCAN1DisturbancePeriod = @sysvar::IL_CAN1::NODES::N_BCM::MESSAGES::IPC_VEHICLE_SETUP::TIMINGS::CyclePeriod;
    ILFaultInjectionSetMsgCycleTime(FDCAN2_1::BCM::IPC_VEHICLE_SETUP, gCAN1DisturbancePeriod);
  }
}

on sysvar_update sysvar::IL_CAN1::NODES::N_BCM::MESSAGES::IPC_VEHICLE_SETUP::TIMINGS::SendOnce
{
  if (@this == 1)
  {
    SetBusContext(gILCAN1_BusContext);
    ILSetMsgEvent(FDCAN2_1::BCM::IPC_VEHICLE_SETUP);
  }
}

on sysvar_update sysvar::IL_CAN1::NODES::N_BCM::MESSAGES::PDC_INFO_FD_ADCM::TIMINGS::EnableCyclic
{
  if (@this == 1)
  {
    SetBusContext(gILCAN1_BusContext);
    ILFaultInjectionEnableMsg  (FDCAN2_1::BCM::PDC_INFO_FD_ADCM);
  }
  else
  {
    SetBusContext(gILCAN1_BusContext);
    ILFaultInjectionDisableMsg (FDCAN2_1::BCM::PDC_INFO_FD_ADCM);
  }
}

on sysvar_update sysvar::IL_CAN1::NODES::N_BCM::MESSAGES::PDC_INFO_FD_ADCM::TIMINGS::SetNormalCycle
{
  if (@this == 1 && @sysvar::IL_CAN1::NODES::N_BCM::MESSAGES::PDC_INFO_FD_ADCM::TIMINGS::EnableCyclic)
  {
    @sysvar::IL_CAN1::NODES::N_BCM::MESSAGES::PDC_INFO_FD_ADCM::TIMINGS::SelectedPeriod = 0;
  }
}

on sysvar_update sysvar::IL_CAN1::NODES::N_BCM::MESSAGES::PDC_INFO_FD_ADCM::TIMINGS::SetNewCycleContinously
{
  if (@this == 1 && @sysvar::IL_CAN1::NODES::N_BCM::MESSAGES::PDC_INFO_FD_ADCM::TIMINGS::EnableCyclic)
  {
    @sysvar::IL_CAN1::NODES::N_BCM::MESSAGES::PDC_INFO_FD_ADCM::TIMINGS::SelectedPeriod = -1;
  }
}

on sysvar_update sysvar::IL_CAN1::NODES::N_BCM::MESSAGES::PDC_INFO_FD_ADCM::TIMINGS::SelectedPeriod
{
  if (@this == 0 && @sysvar::IL_CAN1::NODES::N_BCM::MESSAGES::PDC_INFO_FD_ADCM::TIMINGS::EnableCyclic)
  {
    SetBusContext(gILCAN1_BusContext);
    gCAN1DisturbancePeriod = @sysvar::IL_CAN1::NODES::N_BCM::MESSAGES::PDC_INFO_FD_ADCM::TIMINGS::NormalCyclePeriod;
    ILFaultInjectionResetMsgCycleTime(FDCAN2_1::BCM::PDC_INFO_FD_ADCM);
  }
  else if (@this == 1 && @sysvar::IL_CAN1::NODES::N_BCM::MESSAGES::PDC_INFO_FD_ADCM::TIMINGS::EnableCyclic)
  {
    SetBusContext(gILCAN1_BusContext);
    gCAN1DisturbancePeriod = @sysvar::IL_CAN1::NODES::N_BCM::MESSAGES::PDC_INFO_FD_ADCM::TIMINGS::ActiveCyclePeriod;
    ILFaultInjectionSetMsgCycleTime(FDCAN2_1::BCM::PDC_INFO_FD_ADCM, gCAN1DisturbancePeriod);
  }
  else if (@this == -1 && @sysvar::IL_CAN1::NODES::N_BCM::MESSAGES::PDC_INFO_FD_ADCM::TIMINGS::EnableCyclic)
  {
    SetBusContext(gILCAN1_BusContext);
    gCAN1DisturbancePeriod = @sysvar::IL_CAN1::NODES::N_BCM::MESSAGES::PDC_INFO_FD_ADCM::TIMINGS::CyclePeriod;
    ILFaultInjectionSetMsgCycleTime(FDCAN2_1::BCM::PDC_INFO_FD_ADCM, gCAN1DisturbancePeriod);
  }
}

on sysvar_update sysvar::IL_CAN1::NODES::N_BCM::MESSAGES::PDC_INFO_FD_ADCM::TIMINGS::SendOnce
{
  if (@this == 1)
  {
    SetBusContext(gILCAN1_BusContext);
    ILSetMsgEvent(FDCAN2_1::BCM::PDC_INFO_FD_ADCM);
  }
}

on sysvar_update sysvar::IL_CAN1::NODES::N_BCM::MESSAGES::PDC_INFO_FD_AGSM::TIMINGS::EnableCyclic
{
  if (@this == 1)
  {
    SetBusContext(gILCAN1_BusContext);
    ILFaultInjectionEnableMsg  (FDCAN2_1::BCM::PDC_INFO_FD_AGSM);
  }
  else
  {
    SetBusContext(gILCAN1_BusContext);
    ILFaultInjectionDisableMsg (FDCAN2_1::BCM::PDC_INFO_FD_AGSM);
  }
}

on sysvar_update sysvar::IL_CAN1::NODES::N_BCM::MESSAGES::PDC_INFO_FD_AGSM::TIMINGS::SetNormalCycle
{
  if (@this == 1 && @sysvar::IL_CAN1::NODES::N_BCM::MESSAGES::PDC_INFO_FD_AGSM::TIMINGS::EnableCyclic)
  {
    @sysvar::IL_CAN1::NODES::N_BCM::MESSAGES::PDC_INFO_FD_AGSM::TIMINGS::SelectedPeriod = 0;
  }
}

on sysvar_update sysvar::IL_CAN1::NODES::N_BCM::MESSAGES::PDC_INFO_FD_AGSM::TIMINGS::SetNewCycleContinously
{
  if (@this == 1 && @sysvar::IL_CAN1::NODES::N_BCM::MESSAGES::PDC_INFO_FD_AGSM::TIMINGS::EnableCyclic)
  {
    @sysvar::IL_CAN1::NODES::N_BCM::MESSAGES::PDC_INFO_FD_AGSM::TIMINGS::SelectedPeriod = -1;
  }
}

on sysvar_update sysvar::IL_CAN1::NODES::N_BCM::MESSAGES::PDC_INFO_FD_AGSM::TIMINGS::SelectedPeriod
{
  if (@this == 0 && @sysvar::IL_CAN1::NODES::N_BCM::MESSAGES::PDC_INFO_FD_AGSM::TIMINGS::EnableCyclic)
  {
    SetBusContext(gILCAN1_BusContext);
    gCAN1DisturbancePeriod = @sysvar::IL_CAN1::NODES::N_BCM::MESSAGES::PDC_INFO_FD_AGSM::TIMINGS::NormalCyclePeriod;
    ILFaultInjectionResetMsgCycleTime(FDCAN2_1::BCM::PDC_INFO_FD_AGSM);
  }
  else if (@this == 1 && @sysvar::IL_CAN1::NODES::N_BCM::MESSAGES::PDC_INFO_FD_AGSM::TIMINGS::EnableCyclic)
  {
    SetBusContext(gILCAN1_BusContext);
    gCAN1DisturbancePeriod = @sysvar::IL_CAN1::NODES::N_BCM::MESSAGES::PDC_INFO_FD_AGSM::TIMINGS::ActiveCyclePeriod;
    ILFaultInjectionSetMsgCycleTime(FDCAN2_1::BCM::PDC_INFO_FD_AGSM, gCAN1DisturbancePeriod);
  }
  else if (@this == -1 && @sysvar::IL_CAN1::NODES::N_BCM::MESSAGES::PDC_INFO_FD_AGSM::TIMINGS::EnableCyclic)
  {
    SetBusContext(gILCAN1_BusContext);
    gCAN1DisturbancePeriod = @sysvar::IL_CAN1::NODES::N_BCM::MESSAGES::PDC_INFO_FD_AGSM::TIMINGS::CyclePeriod;
    ILFaultInjectionSetMsgCycleTime(FDCAN2_1::BCM::PDC_INFO_FD_AGSM, gCAN1DisturbancePeriod);
  }
}

on sysvar_update sysvar::IL_CAN1::NODES::N_BCM::MESSAGES::PDC_INFO_FD_AGSM::TIMINGS::SendOnce
{
  if (@this == 1)
  {
    SetBusContext(gILCAN1_BusContext);
    ILSetMsgEvent(FDCAN2_1::BCM::PDC_INFO_FD_AGSM);
  }
}

on sysvar_update sysvar::IL_CAN1::NODES::N_BCM::MESSAGES::PDC_INFO_FD_ASCM::TIMINGS::EnableCyclic
{
  if (@this == 1)
  {
    SetBusContext(gILCAN1_BusContext);
    ILFaultInjectionEnableMsg  (FDCAN2_1::BCM::PDC_INFO_FD_ASCM);
  }
  else
  {
    SetBusContext(gILCAN1_BusContext);
    ILFaultInjectionDisableMsg (FDCAN2_1::BCM::PDC_INFO_FD_ASCM);
  }
}

on sysvar_update sysvar::IL_CAN1::NODES::N_BCM::MESSAGES::PDC_INFO_FD_ASCM::TIMINGS::SetNormalCycle
{
  if (@this == 1 && @sysvar::IL_CAN1::NODES::N_BCM::MESSAGES::PDC_INFO_FD_ASCM::TIMINGS::EnableCyclic)
  {
    @sysvar::IL_CAN1::NODES::N_BCM::MESSAGES::PDC_INFO_FD_ASCM::TIMINGS::SelectedPeriod = 0;
  }
}

on sysvar_update sysvar::IL_CAN1::NODES::N_BCM::MESSAGES::PDC_INFO_FD_ASCM::TIMINGS::SetNewCycleContinously
{
  if (@this == 1 && @sysvar::IL_CAN1::NODES::N_BCM::MESSAGES::PDC_INFO_FD_ASCM::TIMINGS::EnableCyclic)
  {
    @sysvar::IL_CAN1::NODES::N_BCM::MESSAGES::PDC_INFO_FD_ASCM::TIMINGS::SelectedPeriod = -1;
  }
}

on sysvar_update sysvar::IL_CAN1::NODES::N_BCM::MESSAGES::PDC_INFO_FD_ASCM::TIMINGS::SelectedPeriod
{
  if (@this == 0 && @sysvar::IL_CAN1::NODES::N_BCM::MESSAGES::PDC_INFO_FD_ASCM::TIMINGS::EnableCyclic)
  {
    SetBusContext(gILCAN1_BusContext);
    gCAN1DisturbancePeriod = @sysvar::IL_CAN1::NODES::N_BCM::MESSAGES::PDC_INFO_FD_ASCM::TIMINGS::NormalCyclePeriod;
    ILFaultInjectionResetMsgCycleTime(FDCAN2_1::BCM::PDC_INFO_FD_ASCM);
  }
  else if (@this == 1 && @sysvar::IL_CAN1::NODES::N_BCM::MESSAGES::PDC_INFO_FD_ASCM::TIMINGS::EnableCyclic)
  {
    SetBusContext(gILCAN1_BusContext);
    gCAN1DisturbancePeriod = @sysvar::IL_CAN1::NODES::N_BCM::MESSAGES::PDC_INFO_FD_ASCM::TIMINGS::ActiveCyclePeriod;
    ILFaultInjectionSetMsgCycleTime(FDCAN2_1::BCM::PDC_INFO_FD_ASCM, gCAN1DisturbancePeriod);
  }
  else if (@this == -1 && @sysvar::IL_CAN1::NODES::N_BCM::MESSAGES::PDC_INFO_FD_ASCM::TIMINGS::EnableCyclic)
  {
    SetBusContext(gILCAN1_BusContext);
    gCAN1DisturbancePeriod = @sysvar::IL_CAN1::NODES::N_BCM::MESSAGES::PDC_INFO_FD_ASCM::TIMINGS::CyclePeriod;
    ILFaultInjectionSetMsgCycleTime(FDCAN2_1::BCM::PDC_INFO_FD_ASCM, gCAN1DisturbancePeriod);
  }
}

on sysvar_update sysvar::IL_CAN1::NODES::N_BCM::MESSAGES::PDC_INFO_FD_ASCM::TIMINGS::SendOnce
{
  if (@this == 1)
  {
    SetBusContext(gILCAN1_BusContext);
    ILSetMsgEvent(FDCAN2_1::BCM::PDC_INFO_FD_ASCM);
  }
}

on sysvar_update sysvar::IL_CAN1::NODES::N_BCM::MESSAGES::PDC_INFO_FD_BCM::TIMINGS::EnableCyclic
{
  if (@this == 1)
  {
    SetBusContext(gILCAN1_BusContext);
    ILFaultInjectionEnableMsg  (FDCAN2_1::BCM::PDC_INFO_FD_BCM);
  }
  else
  {
    SetBusContext(gILCAN1_BusContext);
    ILFaultInjectionDisableMsg (FDCAN2_1::BCM::PDC_INFO_FD_BCM);
  }
}

on sysvar_update sysvar::IL_CAN1::NODES::N_BCM::MESSAGES::PDC_INFO_FD_BCM::TIMINGS::SetNormalCycle
{
  if (@this == 1 && @sysvar::IL_CAN1::NODES::N_BCM::MESSAGES::PDC_INFO_FD_BCM::TIMINGS::EnableCyclic)
  {
    @sysvar::IL_CAN1::NODES::N_BCM::MESSAGES::PDC_INFO_FD_BCM::TIMINGS::SelectedPeriod = 0;
  }
}

on sysvar_update sysvar::IL_CAN1::NODES::N_BCM::MESSAGES::PDC_INFO_FD_BCM::TIMINGS::SetNewCycleContinously
{
  if (@this == 1 && @sysvar::IL_CAN1::NODES::N_BCM::MESSAGES::PDC_INFO_FD_BCM::TIMINGS::EnableCyclic)
  {
    @sysvar::IL_CAN1::NODES::N_BCM::MESSAGES::PDC_INFO_FD_BCM::TIMINGS::SelectedPeriod = -1;
  }
}

on sysvar_update sysvar::IL_CAN1::NODES::N_BCM::MESSAGES::PDC_INFO_FD_BCM::TIMINGS::SelectedPeriod
{
  if (@this == 0 && @sysvar::IL_CAN1::NODES::N_BCM::MESSAGES::PDC_INFO_FD_BCM::TIMINGS::EnableCyclic)
  {
    SetBusContext(gILCAN1_BusContext);
    gCAN1DisturbancePeriod = @sysvar::IL_CAN1::NODES::N_BCM::MESSAGES::PDC_INFO_FD_BCM::TIMINGS::NormalCyclePeriod;
    ILFaultInjectionResetMsgCycleTime(FDCAN2_1::BCM::PDC_INFO_FD_BCM);
  }
  else if (@this == 1 && @sysvar::IL_CAN1::NODES::N_BCM::MESSAGES::PDC_INFO_FD_BCM::TIMINGS::EnableCyclic)
  {
    SetBusContext(gILCAN1_BusContext);
    gCAN1DisturbancePeriod = @sysvar::IL_CAN1::NODES::N_BCM::MESSAGES::PDC_INFO_FD_BCM::TIMINGS::ActiveCyclePeriod;
    ILFaultInjectionSetMsgCycleTime(FDCAN2_1::BCM::PDC_INFO_FD_BCM, gCAN1DisturbancePeriod);
  }
  else if (@this == -1 && @sysvar::IL_CAN1::NODES::N_BCM::MESSAGES::PDC_INFO_FD_BCM::TIMINGS::EnableCyclic)
  {
    SetBusContext(gILCAN1_BusContext);
    gCAN1DisturbancePeriod = @sysvar::IL_CAN1::NODES::N_BCM::MESSAGES::PDC_INFO_FD_BCM::TIMINGS::CyclePeriod;
    ILFaultInjectionSetMsgCycleTime(FDCAN2_1::BCM::PDC_INFO_FD_BCM, gCAN1DisturbancePeriod);
  }
}

on sysvar_update sysvar::IL_CAN1::NODES::N_BCM::MESSAGES::PDC_INFO_FD_BCM::TIMINGS::SendOnce
{
  if (@this == 1)
  {
    SetBusContext(gILCAN1_BusContext);
    ILSetMsgEvent(FDCAN2_1::BCM::PDC_INFO_FD_BCM);
  }
}

on sysvar_update sysvar::IL_CAN1::NODES::N_BCM::MESSAGES::PDC_INFO_FD_BPCM::TIMINGS::EnableCyclic
{
  if (@this == 1)
  {
    SetBusContext(gILCAN1_BusContext);
    ILFaultInjectionEnableMsg  (FDCAN2_1::BCM::PDC_INFO_FD_BPCM);
  }
  else
  {
    SetBusContext(gILCAN1_BusContext);
    ILFaultInjectionDisableMsg (FDCAN2_1::BCM::PDC_INFO_FD_BPCM);
  }
}

on sysvar_update sysvar::IL_CAN1::NODES::N_BCM::MESSAGES::PDC_INFO_FD_BPCM::TIMINGS::SetNormalCycle
{
  if (@this == 1 && @sysvar::IL_CAN1::NODES::N_BCM::MESSAGES::PDC_INFO_FD_BPCM::TIMINGS::EnableCyclic)
  {
    @sysvar::IL_CAN1::NODES::N_BCM::MESSAGES::PDC_INFO_FD_BPCM::TIMINGS::SelectedPeriod = 0;
  }
}

on sysvar_update sysvar::IL_CAN1::NODES::N_BCM::MESSAGES::PDC_INFO_FD_BPCM::TIMINGS::SetNewCycleContinously
{
  if (@this == 1 && @sysvar::IL_CAN1::NODES::N_BCM::MESSAGES::PDC_INFO_FD_BPCM::TIMINGS::EnableCyclic)
  {
    @sysvar::IL_CAN1::NODES::N_BCM::MESSAGES::PDC_INFO_FD_BPCM::TIMINGS::SelectedPeriod = -1;
  }
}

on sysvar_update sysvar::IL_CAN1::NODES::N_BCM::MESSAGES::PDC_INFO_FD_BPCM::TIMINGS::SelectedPeriod
{
  if (@this == 0 && @sysvar::IL_CAN1::NODES::N_BCM::MESSAGES::PDC_INFO_FD_BPCM::TIMINGS::EnableCyclic)
  {
    SetBusContext(gILCAN1_BusContext);
    gCAN1DisturbancePeriod = @sysvar::IL_CAN1::NODES::N_BCM::MESSAGES::PDC_INFO_FD_BPCM::TIMINGS::NormalCyclePeriod;
    ILFaultInjectionResetMsgCycleTime(FDCAN2_1::BCM::PDC_INFO_FD_BPCM);
  }
  else if (@this == 1 && @sysvar::IL_CAN1::NODES::N_BCM::MESSAGES::PDC_INFO_FD_BPCM::TIMINGS::EnableCyclic)
  {
    SetBusContext(gILCAN1_BusContext);
    gCAN1DisturbancePeriod = @sysvar::IL_CAN1::NODES::N_BCM::MESSAGES::PDC_INFO_FD_BPCM::TIMINGS::ActiveCyclePeriod;
    ILFaultInjectionSetMsgCycleTime(FDCAN2_1::BCM::PDC_INFO_FD_BPCM, gCAN1DisturbancePeriod);
  }
  else if (@this == -1 && @sysvar::IL_CAN1::NODES::N_BCM::MESSAGES::PDC_INFO_FD_BPCM::TIMINGS::EnableCyclic)
  {
    SetBusContext(gILCAN1_BusContext);
    gCAN1DisturbancePeriod = @sysvar::IL_CAN1::NODES::N_BCM::MESSAGES::PDC_INFO_FD_BPCM::TIMINGS::CyclePeriod;
    ILFaultInjectionSetMsgCycleTime(FDCAN2_1::BCM::PDC_INFO_FD_BPCM, gCAN1DisturbancePeriod);
  }
}

on sysvar_update sysvar::IL_CAN1::NODES::N_BCM::MESSAGES::PDC_INFO_FD_BPCM::TIMINGS::SendOnce
{
  if (@this == 1)
  {
    SetBusContext(gILCAN1_BusContext);
    ILSetMsgEvent(FDCAN2_1::BCM::PDC_INFO_FD_BPCM);
  }
}

on sysvar_update sysvar::IL_CAN1::NODES::N_BCM::MESSAGES::PDC_INFO_FD_BSM::TIMINGS::EnableCyclic
{
  if (@this == 1)
  {
    SetBusContext(gILCAN1_BusContext);
    ILFaultInjectionEnableMsg  (FDCAN2_1::BCM::PDC_INFO_FD_BSM);
  }
  else
  {
    SetBusContext(gILCAN1_BusContext);
    ILFaultInjectionDisableMsg (FDCAN2_1::BCM::PDC_INFO_FD_BSM);
  }
}

on sysvar_update sysvar::IL_CAN1::NODES::N_BCM::MESSAGES::PDC_INFO_FD_BSM::TIMINGS::SetNormalCycle
{
  if (@this == 1 && @sysvar::IL_CAN1::NODES::N_BCM::MESSAGES::PDC_INFO_FD_BSM::TIMINGS::EnableCyclic)
  {
    @sysvar::IL_CAN1::NODES::N_BCM::MESSAGES::PDC_INFO_FD_BSM::TIMINGS::SelectedPeriod = 0;
  }
}

on sysvar_update sysvar::IL_CAN1::NODES::N_BCM::MESSAGES::PDC_INFO_FD_BSM::TIMINGS::SetNewCycleContinously
{
  if (@this == 1 && @sysvar::IL_CAN1::NODES::N_BCM::MESSAGES::PDC_INFO_FD_BSM::TIMINGS::EnableCyclic)
  {
    @sysvar::IL_CAN1::NODES::N_BCM::MESSAGES::PDC_INFO_FD_BSM::TIMINGS::SelectedPeriod = -1;
  }
}

on sysvar_update sysvar::IL_CAN1::NODES::N_BCM::MESSAGES::PDC_INFO_FD_BSM::TIMINGS::SelectedPeriod
{
  if (@this == 0 && @sysvar::IL_CAN1::NODES::N_BCM::MESSAGES::PDC_INFO_FD_BSM::TIMINGS::EnableCyclic)
  {
    SetBusContext(gILCAN1_BusContext);
    gCAN1DisturbancePeriod = @sysvar::IL_CAN1::NODES::N_BCM::MESSAGES::PDC_INFO_FD_BSM::TIMINGS::NormalCyclePeriod;
    ILFaultInjectionResetMsgCycleTime(FDCAN2_1::BCM::PDC_INFO_FD_BSM);
  }
  else if (@this == 1 && @sysvar::IL_CAN1::NODES::N_BCM::MESSAGES::PDC_INFO_FD_BSM::TIMINGS::EnableCyclic)
  {
    SetBusContext(gILCAN1_BusContext);
    gCAN1DisturbancePeriod = @sysvar::IL_CAN1::NODES::N_BCM::MESSAGES::PDC_INFO_FD_BSM::TIMINGS::ActiveCyclePeriod;
    ILFaultInjectionSetMsgCycleTime(FDCAN2_1::BCM::PDC_INFO_FD_BSM, gCAN1DisturbancePeriod);
  }
  else if (@this == -1 && @sysvar::IL_CAN1::NODES::N_BCM::MESSAGES::PDC_INFO_FD_BSM::TIMINGS::EnableCyclic)
  {
    SetBusContext(gILCAN1_BusContext);
    gCAN1DisturbancePeriod = @sysvar::IL_CAN1::NODES::N_BCM::MESSAGES::PDC_INFO_FD_BSM::TIMINGS::CyclePeriod;
    ILFaultInjectionSetMsgCycleTime(FDCAN2_1::BCM::PDC_INFO_FD_BSM, gCAN1DisturbancePeriod);
  }
}

on sysvar_update sysvar::IL_CAN1::NODES::N_BCM::MESSAGES::PDC_INFO_FD_BSM::TIMINGS::SendOnce
{
  if (@this == 1)
  {
    SetBusContext(gILCAN1_BusContext);
    ILSetMsgEvent(FDCAN2_1::BCM::PDC_INFO_FD_BSM);
  }
}

on sysvar_update sysvar::IL_CAN1::NODES::N_BCM::MESSAGES::PDC_INFO_FD_CADM::TIMINGS::EnableCyclic
{
  if (@this == 1)
  {
    SetBusContext(gILCAN1_BusContext);
    ILFaultInjectionEnableMsg  (FDCAN2_1::BCM::PDC_INFO_FD_CADM);
  }
  else
  {
    SetBusContext(gILCAN1_BusContext);
    ILFaultInjectionDisableMsg (FDCAN2_1::BCM::PDC_INFO_FD_CADM);
  }
}

on sysvar_update sysvar::IL_CAN1::NODES::N_BCM::MESSAGES::PDC_INFO_FD_CADM::TIMINGS::SetNormalCycle
{
  if (@this == 1 && @sysvar::IL_CAN1::NODES::N_BCM::MESSAGES::PDC_INFO_FD_CADM::TIMINGS::EnableCyclic)
  {
    @sysvar::IL_CAN1::NODES::N_BCM::MESSAGES::PDC_INFO_FD_CADM::TIMINGS::SelectedPeriod = 0;
  }
}

on sysvar_update sysvar::IL_CAN1::NODES::N_BCM::MESSAGES::PDC_INFO_FD_CADM::TIMINGS::SetNewCycleContinously
{
  if (@this == 1 && @sysvar::IL_CAN1::NODES::N_BCM::MESSAGES::PDC_INFO_FD_CADM::TIMINGS::EnableCyclic)
  {
    @sysvar::IL_CAN1::NODES::N_BCM::MESSAGES::PDC_INFO_FD_CADM::TIMINGS::SelectedPeriod = -1;
  }
}

on sysvar_update sysvar::IL_CAN1::NODES::N_BCM::MESSAGES::PDC_INFO_FD_CADM::TIMINGS::SelectedPeriod
{
  if (@this == 0 && @sysvar::IL_CAN1::NODES::N_BCM::MESSAGES::PDC_INFO_FD_CADM::TIMINGS::EnableCyclic)
  {
    SetBusContext(gILCAN1_BusContext);
    gCAN1DisturbancePeriod = @sysvar::IL_CAN1::NODES::N_BCM::MESSAGES::PDC_INFO_FD_CADM::TIMINGS::NormalCyclePeriod;
    ILFaultInjectionResetMsgCycleTime(FDCAN2_1::BCM::PDC_INFO_FD_CADM);
  }
  else if (@this == 1 && @sysvar::IL_CAN1::NODES::N_BCM::MESSAGES::PDC_INFO_FD_CADM::TIMINGS::EnableCyclic)
  {
    SetBusContext(gILCAN1_BusContext);
    gCAN1DisturbancePeriod = @sysvar::IL_CAN1::NODES::N_BCM::MESSAGES::PDC_INFO_FD_CADM::TIMINGS::ActiveCyclePeriod;
    ILFaultInjectionSetMsgCycleTime(FDCAN2_1::BCM::PDC_INFO_FD_CADM, gCAN1DisturbancePeriod);
  }
  else if (@this == -1 && @sysvar::IL_CAN1::NODES::N_BCM::MESSAGES::PDC_INFO_FD_CADM::TIMINGS::EnableCyclic)
  {
    SetBusContext(gILCAN1_BusContext);
    gCAN1DisturbancePeriod = @sysvar::IL_CAN1::NODES::N_BCM::MESSAGES::PDC_INFO_FD_CADM::TIMINGS::CyclePeriod;
    ILFaultInjectionSetMsgCycleTime(FDCAN2_1::BCM::PDC_INFO_FD_CADM, gCAN1DisturbancePeriod);
  }
}

on sysvar_update sysvar::IL_CAN1::NODES::N_BCM::MESSAGES::PDC_INFO_FD_CADM::TIMINGS::SendOnce
{
  if (@this == 1)
  {
    SetBusContext(gILCAN1_BusContext);
    ILSetMsgEvent(FDCAN2_1::BCM::PDC_INFO_FD_CADM);
  }
}

on sysvar_update sysvar::IL_CAN1::NODES::N_BCM::MESSAGES::PDC_INFO_FD_DTCM::TIMINGS::EnableCyclic
{
  if (@this == 1)
  {
    SetBusContext(gILCAN1_BusContext);
    ILFaultInjectionEnableMsg  (FDCAN2_1::BCM::PDC_INFO_FD_DTCM);
  }
  else
  {
    SetBusContext(gILCAN1_BusContext);
    ILFaultInjectionDisableMsg (FDCAN2_1::BCM::PDC_INFO_FD_DTCM);
  }
}

on sysvar_update sysvar::IL_CAN1::NODES::N_BCM::MESSAGES::PDC_INFO_FD_DTCM::TIMINGS::SetNormalCycle
{
  if (@this == 1 && @sysvar::IL_CAN1::NODES::N_BCM::MESSAGES::PDC_INFO_FD_DTCM::TIMINGS::EnableCyclic)
  {
    @sysvar::IL_CAN1::NODES::N_BCM::MESSAGES::PDC_INFO_FD_DTCM::TIMINGS::SelectedPeriod = 0;
  }
}

on sysvar_update sysvar::IL_CAN1::NODES::N_BCM::MESSAGES::PDC_INFO_FD_DTCM::TIMINGS::SetNewCycleContinously
{
  if (@this == 1 && @sysvar::IL_CAN1::NODES::N_BCM::MESSAGES::PDC_INFO_FD_DTCM::TIMINGS::EnableCyclic)
  {
    @sysvar::IL_CAN1::NODES::N_BCM::MESSAGES::PDC_INFO_FD_DTCM::TIMINGS::SelectedPeriod = -1;
  }
}

on sysvar_update sysvar::IL_CAN1::NODES::N_BCM::MESSAGES::PDC_INFO_FD_DTCM::TIMINGS::SelectedPeriod
{
  if (@this == 0 && @sysvar::IL_CAN1::NODES::N_BCM::MESSAGES::PDC_INFO_FD_DTCM::TIMINGS::EnableCyclic)
  {
    SetBusContext(gILCAN1_BusContext);
    gCAN1DisturbancePeriod = @sysvar::IL_CAN1::NODES::N_BCM::MESSAGES::PDC_INFO_FD_DTCM::TIMINGS::NormalCyclePeriod;
    ILFaultInjectionResetMsgCycleTime(FDCAN2_1::BCM::PDC_INFO_FD_DTCM);
  }
  else if (@this == 1 && @sysvar::IL_CAN1::NODES::N_BCM::MESSAGES::PDC_INFO_FD_DTCM::TIMINGS::EnableCyclic)
  {
    SetBusContext(gILCAN1_BusContext);
    gCAN1DisturbancePeriod = @sysvar::IL_CAN1::NODES::N_BCM::MESSAGES::PDC_INFO_FD_DTCM::TIMINGS::ActiveCyclePeriod;
    ILFaultInjectionSetMsgCycleTime(FDCAN2_1::BCM::PDC_INFO_FD_DTCM, gCAN1DisturbancePeriod);
  }
  else if (@this == -1 && @sysvar::IL_CAN1::NODES::N_BCM::MESSAGES::PDC_INFO_FD_DTCM::TIMINGS::EnableCyclic)
  {
    SetBusContext(gILCAN1_BusContext);
    gCAN1DisturbancePeriod = @sysvar::IL_CAN1::NODES::N_BCM::MESSAGES::PDC_INFO_FD_DTCM::TIMINGS::CyclePeriod;
    ILFaultInjectionSetMsgCycleTime(FDCAN2_1::BCM::PDC_INFO_FD_DTCM, gCAN1DisturbancePeriod);
  }
}

on sysvar_update sysvar::IL_CAN1::NODES::N_BCM::MESSAGES::PDC_INFO_FD_DTCM::TIMINGS::SendOnce
{
  if (@this == 1)
  {
    SetBusContext(gILCAN1_BusContext);
    ILSetMsgEvent(FDCAN2_1::BCM::PDC_INFO_FD_DTCM);
  }
}

on sysvar_update sysvar::IL_CAN1::NODES::N_BCM::MESSAGES::PDC_INFO_FD_ECM::TIMINGS::EnableCyclic
{
  if (@this == 1)
  {
    SetBusContext(gILCAN1_BusContext);
    ILFaultInjectionEnableMsg  (FDCAN2_1::BCM::PDC_INFO_FD_ECM);
  }
  else
  {
    SetBusContext(gILCAN1_BusContext);
    ILFaultInjectionDisableMsg (FDCAN2_1::BCM::PDC_INFO_FD_ECM);
  }
}

on sysvar_update sysvar::IL_CAN1::NODES::N_BCM::MESSAGES::PDC_INFO_FD_ECM::TIMINGS::SetNormalCycle
{
  if (@this == 1 && @sysvar::IL_CAN1::NODES::N_BCM::MESSAGES::PDC_INFO_FD_ECM::TIMINGS::EnableCyclic)
  {
    @sysvar::IL_CAN1::NODES::N_BCM::MESSAGES::PDC_INFO_FD_ECM::TIMINGS::SelectedPeriod = 0;
  }
}

on sysvar_update sysvar::IL_CAN1::NODES::N_BCM::MESSAGES::PDC_INFO_FD_ECM::TIMINGS::SetNewCycleContinously
{
  if (@this == 1 && @sysvar::IL_CAN1::NODES::N_BCM::MESSAGES::PDC_INFO_FD_ECM::TIMINGS::EnableCyclic)
  {
    @sysvar::IL_CAN1::NODES::N_BCM::MESSAGES::PDC_INFO_FD_ECM::TIMINGS::SelectedPeriod = -1;
  }
}

on sysvar_update sysvar::IL_CAN1::NODES::N_BCM::MESSAGES::PDC_INFO_FD_ECM::TIMINGS::SelectedPeriod
{
  if (@this == 0 && @sysvar::IL_CAN1::NODES::N_BCM::MESSAGES::PDC_INFO_FD_ECM::TIMINGS::EnableCyclic)
  {
    SetBusContext(gILCAN1_BusContext);
    gCAN1DisturbancePeriod = @sysvar::IL_CAN1::NODES::N_BCM::MESSAGES::PDC_INFO_FD_ECM::TIMINGS::NormalCyclePeriod;
    ILFaultInjectionResetMsgCycleTime(FDCAN2_1::BCM::PDC_INFO_FD_ECM);
  }
  else if (@this == 1 && @sysvar::IL_CAN1::NODES::N_BCM::MESSAGES::PDC_INFO_FD_ECM::TIMINGS::EnableCyclic)
  {
    SetBusContext(gILCAN1_BusContext);
    gCAN1DisturbancePeriod = @sysvar::IL_CAN1::NODES::N_BCM::MESSAGES::PDC_INFO_FD_ECM::TIMINGS::ActiveCyclePeriod;
    ILFaultInjectionSetMsgCycleTime(FDCAN2_1::BCM::PDC_INFO_FD_ECM, gCAN1DisturbancePeriod);
  }
  else if (@this == -1 && @sysvar::IL_CAN1::NODES::N_BCM::MESSAGES::PDC_INFO_FD_ECM::TIMINGS::EnableCyclic)
  {
    SetBusContext(gILCAN1_BusContext);
    gCAN1DisturbancePeriod = @sysvar::IL_CAN1::NODES::N_BCM::MESSAGES::PDC_INFO_FD_ECM::TIMINGS::CyclePeriod;
    ILFaultInjectionSetMsgCycleTime(FDCAN2_1::BCM::PDC_INFO_FD_ECM, gCAN1DisturbancePeriod);
  }
}

on sysvar_update sysvar::IL_CAN1::NODES::N_BCM::MESSAGES::PDC_INFO_FD_ECM::TIMINGS::SendOnce
{
  if (@this == 1)
  {
    SetBusContext(gILCAN1_BusContext);
    ILSetMsgEvent(FDCAN2_1::BCM::PDC_INFO_FD_ECM);
  }
}

on sysvar_update sysvar::IL_CAN1::NODES::N_BCM::MESSAGES::PDC_INFO_FD_FLDHM::TIMINGS::EnableCyclic
{
  if (@this == 1)
  {
    SetBusContext(gILCAN1_BusContext);
    ILFaultInjectionEnableMsg  (FDCAN2_1::BCM::PDC_INFO_FD_FLDHM);
  }
  else
  {
    SetBusContext(gILCAN1_BusContext);
    ILFaultInjectionDisableMsg (FDCAN2_1::BCM::PDC_INFO_FD_FLDHM);
  }
}

on sysvar_update sysvar::IL_CAN1::NODES::N_BCM::MESSAGES::PDC_INFO_FD_FLDHM::TIMINGS::SetNormalCycle
{
  if (@this == 1 && @sysvar::IL_CAN1::NODES::N_BCM::MESSAGES::PDC_INFO_FD_FLDHM::TIMINGS::EnableCyclic)
  {
    @sysvar::IL_CAN1::NODES::N_BCM::MESSAGES::PDC_INFO_FD_FLDHM::TIMINGS::SelectedPeriod = 0;
  }
}

on sysvar_update sysvar::IL_CAN1::NODES::N_BCM::MESSAGES::PDC_INFO_FD_FLDHM::TIMINGS::SetNewCycleContinously
{
  if (@this == 1 && @sysvar::IL_CAN1::NODES::N_BCM::MESSAGES::PDC_INFO_FD_FLDHM::TIMINGS::EnableCyclic)
  {
    @sysvar::IL_CAN1::NODES::N_BCM::MESSAGES::PDC_INFO_FD_FLDHM::TIMINGS::SelectedPeriod = -1;
  }
}

on sysvar_update sysvar::IL_CAN1::NODES::N_BCM::MESSAGES::PDC_INFO_FD_FLDHM::TIMINGS::SelectedPeriod
{
  if (@this == 0 && @sysvar::IL_CAN1::NODES::N_BCM::MESSAGES::PDC_INFO_FD_FLDHM::TIMINGS::EnableCyclic)
  {
    SetBusContext(gILCAN1_BusContext);
    gCAN1DisturbancePeriod = @sysvar::IL_CAN1::NODES::N_BCM::MESSAGES::PDC_INFO_FD_FLDHM::TIMINGS::NormalCyclePeriod;
    ILFaultInjectionResetMsgCycleTime(FDCAN2_1::BCM::PDC_INFO_FD_FLDHM);
  }
  else if (@this == 1 && @sysvar::IL_CAN1::NODES::N_BCM::MESSAGES::PDC_INFO_FD_FLDHM::TIMINGS::EnableCyclic)
  {
    SetBusContext(gILCAN1_BusContext);
    gCAN1DisturbancePeriod = @sysvar::IL_CAN1::NODES::N_BCM::MESSAGES::PDC_INFO_FD_FLDHM::TIMINGS::ActiveCyclePeriod;
    ILFaultInjectionSetMsgCycleTime(FDCAN2_1::BCM::PDC_INFO_FD_FLDHM, gCAN1DisturbancePeriod);
  }
  else if (@this == -1 && @sysvar::IL_CAN1::NODES::N_BCM::MESSAGES::PDC_INFO_FD_FLDHM::TIMINGS::EnableCyclic)
  {
    SetBusContext(gILCAN1_BusContext);
    gCAN1DisturbancePeriod = @sysvar::IL_CAN1::NODES::N_BCM::MESSAGES::PDC_INFO_FD_FLDHM::TIMINGS::CyclePeriod;
    ILFaultInjectionSetMsgCycleTime(FDCAN2_1::BCM::PDC_INFO_FD_FLDHM, gCAN1DisturbancePeriod);
  }
}

on sysvar_update sysvar::IL_CAN1::NODES::N_BCM::MESSAGES::PDC_INFO_FD_FLDHM::TIMINGS::SendOnce
{
  if (@this == 1)
  {
    SetBusContext(gILCAN1_BusContext);
    ILSetMsgEvent(FDCAN2_1::BCM::PDC_INFO_FD_FLDHM);
  }
}

on sysvar_update sysvar::IL_CAN1::NODES::N_BCM::MESSAGES::PDC_INFO_FD_FRDHM::TIMINGS::EnableCyclic
{
  if (@this == 1)
  {
    SetBusContext(gILCAN1_BusContext);
    ILFaultInjectionEnableMsg  (FDCAN2_1::BCM::PDC_INFO_FD_FRDHM);
  }
  else
  {
    SetBusContext(gILCAN1_BusContext);
    ILFaultInjectionDisableMsg (FDCAN2_1::BCM::PDC_INFO_FD_FRDHM);
  }
}

on sysvar_update sysvar::IL_CAN1::NODES::N_BCM::MESSAGES::PDC_INFO_FD_FRDHM::TIMINGS::SetNormalCycle
{
  if (@this == 1 && @sysvar::IL_CAN1::NODES::N_BCM::MESSAGES::PDC_INFO_FD_FRDHM::TIMINGS::EnableCyclic)
  {
    @sysvar::IL_CAN1::NODES::N_BCM::MESSAGES::PDC_INFO_FD_FRDHM::TIMINGS::SelectedPeriod = 0;
  }
}

on sysvar_update sysvar::IL_CAN1::NODES::N_BCM::MESSAGES::PDC_INFO_FD_FRDHM::TIMINGS::SetNewCycleContinously
{
  if (@this == 1 && @sysvar::IL_CAN1::NODES::N_BCM::MESSAGES::PDC_INFO_FD_FRDHM::TIMINGS::EnableCyclic)
  {
    @sysvar::IL_CAN1::NODES::N_BCM::MESSAGES::PDC_INFO_FD_FRDHM::TIMINGS::SelectedPeriod = -1;
  }
}

on sysvar_update sysvar::IL_CAN1::NODES::N_BCM::MESSAGES::PDC_INFO_FD_FRDHM::TIMINGS::SelectedPeriod
{
  if (@this == 0 && @sysvar::IL_CAN1::NODES::N_BCM::MESSAGES::PDC_INFO_FD_FRDHM::TIMINGS::EnableCyclic)
  {
    SetBusContext(gILCAN1_BusContext);
    gCAN1DisturbancePeriod = @sysvar::IL_CAN1::NODES::N_BCM::MESSAGES::PDC_INFO_FD_FRDHM::TIMINGS::NormalCyclePeriod;
    ILFaultInjectionResetMsgCycleTime(FDCAN2_1::BCM::PDC_INFO_FD_FRDHM);
  }
  else if (@this == 1 && @sysvar::IL_CAN1::NODES::N_BCM::MESSAGES::PDC_INFO_FD_FRDHM::TIMINGS::EnableCyclic)
  {
    SetBusContext(gILCAN1_BusContext);
    gCAN1DisturbancePeriod = @sysvar::IL_CAN1::NODES::N_BCM::MESSAGES::PDC_INFO_FD_FRDHM::TIMINGS::ActiveCyclePeriod;
    ILFaultInjectionSetMsgCycleTime(FDCAN2_1::BCM::PDC_INFO_FD_FRDHM, gCAN1DisturbancePeriod);
  }
  else if (@this == -1 && @sysvar::IL_CAN1::NODES::N_BCM::MESSAGES::PDC_INFO_FD_FRDHM::TIMINGS::EnableCyclic)
  {
    SetBusContext(gILCAN1_BusContext);
    gCAN1DisturbancePeriod = @sysvar::IL_CAN1::NODES::N_BCM::MESSAGES::PDC_INFO_FD_FRDHM::TIMINGS::CyclePeriod;
    ILFaultInjectionSetMsgCycleTime(FDCAN2_1::BCM::PDC_INFO_FD_FRDHM, gCAN1DisturbancePeriod);
  }
}

on sysvar_update sysvar::IL_CAN1::NODES::N_BCM::MESSAGES::PDC_INFO_FD_FRDHM::TIMINGS::SendOnce
{
  if (@this == 1)
  {
    SetBusContext(gILCAN1_BusContext);
    ILSetMsgEvent(FDCAN2_1::BCM::PDC_INFO_FD_FRDHM);
  }
}

on sysvar_update sysvar::IL_CAN1::NODES::N_BCM::MESSAGES::PDC_INFO_FD_GNMM::TIMINGS::EnableCyclic
{
  if (@this == 1)
  {
    SetBusContext(gILCAN1_BusContext);
    ILFaultInjectionEnableMsg  (FDCAN2_1::BCM::PDC_INFO_FD_GNMM);
  }
  else
  {
    SetBusContext(gILCAN1_BusContext);
    ILFaultInjectionDisableMsg (FDCAN2_1::BCM::PDC_INFO_FD_GNMM);
  }
}

on sysvar_update sysvar::IL_CAN1::NODES::N_BCM::MESSAGES::PDC_INFO_FD_GNMM::TIMINGS::SetNormalCycle
{
  if (@this == 1 && @sysvar::IL_CAN1::NODES::N_BCM::MESSAGES::PDC_INFO_FD_GNMM::TIMINGS::EnableCyclic)
  {
    @sysvar::IL_CAN1::NODES::N_BCM::MESSAGES::PDC_INFO_FD_GNMM::TIMINGS::SelectedPeriod = 0;
  }
}

on sysvar_update sysvar::IL_CAN1::NODES::N_BCM::MESSAGES::PDC_INFO_FD_GNMM::TIMINGS::SetNewCycleContinously
{
  if (@this == 1 && @sysvar::IL_CAN1::NODES::N_BCM::MESSAGES::PDC_INFO_FD_GNMM::TIMINGS::EnableCyclic)
  {
    @sysvar::IL_CAN1::NODES::N_BCM::MESSAGES::PDC_INFO_FD_GNMM::TIMINGS::SelectedPeriod = -1;
  }
}

on sysvar_update sysvar::IL_CAN1::NODES::N_BCM::MESSAGES::PDC_INFO_FD_GNMM::TIMINGS::SelectedPeriod
{
  if (@this == 0 && @sysvar::IL_CAN1::NODES::N_BCM::MESSAGES::PDC_INFO_FD_GNMM::TIMINGS::EnableCyclic)
  {
    SetBusContext(gILCAN1_BusContext);
    gCAN1DisturbancePeriod = @sysvar::IL_CAN1::NODES::N_BCM::MESSAGES::PDC_INFO_FD_GNMM::TIMINGS::NormalCyclePeriod;
    ILFaultInjectionResetMsgCycleTime(FDCAN2_1::BCM::PDC_INFO_FD_GNMM);
  }
  else if (@this == 1 && @sysvar::IL_CAN1::NODES::N_BCM::MESSAGES::PDC_INFO_FD_GNMM::TIMINGS::EnableCyclic)
  {
    SetBusContext(gILCAN1_BusContext);
    gCAN1DisturbancePeriod = @sysvar::IL_CAN1::NODES::N_BCM::MESSAGES::PDC_INFO_FD_GNMM::TIMINGS::ActiveCyclePeriod;
    ILFaultInjectionSetMsgCycleTime(FDCAN2_1::BCM::PDC_INFO_FD_GNMM, gCAN1DisturbancePeriod);
  }
  else if (@this == -1 && @sysvar::IL_CAN1::NODES::N_BCM::MESSAGES::PDC_INFO_FD_GNMM::TIMINGS::EnableCyclic)
  {
    SetBusContext(gILCAN1_BusContext);
    gCAN1DisturbancePeriod = @sysvar::IL_CAN1::NODES::N_BCM::MESSAGES::PDC_INFO_FD_GNMM::TIMINGS::CyclePeriod;
    ILFaultInjectionSetMsgCycleTime(FDCAN2_1::BCM::PDC_INFO_FD_GNMM, gCAN1DisturbancePeriod);
  }
}

on sysvar_update sysvar::IL_CAN1::NODES::N_BCM::MESSAGES::PDC_INFO_FD_GNMM::TIMINGS::SendOnce
{
  if (@this == 1)
  {
    SetBusContext(gILCAN1_BusContext);
    ILSetMsgEvent(FDCAN2_1::BCM::PDC_INFO_FD_GNMM);
  }
}

on sysvar_update sysvar::IL_CAN1::NODES::N_BCM::MESSAGES::PDC_INFO_FD_HCP::TIMINGS::EnableCyclic
{
  if (@this == 1)
  {
    SetBusContext(gILCAN1_BusContext);
    ILFaultInjectionEnableMsg  (FDCAN2_1::BCM::PDC_INFO_FD_HCP);
  }
  else
  {
    SetBusContext(gILCAN1_BusContext);
    ILFaultInjectionDisableMsg (FDCAN2_1::BCM::PDC_INFO_FD_HCP);
  }
}

on sysvar_update sysvar::IL_CAN1::NODES::N_BCM::MESSAGES::PDC_INFO_FD_HCP::TIMINGS::SetNormalCycle
{
  if (@this == 1 && @sysvar::IL_CAN1::NODES::N_BCM::MESSAGES::PDC_INFO_FD_HCP::TIMINGS::EnableCyclic)
  {
    @sysvar::IL_CAN1::NODES::N_BCM::MESSAGES::PDC_INFO_FD_HCP::TIMINGS::SelectedPeriod = 0;
  }
}

on sysvar_update sysvar::IL_CAN1::NODES::N_BCM::MESSAGES::PDC_INFO_FD_HCP::TIMINGS::SetNewCycleContinously
{
  if (@this == 1 && @sysvar::IL_CAN1::NODES::N_BCM::MESSAGES::PDC_INFO_FD_HCP::TIMINGS::EnableCyclic)
  {
    @sysvar::IL_CAN1::NODES::N_BCM::MESSAGES::PDC_INFO_FD_HCP::TIMINGS::SelectedPeriod = -1;
  }
}

on sysvar_update sysvar::IL_CAN1::NODES::N_BCM::MESSAGES::PDC_INFO_FD_HCP::TIMINGS::SelectedPeriod
{
  if (@this == 0 && @sysvar::IL_CAN1::NODES::N_BCM::MESSAGES::PDC_INFO_FD_HCP::TIMINGS::EnableCyclic)
  {
    SetBusContext(gILCAN1_BusContext);
    gCAN1DisturbancePeriod = @sysvar::IL_CAN1::NODES::N_BCM::MESSAGES::PDC_INFO_FD_HCP::TIMINGS::NormalCyclePeriod;
    ILFaultInjectionResetMsgCycleTime(FDCAN2_1::BCM::PDC_INFO_FD_HCP);
  }
  else if (@this == 1 && @sysvar::IL_CAN1::NODES::N_BCM::MESSAGES::PDC_INFO_FD_HCP::TIMINGS::EnableCyclic)
  {
    SetBusContext(gILCAN1_BusContext);
    gCAN1DisturbancePeriod = @sysvar::IL_CAN1::NODES::N_BCM::MESSAGES::PDC_INFO_FD_HCP::TIMINGS::ActiveCyclePeriod;
    ILFaultInjectionSetMsgCycleTime(FDCAN2_1::BCM::PDC_INFO_FD_HCP, gCAN1DisturbancePeriod);
  }
  else if (@this == -1 && @sysvar::IL_CAN1::NODES::N_BCM::MESSAGES::PDC_INFO_FD_HCP::TIMINGS::EnableCyclic)
  {
    SetBusContext(gILCAN1_BusContext);
    gCAN1DisturbancePeriod = @sysvar::IL_CAN1::NODES::N_BCM::MESSAGES::PDC_INFO_FD_HCP::TIMINGS::CyclePeriod;
    ILFaultInjectionSetMsgCycleTime(FDCAN2_1::BCM::PDC_INFO_FD_HCP, gCAN1DisturbancePeriod);
  }
}

on sysvar_update sysvar::IL_CAN1::NODES::N_BCM::MESSAGES::PDC_INFO_FD_HCP::TIMINGS::SendOnce
{
  if (@this == 1)
  {
    SetBusContext(gILCAN1_BusContext);
    ILSetMsgEvent(FDCAN2_1::BCM::PDC_INFO_FD_HCP);
  }
}

on sysvar_update sysvar::IL_CAN1::NODES::N_BCM::MESSAGES::PDC_INFO_FD_IPC::TIMINGS::EnableCyclic
{
  if (@this == 1)
  {
    SetBusContext(gILCAN1_BusContext);
    ILFaultInjectionEnableMsg  (FDCAN2_1::BCM::PDC_INFO_FD_IPC);
  }
  else
  {
    SetBusContext(gILCAN1_BusContext);
    ILFaultInjectionDisableMsg (FDCAN2_1::BCM::PDC_INFO_FD_IPC);
  }
}

on sysvar_update sysvar::IL_CAN1::NODES::N_BCM::MESSAGES::PDC_INFO_FD_IPC::TIMINGS::SetNormalCycle
{
  if (@this == 1 && @sysvar::IL_CAN1::NODES::N_BCM::MESSAGES::PDC_INFO_FD_IPC::TIMINGS::EnableCyclic)
  {
    @sysvar::IL_CAN1::NODES::N_BCM::MESSAGES::PDC_INFO_FD_IPC::TIMINGS::SelectedPeriod = 0;
  }
}

on sysvar_update sysvar::IL_CAN1::NODES::N_BCM::MESSAGES::PDC_INFO_FD_IPC::TIMINGS::SetNewCycleContinously
{
  if (@this == 1 && @sysvar::IL_CAN1::NODES::N_BCM::MESSAGES::PDC_INFO_FD_IPC::TIMINGS::EnableCyclic)
  {
    @sysvar::IL_CAN1::NODES::N_BCM::MESSAGES::PDC_INFO_FD_IPC::TIMINGS::SelectedPeriod = -1;
  }
}

on sysvar_update sysvar::IL_CAN1::NODES::N_BCM::MESSAGES::PDC_INFO_FD_IPC::TIMINGS::SelectedPeriod
{
  if (@this == 0 && @sysvar::IL_CAN1::NODES::N_BCM::MESSAGES::PDC_INFO_FD_IPC::TIMINGS::EnableCyclic)
  {
    SetBusContext(gILCAN1_BusContext);
    gCAN1DisturbancePeriod = @sysvar::IL_CAN1::NODES::N_BCM::MESSAGES::PDC_INFO_FD_IPC::TIMINGS::NormalCyclePeriod;
    ILFaultInjectionResetMsgCycleTime(FDCAN2_1::BCM::PDC_INFO_FD_IPC);
  }
  else if (@this == 1 && @sysvar::IL_CAN1::NODES::N_BCM::MESSAGES::PDC_INFO_FD_IPC::TIMINGS::EnableCyclic)
  {
    SetBusContext(gILCAN1_BusContext);
    gCAN1DisturbancePeriod = @sysvar::IL_CAN1::NODES::N_BCM::MESSAGES::PDC_INFO_FD_IPC::TIMINGS::ActiveCyclePeriod;
    ILFaultInjectionSetMsgCycleTime(FDCAN2_1::BCM::PDC_INFO_FD_IPC, gCAN1DisturbancePeriod);
  }
  else if (@this == -1 && @sysvar::IL_CAN1::NODES::N_BCM::MESSAGES::PDC_INFO_FD_IPC::TIMINGS::EnableCyclic)
  {
    SetBusContext(gILCAN1_BusContext);
    gCAN1DisturbancePeriod = @sysvar::IL_CAN1::NODES::N_BCM::MESSAGES::PDC_INFO_FD_IPC::TIMINGS::CyclePeriod;
    ILFaultInjectionSetMsgCycleTime(FDCAN2_1::BCM::PDC_INFO_FD_IPC, gCAN1DisturbancePeriod);
  }
}

on sysvar_update sysvar::IL_CAN1::NODES::N_BCM::MESSAGES::PDC_INFO_FD_IPC::TIMINGS::SendOnce
{
  if (@this == 1)
  {
    SetBusContext(gILCAN1_BusContext);
    ILSetMsgEvent(FDCAN2_1::BCM::PDC_INFO_FD_IPC);
  }
}

on sysvar_update sysvar::IL_CAN1::NODES::N_BCM::MESSAGES::PDC_INFO_FD_RFHM::TIMINGS::EnableCyclic
{
  if (@this == 1)
  {
    SetBusContext(gILCAN1_BusContext);
    ILFaultInjectionEnableMsg  (FDCAN2_1::BCM::PDC_INFO_FD_RFHM);
  }
  else
  {
    SetBusContext(gILCAN1_BusContext);
    ILFaultInjectionDisableMsg (FDCAN2_1::BCM::PDC_INFO_FD_RFHM);
  }
}

on sysvar_update sysvar::IL_CAN1::NODES::N_BCM::MESSAGES::PDC_INFO_FD_RFHM::TIMINGS::SetNormalCycle
{
  if (@this == 1 && @sysvar::IL_CAN1::NODES::N_BCM::MESSAGES::PDC_INFO_FD_RFHM::TIMINGS::EnableCyclic)
  {
    @sysvar::IL_CAN1::NODES::N_BCM::MESSAGES::PDC_INFO_FD_RFHM::TIMINGS::SelectedPeriod = 0;
  }
}

on sysvar_update sysvar::IL_CAN1::NODES::N_BCM::MESSAGES::PDC_INFO_FD_RFHM::TIMINGS::SetNewCycleContinously
{
  if (@this == 1 && @sysvar::IL_CAN1::NODES::N_BCM::MESSAGES::PDC_INFO_FD_RFHM::TIMINGS::EnableCyclic)
  {
    @sysvar::IL_CAN1::NODES::N_BCM::MESSAGES::PDC_INFO_FD_RFHM::TIMINGS::SelectedPeriod = -1;
  }
}

on sysvar_update sysvar::IL_CAN1::NODES::N_BCM::MESSAGES::PDC_INFO_FD_RFHM::TIMINGS::SelectedPeriod
{
  if (@this == 0 && @sysvar::IL_CAN1::NODES::N_BCM::MESSAGES::PDC_INFO_FD_RFHM::TIMINGS::EnableCyclic)
  {
    SetBusContext(gILCAN1_BusContext);
    gCAN1DisturbancePeriod = @sysvar::IL_CAN1::NODES::N_BCM::MESSAGES::PDC_INFO_FD_RFHM::TIMINGS::NormalCyclePeriod;
    ILFaultInjectionResetMsgCycleTime(FDCAN2_1::BCM::PDC_INFO_FD_RFHM);
  }
  else if (@this == 1 && @sysvar::IL_CAN1::NODES::N_BCM::MESSAGES::PDC_INFO_FD_RFHM::TIMINGS::EnableCyclic)
  {
    SetBusContext(gILCAN1_BusContext);
    gCAN1DisturbancePeriod = @sysvar::IL_CAN1::NODES::N_BCM::MESSAGES::PDC_INFO_FD_RFHM::TIMINGS::ActiveCyclePeriod;
    ILFaultInjectionSetMsgCycleTime(FDCAN2_1::BCM::PDC_INFO_FD_RFHM, gCAN1DisturbancePeriod);
  }
  else if (@this == -1 && @sysvar::IL_CAN1::NODES::N_BCM::MESSAGES::PDC_INFO_FD_RFHM::TIMINGS::EnableCyclic)
  {
    SetBusContext(gILCAN1_BusContext);
    gCAN1DisturbancePeriod = @sysvar::IL_CAN1::NODES::N_BCM::MESSAGES::PDC_INFO_FD_RFHM::TIMINGS::CyclePeriod;
    ILFaultInjectionSetMsgCycleTime(FDCAN2_1::BCM::PDC_INFO_FD_RFHM, gCAN1DisturbancePeriod);
  }
}

on sysvar_update sysvar::IL_CAN1::NODES::N_BCM::MESSAGES::PDC_INFO_FD_RFHM::TIMINGS::SendOnce
{
  if (@this == 1)
  {
    SetBusContext(gILCAN1_BusContext);
    ILSetMsgEvent(FDCAN2_1::BCM::PDC_INFO_FD_RFHM);
  }
}

on sysvar_update sysvar::IL_CAN1::NODES::N_BCM::MESSAGES::PDC_INFO_FD_SLML::TIMINGS::EnableCyclic
{
  if (@this == 1)
  {
    SetBusContext(gILCAN1_BusContext);
    ILFaultInjectionEnableMsg  (FDCAN2_1::BCM::PDC_INFO_FD_SLML);
  }
  else
  {
    SetBusContext(gILCAN1_BusContext);
    ILFaultInjectionDisableMsg (FDCAN2_1::BCM::PDC_INFO_FD_SLML);
  }
}

on sysvar_update sysvar::IL_CAN1::NODES::N_BCM::MESSAGES::PDC_INFO_FD_SLML::TIMINGS::SetNormalCycle
{
  if (@this == 1 && @sysvar::IL_CAN1::NODES::N_BCM::MESSAGES::PDC_INFO_FD_SLML::TIMINGS::EnableCyclic)
  {
    @sysvar::IL_CAN1::NODES::N_BCM::MESSAGES::PDC_INFO_FD_SLML::TIMINGS::SelectedPeriod = 0;
  }
}

on sysvar_update sysvar::IL_CAN1::NODES::N_BCM::MESSAGES::PDC_INFO_FD_SLML::TIMINGS::SetNewCycleContinously
{
  if (@this == 1 && @sysvar::IL_CAN1::NODES::N_BCM::MESSAGES::PDC_INFO_FD_SLML::TIMINGS::EnableCyclic)
  {
    @sysvar::IL_CAN1::NODES::N_BCM::MESSAGES::PDC_INFO_FD_SLML::TIMINGS::SelectedPeriod = -1;
  }
}

on sysvar_update sysvar::IL_CAN1::NODES::N_BCM::MESSAGES::PDC_INFO_FD_SLML::TIMINGS::SelectedPeriod
{
  if (@this == 0 && @sysvar::IL_CAN1::NODES::N_BCM::MESSAGES::PDC_INFO_FD_SLML::TIMINGS::EnableCyclic)
  {
    SetBusContext(gILCAN1_BusContext);
    gCAN1DisturbancePeriod = @sysvar::IL_CAN1::NODES::N_BCM::MESSAGES::PDC_INFO_FD_SLML::TIMINGS::NormalCyclePeriod;
    ILFaultInjectionResetMsgCycleTime(FDCAN2_1::BCM::PDC_INFO_FD_SLML);
  }
  else if (@this == 1 && @sysvar::IL_CAN1::NODES::N_BCM::MESSAGES::PDC_INFO_FD_SLML::TIMINGS::EnableCyclic)
  {
    SetBusContext(gILCAN1_BusContext);
    gCAN1DisturbancePeriod = @sysvar::IL_CAN1::NODES::N_BCM::MESSAGES::PDC_INFO_FD_SLML::TIMINGS::ActiveCyclePeriod;
    ILFaultInjectionSetMsgCycleTime(FDCAN2_1::BCM::PDC_INFO_FD_SLML, gCAN1DisturbancePeriod);
  }
  else if (@this == -1 && @sysvar::IL_CAN1::NODES::N_BCM::MESSAGES::PDC_INFO_FD_SLML::TIMINGS::EnableCyclic)
  {
    SetBusContext(gILCAN1_BusContext);
    gCAN1DisturbancePeriod = @sysvar::IL_CAN1::NODES::N_BCM::MESSAGES::PDC_INFO_FD_SLML::TIMINGS::CyclePeriod;
    ILFaultInjectionSetMsgCycleTime(FDCAN2_1::BCM::PDC_INFO_FD_SLML, gCAN1DisturbancePeriod);
  }
}

on sysvar_update sysvar::IL_CAN1::NODES::N_BCM::MESSAGES::PDC_INFO_FD_SLML::TIMINGS::SendOnce
{
  if (@this == 1)
  {
    SetBusContext(gILCAN1_BusContext);
    ILSetMsgEvent(FDCAN2_1::BCM::PDC_INFO_FD_SLML);
  }
}

on sysvar_update sysvar::IL_CAN1::NODES::N_BCM::MESSAGES::PDC_INFO_FD_SLMR::TIMINGS::EnableCyclic
{
  if (@this == 1)
  {
    SetBusContext(gILCAN1_BusContext);
    ILFaultInjectionEnableMsg  (FDCAN2_1::BCM::PDC_INFO_FD_SLMR);
  }
  else
  {
    SetBusContext(gILCAN1_BusContext);
    ILFaultInjectionDisableMsg (FDCAN2_1::BCM::PDC_INFO_FD_SLMR);
  }
}

on sysvar_update sysvar::IL_CAN1::NODES::N_BCM::MESSAGES::PDC_INFO_FD_SLMR::TIMINGS::SetNormalCycle
{
  if (@this == 1 && @sysvar::IL_CAN1::NODES::N_BCM::MESSAGES::PDC_INFO_FD_SLMR::TIMINGS::EnableCyclic)
  {
    @sysvar::IL_CAN1::NODES::N_BCM::MESSAGES::PDC_INFO_FD_SLMR::TIMINGS::SelectedPeriod = 0;
  }
}

on sysvar_update sysvar::IL_CAN1::NODES::N_BCM::MESSAGES::PDC_INFO_FD_SLMR::TIMINGS::SetNewCycleContinously
{
  if (@this == 1 && @sysvar::IL_CAN1::NODES::N_BCM::MESSAGES::PDC_INFO_FD_SLMR::TIMINGS::EnableCyclic)
  {
    @sysvar::IL_CAN1::NODES::N_BCM::MESSAGES::PDC_INFO_FD_SLMR::TIMINGS::SelectedPeriod = -1;
  }
}

on sysvar_update sysvar::IL_CAN1::NODES::N_BCM::MESSAGES::PDC_INFO_FD_SLMR::TIMINGS::SelectedPeriod
{
  if (@this == 0 && @sysvar::IL_CAN1::NODES::N_BCM::MESSAGES::PDC_INFO_FD_SLMR::TIMINGS::EnableCyclic)
  {
    SetBusContext(gILCAN1_BusContext);
    gCAN1DisturbancePeriod = @sysvar::IL_CAN1::NODES::N_BCM::MESSAGES::PDC_INFO_FD_SLMR::TIMINGS::NormalCyclePeriod;
    ILFaultInjectionResetMsgCycleTime(FDCAN2_1::BCM::PDC_INFO_FD_SLMR);
  }
  else if (@this == 1 && @sysvar::IL_CAN1::NODES::N_BCM::MESSAGES::PDC_INFO_FD_SLMR::TIMINGS::EnableCyclic)
  {
    SetBusContext(gILCAN1_BusContext);
    gCAN1DisturbancePeriod = @sysvar::IL_CAN1::NODES::N_BCM::MESSAGES::PDC_INFO_FD_SLMR::TIMINGS::ActiveCyclePeriod;
    ILFaultInjectionSetMsgCycleTime(FDCAN2_1::BCM::PDC_INFO_FD_SLMR, gCAN1DisturbancePeriod);
  }
  else if (@this == -1 && @sysvar::IL_CAN1::NODES::N_BCM::MESSAGES::PDC_INFO_FD_SLMR::TIMINGS::EnableCyclic)
  {
    SetBusContext(gILCAN1_BusContext);
    gCAN1DisturbancePeriod = @sysvar::IL_CAN1::NODES::N_BCM::MESSAGES::PDC_INFO_FD_SLMR::TIMINGS::CyclePeriod;
    ILFaultInjectionSetMsgCycleTime(FDCAN2_1::BCM::PDC_INFO_FD_SLMR, gCAN1DisturbancePeriod);
  }
}

on sysvar_update sysvar::IL_CAN1::NODES::N_BCM::MESSAGES::PDC_INFO_FD_SLMR::TIMINGS::SendOnce
{
  if (@this == 1)
  {
    SetBusContext(gILCAN1_BusContext);
    ILSetMsgEvent(FDCAN2_1::BCM::PDC_INFO_FD_SLMR);
  }
}

on sysvar_update sysvar::IL_CAN1::NODES::N_BCM::MESSAGES::PDC_INFO_FD_SPAAK::TIMINGS::EnableCyclic
{
  if (@this == 1)
  {
    SetBusContext(gILCAN1_BusContext);
    ILFaultInjectionEnableMsg  (FDCAN2_1::BCM::PDC_INFO_FD_SPAAK);
  }
  else
  {
    SetBusContext(gILCAN1_BusContext);
    ILFaultInjectionDisableMsg (FDCAN2_1::BCM::PDC_INFO_FD_SPAAK);
  }
}

on sysvar_update sysvar::IL_CAN1::NODES::N_BCM::MESSAGES::PDC_INFO_FD_SPAAK::TIMINGS::SetNormalCycle
{
  if (@this == 1 && @sysvar::IL_CAN1::NODES::N_BCM::MESSAGES::PDC_INFO_FD_SPAAK::TIMINGS::EnableCyclic)
  {
    @sysvar::IL_CAN1::NODES::N_BCM::MESSAGES::PDC_INFO_FD_SPAAK::TIMINGS::SelectedPeriod = 0;
  }
}

on sysvar_update sysvar::IL_CAN1::NODES::N_BCM::MESSAGES::PDC_INFO_FD_SPAAK::TIMINGS::SetNewCycleContinously
{
  if (@this == 1 && @sysvar::IL_CAN1::NODES::N_BCM::MESSAGES::PDC_INFO_FD_SPAAK::TIMINGS::EnableCyclic)
  {
    @sysvar::IL_CAN1::NODES::N_BCM::MESSAGES::PDC_INFO_FD_SPAAK::TIMINGS::SelectedPeriod = -1;
  }
}

on sysvar_update sysvar::IL_CAN1::NODES::N_BCM::MESSAGES::PDC_INFO_FD_SPAAK::TIMINGS::SelectedPeriod
{
  if (@this == 0 && @sysvar::IL_CAN1::NODES::N_BCM::MESSAGES::PDC_INFO_FD_SPAAK::TIMINGS::EnableCyclic)
  {
    SetBusContext(gILCAN1_BusContext);
    gCAN1DisturbancePeriod = @sysvar::IL_CAN1::NODES::N_BCM::MESSAGES::PDC_INFO_FD_SPAAK::TIMINGS::NormalCyclePeriod;
    ILFaultInjectionResetMsgCycleTime(FDCAN2_1::BCM::PDC_INFO_FD_SPAAK);
  }
  else if (@this == 1 && @sysvar::IL_CAN1::NODES::N_BCM::MESSAGES::PDC_INFO_FD_SPAAK::TIMINGS::EnableCyclic)
  {
    SetBusContext(gILCAN1_BusContext);
    gCAN1DisturbancePeriod = @sysvar::IL_CAN1::NODES::N_BCM::MESSAGES::PDC_INFO_FD_SPAAK::TIMINGS::ActiveCyclePeriod;
    ILFaultInjectionSetMsgCycleTime(FDCAN2_1::BCM::PDC_INFO_FD_SPAAK, gCAN1DisturbancePeriod);
  }
  else if (@this == -1 && @sysvar::IL_CAN1::NODES::N_BCM::MESSAGES::PDC_INFO_FD_SPAAK::TIMINGS::EnableCyclic)
  {
    SetBusContext(gILCAN1_BusContext);
    gCAN1DisturbancePeriod = @sysvar::IL_CAN1::NODES::N_BCM::MESSAGES::PDC_INFO_FD_SPAAK::TIMINGS::CyclePeriod;
    ILFaultInjectionSetMsgCycleTime(FDCAN2_1::BCM::PDC_INFO_FD_SPAAK, gCAN1DisturbancePeriod);
  }
}

on sysvar_update sysvar::IL_CAN1::NODES::N_BCM::MESSAGES::PDC_INFO_FD_SPAAK::TIMINGS::SendOnce
{
  if (@this == 1)
  {
    SetBusContext(gILCAN1_BusContext);
    ILSetMsgEvent(FDCAN2_1::BCM::PDC_INFO_FD_SPAAK);
  }
}

on sysvar_update sysvar::IL_CAN1::NODES::N_BCM::MESSAGES::PDC_INFO_FD_TCM::TIMINGS::EnableCyclic
{
  if (@this == 1)
  {
    SetBusContext(gILCAN1_BusContext);
    ILFaultInjectionEnableMsg  (FDCAN2_1::BCM::PDC_INFO_FD_TCM);
  }
  else
  {
    SetBusContext(gILCAN1_BusContext);
    ILFaultInjectionDisableMsg (FDCAN2_1::BCM::PDC_INFO_FD_TCM);
  }
}

on sysvar_update sysvar::IL_CAN1::NODES::N_BCM::MESSAGES::PDC_INFO_FD_TCM::TIMINGS::SetNormalCycle
{
  if (@this == 1 && @sysvar::IL_CAN1::NODES::N_BCM::MESSAGES::PDC_INFO_FD_TCM::TIMINGS::EnableCyclic)
  {
    @sysvar::IL_CAN1::NODES::N_BCM::MESSAGES::PDC_INFO_FD_TCM::TIMINGS::SelectedPeriod = 0;
  }
}

on sysvar_update sysvar::IL_CAN1::NODES::N_BCM::MESSAGES::PDC_INFO_FD_TCM::TIMINGS::SetNewCycleContinously
{
  if (@this == 1 && @sysvar::IL_CAN1::NODES::N_BCM::MESSAGES::PDC_INFO_FD_TCM::TIMINGS::EnableCyclic)
  {
    @sysvar::IL_CAN1::NODES::N_BCM::MESSAGES::PDC_INFO_FD_TCM::TIMINGS::SelectedPeriod = -1;
  }
}

on sysvar_update sysvar::IL_CAN1::NODES::N_BCM::MESSAGES::PDC_INFO_FD_TCM::TIMINGS::SelectedPeriod
{
  if (@this == 0 && @sysvar::IL_CAN1::NODES::N_BCM::MESSAGES::PDC_INFO_FD_TCM::TIMINGS::EnableCyclic)
  {
    SetBusContext(gILCAN1_BusContext);
    gCAN1DisturbancePeriod = @sysvar::IL_CAN1::NODES::N_BCM::MESSAGES::PDC_INFO_FD_TCM::TIMINGS::NormalCyclePeriod;
    ILFaultInjectionResetMsgCycleTime(FDCAN2_1::BCM::PDC_INFO_FD_TCM);
  }
  else if (@this == 1 && @sysvar::IL_CAN1::NODES::N_BCM::MESSAGES::PDC_INFO_FD_TCM::TIMINGS::EnableCyclic)
  {
    SetBusContext(gILCAN1_BusContext);
    gCAN1DisturbancePeriod = @sysvar::IL_CAN1::NODES::N_BCM::MESSAGES::PDC_INFO_FD_TCM::TIMINGS::ActiveCyclePeriod;
    ILFaultInjectionSetMsgCycleTime(FDCAN2_1::BCM::PDC_INFO_FD_TCM, gCAN1DisturbancePeriod);
  }
  else if (@this == -1 && @sysvar::IL_CAN1::NODES::N_BCM::MESSAGES::PDC_INFO_FD_TCM::TIMINGS::EnableCyclic)
  {
    SetBusContext(gILCAN1_BusContext);
    gCAN1DisturbancePeriod = @sysvar::IL_CAN1::NODES::N_BCM::MESSAGES::PDC_INFO_FD_TCM::TIMINGS::CyclePeriod;
    ILFaultInjectionSetMsgCycleTime(FDCAN2_1::BCM::PDC_INFO_FD_TCM, gCAN1DisturbancePeriod);
  }
}

on sysvar_update sysvar::IL_CAN1::NODES::N_BCM::MESSAGES::PDC_INFO_FD_TCM::TIMINGS::SendOnce
{
  if (@this == 1)
  {
    SetBusContext(gILCAN1_BusContext);
    ILSetMsgEvent(FDCAN2_1::BCM::PDC_INFO_FD_TCM);
  }
}

on sysvar_update sysvar::IL_CAN1::NODES::N_BCM::MESSAGES::PDC_INFO_FD_UWBS1::TIMINGS::EnableCyclic
{
  if (@this == 1)
  {
    SetBusContext(gILCAN1_BusContext);
    ILFaultInjectionEnableMsg  (FDCAN2_1::BCM::PDC_INFO_FD_UWBS1);
  }
  else
  {
    SetBusContext(gILCAN1_BusContext);
    ILFaultInjectionDisableMsg (FDCAN2_1::BCM::PDC_INFO_FD_UWBS1);
  }
}

on sysvar_update sysvar::IL_CAN1::NODES::N_BCM::MESSAGES::PDC_INFO_FD_UWBS1::TIMINGS::SetNormalCycle
{
  if (@this == 1 && @sysvar::IL_CAN1::NODES::N_BCM::MESSAGES::PDC_INFO_FD_UWBS1::TIMINGS::EnableCyclic)
  {
    @sysvar::IL_CAN1::NODES::N_BCM::MESSAGES::PDC_INFO_FD_UWBS1::TIMINGS::SelectedPeriod = 0;
  }
}

on sysvar_update sysvar::IL_CAN1::NODES::N_BCM::MESSAGES::PDC_INFO_FD_UWBS1::TIMINGS::SetNewCycleContinously
{
  if (@this == 1 && @sysvar::IL_CAN1::NODES::N_BCM::MESSAGES::PDC_INFO_FD_UWBS1::TIMINGS::EnableCyclic)
  {
    @sysvar::IL_CAN1::NODES::N_BCM::MESSAGES::PDC_INFO_FD_UWBS1::TIMINGS::SelectedPeriod = -1;
  }
}

on sysvar_update sysvar::IL_CAN1::NODES::N_BCM::MESSAGES::PDC_INFO_FD_UWBS1::TIMINGS::SelectedPeriod
{
  if (@this == 0 && @sysvar::IL_CAN1::NODES::N_BCM::MESSAGES::PDC_INFO_FD_UWBS1::TIMINGS::EnableCyclic)
  {
    SetBusContext(gILCAN1_BusContext);
    gCAN1DisturbancePeriod = @sysvar::IL_CAN1::NODES::N_BCM::MESSAGES::PDC_INFO_FD_UWBS1::TIMINGS::NormalCyclePeriod;
    ILFaultInjectionResetMsgCycleTime(FDCAN2_1::BCM::PDC_INFO_FD_UWBS1);
  }
  else if (@this == 1 && @sysvar::IL_CAN1::NODES::N_BCM::MESSAGES::PDC_INFO_FD_UWBS1::TIMINGS::EnableCyclic)
  {
    SetBusContext(gILCAN1_BusContext);
    gCAN1DisturbancePeriod = @sysvar::IL_CAN1::NODES::N_BCM::MESSAGES::PDC_INFO_FD_UWBS1::TIMINGS::ActiveCyclePeriod;
    ILFaultInjectionSetMsgCycleTime(FDCAN2_1::BCM::PDC_INFO_FD_UWBS1, gCAN1DisturbancePeriod);
  }
  else if (@this == -1 && @sysvar::IL_CAN1::NODES::N_BCM::MESSAGES::PDC_INFO_FD_UWBS1::TIMINGS::EnableCyclic)
  {
    SetBusContext(gILCAN1_BusContext);
    gCAN1DisturbancePeriod = @sysvar::IL_CAN1::NODES::N_BCM::MESSAGES::PDC_INFO_FD_UWBS1::TIMINGS::CyclePeriod;
    ILFaultInjectionSetMsgCycleTime(FDCAN2_1::BCM::PDC_INFO_FD_UWBS1, gCAN1DisturbancePeriod);
  }
}

on sysvar_update sysvar::IL_CAN1::NODES::N_BCM::MESSAGES::PDC_INFO_FD_UWBS1::TIMINGS::SendOnce
{
  if (@this == 1)
  {
    SetBusContext(gILCAN1_BusContext);
    ILSetMsgEvent(FDCAN2_1::BCM::PDC_INFO_FD_UWBS1);
  }
}

on sysvar_update sysvar::IL_CAN1::NODES::N_BCM::MESSAGES::PDC_INFO_FD_UWBS2::TIMINGS::EnableCyclic
{
  if (@this == 1)
  {
    SetBusContext(gILCAN1_BusContext);
    ILFaultInjectionEnableMsg  (FDCAN2_1::BCM::PDC_INFO_FD_UWBS2);
  }
  else
  {
    SetBusContext(gILCAN1_BusContext);
    ILFaultInjectionDisableMsg (FDCAN2_1::BCM::PDC_INFO_FD_UWBS2);
  }
}

on sysvar_update sysvar::IL_CAN1::NODES::N_BCM::MESSAGES::PDC_INFO_FD_UWBS2::TIMINGS::SetNormalCycle
{
  if (@this == 1 && @sysvar::IL_CAN1::NODES::N_BCM::MESSAGES::PDC_INFO_FD_UWBS2::TIMINGS::EnableCyclic)
  {
    @sysvar::IL_CAN1::NODES::N_BCM::MESSAGES::PDC_INFO_FD_UWBS2::TIMINGS::SelectedPeriod = 0;
  }
}

on sysvar_update sysvar::IL_CAN1::NODES::N_BCM::MESSAGES::PDC_INFO_FD_UWBS2::TIMINGS::SetNewCycleContinously
{
  if (@this == 1 && @sysvar::IL_CAN1::NODES::N_BCM::MESSAGES::PDC_INFO_FD_UWBS2::TIMINGS::EnableCyclic)
  {
    @sysvar::IL_CAN1::NODES::N_BCM::MESSAGES::PDC_INFO_FD_UWBS2::TIMINGS::SelectedPeriod = -1;
  }
}

on sysvar_update sysvar::IL_CAN1::NODES::N_BCM::MESSAGES::PDC_INFO_FD_UWBS2::TIMINGS::SelectedPeriod
{
  if (@this == 0 && @sysvar::IL_CAN1::NODES::N_BCM::MESSAGES::PDC_INFO_FD_UWBS2::TIMINGS::EnableCyclic)
  {
    SetBusContext(gILCAN1_BusContext);
    gCAN1DisturbancePeriod = @sysvar::IL_CAN1::NODES::N_BCM::MESSAGES::PDC_INFO_FD_UWBS2::TIMINGS::NormalCyclePeriod;
    ILFaultInjectionResetMsgCycleTime(FDCAN2_1::BCM::PDC_INFO_FD_UWBS2);
  }
  else if (@this == 1 && @sysvar::IL_CAN1::NODES::N_BCM::MESSAGES::PDC_INFO_FD_UWBS2::TIMINGS::EnableCyclic)
  {
    SetBusContext(gILCAN1_BusContext);
    gCAN1DisturbancePeriod = @sysvar::IL_CAN1::NODES::N_BCM::MESSAGES::PDC_INFO_FD_UWBS2::TIMINGS::ActiveCyclePeriod;
    ILFaultInjectionSetMsgCycleTime(FDCAN2_1::BCM::PDC_INFO_FD_UWBS2, gCAN1DisturbancePeriod);
  }
  else if (@this == -1 && @sysvar::IL_CAN1::NODES::N_BCM::MESSAGES::PDC_INFO_FD_UWBS2::TIMINGS::EnableCyclic)
  {
    SetBusContext(gILCAN1_BusContext);
    gCAN1DisturbancePeriod = @sysvar::IL_CAN1::NODES::N_BCM::MESSAGES::PDC_INFO_FD_UWBS2::TIMINGS::CyclePeriod;
    ILFaultInjectionSetMsgCycleTime(FDCAN2_1::BCM::PDC_INFO_FD_UWBS2, gCAN1DisturbancePeriod);
  }
}

on sysvar_update sysvar::IL_CAN1::NODES::N_BCM::MESSAGES::PDC_INFO_FD_UWBS2::TIMINGS::SendOnce
{
  if (@this == 1)
  {
    SetBusContext(gILCAN1_BusContext);
    ILSetMsgEvent(FDCAN2_1::BCM::PDC_INFO_FD_UWBS2);
  }
}

on sysvar_update sysvar::IL_CAN1::NODES::N_BCM::MESSAGES::PDC_INFO_FD_UWBS3::TIMINGS::EnableCyclic
{
  if (@this == 1)
  {
    SetBusContext(gILCAN1_BusContext);
    ILFaultInjectionEnableMsg  (FDCAN2_1::BCM::PDC_INFO_FD_UWBS3);
  }
  else
  {
    SetBusContext(gILCAN1_BusContext);
    ILFaultInjectionDisableMsg (FDCAN2_1::BCM::PDC_INFO_FD_UWBS3);
  }
}

on sysvar_update sysvar::IL_CAN1::NODES::N_BCM::MESSAGES::PDC_INFO_FD_UWBS3::TIMINGS::SetNormalCycle
{
  if (@this == 1 && @sysvar::IL_CAN1::NODES::N_BCM::MESSAGES::PDC_INFO_FD_UWBS3::TIMINGS::EnableCyclic)
  {
    @sysvar::IL_CAN1::NODES::N_BCM::MESSAGES::PDC_INFO_FD_UWBS3::TIMINGS::SelectedPeriod = 0;
  }
}

on sysvar_update sysvar::IL_CAN1::NODES::N_BCM::MESSAGES::PDC_INFO_FD_UWBS3::TIMINGS::SetNewCycleContinously
{
  if (@this == 1 && @sysvar::IL_CAN1::NODES::N_BCM::MESSAGES::PDC_INFO_FD_UWBS3::TIMINGS::EnableCyclic)
  {
    @sysvar::IL_CAN1::NODES::N_BCM::MESSAGES::PDC_INFO_FD_UWBS3::TIMINGS::SelectedPeriod = -1;
  }
}

on sysvar_update sysvar::IL_CAN1::NODES::N_BCM::MESSAGES::PDC_INFO_FD_UWBS3::TIMINGS::SelectedPeriod
{
  if (@this == 0 && @sysvar::IL_CAN1::NODES::N_BCM::MESSAGES::PDC_INFO_FD_UWBS3::TIMINGS::EnableCyclic)
  {
    SetBusContext(gILCAN1_BusContext);
    gCAN1DisturbancePeriod = @sysvar::IL_CAN1::NODES::N_BCM::MESSAGES::PDC_INFO_FD_UWBS3::TIMINGS::NormalCyclePeriod;
    ILFaultInjectionResetMsgCycleTime(FDCAN2_1::BCM::PDC_INFO_FD_UWBS3);
  }
  else if (@this == 1 && @sysvar::IL_CAN1::NODES::N_BCM::MESSAGES::PDC_INFO_FD_UWBS3::TIMINGS::EnableCyclic)
  {
    SetBusContext(gILCAN1_BusContext);
    gCAN1DisturbancePeriod = @sysvar::IL_CAN1::NODES::N_BCM::MESSAGES::PDC_INFO_FD_UWBS3::TIMINGS::ActiveCyclePeriod;
    ILFaultInjectionSetMsgCycleTime(FDCAN2_1::BCM::PDC_INFO_FD_UWBS3, gCAN1DisturbancePeriod);
  }
  else if (@this == -1 && @sysvar::IL_CAN1::NODES::N_BCM::MESSAGES::PDC_INFO_FD_UWBS3::TIMINGS::EnableCyclic)
  {
    SetBusContext(gILCAN1_BusContext);
    gCAN1DisturbancePeriod = @sysvar::IL_CAN1::NODES::N_BCM::MESSAGES::PDC_INFO_FD_UWBS3::TIMINGS::CyclePeriod;
    ILFaultInjectionSetMsgCycleTime(FDCAN2_1::BCM::PDC_INFO_FD_UWBS3, gCAN1DisturbancePeriod);
  }
}

on sysvar_update sysvar::IL_CAN1::NODES::N_BCM::MESSAGES::PDC_INFO_FD_UWBS3::TIMINGS::SendOnce
{
  if (@this == 1)
  {
    SetBusContext(gILCAN1_BusContext);
    ILSetMsgEvent(FDCAN2_1::BCM::PDC_INFO_FD_UWBS3);
  }
}

on sysvar_update sysvar::IL_CAN1::NODES::N_BCM::MESSAGES::PDC_INFO_FD_UWBS4::TIMINGS::EnableCyclic
{
  if (@this == 1)
  {
    SetBusContext(gILCAN1_BusContext);
    ILFaultInjectionEnableMsg  (FDCAN2_1::BCM::PDC_INFO_FD_UWBS4);
  }
  else
  {
    SetBusContext(gILCAN1_BusContext);
    ILFaultInjectionDisableMsg (FDCAN2_1::BCM::PDC_INFO_FD_UWBS4);
  }
}

on sysvar_update sysvar::IL_CAN1::NODES::N_BCM::MESSAGES::PDC_INFO_FD_UWBS4::TIMINGS::SetNormalCycle
{
  if (@this == 1 && @sysvar::IL_CAN1::NODES::N_BCM::MESSAGES::PDC_INFO_FD_UWBS4::TIMINGS::EnableCyclic)
  {
    @sysvar::IL_CAN1::NODES::N_BCM::MESSAGES::PDC_INFO_FD_UWBS4::TIMINGS::SelectedPeriod = 0;
  }
}

on sysvar_update sysvar::IL_CAN1::NODES::N_BCM::MESSAGES::PDC_INFO_FD_UWBS4::TIMINGS::SetNewCycleContinously
{
  if (@this == 1 && @sysvar::IL_CAN1::NODES::N_BCM::MESSAGES::PDC_INFO_FD_UWBS4::TIMINGS::EnableCyclic)
  {
    @sysvar::IL_CAN1::NODES::N_BCM::MESSAGES::PDC_INFO_FD_UWBS4::TIMINGS::SelectedPeriod = -1;
  }
}

on sysvar_update sysvar::IL_CAN1::NODES::N_BCM::MESSAGES::PDC_INFO_FD_UWBS4::TIMINGS::SelectedPeriod
{
  if (@this == 0 && @sysvar::IL_CAN1::NODES::N_BCM::MESSAGES::PDC_INFO_FD_UWBS4::TIMINGS::EnableCyclic)
  {
    SetBusContext(gILCAN1_BusContext);
    gCAN1DisturbancePeriod = @sysvar::IL_CAN1::NODES::N_BCM::MESSAGES::PDC_INFO_FD_UWBS4::TIMINGS::NormalCyclePeriod;
    ILFaultInjectionResetMsgCycleTime(FDCAN2_1::BCM::PDC_INFO_FD_UWBS4);
  }
  else if (@this == 1 && @sysvar::IL_CAN1::NODES::N_BCM::MESSAGES::PDC_INFO_FD_UWBS4::TIMINGS::EnableCyclic)
  {
    SetBusContext(gILCAN1_BusContext);
    gCAN1DisturbancePeriod = @sysvar::IL_CAN1::NODES::N_BCM::MESSAGES::PDC_INFO_FD_UWBS4::TIMINGS::ActiveCyclePeriod;
    ILFaultInjectionSetMsgCycleTime(FDCAN2_1::BCM::PDC_INFO_FD_UWBS4, gCAN1DisturbancePeriod);
  }
  else if (@this == -1 && @sysvar::IL_CAN1::NODES::N_BCM::MESSAGES::PDC_INFO_FD_UWBS4::TIMINGS::EnableCyclic)
  {
    SetBusContext(gILCAN1_BusContext);
    gCAN1DisturbancePeriod = @sysvar::IL_CAN1::NODES::N_BCM::MESSAGES::PDC_INFO_FD_UWBS4::TIMINGS::CyclePeriod;
    ILFaultInjectionSetMsgCycleTime(FDCAN2_1::BCM::PDC_INFO_FD_UWBS4, gCAN1DisturbancePeriod);
  }
}

on sysvar_update sysvar::IL_CAN1::NODES::N_BCM::MESSAGES::PDC_INFO_FD_UWBS4::TIMINGS::SendOnce
{
  if (@this == 1)
  {
    SetBusContext(gILCAN1_BusContext);
    ILSetMsgEvent(FDCAN2_1::BCM::PDC_INFO_FD_UWBS4);
  }
}

on sysvar_update sysvar::IL_CAN1::NODES::N_BCM::MESSAGES::PDC_INFO_FD_UWBS5::TIMINGS::EnableCyclic
{
  if (@this == 1)
  {
    SetBusContext(gILCAN1_BusContext);
    ILFaultInjectionEnableMsg  (FDCAN2_1::BCM::PDC_INFO_FD_UWBS5);
  }
  else
  {
    SetBusContext(gILCAN1_BusContext);
    ILFaultInjectionDisableMsg (FDCAN2_1::BCM::PDC_INFO_FD_UWBS5);
  }
}

on sysvar_update sysvar::IL_CAN1::NODES::N_BCM::MESSAGES::PDC_INFO_FD_UWBS5::TIMINGS::SetNormalCycle
{
  if (@this == 1 && @sysvar::IL_CAN1::NODES::N_BCM::MESSAGES::PDC_INFO_FD_UWBS5::TIMINGS::EnableCyclic)
  {
    @sysvar::IL_CAN1::NODES::N_BCM::MESSAGES::PDC_INFO_FD_UWBS5::TIMINGS::SelectedPeriod = 0;
  }
}

on sysvar_update sysvar::IL_CAN1::NODES::N_BCM::MESSAGES::PDC_INFO_FD_UWBS5::TIMINGS::SetNewCycleContinously
{
  if (@this == 1 && @sysvar::IL_CAN1::NODES::N_BCM::MESSAGES::PDC_INFO_FD_UWBS5::TIMINGS::EnableCyclic)
  {
    @sysvar::IL_CAN1::NODES::N_BCM::MESSAGES::PDC_INFO_FD_UWBS5::TIMINGS::SelectedPeriod = -1;
  }
}

on sysvar_update sysvar::IL_CAN1::NODES::N_BCM::MESSAGES::PDC_INFO_FD_UWBS5::TIMINGS::SelectedPeriod
{
  if (@this == 0 && @sysvar::IL_CAN1::NODES::N_BCM::MESSAGES::PDC_INFO_FD_UWBS5::TIMINGS::EnableCyclic)
  {
    SetBusContext(gILCAN1_BusContext);
    gCAN1DisturbancePeriod = @sysvar::IL_CAN1::NODES::N_BCM::MESSAGES::PDC_INFO_FD_UWBS5::TIMINGS::NormalCyclePeriod;
    ILFaultInjectionResetMsgCycleTime(FDCAN2_1::BCM::PDC_INFO_FD_UWBS5);
  }
  else if (@this == 1 && @sysvar::IL_CAN1::NODES::N_BCM::MESSAGES::PDC_INFO_FD_UWBS5::TIMINGS::EnableCyclic)
  {
    SetBusContext(gILCAN1_BusContext);
    gCAN1DisturbancePeriod = @sysvar::IL_CAN1::NODES::N_BCM::MESSAGES::PDC_INFO_FD_UWBS5::TIMINGS::ActiveCyclePeriod;
    ILFaultInjectionSetMsgCycleTime(FDCAN2_1::BCM::PDC_INFO_FD_UWBS5, gCAN1DisturbancePeriod);
  }
  else if (@this == -1 && @sysvar::IL_CAN1::NODES::N_BCM::MESSAGES::PDC_INFO_FD_UWBS5::TIMINGS::EnableCyclic)
  {
    SetBusContext(gILCAN1_BusContext);
    gCAN1DisturbancePeriod = @sysvar::IL_CAN1::NODES::N_BCM::MESSAGES::PDC_INFO_FD_UWBS5::TIMINGS::CyclePeriod;
    ILFaultInjectionSetMsgCycleTime(FDCAN2_1::BCM::PDC_INFO_FD_UWBS5, gCAN1DisturbancePeriod);
  }
}

on sysvar_update sysvar::IL_CAN1::NODES::N_BCM::MESSAGES::PDC_INFO_FD_UWBS5::TIMINGS::SendOnce
{
  if (@this == 1)
  {
    SetBusContext(gILCAN1_BusContext);
    ILSetMsgEvent(FDCAN2_1::BCM::PDC_INFO_FD_UWBS5);
  }
}

on sysvar_update sysvar::IL_CAN1::NODES::N_BCM::MESSAGES::PDC_INFO_FD_WCPM2::TIMINGS::EnableCyclic
{
  if (@this == 1)
  {
    SetBusContext(gILCAN1_BusContext);
    ILFaultInjectionEnableMsg  (FDCAN2_1::BCM::PDC_INFO_FD_WCPM2);
  }
  else
  {
    SetBusContext(gILCAN1_BusContext);
    ILFaultInjectionDisableMsg (FDCAN2_1::BCM::PDC_INFO_FD_WCPM2);
  }
}

on sysvar_update sysvar::IL_CAN1::NODES::N_BCM::MESSAGES::PDC_INFO_FD_WCPM2::TIMINGS::SetNormalCycle
{
  if (@this == 1 && @sysvar::IL_CAN1::NODES::N_BCM::MESSAGES::PDC_INFO_FD_WCPM2::TIMINGS::EnableCyclic)
  {
    @sysvar::IL_CAN1::NODES::N_BCM::MESSAGES::PDC_INFO_FD_WCPM2::TIMINGS::SelectedPeriod = 0;
  }
}

on sysvar_update sysvar::IL_CAN1::NODES::N_BCM::MESSAGES::PDC_INFO_FD_WCPM2::TIMINGS::SetNewCycleContinously
{
  if (@this == 1 && @sysvar::IL_CAN1::NODES::N_BCM::MESSAGES::PDC_INFO_FD_WCPM2::TIMINGS::EnableCyclic)
  {
    @sysvar::IL_CAN1::NODES::N_BCM::MESSAGES::PDC_INFO_FD_WCPM2::TIMINGS::SelectedPeriod = -1;
  }
}

on sysvar_update sysvar::IL_CAN1::NODES::N_BCM::MESSAGES::PDC_INFO_FD_WCPM2::TIMINGS::SelectedPeriod
{
  if (@this == 0 && @sysvar::IL_CAN1::NODES::N_BCM::MESSAGES::PDC_INFO_FD_WCPM2::TIMINGS::EnableCyclic)
  {
    SetBusContext(gILCAN1_BusContext);
    gCAN1DisturbancePeriod = @sysvar::IL_CAN1::NODES::N_BCM::MESSAGES::PDC_INFO_FD_WCPM2::TIMINGS::NormalCyclePeriod;
    ILFaultInjectionResetMsgCycleTime(FDCAN2_1::BCM::PDC_INFO_FD_WCPM2);
  }
  else if (@this == 1 && @sysvar::IL_CAN1::NODES::N_BCM::MESSAGES::PDC_INFO_FD_WCPM2::TIMINGS::EnableCyclic)
  {
    SetBusContext(gILCAN1_BusContext);
    gCAN1DisturbancePeriod = @sysvar::IL_CAN1::NODES::N_BCM::MESSAGES::PDC_INFO_FD_WCPM2::TIMINGS::ActiveCyclePeriod;
    ILFaultInjectionSetMsgCycleTime(FDCAN2_1::BCM::PDC_INFO_FD_WCPM2, gCAN1DisturbancePeriod);
  }
  else if (@this == -1 && @sysvar::IL_CAN1::NODES::N_BCM::MESSAGES::PDC_INFO_FD_WCPM2::TIMINGS::EnableCyclic)
  {
    SetBusContext(gILCAN1_BusContext);
    gCAN1DisturbancePeriod = @sysvar::IL_CAN1::NODES::N_BCM::MESSAGES::PDC_INFO_FD_WCPM2::TIMINGS::CyclePeriod;
    ILFaultInjectionSetMsgCycleTime(FDCAN2_1::BCM::PDC_INFO_FD_WCPM2, gCAN1DisturbancePeriod);
  }
}

on sysvar_update sysvar::IL_CAN1::NODES::N_BCM::MESSAGES::PDC_INFO_FD_WCPM2::TIMINGS::SendOnce
{
  if (@this == 1)
  {
    SetBusContext(gILCAN1_BusContext);
    ILSetMsgEvent(FDCAN2_1::BCM::PDC_INFO_FD_WCPM2);
  }
}

on sysvar_update sysvar::IL_CAN1::NODES::N_BCM::MESSAGES::PT_TORQUE_FD_1::TIMINGS::EnableCyclic
{
  if (@this == 1)
  {
    SetBusContext(gILCAN1_BusContext);
    ILFaultInjectionEnableMsg  (FDCAN2_1::BCM::PT_TORQUE_FD_1);
  }
  else
  {
    SetBusContext(gILCAN1_BusContext);
    ILFaultInjectionDisableMsg (FDCAN2_1::BCM::PT_TORQUE_FD_1);
  }
}

on sysvar_update sysvar::IL_CAN1::NODES::N_BCM::MESSAGES::PT_TORQUE_FD_1::TIMINGS::SetNormalCycle
{
  if (@this == 1 && @sysvar::IL_CAN1::NODES::N_BCM::MESSAGES::PT_TORQUE_FD_1::TIMINGS::EnableCyclic)
  {
    @sysvar::IL_CAN1::NODES::N_BCM::MESSAGES::PT_TORQUE_FD_1::TIMINGS::SelectedPeriod = 0;
  }
}

on sysvar_update sysvar::IL_CAN1::NODES::N_BCM::MESSAGES::PT_TORQUE_FD_1::TIMINGS::SetNewCycleContinously
{
  if (@this == 1 && @sysvar::IL_CAN1::NODES::N_BCM::MESSAGES::PT_TORQUE_FD_1::TIMINGS::EnableCyclic)
  {
    @sysvar::IL_CAN1::NODES::N_BCM::MESSAGES::PT_TORQUE_FD_1::TIMINGS::SelectedPeriod = -1;
  }
}

on sysvar_update sysvar::IL_CAN1::NODES::N_BCM::MESSAGES::PT_TORQUE_FD_1::TIMINGS::SelectedPeriod
{
  if (@this == 0 && @sysvar::IL_CAN1::NODES::N_BCM::MESSAGES::PT_TORQUE_FD_1::TIMINGS::EnableCyclic)
  {
    SetBusContext(gILCAN1_BusContext);
    gCAN1DisturbancePeriod = @sysvar::IL_CAN1::NODES::N_BCM::MESSAGES::PT_TORQUE_FD_1::TIMINGS::NormalCyclePeriod;
    ILFaultInjectionResetMsgCycleTime(FDCAN2_1::BCM::PT_TORQUE_FD_1);
  }
  else if (@this == 1 && @sysvar::IL_CAN1::NODES::N_BCM::MESSAGES::PT_TORQUE_FD_1::TIMINGS::EnableCyclic)
  {
    SetBusContext(gILCAN1_BusContext);
    gCAN1DisturbancePeriod = @sysvar::IL_CAN1::NODES::N_BCM::MESSAGES::PT_TORQUE_FD_1::TIMINGS::ActiveCyclePeriod;
    ILFaultInjectionSetMsgCycleTime(FDCAN2_1::BCM::PT_TORQUE_FD_1, gCAN1DisturbancePeriod);
  }
  else if (@this == -1 && @sysvar::IL_CAN1::NODES::N_BCM::MESSAGES::PT_TORQUE_FD_1::TIMINGS::EnableCyclic)
  {
    SetBusContext(gILCAN1_BusContext);
    gCAN1DisturbancePeriod = @sysvar::IL_CAN1::NODES::N_BCM::MESSAGES::PT_TORQUE_FD_1::TIMINGS::CyclePeriod;
    ILFaultInjectionSetMsgCycleTime(FDCAN2_1::BCM::PT_TORQUE_FD_1, gCAN1DisturbancePeriod);
  }
}

on sysvar_update sysvar::IL_CAN1::NODES::N_BCM::MESSAGES::PT_TORQUE_FD_1::TIMINGS::SendOnce
{
  if (@this == 1)
  {
    SetBusContext(gILCAN1_BusContext);
    ILSetMsgEvent(FDCAN2_1::BCM::PT_TORQUE_FD_1);
  }
}

on sysvar_update sysvar::IL_CAN1::NODES::N_BCM::MESSAGES::RFHUB_FD_3::TIMINGS::EnableCyclic
{
  if (@this == 1)
  {
    SetBusContext(gILCAN1_BusContext);
    ILFaultInjectionEnableMsg  (FDCAN2_1::BCM::RFHUB_FD_3);
  }
  else
  {
    SetBusContext(gILCAN1_BusContext);
    ILFaultInjectionDisableMsg (FDCAN2_1::BCM::RFHUB_FD_3);
  }
}

on sysvar_update sysvar::IL_CAN1::NODES::N_BCM::MESSAGES::RFHUB_FD_3::TIMINGS::SetNormalCycle
{
  if (@this == 1 && @sysvar::IL_CAN1::NODES::N_BCM::MESSAGES::RFHUB_FD_3::TIMINGS::EnableCyclic)
  {
    @sysvar::IL_CAN1::NODES::N_BCM::MESSAGES::RFHUB_FD_3::TIMINGS::SelectedPeriod = 0;
  }
}

on sysvar_update sysvar::IL_CAN1::NODES::N_BCM::MESSAGES::RFHUB_FD_3::TIMINGS::SetNewCycleContinously
{
  if (@this == 1 && @sysvar::IL_CAN1::NODES::N_BCM::MESSAGES::RFHUB_FD_3::TIMINGS::EnableCyclic)
  {
    @sysvar::IL_CAN1::NODES::N_BCM::MESSAGES::RFHUB_FD_3::TIMINGS::SelectedPeriod = -1;
  }
}

on sysvar_update sysvar::IL_CAN1::NODES::N_BCM::MESSAGES::RFHUB_FD_3::TIMINGS::SelectedPeriod
{
  if (@this == 0 && @sysvar::IL_CAN1::NODES::N_BCM::MESSAGES::RFHUB_FD_3::TIMINGS::EnableCyclic)
  {
    SetBusContext(gILCAN1_BusContext);
    gCAN1DisturbancePeriod = @sysvar::IL_CAN1::NODES::N_BCM::MESSAGES::RFHUB_FD_3::TIMINGS::NormalCyclePeriod;
    ILFaultInjectionResetMsgCycleTime(FDCAN2_1::BCM::RFHUB_FD_3);
  }
  else if (@this == 1 && @sysvar::IL_CAN1::NODES::N_BCM::MESSAGES::RFHUB_FD_3::TIMINGS::EnableCyclic)
  {
    SetBusContext(gILCAN1_BusContext);
    gCAN1DisturbancePeriod = @sysvar::IL_CAN1::NODES::N_BCM::MESSAGES::RFHUB_FD_3::TIMINGS::ActiveCyclePeriod;
    ILFaultInjectionSetMsgCycleTime(FDCAN2_1::BCM::RFHUB_FD_3, gCAN1DisturbancePeriod);
  }
  else if (@this == -1 && @sysvar::IL_CAN1::NODES::N_BCM::MESSAGES::RFHUB_FD_3::TIMINGS::EnableCyclic)
  {
    SetBusContext(gILCAN1_BusContext);
    gCAN1DisturbancePeriod = @sysvar::IL_CAN1::NODES::N_BCM::MESSAGES::RFHUB_FD_3::TIMINGS::CyclePeriod;
    ILFaultInjectionSetMsgCycleTime(FDCAN2_1::BCM::RFHUB_FD_3, gCAN1DisturbancePeriod);
  }
}

on sysvar_update sysvar::IL_CAN1::NODES::N_BCM::MESSAGES::RFHUB_FD_3::TIMINGS::SendOnce
{
  if (@this == 1)
  {
    SetBusContext(gILCAN1_BusContext);
    ILSetMsgEvent(FDCAN2_1::BCM::RFHUB_FD_3);
  }
}

on sysvar_update sysvar::IL_CAN1::NODES::N_BCM::MESSAGES::SWSM_1::TIMINGS::EnableCyclic
{
  if (@this == 1)
  {
    SetBusContext(gILCAN1_BusContext);
    ILFaultInjectionEnableMsg  (FDCAN2_1::BCM::SWSM_1);
  }
  else
  {
    SetBusContext(gILCAN1_BusContext);
    ILFaultInjectionDisableMsg (FDCAN2_1::BCM::SWSM_1);
  }
}

on sysvar_update sysvar::IL_CAN1::NODES::N_BCM::MESSAGES::SWSM_1::TIMINGS::SetNormalCycle
{
  if (@this == 1 && @sysvar::IL_CAN1::NODES::N_BCM::MESSAGES::SWSM_1::TIMINGS::EnableCyclic)
  {
    @sysvar::IL_CAN1::NODES::N_BCM::MESSAGES::SWSM_1::TIMINGS::SelectedPeriod = 0;
  }
}

on sysvar_update sysvar::IL_CAN1::NODES::N_BCM::MESSAGES::SWSM_1::TIMINGS::SetNewCycleContinously
{
  if (@this == 1 && @sysvar::IL_CAN1::NODES::N_BCM::MESSAGES::SWSM_1::TIMINGS::EnableCyclic)
  {
    @sysvar::IL_CAN1::NODES::N_BCM::MESSAGES::SWSM_1::TIMINGS::SelectedPeriod = -1;
  }
}

on sysvar_update sysvar::IL_CAN1::NODES::N_BCM::MESSAGES::SWSM_1::TIMINGS::SelectedPeriod
{
  if (@this == 0 && @sysvar::IL_CAN1::NODES::N_BCM::MESSAGES::SWSM_1::TIMINGS::EnableCyclic)
  {
    SetBusContext(gILCAN1_BusContext);
    gCAN1DisturbancePeriod = @sysvar::IL_CAN1::NODES::N_BCM::MESSAGES::SWSM_1::TIMINGS::NormalCyclePeriod;
    ILFaultInjectionResetMsgCycleTime(FDCAN2_1::BCM::SWSM_1);
  }
  else if (@this == 1 && @sysvar::IL_CAN1::NODES::N_BCM::MESSAGES::SWSM_1::TIMINGS::EnableCyclic)
  {
    SetBusContext(gILCAN1_BusContext);
    gCAN1DisturbancePeriod = @sysvar::IL_CAN1::NODES::N_BCM::MESSAGES::SWSM_1::TIMINGS::ActiveCyclePeriod;
    ILFaultInjectionSetMsgCycleTime(FDCAN2_1::BCM::SWSM_1, gCAN1DisturbancePeriod);
  }
  else if (@this == -1 && @sysvar::IL_CAN1::NODES::N_BCM::MESSAGES::SWSM_1::TIMINGS::EnableCyclic)
  {
    SetBusContext(gILCAN1_BusContext);
    gCAN1DisturbancePeriod = @sysvar::IL_CAN1::NODES::N_BCM::MESSAGES::SWSM_1::TIMINGS::CyclePeriod;
    ILFaultInjectionSetMsgCycleTime(FDCAN2_1::BCM::SWSM_1, gCAN1DisturbancePeriod);
  }
}

on sysvar_update sysvar::IL_CAN1::NODES::N_BCM::MESSAGES::SWSM_1::TIMINGS::SendOnce
{
  if (@this == 1)
  {
    SetBusContext(gILCAN1_BusContext);
    ILSetMsgEvent(FDCAN2_1::BCM::SWSM_1);
  }
}

on sysvar_update sysvar::IL_CAN1::NODES::N_BCM::MESSAGES::TRANSM_FD_1::TIMINGS::EnableCyclic
{
  if (@this == 1)
  {
    SetBusContext(gILCAN1_BusContext);
    ILFaultInjectionEnableMsg  (FDCAN2_1::BCM::TRANSM_FD_1);
  }
  else
  {
    SetBusContext(gILCAN1_BusContext);
    ILFaultInjectionDisableMsg (FDCAN2_1::BCM::TRANSM_FD_1);
  }
}

on sysvar_update sysvar::IL_CAN1::NODES::N_BCM::MESSAGES::TRANSM_FD_1::TIMINGS::SetNormalCycle
{
  if (@this == 1 && @sysvar::IL_CAN1::NODES::N_BCM::MESSAGES::TRANSM_FD_1::TIMINGS::EnableCyclic)
  {
    @sysvar::IL_CAN1::NODES::N_BCM::MESSAGES::TRANSM_FD_1::TIMINGS::SelectedPeriod = 0;
  }
}

on sysvar_update sysvar::IL_CAN1::NODES::N_BCM::MESSAGES::TRANSM_FD_1::TIMINGS::SetNewCycleContinously
{
  if (@this == 1 && @sysvar::IL_CAN1::NODES::N_BCM::MESSAGES::TRANSM_FD_1::TIMINGS::EnableCyclic)
  {
    @sysvar::IL_CAN1::NODES::N_BCM::MESSAGES::TRANSM_FD_1::TIMINGS::SelectedPeriod = -1;
  }
}

on sysvar_update sysvar::IL_CAN1::NODES::N_BCM::MESSAGES::TRANSM_FD_1::TIMINGS::SelectedPeriod
{
  if (@this == 0 && @sysvar::IL_CAN1::NODES::N_BCM::MESSAGES::TRANSM_FD_1::TIMINGS::EnableCyclic)
  {
    SetBusContext(gILCAN1_BusContext);
    gCAN1DisturbancePeriod = @sysvar::IL_CAN1::NODES::N_BCM::MESSAGES::TRANSM_FD_1::TIMINGS::NormalCyclePeriod;
    ILFaultInjectionResetMsgCycleTime(FDCAN2_1::BCM::TRANSM_FD_1);
  }
  else if (@this == 1 && @sysvar::IL_CAN1::NODES::N_BCM::MESSAGES::TRANSM_FD_1::TIMINGS::EnableCyclic)
  {
    SetBusContext(gILCAN1_BusContext);
    gCAN1DisturbancePeriod = @sysvar::IL_CAN1::NODES::N_BCM::MESSAGES::TRANSM_FD_1::TIMINGS::ActiveCyclePeriod;
    ILFaultInjectionSetMsgCycleTime(FDCAN2_1::BCM::TRANSM_FD_1, gCAN1DisturbancePeriod);
  }
  else if (@this == -1 && @sysvar::IL_CAN1::NODES::N_BCM::MESSAGES::TRANSM_FD_1::TIMINGS::EnableCyclic)
  {
    SetBusContext(gILCAN1_BusContext);
    gCAN1DisturbancePeriod = @sysvar::IL_CAN1::NODES::N_BCM::MESSAGES::TRANSM_FD_1::TIMINGS::CyclePeriod;
    ILFaultInjectionSetMsgCycleTime(FDCAN2_1::BCM::TRANSM_FD_1, gCAN1DisturbancePeriod);
  }
}

on sysvar_update sysvar::IL_CAN1::NODES::N_BCM::MESSAGES::TRANSM_FD_1::TIMINGS::SendOnce
{
  if (@this == 1)
  {
    SetBusContext(gILCAN1_BusContext);
    ILSetMsgEvent(FDCAN2_1::BCM::TRANSM_FD_1);
  }
}

on sysvar_update sysvar::IL_CAN1::NODES::N_BCM::MESSAGES::TRANSM_FD_2::TIMINGS::EnableCyclic
{
  if (@this == 1)
  {
    SetBusContext(gILCAN1_BusContext);
    ILFaultInjectionEnableMsg  (FDCAN2_1::BCM::TRANSM_FD_2);
  }
  else
  {
    SetBusContext(gILCAN1_BusContext);
    ILFaultInjectionDisableMsg (FDCAN2_1::BCM::TRANSM_FD_2);
  }
}

on sysvar_update sysvar::IL_CAN1::NODES::N_BCM::MESSAGES::TRANSM_FD_2::TIMINGS::SetNormalCycle
{
  if (@this == 1 && @sysvar::IL_CAN1::NODES::N_BCM::MESSAGES::TRANSM_FD_2::TIMINGS::EnableCyclic)
  {
    @sysvar::IL_CAN1::NODES::N_BCM::MESSAGES::TRANSM_FD_2::TIMINGS::SelectedPeriod = 0;
  }
}

on sysvar_update sysvar::IL_CAN1::NODES::N_BCM::MESSAGES::TRANSM_FD_2::TIMINGS::SetNewCycleContinously
{
  if (@this == 1 && @sysvar::IL_CAN1::NODES::N_BCM::MESSAGES::TRANSM_FD_2::TIMINGS::EnableCyclic)
  {
    @sysvar::IL_CAN1::NODES::N_BCM::MESSAGES::TRANSM_FD_2::TIMINGS::SelectedPeriod = -1;
  }
}

on sysvar_update sysvar::IL_CAN1::NODES::N_BCM::MESSAGES::TRANSM_FD_2::TIMINGS::SelectedPeriod
{
  if (@this == 0 && @sysvar::IL_CAN1::NODES::N_BCM::MESSAGES::TRANSM_FD_2::TIMINGS::EnableCyclic)
  {
    SetBusContext(gILCAN1_BusContext);
    gCAN1DisturbancePeriod = @sysvar::IL_CAN1::NODES::N_BCM::MESSAGES::TRANSM_FD_2::TIMINGS::NormalCyclePeriod;
    ILFaultInjectionResetMsgCycleTime(FDCAN2_1::BCM::TRANSM_FD_2);
  }
  else if (@this == 1 && @sysvar::IL_CAN1::NODES::N_BCM::MESSAGES::TRANSM_FD_2::TIMINGS::EnableCyclic)
  {
    SetBusContext(gILCAN1_BusContext);
    gCAN1DisturbancePeriod = @sysvar::IL_CAN1::NODES::N_BCM::MESSAGES::TRANSM_FD_2::TIMINGS::ActiveCyclePeriod;
    ILFaultInjectionSetMsgCycleTime(FDCAN2_1::BCM::TRANSM_FD_2, gCAN1DisturbancePeriod);
  }
  else if (@this == -1 && @sysvar::IL_CAN1::NODES::N_BCM::MESSAGES::TRANSM_FD_2::TIMINGS::EnableCyclic)
  {
    SetBusContext(gILCAN1_BusContext);
    gCAN1DisturbancePeriod = @sysvar::IL_CAN1::NODES::N_BCM::MESSAGES::TRANSM_FD_2::TIMINGS::CyclePeriod;
    ILFaultInjectionSetMsgCycleTime(FDCAN2_1::BCM::TRANSM_FD_2, gCAN1DisturbancePeriod);
  }
}

on sysvar_update sysvar::IL_CAN1::NODES::N_BCM::MESSAGES::TRANSM_FD_2::TIMINGS::SendOnce
{
  if (@this == 1)
  {
    SetBusContext(gILCAN1_BusContext);
    ILSetMsgEvent(FDCAN2_1::BCM::TRANSM_FD_2);
  }
}

on sysvar_update sysvar::IL_CAN1::NODES::N_BCM::MESSAGES::TRANSM_FD_4::TIMINGS::EnableCyclic
{
  if (@this == 1)
  {
    SetBusContext(gILCAN1_BusContext);
    ILFaultInjectionEnableMsg  (FDCAN2_1::BCM::TRANSM_FD_4);
  }
  else
  {
    SetBusContext(gILCAN1_BusContext);
    ILFaultInjectionDisableMsg (FDCAN2_1::BCM::TRANSM_FD_4);
  }
}

on sysvar_update sysvar::IL_CAN1::NODES::N_BCM::MESSAGES::TRANSM_FD_4::TIMINGS::SetNormalCycle
{
  if (@this == 1 && @sysvar::IL_CAN1::NODES::N_BCM::MESSAGES::TRANSM_FD_4::TIMINGS::EnableCyclic)
  {
    @sysvar::IL_CAN1::NODES::N_BCM::MESSAGES::TRANSM_FD_4::TIMINGS::SelectedPeriod = 0;
  }
}

on sysvar_update sysvar::IL_CAN1::NODES::N_BCM::MESSAGES::TRANSM_FD_4::TIMINGS::SetNewCycleContinously
{
  if (@this == 1 && @sysvar::IL_CAN1::NODES::N_BCM::MESSAGES::TRANSM_FD_4::TIMINGS::EnableCyclic)
  {
    @sysvar::IL_CAN1::NODES::N_BCM::MESSAGES::TRANSM_FD_4::TIMINGS::SelectedPeriod = -1;
  }
}

on sysvar_update sysvar::IL_CAN1::NODES::N_BCM::MESSAGES::TRANSM_FD_4::TIMINGS::SelectedPeriod
{
  if (@this == 0 && @sysvar::IL_CAN1::NODES::N_BCM::MESSAGES::TRANSM_FD_4::TIMINGS::EnableCyclic)
  {
    SetBusContext(gILCAN1_BusContext);
    gCAN1DisturbancePeriod = @sysvar::IL_CAN1::NODES::N_BCM::MESSAGES::TRANSM_FD_4::TIMINGS::NormalCyclePeriod;
    ILFaultInjectionResetMsgCycleTime(FDCAN2_1::BCM::TRANSM_FD_4);
  }
  else if (@this == 1 && @sysvar::IL_CAN1::NODES::N_BCM::MESSAGES::TRANSM_FD_4::TIMINGS::EnableCyclic)
  {
    SetBusContext(gILCAN1_BusContext);
    gCAN1DisturbancePeriod = @sysvar::IL_CAN1::NODES::N_BCM::MESSAGES::TRANSM_FD_4::TIMINGS::ActiveCyclePeriod;
    ILFaultInjectionSetMsgCycleTime(FDCAN2_1::BCM::TRANSM_FD_4, gCAN1DisturbancePeriod);
  }
  else if (@this == -1 && @sysvar::IL_CAN1::NODES::N_BCM::MESSAGES::TRANSM_FD_4::TIMINGS::EnableCyclic)
  {
    SetBusContext(gILCAN1_BusContext);
    gCAN1DisturbancePeriod = @sysvar::IL_CAN1::NODES::N_BCM::MESSAGES::TRANSM_FD_4::TIMINGS::CyclePeriod;
    ILFaultInjectionSetMsgCycleTime(FDCAN2_1::BCM::TRANSM_FD_4, gCAN1DisturbancePeriod);
  }
}

on sysvar_update sysvar::IL_CAN1::NODES::N_BCM::MESSAGES::TRANSM_FD_4::TIMINGS::SendOnce
{
  if (@this == 1)
  {
    SetBusContext(gILCAN1_BusContext);
    ILSetMsgEvent(FDCAN2_1::BCM::TRANSM_FD_4);
  }
}

on sysvar_update sysvar::IL_CAN1::NODES::N_BCM::MESSAGES::VIN::TIMINGS::EnableCyclic
{
  if (@this == 1)
  {
    SetBusContext(gILCAN1_BusContext);
    ILFaultInjectionEnableMsg  (FDCAN2_1::BCM::VIN);
  }
  else
  {
    SetBusContext(gILCAN1_BusContext);
    ILFaultInjectionDisableMsg (FDCAN2_1::BCM::VIN);
  }
}

on sysvar_update sysvar::IL_CAN1::NODES::N_BCM::MESSAGES::VIN::TIMINGS::SetNormalCycle
{
  if (@this == 1 && @sysvar::IL_CAN1::NODES::N_BCM::MESSAGES::VIN::TIMINGS::EnableCyclic)
  {
    @sysvar::IL_CAN1::NODES::N_BCM::MESSAGES::VIN::TIMINGS::SelectedPeriod = 0;
  }
}

on sysvar_update sysvar::IL_CAN1::NODES::N_BCM::MESSAGES::VIN::TIMINGS::SetNewCycleContinously
{
  if (@this == 1 && @sysvar::IL_CAN1::NODES::N_BCM::MESSAGES::VIN::TIMINGS::EnableCyclic)
  {
    @sysvar::IL_CAN1::NODES::N_BCM::MESSAGES::VIN::TIMINGS::SelectedPeriod = -1;
  }
}

on sysvar_update sysvar::IL_CAN1::NODES::N_BCM::MESSAGES::VIN::TIMINGS::SelectedPeriod
{
  if (@this == 0 && @sysvar::IL_CAN1::NODES::N_BCM::MESSAGES::VIN::TIMINGS::EnableCyclic)
  {
    SetBusContext(gILCAN1_BusContext);
    gCAN1DisturbancePeriod = @sysvar::IL_CAN1::NODES::N_BCM::MESSAGES::VIN::TIMINGS::NormalCyclePeriod;
    ILFaultInjectionResetMsgCycleTime(FDCAN2_1::BCM::VIN);
  }
  else if (@this == 1 && @sysvar::IL_CAN1::NODES::N_BCM::MESSAGES::VIN::TIMINGS::EnableCyclic)
  {
    SetBusContext(gILCAN1_BusContext);
    gCAN1DisturbancePeriod = @sysvar::IL_CAN1::NODES::N_BCM::MESSAGES::VIN::TIMINGS::ActiveCyclePeriod;
    ILFaultInjectionSetMsgCycleTime(FDCAN2_1::BCM::VIN, gCAN1DisturbancePeriod);
  }
  else if (@this == -1 && @sysvar::IL_CAN1::NODES::N_BCM::MESSAGES::VIN::TIMINGS::EnableCyclic)
  {
    SetBusContext(gILCAN1_BusContext);
    gCAN1DisturbancePeriod = @sysvar::IL_CAN1::NODES::N_BCM::MESSAGES::VIN::TIMINGS::CyclePeriod;
    ILFaultInjectionSetMsgCycleTime(FDCAN2_1::BCM::VIN, gCAN1DisturbancePeriod);
  }
}

on sysvar_update sysvar::IL_CAN1::NODES::N_BCM::MESSAGES::VIN::TIMINGS::SendOnce
{
  if (@this == 1)
  {
    SetBusContext(gILCAN1_BusContext);
    ILSetMsgEvent(FDCAN2_1::BCM::VIN);
  }
}

/* #ChannelEnd# |CAN1| #BusEnd# |FDCAN2_1| */
//--- end generated part --- Block end <#SysVar_Handler#> do not delete this line! Add application code below this line.

//--- begin generated part --- Block start <#MsgUpdateFcns#> do not delete this line and do not add application code in this code block!
/* #ChannelStart# |CAN1| #BusStart# |FDCAN2_1| */
/* #ChannelEnd# |CAN1| #BusEnd# |FDCAN2_1| */
//--- end generated part --- Block end <#MsgUpdateFcns#> do not delete this line! Add application code below this line.



//if(aId ==CRC_BCM_FD29.id) // No CRC for thise signal
//    {
//        byte dataarray[32];
//        if( @sysvar::message_control::FD_CAN_2::alive_counter_CRC_BCM_FD29== 0)
//        {
//            if(MsgCtr_CRC_BCM_FD29<15)
//            {
//                MsgCtr_CRC_BCM_FD29++;
//            }
//            else
//            {
//                MsgCtr_CRC_BCM_FD29= 0;
//            }
//            data[22]=MsgCtr_CRC_BCM_FD29;
//        }
//        if(@sysvar::message_control::FD_CAN_2::crc_CRC_BCM_FD29 == 0)
//        {
//            for(i=0;i<23;i++)
//            {
//                dataarray[i] = data[i];
//            }
//            Crc_CalculateCRC8(dataarray, 31, 0, 23, 0, 0xFF, crc);
//            data[23]=crc;
//        }
//    }
//	
//	if(aId ==CRC_AGSM_FD2 .id)//No CRC for thise signal
//    {
//        byte dataarray[32];
//        if( @sysvar::message_control::FD_CAN_2::alive_counter_CRC_AGSM_FD2 == 0)
//        {
//            if(MsgCtr_CRC_AGSM_FD2 <15)
//            {
//                MsgCtr_CRC_AGSM_FD2 ++;
//            }
//            else
//            {
//                MsgCtr_CRC_AGSM_FD2 = 0;
//            }
//            data[22]=MsgCtr_CRC_AGSM_FD2 ;
//        }
//        if(@sysvar::message_control::FD_CAN_2::crc_CRC_AGSM_FD2  == 0)
//        {
//            for(i=0;i<23;i++)
//            {
//                dataarray[i] = data[i];
//            }
//            Crc_CalculateCRC8(dataarray, 31, 0, 23, 0, 0xFF, crc);
//            data[23]=crc;
//        }
//    }


//	if(aId ==MC_BCM_FD29 .id) // No CRC for thise signal
//    {
//        byte dataarray[32];
//        if( @sysvar::message_control::FD_CAN_2::alive_counter_MC_BCM_FD29 == 0)
//        {
//            if(MsgCtr_MC_BCM_FD29 <15)
//            {
//                MsgCtr_MC_BCM_FD29 ++;
//            }
//            else
//            {
//                MsgCtr_MC_BCM_FD29 = 0;
//            }
//            data[22]=MsgCtr_MC_BCM_FD29 ;
//        }
//        if(@sysvar::message_control::FD_CAN_2::crc_MC_BCM_FD29  == 0)
//        {
//            for(i=0;i<23;i++)
//            {
//                dataarray[i] = data[i];
//            }
//            Crc_CalculateCRC8(dataarray, 31, 0, 23, 0, 0xFF, crc);
//            data[23]=crc;
//        }
//    }


//	if(aId ==CRC_ASCM_FD1 .id)// No CRC for thise signal
//    {
//        byte dataarray[32];
//        if( @sysvar::message_control::FD_CAN_2::alive_counter_CRC_ASCM_FD1 == 0)
//        {
//            if(MsgCtr_CRC_ASCM_FD1 <15)
//            {
//                MsgCtr_CRC_ASCM_FD1 ++;
//            }
//            else
//            {
//                MsgCtr_CRC_ASCM_FD1= 0;
//            }
//            data[22]=MsgCtr_CRC_ASCM_FD1 ;
//        }
//        if(@sysvar::message_control::FD_CAN_2::crc_CRC_ASCM_FD1 == 0)
//        {
//            for(i=0;i<23;i++)
//            {
//                dataarray[i] = data[i];
//            }
//            Crc_CalculateCRC8(dataarray, 31, 0, 23, 0, 0xFF, crc);
//            data[23]=crc;
//        }
//    }
//	
//    
//    
//    if(aId ==CRC_ASCM_FD2 .id)// No CRC for thise signal
//    {
//        byte dataarray[32];
//        if( @sysvar::message_control::FD_CAN_2::alive_counter_CRC_ASCM_FD2 == 0)
//        {
//            if(MsgCtr_CRC_ASCM_FD2 <15)
//            {
//                MsgCtr_CRC_ASCM_FD2 ++;
//            }
//            else
//            {
//                MsgCtr_CRC_ASCM_FD1= 0;
//            }
//            data[22]=MsgCtr_CRC_ASCM_FD2 ;
//        }
//        if(@sysvar::message_control::FD_CAN_2::crc_CRC_ASCM_FD2 == 0)
//        {
//            for(i=0;i<23;i++)
//            {
//                dataarray[i] = data[i];
//            }
//            Crc_CalculateCRC8(dataarray, 31, 0, 23, 0, 0xFF, crc);
//            data[23]=crc;
//        }
//    }
//    
//    
//    
//    
//    	if(aId ==MC_ASCM_FD1 .id)// No CRC for thise signal
//    {
//        byte dataarray[32];
//        if( @sysvar::message_control::FD_CAN_2::alive_counter_MC_ASCM_FD1 == 0)
//        {
//            if(MsgCtr_MC_ASCM_FD1 <15)
//            {
//                MsgCtr_MC_ASCM_FD1 ++;
//            }
//            else
//            {
//                MsgCtr_MC_ASCM_FD1= 0;
//            }
//            data[22]=MsgCtr_MC_ASCM_FD1 ;
//        }
//        if(@sysvar::message_control::FD_CAN_2::crc_MC_ASCM_FD1== 0)
//        {
//            for(i=0;i<23;i++)
//            {
//                dataarray[i] = data[i];
//            }
//            Crc_CalculateCRC8(dataarray, 31, 0, 23, 0, 0xFF, crc);
//            data[23]=crc;
//        }
//    }
	
//
//		if(aId ==MC_ASCM_FD2 .id)// No CRC for thise signal
//    {
//        byte dataarray[32];
//        if( @sysvar::message_control::FD_CAN_2::alive_counter_MC_ASCM_FD2 == 0)
//        {
//            if(MsgCtr_MC_ASCM_FD2 <15)
//            {
//                MsgCtr_MC_ASCM_FD2 ++;
//            }
//            else
//            {
//                MsgCtr_MC_ASCM_FD2= 0;
//            }
//            data[22]=MsgCtr_MC_ASCM_FD2 ;
//        }
//        if(@sysvar::message_control::FD_CAN_2::crc_MC_ASCM_FD2== 0)
//        {
//            for(i=0;i<23;i++)
//            {
//                dataarray[i] = data[i];
//            }
//            Crc_CalculateCRC8(dataarray, 31, 0, 23, 0, 0xFF, crc);
//            data[23]=crc;
//        }
//    }
//	


//			if(aId ==MC_AGSM_FD2 .id)\\ No CRC for thise signal
//    {
//        byte dataarray[32];
//        if( @sysvar::message_control::FD_CAN_2::alive_counter_MC_AGSM_FD2 == 0)
//        {
//            if(MsgCtr_MC_AGSM_FD2 <15)
//            {
//                MsgCtr_MC_AGSM_FD2 ++;
//            }
//            else
//            {
//                MsgCtr_MC_AGSM_FD2= 0;
//            }
//            data[22]=MsgCtr_MC_AGSM_FD2 ;
//        }
//        if(@sysvar::message_control::FD_CAN_2::crc_MC_AGSM_FD2== 0)
//        {
//            for(i=0;i<23;i++)
//            {
//                dataarray[i] = data[i];
//            }
//            Crc_CalculateCRC8(dataarray, 31, 0, 23, 0, 0xFF, crc);
//            data[23]=crc;
//        }
//    }
//	
	




