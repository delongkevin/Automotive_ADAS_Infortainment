/*@!Encoding:1252*/
includes
{
  // Import required CAPL include files
  //--- begin generated part --- Block start #Hdr_Includes#; do not delete this line and do not add application code in this code block!
  /* #ChannelStart# |CAN1| #BusStart# |FDCAN2| */
  /* #ChannelEnd# |CAN1| #BusEnd# |FDCAN2| */
  //--- end generated part --- Block end #Hdr_Includes#; do not delete this line! Add application code below this line.
  //--- begin generated part --- Block start #Body_Includes#; do not delete this line and do not add application code in this code block!
  /* #ChannelStart# |CAN1| #BusStart# |FDCAN2| */
  #include "..\CAPL\Vector-IL-KL30-Helper_CAN1.cin"
  #include "Cin_Files\CRC_CVADAS.cin"
  #include "..\CAPL\Vector-NM-Panel-Helper_CAN1.cin"
  #include "..\CAPL\Vector-NM-ASR-Helper_CAN1.cin"
  /* #ChannelEnd# |CAN1| #BusEnd# |FDCAN2| */
  /* #ChannelStart# |CAN2| #BusStart# |FDCAN14| */
  #include "..\CAPL\Vector-IL-KL30-Helper_CAN2.cin"
  #include "..\CAPL\Vector-NM-Panel-Helper_CAN2.cin"
  #include "..\CAPL\Vector-NM-ASR-Helper_CAN2.cin"
  /* #ChannelEnd# |CAN2| #BusEnd# |FDCAN14| */
  //--- end generated part --- Block end #Body_Includes#; do not delete this line! Add application code below this line.
}

variables
{
  // Define global variables for this CAPL file

  /*--- #GenHeader Begin# --- begin generated comment ---
  | Generated on Friday, January 12, 2024, 14:44:12
  | By ModelGenerator for Vector 1.5.4.10, ModelGeneratorVectorDLL 1.5.4.41
  | Package Vector 4.0.21
  | Target Bus: FDCAN2; Channel: CAN1; DB Cluster: PDT24_FDCAN2;
  | From Database: PDT24_FDCAN2.dbc
  | CANoe Version 15.4.35.0
  | 
  | Extended on Friday, January 12, 2024, 14:48:24
  | By ModelGenerator for Vector 1.5.4.10, ModelGeneratorVectorDLL 1.5.4.41
  | Package Vector 4.0.21
  | Target Bus: FDCAN14; Channel: CAN2; DB Cluster: PDT24_FDCAN14;
  | From Database: PDT24_FDCAN14.dbc
  | CANoe Version 15.4.35.0
    --- #GenHeader End  # --- end generated comment --- */

  char gECU[256] = "BSM2";
  //--- begin generated part --- Block start #Hdr_GlobalVariables#; do not delete this line and do not add application code in this code block!
  /* #ChannelStart# |CAN1| #BusStart# |FDCAN2| */
  /* #ChannelEnd# |CAN1| #BusEnd# |FDCAN2| */
  //--- end generated part --- Block end #Hdr_GlobalVariables#; do not delete this line! Add application code below this line.
  //--- begin generated part --- Block start #Body_GlobalVariables#; do not delete this line and do not add application code in this code block!
  /* #ChannelStart# |CAN1| #BusStart# |FDCAN2| */
  char gCAN1BusName[256] = "FDCAN2";
  int gCAN1Channel = 1; //// The channel the bus is attached to

  long gCAN1DisturbanceMode;
  long gCAN1DisturbanceCount;
  long gCAN1DisturbanceValue;
  long gCAN1DisturbanceContinueMode;
  double gCAN1DisturbancePeriod;
  /* #ChannelEnd# |CAN1| #BusEnd# |FDCAN2| */
  /* #ChannelStart# |CAN2| #BusStart# |FDCAN14| */
  char gCAN2BusName[256] = "FDCAN14";
  int gCAN2Channel = 2; //// The channel the bus is attached to

  long gCAN2DisturbanceMode;
  long gCAN2DisturbanceCount;
  long gCAN2DisturbanceValue;
  long gCAN2DisturbanceContinueMode;
  double gCAN2DisturbancePeriod;
  /* #ChannelEnd# |CAN2| #BusEnd# |FDCAN14| */
  //--- end generated part --- Block end #Body_GlobalVariables#; do not delete this line! Add application code below this line.
}

on preStart
{
  // Initialize CAPL includes and node's modules/DLLs
  //--- begin generated part --- Block start #Hdr_OnInit#; do not delete this line and do not add application code in this code block!
  /* #ChannelStart# |CAN1| #BusStart# |FDCAN2| */
  /* #ChannelEnd# |CAN1| #BusEnd# |FDCAN2| */
  //--- end generated part --- Block end #Hdr_OnInit#; do not delete this line! Add application code below this line.
  //--- begin generated part --- Block start #Body_OnInit#; do not delete this line and do not add application code in this code block!
  /* #ChannelStart# |CAN1| #BusStart# |FDCAN2| */
  ILCAN1_OnInit();
  NMCAN1_OnInit();
  /* #ChannelEnd# |CAN1| #BusEnd# |FDCAN2| */
  /* #ChannelStart# |CAN2| #BusStart# |FDCAN14| */
  ILCAN2_OnInit();
  NMCAN2_OnInit();
  /* #ChannelEnd# |CAN2| #BusEnd# |FDCAN14| */
  //--- end generated part --- Block end #Body_OnInit#; do not delete this line! Add application code below this line.
}

on start
{
  // Start CAPL includes and node's modules/DLLs
  //--- begin generated part --- Block start #Hdr_OnStart#; do not delete this line and do not add application code in this code block!
  /* #ChannelStart# |CAN1| #BusStart# |FDCAN2| */
  /* #ChannelEnd# |CAN1| #BusEnd# |FDCAN2| */
  //--- end generated part --- Block end #Hdr_OnStart#; do not delete this line! Add application code below this line.
  //--- begin generated part --- Block start #Body_OnStart#; do not delete this line and do not add application code in this code block!
  /* #ChannelStart# |CAN1| #BusStart# |FDCAN2| */
  ILCAN1_OnStart();
  NMCAN1_OnStart();
  /* #ChannelEnd# |CAN1| #BusEnd# |FDCAN2| */
  /* #ChannelStart# |CAN2| #BusStart# |FDCAN14| */
  ILCAN2_OnStart();
  NMCAN2_OnStart();
  /* #ChannelEnd# |CAN2| #BusEnd# |FDCAN14| */
  //--- end generated part --- Block end #Body_OnStart#; do not delete this line! Add application code below this line.
}

on preStop
{
  // Prepare stopping
  //--- begin generated part --- Block start #Hdr_OnStopping#; do not delete this line and do not add application code in this code block!
  /* #ChannelStart# |CAN1| #BusStart# |FDCAN2| */
  /* #ChannelEnd# |CAN1| #BusEnd# |FDCAN2| */
  //--- end generated part --- Block end #Hdr_OnStopping#; do not delete this line! Add application code below this line.
  //--- begin generated part --- Block start #Body_OnStopping#; do not delete this line and do not add application code in this code block!
  /* #ChannelStart# |CAN1| #BusStart# |FDCAN2| */
  /* #ChannelEnd# |CAN1| #BusEnd# |FDCAN2| */
  //--- end generated part --- Block end #Body_OnStopping#; do not delete this line! Add application code below this line.
}

on stopMeasurement
{
  // Stop actions
  //--- begin generated part --- Block start #Hdr_OnStop#; do not delete this line and do not add application code in this code block!
  /* #ChannelStart# |CAN1| #BusStart# |FDCAN2| */
  /* #ChannelEnd# |CAN1| #BusEnd# |FDCAN2| */
  //--- end generated part --- Block end #Hdr_OnStop#; do not delete this line! Add application code below this line.
  //--- begin generated part --- Block start #Body_OnStop#; do not delete this line and do not add application code in this code block!
  /* #ChannelStart# |CAN1| #BusStart# |FDCAN2| */
  /* #ChannelEnd# |CAN1| #BusEnd# |FDCAN2| */
  //--- end generated part --- Block end #Body_OnStop#; do not delete this line! Add application code below this line.
}

void StartSim(dword busContext, int busActive, int mode)
{
  // Called when ... due to ...
  //   mode == 1: ILControlResume
  //   mode == 2: ILControlStart
  //   mode == 3: ILControlSimulationOn
  //--- begin generated part --- Block start #Hdr_StartSim#; do not delete this line and do not add application code in this code block!
  /* #ChannelStart# |CAN1| #BusStart# |FDCAN2| */
  /* #ChannelEnd# |CAN1| #BusEnd# |FDCAN2| */
  //--- end generated part --- Block end #Hdr_StartSim#; do not delete this line! Add application code below this line.
  //write("[%.6f %NODE_NAME%] StartSim(0x%X, %d, %d)", TimeNowNS()/1e9, busContext, busActive, mode);
  //--- begin generated part --- Block start #Body_StartSim#; do not delete this line and do not add application code in this code block!
  /* #ChannelStart# |CAN1| #BusStart# |FDCAN2| */
  /* #ChannelEnd# |CAN1| #BusEnd# |FDCAN2| */
  //--- end generated part --- Block end #Body_StartSim#; do not delete this line! Add application code below this line.
}

void StopSim(dword busContext, int busActive, int mode)
{
  // Called when ... due to ...
  //   mode == 1: ILControlWait
  //   mode == 2: ILControlStop
  //   mode == 3: ILControlSimulationOff
  //--- begin generated part --- Block start #Hdr_StopSim#; do not delete this line and do not add application code in this code block!
  /* #ChannelStart# |CAN1| #BusStart# |FDCAN2| */
  /* #ChannelEnd# |CAN1| #BusEnd# |FDCAN2| */
  //--- end generated part --- Block end #Hdr_StopSim#; do not delete this line! Add application code below this line.
  //write("[%.6f %NODE_NAME%] StopSim(0x%X, %d, %d)", TimeNowNS()/1e9, busContext, busActive, mode);
  //--- begin generated part --- Block start #Body_StopSim#; do not delete this line and do not add application code in this code block!
  /* #ChannelStart# |CAN1| #BusStart# |FDCAN2| */
  /* #ChannelEnd# |CAN1| #BusEnd# |FDCAN2| */
  //--- end generated part --- Block end #Body_StopSim#; do not delete this line! Add application code below this line.
}

on sysvar_update sysvar::IL::Klemme15
{
  // Handle system state variable
  //--- begin generated part --- Block start #Hdr_KL15_Klemme15#; do not delete this line and do not add application code in this code block!
  /* #ChannelStart# |CAN1| #BusStart# |FDCAN2| */
  /* #ChannelEnd# |CAN1| #BusEnd# |FDCAN2| */
  //--- end generated part --- Block end #Hdr_KL15_Klemme15#; do not delete this line! Add application code below this line.
  //--- begin generated part --- Block start #Body_KL15_Klemme15#; do not delete this line and do not add application code in this code block!
  /* #ChannelStart# |CAN1| #BusStart# |FDCAN2| */
  ILCAN1_OnEnvKlemme15(@this);
  /* #ChannelEnd# |CAN1| #BusEnd# |FDCAN2| */
  /* #ChannelStart# |CAN2| #BusStart# |FDCAN14| */
  ILCAN2_OnEnvKlemme15(@this);
  /* #ChannelEnd# |CAN2| #BusEnd# |FDCAN14| */
  //--- end generated part --- Block end #Body_KL15_Klemme15#; do not delete this line! Add application code below this line.
}

on sysvar_update sysvar::IL::Klemme30
{
  // Handle system state variable
  //--- begin generated part --- Block start #Hdr_KL30_Klemme30#; do not delete this line and do not add application code in this code block!
  /* #ChannelStart# |CAN1| #BusStart# |FDCAN2| */
  /* #ChannelEnd# |CAN1| #BusEnd# |FDCAN2| */
  //--- end generated part --- Block end #Hdr_KL30_Klemme30#; do not delete this line! Add application code below this line.
  //--- begin generated part --- Block start #Body_KL30_Klemme30#; do not delete this line and do not add application code in this code block!
  /* #ChannelStart# |CAN1| #BusStart# |FDCAN2| */
  ILCAN1_OnEnvKlemme30(@this);
  /* #ChannelEnd# |CAN1| #BusEnd# |FDCAN2| */
  /* #ChannelStart# |CAN2| #BusStart# |FDCAN14| */
  ILCAN2_OnEnvKlemme30(@this);
  /* #ChannelEnd# |CAN2| #BusEnd# |FDCAN14| */
  //--- end generated part --- Block end #Body_KL30_Klemme30#; do not delete this line! Add application code below this line.
}

//dword applILTxPending(long aId, dword aDlc, byte data[])
//{
 // dword ret = 1;
 // //--- begin generated part --- Block start #Hdr_applILTxPending#; do not delete this line and do not add application code in this code block!
  /* #ChannelStart# |CAN1| #BusStart# |FDCAN2| */
  /* #ChannelEnd# |CAN1| #BusEnd# |FDCAN2| */
  //--- end generated part --- Block end #Hdr_applILTxPending#; do not delete this line! Add application code below this line.
 // //--- begin generated part --- Block start #Body_applILTxPending#; do not delete this line and do not add application code in this code block!
  /* #ChannelStart# |CAN1| #BusStart# |FDCAN2| */
  /* #ChannelEnd# |CAN1| #BusEnd# |FDCAN2| */
  //--- end generated part --- Block end #Body_applILTxPending#; do not delete this line! Add application code below this line.
 // return ret;
//}

void Nm_NetworkStartInd()
{
  // Callback of CAN AUTOSAR NM DLL
  dword lBusContext;
  //--- begin generated part --- Block start #Hdr_Nm_NetworkStartInd#; do not delete this line and do not add application code in this code block!
  /* #ChannelStart# |CAN1| #BusStart# |FDCAN2| */
  /* #ChannelEnd# |CAN1| #BusEnd# |FDCAN2| */
  //--- end generated part --- Block end #Hdr_Nm_NetworkStartInd#; do not delete this line! Add application code below this line.
  lBusContext = GetBusContext();
  //--- begin generated part --- Block start #Body_Nm_NetworkStartInd#; do not delete this line and do not add application code in this code block!
  /* #ChannelStart# |CAN1| #BusStart# |FDCAN2| */
  if (lBusContext == gNMCAN1_BusContext) NMCAN1_IndNetworkStart();
  /* #ChannelEnd# |CAN1| #BusEnd# |FDCAN2| */
  /* #ChannelStart# |CAN2| #BusStart# |FDCAN14| */
  if (lBusContext == gNMCAN2_BusContext) NMCAN2_IndNetworkStart();
  /* #ChannelEnd# |CAN2| #BusEnd# |FDCAN14| */
  //--- end generated part --- Block end #Body_Nm_NetworkStartInd#; do not delete this line! Add application code below this line.
  SetBusContext(lBusContext);
}

void Nm_NetworkModeInd()
{
  // Callback of CAN AUTOSAR NM DLL
  dword lBusContext;
  //--- begin generated part --- Block start #Hdr_Nm_NetworkModeInd#; do not delete this line and do not add application code in this code block!
  /* #ChannelStart# |CAN1| #BusStart# |FDCAN2| */
  /* #ChannelEnd# |CAN1| #BusEnd# |FDCAN2| */
  //--- end generated part --- Block end #Hdr_Nm_NetworkModeInd#; do not delete this line! Add application code below this line.
  lBusContext = GetBusContext();
  //--- begin generated part --- Block start #Body_Nm_NetworkModeInd#; do not delete this line and do not add application code in this code block!
  /* #ChannelStart# |CAN1| #BusStart# |FDCAN2| */
  if (lBusContext == gNMCAN1_BusContext) NMCAN1_IndNetworkMode();
  /* #ChannelEnd# |CAN1| #BusEnd# |FDCAN2| */
  /* #ChannelStart# |CAN2| #BusStart# |FDCAN14| */
  if (lBusContext == gNMCAN2_BusContext) NMCAN2_IndNetworkMode();
  /* #ChannelEnd# |CAN2| #BusEnd# |FDCAN14| */
  //--- end generated part --- Block end #Body_Nm_NetworkModeInd#; do not delete this line! Add application code below this line.
  SetBusContext(lBusContext);
}

void Nm_NetworkTimeoutInd()
{
  // Callback of CAN AUTOSAR NM DLL
  dword lBusContext;
  //--- begin generated part --- Block start #Hdr_Nm_NetworkTimeoutInd#; do not delete this line and do not add application code in this code block!
  /* #ChannelStart# |CAN1| #BusStart# |FDCAN2| */
  /* #ChannelEnd# |CAN1| #BusEnd# |FDCAN2| */
  //--- end generated part --- Block end #Hdr_Nm_NetworkTimeoutInd#; do not delete this line! Add application code below this line.
  lBusContext = GetBusContext();
  //--- begin generated part --- Block start #Body_Nm_NetworkTimeoutInd#; do not delete this line and do not add application code in this code block!
  /* #ChannelStart# |CAN1| #BusStart# |FDCAN2| */
  if (lBusContext == gNMCAN1_BusContext) NMCAN1_IndNetworkTimeout();
  /* #ChannelEnd# |CAN1| #BusEnd# |FDCAN2| */
  /* #ChannelStart# |CAN2| #BusStart# |FDCAN14| */
  if (lBusContext == gNMCAN2_BusContext) NMCAN2_IndNetworkTimeout();
  /* #ChannelEnd# |CAN2| #BusEnd# |FDCAN14| */
  //--- end generated part --- Block end #Body_Nm_NetworkTimeoutInd#; do not delete this line! Add application code below this line.
  SetBusContext(lBusContext);
}

void Nm_PrepareBusSleepModeInd()
{
  // Callback of CAN AUTOSAR NM DLL
  dword lBusContext;
  //--- begin generated part --- Block start #Hdr_Nm_PrepareBusSleepModeInd#; do not delete this line and do not add application code in this code block!
  /* #ChannelStart# |CAN1| #BusStart# |FDCAN2| */
  /* #ChannelEnd# |CAN1| #BusEnd# |FDCAN2| */
  //--- end generated part --- Block end #Hdr_Nm_PrepareBusSleepModeInd#; do not delete this line! Add application code below this line.
  lBusContext = GetBusContext();
  //--- begin generated part --- Block start #Body_Nm_PrepareBusSleepModeInd#; do not delete this line and do not add application code in this code block!
  /* #ChannelStart# |CAN1| #BusStart# |FDCAN2| */
  if (lBusContext == gNMCAN1_BusContext) NMCAN1_IndPrepareBusSleepMode();
  /* #ChannelEnd# |CAN1| #BusEnd# |FDCAN2| */
  /* #ChannelStart# |CAN2| #BusStart# |FDCAN14| */
  if (lBusContext == gNMCAN2_BusContext) NMCAN2_IndPrepareBusSleepMode();
  /* #ChannelEnd# |CAN2| #BusEnd# |FDCAN14| */
  //--- end generated part --- Block end #Body_Nm_PrepareBusSleepModeInd#; do not delete this line! Add application code below this line.
  SetBusContext(lBusContext);
}

void Nm_BusSleepModeInd()
{
  // Callback of CAN AUTOSAR NM DLL
  dword lBusContext;
  //--- begin generated part --- Block start #Hdr_Nm_BusSleepModeInd#; do not delete this line and do not add application code in this code block!
  /* #ChannelStart# |CAN1| #BusStart# |FDCAN2| */
  /* #ChannelEnd# |CAN1| #BusEnd# |FDCAN2| */
  //--- end generated part --- Block end #Hdr_Nm_BusSleepModeInd#; do not delete this line! Add application code below this line.
  lBusContext = GetBusContext();
  //--- begin generated part --- Block start #Body_Nm_BusSleepModeInd#; do not delete this line and do not add application code in this code block!
  /* #ChannelStart# |CAN1| #BusStart# |FDCAN2| */
  if (lBusContext == gNMCAN1_BusContext) NMCAN1_IndBusSleepMode();
  /* #ChannelEnd# |CAN1| #BusEnd# |FDCAN2| */
  /* #ChannelStart# |CAN2| #BusStart# |FDCAN14| */
  if (lBusContext == gNMCAN2_BusContext) NMCAN2_IndBusSleepMode();
  /* #ChannelEnd# |CAN2| #BusEnd# |FDCAN14| */
  //--- end generated part --- Block end #Body_Nm_BusSleepModeInd#; do not delete this line! Add application code below this line.
  SetBusContext(lBusContext);
}

void Nm_StateChangeNotification(long previousState, long currentState)
{
  // Callback of CAN AUTOSAR NM DLL
  dword lBusContext;
  //--- begin generated part --- Block start #Hdr_Nm_StateChangeNotification#; do not delete this line and do not add application code in this code block!
  /* #ChannelStart# |CAN1| #BusStart# |FDCAN2| */
  /* #ChannelEnd# |CAN1| #BusEnd# |FDCAN2| */
  //--- end generated part --- Block end #Hdr_Nm_StateChangeNotification#; do not delete this line! Add application code below this line.
  lBusContext = GetBusContext();
  //--- begin generated part --- Block start #Body_Nm_StateChangeNotification#; do not delete this line and do not add application code in this code block!
  /* #ChannelStart# |CAN1| #BusStart# |FDCAN2| */
  if (lBusContext == gNMCAN1_BusContext) NMCAN1_IndStateChangeNotification(previousState, currentState);
  /* #ChannelEnd# |CAN1| #BusEnd# |FDCAN2| */
  /* #ChannelStart# |CAN2| #BusStart# |FDCAN14| */
  if (lBusContext == gNMCAN2_BusContext) NMCAN2_IndStateChangeNotification(previousState, currentState);
  /* #ChannelEnd# |CAN2| #BusEnd# |FDCAN14| */
  //--- end generated part --- Block end #Body_Nm_StateChangeNotification#; do not delete this line! Add application code below this line.
  SetBusContext(lBusContext);
}

/**************************** DLC Fault Injection ****************************/

on sysvar_update DLC_FAULT_INJECTION::SVar_PDC_INFO_FD_BSM2_DLCFault_Value_SET
{
  dword BusContext;
  if (@this >= 10)
  {
    if (@DLC_FAULT_INJECTION::SVar_PDC_INFO_FD_BSM2_DLCFlt_Injctn_SET == 1)
    {
      BusContext = GetBusNameContext("FDCAN2");
      setBusContext(BusContext);
      
      ILFaultInjectionSetMsgDlc(PDC_INFO_FD_BSM2, @DLC_FAULT_INJECTION::SVar_PDC_INFO_FD_BSM2_DLCFault_Value_SET);
    }
    
    else
    {
      ILFaultInjectionResetMsgDlc(PDC_INFO_FD_BSM2);
    }
  }
  
  else
  {
    ILFaultInjectionResetMsgDlc(PDC_INFO_FD_BSM2);
  }
}

on sysvar_update DLC_FAULT_INJECTION::SVar_NM_BSM2_DLCFault_Value_SET
{
  dword BusContext;
  if (@this >= 10)
  {
    if (@DLC_FAULT_INJECTION::SVar_NM_BSM2_DLCFlt_Injctn_SET == 1)
    {
      BusContext = GetBusNameContext("FDCAN2");
      setBusContext(BusContext);
      ILFaultInjectionSetMsgDlc(NM_BSM2, @DLC_FAULT_INJECTION::SVar_NM_BSM2_DLCFault_Value_SET);
    }
    
    else
    {
      ILFaultInjectionResetMsgDlc(NM_BSM2);
    }
  }
  
  else
  {
    ILFaultInjectionResetMsgDlc(NM_BSM2);
  }
}

on sysvar_update DLC_FAULT_INJECTION::SVar_NM_BSM2_DLCFault_Value_14_SET
{
  dword BusContext;
  if (@this >= 0)
  {
    if (@DLC_FAULT_INJECTION::SVar_NM_BSM2_14DLCFlt_Injctn_SET == 1)
    {
      
      BusContext = GetBusNameContext("FDCAN14");
      setBusContext(BusContext);
      ILFaultInjectionSetMsgDlc(NM_BSM2, @DLC_FAULT_INJECTION::SVar_NM_BSM2_DLCFault_Value_14_SET);
    }
    
    else
    {
      ILFaultInjectionResetMsgDlc(NM_BSM2);
    }
  }
  
  else
  {
    ILFaultInjectionResetMsgDlc(NM_BSM2);
  }
}


//--- begin generated part --- Block start <#Helper_Functions#> do not delete this line and do not add application code in this code block!
/* #ChannelStart# |CAN1| #BusStart# |FDCAN2| */
/* #ChannelEnd# |CAN1| #BusEnd# |FDCAN2| */
//--- end generated part --- Block end <#Helper_Functions#> do not delete this line! Add application code below this line.

//--- begin generated part --- Block start <#SysVar_Handler#> do not delete this line and do not add application code in this code block!
/* #ChannelStart# |CAN1| #BusStart# |FDCAN2| */
on sysvar_update sysvar::IL_CAN1::NODES::N_BSM2::EnableNode
{
  ILCAN1_Enable(@this && @sysvar::IL_CAN1::enable_AllNodes);
}

on sysvar_update sysvar::IL_CAN1::enable_AllNodes
{
  ILCAN1_Enable(@this && @sysvar::IL_CAN1::NODES::N_BSM2::EnableNode);
}

on sysvar_update sysvar::NM_CAN1::NODES::N_BSM2::DeactivateNM
{
  if( @this == 1 || @sysvar::NM_CAN1::StateControl::DeactivateNM == 1)
  {
    NMCAN1_Enable(0);
  }
  else
  {
    NMCAN1_Enable(1);
  }
}

on sysvar_update sysvar::NM_CAN1::StateControl::DeactivateNM
{
  if( @this == 1 || @sysvar::NM_CAN1::NODES::N_BSM2::DeactivateNM == 1)
  {
    NMCAN1_Enable(0);
  }
  else
  {
    NMCAN1_Enable(1);
  }
}

on sysvar_update sysvar::IL_CAN1::NODES::N_BSM2::MESSAGES::BRAKE2_FD_1::TIMINGS::EnableCyclic
{
  if (@this == 1)
  {
    SetBusContext(gILCAN1_BusContext);
    ILFaultInjectionEnableMsg  (FDCAN2::BSM2::BRAKE2_FD_1);
  }
  else
  {
    SetBusContext(gILCAN1_BusContext);
    ILFaultInjectionDisableMsg (FDCAN2::BSM2::BRAKE2_FD_1);
  }
}

on sysvar_update sysvar::IL_CAN1::NODES::N_BSM2::MESSAGES::BRAKE2_FD_1::TIMINGS::SetNormalCycle
{
  if (@this == 1 && @sysvar::IL_CAN1::NODES::N_BSM2::MESSAGES::BRAKE2_FD_1::TIMINGS::EnableCyclic)
  {
    @sysvar::IL_CAN1::NODES::N_BSM2::MESSAGES::BRAKE2_FD_1::TIMINGS::SelectedPeriod = 0;
  }
}

on sysvar_update sysvar::IL_CAN1::NODES::N_BSM2::MESSAGES::BRAKE2_FD_1::TIMINGS::SetNewCycleContinously
{
  if (@this == 1 && @sysvar::IL_CAN1::NODES::N_BSM2::MESSAGES::BRAKE2_FD_1::TIMINGS::EnableCyclic)
  {
    @sysvar::IL_CAN1::NODES::N_BSM2::MESSAGES::BRAKE2_FD_1::TIMINGS::SelectedPeriod = -1;
  }
}

on sysvar_update sysvar::IL_CAN1::NODES::N_BSM2::MESSAGES::BRAKE2_FD_1::TIMINGS::SelectedPeriod
{
  if (@this == 0 && @sysvar::IL_CAN1::NODES::N_BSM2::MESSAGES::BRAKE2_FD_1::TIMINGS::EnableCyclic)
  {
    SetBusContext(gILCAN1_BusContext);
    gCAN1DisturbancePeriod = @sysvar::IL_CAN1::NODES::N_BSM2::MESSAGES::BRAKE2_FD_1::TIMINGS::NormalCyclePeriod;
    ILFaultInjectionResetMsgCycleTime(FDCAN2::BSM2::BRAKE2_FD_1);
  }
  else if (@this == 1 && @sysvar::IL_CAN1::NODES::N_BSM2::MESSAGES::BRAKE2_FD_1::TIMINGS::EnableCyclic)
  {
    SetBusContext(gILCAN1_BusContext);
    gCAN1DisturbancePeriod = @sysvar::IL_CAN1::NODES::N_BSM2::MESSAGES::BRAKE2_FD_1::TIMINGS::ActiveCyclePeriod;
    ILFaultInjectionSetMsgCycleTime(FDCAN2::BSM2::BRAKE2_FD_1, gCAN1DisturbancePeriod);
  }
  else if (@this == -1 && @sysvar::IL_CAN1::NODES::N_BSM2::MESSAGES::BRAKE2_FD_1::TIMINGS::EnableCyclic)
  {
    SetBusContext(gILCAN1_BusContext);
    gCAN1DisturbancePeriod = @sysvar::IL_CAN1::NODES::N_BSM2::MESSAGES::BRAKE2_FD_1::TIMINGS::CyclePeriod;
    ILFaultInjectionSetMsgCycleTime(FDCAN2::BSM2::BRAKE2_FD_1, gCAN1DisturbancePeriod);
  }
}

on sysvar_update sysvar::IL_CAN1::NODES::N_BSM2::MESSAGES::BRAKE2_FD_1::TIMINGS::SendOnce
{
  if (@this == 1)
  {
    SetBusContext(gILCAN1_BusContext);
    ILSetMsgEvent(FDCAN2::BSM2::BRAKE2_FD_1);
  }
}

on sysvar_update sysvar::IL_CAN1::NODES::N_BSM2::MESSAGES::BRAKE2_FD_2::TIMINGS::EnableCyclic
{
  if (@this == 1)
  {
    SetBusContext(gILCAN1_BusContext);
    ILFaultInjectionEnableMsg  (FDCAN2::BSM2::BRAKE2_FD_2);
  }
  else
  {
    SetBusContext(gILCAN1_BusContext);
    ILFaultInjectionDisableMsg (FDCAN2::BSM2::BRAKE2_FD_2);
  }
}

on sysvar_update sysvar::IL_CAN1::NODES::N_BSM2::MESSAGES::BRAKE2_FD_2::TIMINGS::SetNormalCycle
{
  if (@this == 1 && @sysvar::IL_CAN1::NODES::N_BSM2::MESSAGES::BRAKE2_FD_2::TIMINGS::EnableCyclic)
  {
    @sysvar::IL_CAN1::NODES::N_BSM2::MESSAGES::BRAKE2_FD_2::TIMINGS::SelectedPeriod = 0;
  }
}

on sysvar_update sysvar::IL_CAN1::NODES::N_BSM2::MESSAGES::BRAKE2_FD_2::TIMINGS::SetNewCycleContinously
{
  if (@this == 1 && @sysvar::IL_CAN1::NODES::N_BSM2::MESSAGES::BRAKE2_FD_2::TIMINGS::EnableCyclic)
  {
    @sysvar::IL_CAN1::NODES::N_BSM2::MESSAGES::BRAKE2_FD_2::TIMINGS::SelectedPeriod = -1;
  }
}

on sysvar_update sysvar::IL_CAN1::NODES::N_BSM2::MESSAGES::BRAKE2_FD_2::TIMINGS::SelectedPeriod
{
  if (@this == 0 && @sysvar::IL_CAN1::NODES::N_BSM2::MESSAGES::BRAKE2_FD_2::TIMINGS::EnableCyclic)
  {
    SetBusContext(gILCAN1_BusContext);
    gCAN1DisturbancePeriod = @sysvar::IL_CAN1::NODES::N_BSM2::MESSAGES::BRAKE2_FD_2::TIMINGS::NormalCyclePeriod;
    ILFaultInjectionResetMsgCycleTime(FDCAN2::BSM2::BRAKE2_FD_2);
  }
  else if (@this == 1 && @sysvar::IL_CAN1::NODES::N_BSM2::MESSAGES::BRAKE2_FD_2::TIMINGS::EnableCyclic)
  {
    SetBusContext(gILCAN1_BusContext);
    gCAN1DisturbancePeriod = @sysvar::IL_CAN1::NODES::N_BSM2::MESSAGES::BRAKE2_FD_2::TIMINGS::ActiveCyclePeriod;
    ILFaultInjectionSetMsgCycleTime(FDCAN2::BSM2::BRAKE2_FD_2, gCAN1DisturbancePeriod);
  }
  else if (@this == -1 && @sysvar::IL_CAN1::NODES::N_BSM2::MESSAGES::BRAKE2_FD_2::TIMINGS::EnableCyclic)
  {
    SetBusContext(gILCAN1_BusContext);
    gCAN1DisturbancePeriod = @sysvar::IL_CAN1::NODES::N_BSM2::MESSAGES::BRAKE2_FD_2::TIMINGS::CyclePeriod;
    ILFaultInjectionSetMsgCycleTime(FDCAN2::BSM2::BRAKE2_FD_2, gCAN1DisturbancePeriod);
  }
}

on sysvar_update sysvar::IL_CAN1::NODES::N_BSM2::MESSAGES::BRAKE2_FD_2::TIMINGS::SendOnce
{
  if (@this == 1)
  {
    SetBusContext(gILCAN1_BusContext);
    ILSetMsgEvent(FDCAN2::BSM2::BRAKE2_FD_2);
  }
}

on sysvar_update sysvar::IL_CAN1::NODES::N_BSM2::MESSAGES::BRAKE2_FD_3::TIMINGS::EnableCyclic
{
  if (@this == 1)
  {
    SetBusContext(gILCAN1_BusContext);
    ILFaultInjectionEnableMsg  (FDCAN2::BSM2::BRAKE2_FD_3);
  }
  else
  {
    SetBusContext(gILCAN1_BusContext);
    ILFaultInjectionDisableMsg (FDCAN2::BSM2::BRAKE2_FD_3);
  }
}

on sysvar_update sysvar::IL_CAN1::NODES::N_BSM2::MESSAGES::BRAKE2_FD_3::TIMINGS::SetNormalCycle
{
  if (@this == 1 && @sysvar::IL_CAN1::NODES::N_BSM2::MESSAGES::BRAKE2_FD_3::TIMINGS::EnableCyclic)
  {
    @sysvar::IL_CAN1::NODES::N_BSM2::MESSAGES::BRAKE2_FD_3::TIMINGS::SelectedPeriod = 0;
  }
}

on sysvar_update sysvar::IL_CAN1::NODES::N_BSM2::MESSAGES::BRAKE2_FD_3::TIMINGS::SetNewCycleContinously
{
  if (@this == 1 && @sysvar::IL_CAN1::NODES::N_BSM2::MESSAGES::BRAKE2_FD_3::TIMINGS::EnableCyclic)
  {
    @sysvar::IL_CAN1::NODES::N_BSM2::MESSAGES::BRAKE2_FD_3::TIMINGS::SelectedPeriod = -1;
  }
}

on sysvar_update sysvar::IL_CAN1::NODES::N_BSM2::MESSAGES::BRAKE2_FD_3::TIMINGS::SelectedPeriod
{
  if (@this == 0 && @sysvar::IL_CAN1::NODES::N_BSM2::MESSAGES::BRAKE2_FD_3::TIMINGS::EnableCyclic)
  {
    SetBusContext(gILCAN1_BusContext);
    gCAN1DisturbancePeriod = @sysvar::IL_CAN1::NODES::N_BSM2::MESSAGES::BRAKE2_FD_3::TIMINGS::NormalCyclePeriod;
    ILFaultInjectionResetMsgCycleTime(FDCAN2::BSM2::BRAKE2_FD_3);
  }
  else if (@this == 1 && @sysvar::IL_CAN1::NODES::N_BSM2::MESSAGES::BRAKE2_FD_3::TIMINGS::EnableCyclic)
  {
    SetBusContext(gILCAN1_BusContext);
    gCAN1DisturbancePeriod = @sysvar::IL_CAN1::NODES::N_BSM2::MESSAGES::BRAKE2_FD_3::TIMINGS::ActiveCyclePeriod;
    ILFaultInjectionSetMsgCycleTime(FDCAN2::BSM2::BRAKE2_FD_3, gCAN1DisturbancePeriod);
  }
  else if (@this == -1 && @sysvar::IL_CAN1::NODES::N_BSM2::MESSAGES::BRAKE2_FD_3::TIMINGS::EnableCyclic)
  {
    SetBusContext(gILCAN1_BusContext);
    gCAN1DisturbancePeriod = @sysvar::IL_CAN1::NODES::N_BSM2::MESSAGES::BRAKE2_FD_3::TIMINGS::CyclePeriod;
    ILFaultInjectionSetMsgCycleTime(FDCAN2::BSM2::BRAKE2_FD_3, gCAN1DisturbancePeriod);
  }
}

on sysvar_update sysvar::IL_CAN1::NODES::N_BSM2::MESSAGES::BRAKE2_FD_3::TIMINGS::SendOnce
{
  if (@this == 1)
  {
    SetBusContext(gILCAN1_BusContext);
    ILSetMsgEvent(FDCAN2::BSM2::BRAKE2_FD_3);
  }
}

on sysvar_update sysvar::IL_CAN1::NODES::N_BSM2::MESSAGES::CFG_DATA_CODE_RSP_BSM2::TIMINGS::EnableCyclic
{
  if (@this == 1)
  {
    SetBusContext(gILCAN1_BusContext);
    ILFaultInjectionEnableMsg  (FDCAN2::BSM2::CFG_DATA_CODE_RSP_BSM2);
  }
  else
  {
    SetBusContext(gILCAN1_BusContext);
    ILFaultInjectionDisableMsg (FDCAN2::BSM2::CFG_DATA_CODE_RSP_BSM2);
  }
}

on sysvar_update sysvar::IL_CAN1::NODES::N_BSM2::MESSAGES::CFG_DATA_CODE_RSP_BSM2::TIMINGS::SetNormalCycle
{
  if (@this == 1 && @sysvar::IL_CAN1::NODES::N_BSM2::MESSAGES::CFG_DATA_CODE_RSP_BSM2::TIMINGS::EnableCyclic)
  {
    @sysvar::IL_CAN1::NODES::N_BSM2::MESSAGES::CFG_DATA_CODE_RSP_BSM2::TIMINGS::SelectedPeriod = 0;
  }
}

on sysvar_update sysvar::IL_CAN1::NODES::N_BSM2::MESSAGES::CFG_DATA_CODE_RSP_BSM2::TIMINGS::SetNewCycleContinously
{
  if (@this == 1 && @sysvar::IL_CAN1::NODES::N_BSM2::MESSAGES::CFG_DATA_CODE_RSP_BSM2::TIMINGS::EnableCyclic)
  {
    @sysvar::IL_CAN1::NODES::N_BSM2::MESSAGES::CFG_DATA_CODE_RSP_BSM2::TIMINGS::SelectedPeriod = -1;
  }
}

on sysvar_update sysvar::IL_CAN1::NODES::N_BSM2::MESSAGES::CFG_DATA_CODE_RSP_BSM2::TIMINGS::SelectedPeriod
{
  if (@this == 0 && @sysvar::IL_CAN1::NODES::N_BSM2::MESSAGES::CFG_DATA_CODE_RSP_BSM2::TIMINGS::EnableCyclic)
  {
    SetBusContext(gILCAN1_BusContext);
    gCAN1DisturbancePeriod = @sysvar::IL_CAN1::NODES::N_BSM2::MESSAGES::CFG_DATA_CODE_RSP_BSM2::TIMINGS::NormalCyclePeriod;
    ILFaultInjectionResetMsgCycleTime(FDCAN2::BSM2::CFG_DATA_CODE_RSP_BSM2);
  }
  else if (@this == 1 && @sysvar::IL_CAN1::NODES::N_BSM2::MESSAGES::CFG_DATA_CODE_RSP_BSM2::TIMINGS::EnableCyclic)
  {
    SetBusContext(gILCAN1_BusContext);
    gCAN1DisturbancePeriod = @sysvar::IL_CAN1::NODES::N_BSM2::MESSAGES::CFG_DATA_CODE_RSP_BSM2::TIMINGS::ActiveCyclePeriod;
    ILFaultInjectionSetMsgCycleTime(FDCAN2::BSM2::CFG_DATA_CODE_RSP_BSM2, gCAN1DisturbancePeriod);
  }
  else if (@this == -1 && @sysvar::IL_CAN1::NODES::N_BSM2::MESSAGES::CFG_DATA_CODE_RSP_BSM2::TIMINGS::EnableCyclic)
  {
    SetBusContext(gILCAN1_BusContext);
    gCAN1DisturbancePeriod = @sysvar::IL_CAN1::NODES::N_BSM2::MESSAGES::CFG_DATA_CODE_RSP_BSM2::TIMINGS::CyclePeriod;
    ILFaultInjectionSetMsgCycleTime(FDCAN2::BSM2::CFG_DATA_CODE_RSP_BSM2, gCAN1DisturbancePeriod);
  }
}

on sysvar_update sysvar::IL_CAN1::NODES::N_BSM2::MESSAGES::CFG_DATA_CODE_RSP_BSM2::TIMINGS::SendOnce
{
  if (@this == 1)
  {
    SetBusContext(gILCAN1_BusContext);
    ILSetMsgEvent(FDCAN2::BSM2::CFG_DATA_CODE_RSP_BSM2);
  }
}

on sysvar_update sysvar::IL_CAN1::NODES::N_BSM2::MESSAGES::PDC_INFO_FD_BSM2::TIMINGS::EnableCyclic
{
  if (@this == 1)
  {
    SetBusContext(gILCAN1_BusContext);
    ILFaultInjectionEnableMsg  (FDCAN2::BSM2::PDC_INFO_FD_BSM2);
  }
  else
  {
    SetBusContext(gILCAN1_BusContext);
    ILFaultInjectionDisableMsg (FDCAN2::BSM2::PDC_INFO_FD_BSM2);
  }
}

on sysvar_update sysvar::IL_CAN1::NODES::N_BSM2::MESSAGES::PDC_INFO_FD_BSM2::TIMINGS::SetNormalCycle
{
  if (@this == 1 && @sysvar::IL_CAN1::NODES::N_BSM2::MESSAGES::PDC_INFO_FD_BSM2::TIMINGS::EnableCyclic)
  {
    @sysvar::IL_CAN1::NODES::N_BSM2::MESSAGES::PDC_INFO_FD_BSM2::TIMINGS::SelectedPeriod = 0;
  }
}

on sysvar_update sysvar::IL_CAN1::NODES::N_BSM2::MESSAGES::PDC_INFO_FD_BSM2::TIMINGS::SetNewCycleContinously
{
  if (@this == 1 && @sysvar::IL_CAN1::NODES::N_BSM2::MESSAGES::PDC_INFO_FD_BSM2::TIMINGS::EnableCyclic)
  {
    @sysvar::IL_CAN1::NODES::N_BSM2::MESSAGES::PDC_INFO_FD_BSM2::TIMINGS::SelectedPeriod = -1;
  }
}

on sysvar_update sysvar::IL_CAN1::NODES::N_BSM2::MESSAGES::PDC_INFO_FD_BSM2::TIMINGS::SelectedPeriod
{
  if (@this == 0 && @sysvar::IL_CAN1::NODES::N_BSM2::MESSAGES::PDC_INFO_FD_BSM2::TIMINGS::EnableCyclic)
  {
    SetBusContext(gILCAN1_BusContext);
    gCAN1DisturbancePeriod = @sysvar::IL_CAN1::NODES::N_BSM2::MESSAGES::PDC_INFO_FD_BSM2::TIMINGS::NormalCyclePeriod;
    ILFaultInjectionResetMsgCycleTime(FDCAN2::BSM2::PDC_INFO_FD_BSM2);
  }
  else if (@this == 1 && @sysvar::IL_CAN1::NODES::N_BSM2::MESSAGES::PDC_INFO_FD_BSM2::TIMINGS::EnableCyclic)
  {
    SetBusContext(gILCAN1_BusContext);
    gCAN1DisturbancePeriod = @sysvar::IL_CAN1::NODES::N_BSM2::MESSAGES::PDC_INFO_FD_BSM2::TIMINGS::ActiveCyclePeriod;
    ILFaultInjectionSetMsgCycleTime(FDCAN2::BSM2::PDC_INFO_FD_BSM2, gCAN1DisturbancePeriod);
  }
  else if (@this == -1 && @sysvar::IL_CAN1::NODES::N_BSM2::MESSAGES::PDC_INFO_FD_BSM2::TIMINGS::EnableCyclic)
  {
    SetBusContext(gILCAN1_BusContext);
    gCAN1DisturbancePeriod = @sysvar::IL_CAN1::NODES::N_BSM2::MESSAGES::PDC_INFO_FD_BSM2::TIMINGS::CyclePeriod;
    ILFaultInjectionSetMsgCycleTime(FDCAN2::BSM2::PDC_INFO_FD_BSM2, gCAN1DisturbancePeriod);
  }
}

on sysvar_update sysvar::IL_CAN1::NODES::N_BSM2::MESSAGES::PDC_INFO_FD_BSM2::TIMINGS::SendOnce
{
  if (@this == 1)
  {
    SetBusContext(gILCAN1_BusContext);
    ILSetMsgEvent(FDCAN2::BSM2::PDC_INFO_FD_BSM2);
  }
}

on sysvar_update sysvar::NM_CAN1::NODES::N_BSM2::OpenNodePanel
{
  OpenNodePanel("FDCAN2::BSM2", 1);
}

on sysvar_update sysvar::NM_CAN1::StateControl::CloseNodePanels
{
  OpenNodePanel("FDCAN2::BSM2", 0);
}

/* #ChannelEnd# |CAN1| #BusEnd# |FDCAN2| */
/* #ChannelStart# |CAN2| #BusStart# |FDCAN14| */
on sysvar_update sysvar::IL_CAN2::NODES::N_BSM2::EnableNode
{
  ILCAN2_Enable(@this && @sysvar::IL_CAN2::enable_AllNodes);
}

on sysvar_update sysvar::IL_CAN2::enable_AllNodes
{
  ILCAN2_Enable(@this && @sysvar::IL_CAN2::NODES::N_BSM2::EnableNode);
}

on sysvar_update sysvar::NM_CAN2::NODES::N_BSM2::DeactivateNM
{
  if( @this == 1 || @sysvar::NM_CAN2::StateControl::DeactivateNM == 1)
  {
    NMCAN2_Enable(0);
  }
  else
  {
    NMCAN2_Enable(1);
  }
}

on sysvar_update sysvar::NM_CAN2::StateControl::DeactivateNM
{
  if( @this == 1 || @sysvar::NM_CAN2::NODES::N_BSM2::DeactivateNM == 1)
  {
    NMCAN2_Enable(0);
  }
  else
  {
    NMCAN2_Enable(1);
  }
}

on sysvar_update sysvar::IL_CAN2::NODES::N_BSM2::MESSAGES::BRAKE2_FD_1::TIMINGS::EnableCyclic
{
  if (@this == 1)
  {
    SetBusContext(gILCAN2_BusContext);
    ILFaultInjectionEnableMsg  (FDCAN14::BSM2::BRAKE2_FD_1);
  }
  else
  {
    SetBusContext(gILCAN2_BusContext);
    ILFaultInjectionDisableMsg (FDCAN14::BSM2::BRAKE2_FD_1);
  }
}

on sysvar_update sysvar::IL_CAN2::NODES::N_BSM2::MESSAGES::BRAKE2_FD_1::TIMINGS::SetNormalCycle
{
  if (@this == 1 && @sysvar::IL_CAN2::NODES::N_BSM2::MESSAGES::BRAKE2_FD_1::TIMINGS::EnableCyclic)
  {
    @sysvar::IL_CAN2::NODES::N_BSM2::MESSAGES::BRAKE2_FD_1::TIMINGS::SelectedPeriod = 0;
  }
}

on sysvar_update sysvar::IL_CAN2::NODES::N_BSM2::MESSAGES::BRAKE2_FD_1::TIMINGS::SetNewCycleContinously
{
  if (@this == 1 && @sysvar::IL_CAN2::NODES::N_BSM2::MESSAGES::BRAKE2_FD_1::TIMINGS::EnableCyclic)
  {
    @sysvar::IL_CAN2::NODES::N_BSM2::MESSAGES::BRAKE2_FD_1::TIMINGS::SelectedPeriod = -1;
  }
}

on sysvar_update sysvar::IL_CAN2::NODES::N_BSM2::MESSAGES::BRAKE2_FD_1::TIMINGS::SelectedPeriod
{
  if (@this == 0 && @sysvar::IL_CAN2::NODES::N_BSM2::MESSAGES::BRAKE2_FD_1::TIMINGS::EnableCyclic)
  {
    SetBusContext(gILCAN2_BusContext);
    gCAN2DisturbancePeriod = @sysvar::IL_CAN2::NODES::N_BSM2::MESSAGES::BRAKE2_FD_1::TIMINGS::NormalCyclePeriod;
    ILFaultInjectionResetMsgCycleTime(FDCAN14::BSM2::BRAKE2_FD_1);
  }
  else if (@this == 1 && @sysvar::IL_CAN2::NODES::N_BSM2::MESSAGES::BRAKE2_FD_1::TIMINGS::EnableCyclic)
  {
    SetBusContext(gILCAN2_BusContext);
    gCAN2DisturbancePeriod = @sysvar::IL_CAN2::NODES::N_BSM2::MESSAGES::BRAKE2_FD_1::TIMINGS::ActiveCyclePeriod;
    ILFaultInjectionSetMsgCycleTime(FDCAN14::BSM2::BRAKE2_FD_1, gCAN2DisturbancePeriod);
  }
  else if (@this == -1 && @sysvar::IL_CAN2::NODES::N_BSM2::MESSAGES::BRAKE2_FD_1::TIMINGS::EnableCyclic)
  {
    SetBusContext(gILCAN2_BusContext);
    gCAN2DisturbancePeriod = @sysvar::IL_CAN2::NODES::N_BSM2::MESSAGES::BRAKE2_FD_1::TIMINGS::CyclePeriod;
    ILFaultInjectionSetMsgCycleTime(FDCAN14::BSM2::BRAKE2_FD_1, gCAN2DisturbancePeriod);
  }
}

on sysvar_update sysvar::IL_CAN2::NODES::N_BSM2::MESSAGES::BRAKE2_FD_1::TIMINGS::SendOnce
{
  if (@this == 1)
  {
    SetBusContext(gILCAN2_BusContext);
    ILSetMsgEvent(FDCAN14::BSM2::BRAKE2_FD_1);
  }
}

on sysvar_update sysvar::IL_CAN2::NODES::N_BSM2::MESSAGES::BRAKE2_FD_2::TIMINGS::EnableCyclic
{
  if (@this == 1)
  {
    SetBusContext(gILCAN2_BusContext);
    ILFaultInjectionEnableMsg  (FDCAN14::BSM2::BRAKE2_FD_2);
  }
  else
  {
    SetBusContext(gILCAN2_BusContext);
    ILFaultInjectionDisableMsg (FDCAN14::BSM2::BRAKE2_FD_2);
  }
}

on sysvar_update sysvar::IL_CAN2::NODES::N_BSM2::MESSAGES::BRAKE2_FD_2::TIMINGS::SetNormalCycle
{
  if (@this == 1 && @sysvar::IL_CAN2::NODES::N_BSM2::MESSAGES::BRAKE2_FD_2::TIMINGS::EnableCyclic)
  {
    @sysvar::IL_CAN2::NODES::N_BSM2::MESSAGES::BRAKE2_FD_2::TIMINGS::SelectedPeriod = 0;
  }
}

on sysvar_update sysvar::IL_CAN2::NODES::N_BSM2::MESSAGES::BRAKE2_FD_2::TIMINGS::SetNewCycleContinously
{
  if (@this == 1 && @sysvar::IL_CAN2::NODES::N_BSM2::MESSAGES::BRAKE2_FD_2::TIMINGS::EnableCyclic)
  {
    @sysvar::IL_CAN2::NODES::N_BSM2::MESSAGES::BRAKE2_FD_2::TIMINGS::SelectedPeriod = -1;
  }
}

on sysvar_update sysvar::IL_CAN2::NODES::N_BSM2::MESSAGES::BRAKE2_FD_2::TIMINGS::SelectedPeriod
{
  if (@this == 0 && @sysvar::IL_CAN2::NODES::N_BSM2::MESSAGES::BRAKE2_FD_2::TIMINGS::EnableCyclic)
  {
    SetBusContext(gILCAN2_BusContext);
    gCAN2DisturbancePeriod = @sysvar::IL_CAN2::NODES::N_BSM2::MESSAGES::BRAKE2_FD_2::TIMINGS::NormalCyclePeriod;
    ILFaultInjectionResetMsgCycleTime(FDCAN14::BSM2::BRAKE2_FD_2);
  }
  else if (@this == 1 && @sysvar::IL_CAN2::NODES::N_BSM2::MESSAGES::BRAKE2_FD_2::TIMINGS::EnableCyclic)
  {
    SetBusContext(gILCAN2_BusContext);
    gCAN2DisturbancePeriod = @sysvar::IL_CAN2::NODES::N_BSM2::MESSAGES::BRAKE2_FD_2::TIMINGS::ActiveCyclePeriod;
    ILFaultInjectionSetMsgCycleTime(FDCAN14::BSM2::BRAKE2_FD_2, gCAN2DisturbancePeriod);
  }
  else if (@this == -1 && @sysvar::IL_CAN2::NODES::N_BSM2::MESSAGES::BRAKE2_FD_2::TIMINGS::EnableCyclic)
  {
    SetBusContext(gILCAN2_BusContext);
    gCAN2DisturbancePeriod = @sysvar::IL_CAN2::NODES::N_BSM2::MESSAGES::BRAKE2_FD_2::TIMINGS::CyclePeriod;
    ILFaultInjectionSetMsgCycleTime(FDCAN14::BSM2::BRAKE2_FD_2, gCAN2DisturbancePeriod);
  }
}

on sysvar_update sysvar::IL_CAN2::NODES::N_BSM2::MESSAGES::BRAKE2_FD_2::TIMINGS::SendOnce
{
  if (@this == 1)
  {
    SetBusContext(gILCAN2_BusContext);
    ILSetMsgEvent(FDCAN14::BSM2::BRAKE2_FD_2);
  }
}

on sysvar_update sysvar::IL_CAN2::NODES::N_BSM2::MESSAGES::BRAKE2_FD_3::TIMINGS::EnableCyclic
{
  if (@this == 1)
  {
    SetBusContext(gILCAN2_BusContext);
    ILFaultInjectionEnableMsg  (FDCAN14::BSM2::BRAKE2_FD_3);
  }
  else
  {
    SetBusContext(gILCAN2_BusContext);
    ILFaultInjectionDisableMsg (FDCAN14::BSM2::BRAKE2_FD_3);
  }
}

on sysvar_update sysvar::IL_CAN2::NODES::N_BSM2::MESSAGES::BRAKE2_FD_3::TIMINGS::SetNormalCycle
{
  if (@this == 1 && @sysvar::IL_CAN2::NODES::N_BSM2::MESSAGES::BRAKE2_FD_3::TIMINGS::EnableCyclic)
  {
    @sysvar::IL_CAN2::NODES::N_BSM2::MESSAGES::BRAKE2_FD_3::TIMINGS::SelectedPeriod = 0;
  }
}

on sysvar_update sysvar::IL_CAN2::NODES::N_BSM2::MESSAGES::BRAKE2_FD_3::TIMINGS::SetNewCycleContinously
{
  if (@this == 1 && @sysvar::IL_CAN2::NODES::N_BSM2::MESSAGES::BRAKE2_FD_3::TIMINGS::EnableCyclic)
  {
    @sysvar::IL_CAN2::NODES::N_BSM2::MESSAGES::BRAKE2_FD_3::TIMINGS::SelectedPeriod = -1;
  }
}

on sysvar_update sysvar::IL_CAN2::NODES::N_BSM2::MESSAGES::BRAKE2_FD_3::TIMINGS::SelectedPeriod
{
  if (@this == 0 && @sysvar::IL_CAN2::NODES::N_BSM2::MESSAGES::BRAKE2_FD_3::TIMINGS::EnableCyclic)
  {
    SetBusContext(gILCAN2_BusContext);
    gCAN2DisturbancePeriod = @sysvar::IL_CAN2::NODES::N_BSM2::MESSAGES::BRAKE2_FD_3::TIMINGS::NormalCyclePeriod;
    ILFaultInjectionResetMsgCycleTime(FDCAN14::BSM2::BRAKE2_FD_3);
  }
  else if (@this == 1 && @sysvar::IL_CAN2::NODES::N_BSM2::MESSAGES::BRAKE2_FD_3::TIMINGS::EnableCyclic)
  {
    SetBusContext(gILCAN2_BusContext);
    gCAN2DisturbancePeriod = @sysvar::IL_CAN2::NODES::N_BSM2::MESSAGES::BRAKE2_FD_3::TIMINGS::ActiveCyclePeriod;
    ILFaultInjectionSetMsgCycleTime(FDCAN14::BSM2::BRAKE2_FD_3, gCAN2DisturbancePeriod);
  }
  else if (@this == -1 && @sysvar::IL_CAN2::NODES::N_BSM2::MESSAGES::BRAKE2_FD_3::TIMINGS::EnableCyclic)
  {
    SetBusContext(gILCAN2_BusContext);
    gCAN2DisturbancePeriod = @sysvar::IL_CAN2::NODES::N_BSM2::MESSAGES::BRAKE2_FD_3::TIMINGS::CyclePeriod;
    ILFaultInjectionSetMsgCycleTime(FDCAN14::BSM2::BRAKE2_FD_3, gCAN2DisturbancePeriod);
  }
}

on sysvar_update sysvar::IL_CAN2::NODES::N_BSM2::MESSAGES::BRAKE2_FD_3::TIMINGS::SendOnce
{
  if (@this == 1)
  {
    SetBusContext(gILCAN2_BusContext);
    ILSetMsgEvent(FDCAN14::BSM2::BRAKE2_FD_3);
  }
}

on sysvar_update sysvar::NM_CAN2::NODES::N_BSM2::OpenNodePanel
{
  OpenNodePanel("FDCAN14::BSM2", 1);
}

on sysvar_update sysvar::NM_CAN2::StateControl::CloseNodePanels
{
  OpenNodePanel("FDCAN14::BSM2", 0);
}

/* #ChannelEnd# |CAN2| #BusEnd# |FDCAN14| */
//--- end generated part --- Block end <#SysVar_Handler#> do not delete this line! Add application code below this line.

//--- begin generated part --- Block start <#MsgUpdateFcns#> do not delete this line and do not add application code in this code block!
/* #ChannelStart# |CAN1| #BusStart# |FDCAN2| */
/* #ChannelEnd# |CAN1| #BusEnd# |FDCAN2| */
//--- end generated part --- Block end <#MsgUpdateFcns#> do not delete this line! Add application code below this line.

