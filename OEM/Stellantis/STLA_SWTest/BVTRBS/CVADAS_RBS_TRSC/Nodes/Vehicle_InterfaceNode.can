/*@!Encoding:1252*/
includes
{
  
}

variables
{
  msTimer msVehSpeedSweepTimer;
  msTimer msStwAngleSweepTimer;
  int sweepVehSpeed=0;
  int sweepStwAngle=0;
}


on start
{
  
  @MEnv_StwAngleSweep_SET_BOL_1 = 0;
  @MEnv_StwAngleSweepDel_SET_FLT_1 = 1;
  @MEnv_StwAngleSweepMax_SET_FLT_1 = 720;
  @MEnv_StwAngleSweepMin_SET_FLT_1 = -720;
  @MEnv_StwAngleSweepTime_SET_INT_1 = 100;
  @MEnv_VehSpeedSweep_SET_BOL_1 = 0;
  @MEnv_VehSpeedSweepDel_SET_INT_1 = 1;
  @MEnv_VehSpeedSweepMax_SET_INT_1 = 511.875;
  @MEnv_VehSpeedSweepMin_SET_INT_1 = 0;
  @MEnv_VehSpeedSweepTime_SET_INT_1 = 100;
}

//on stopMeasurement
//{
//  // setsignal(CmdIgnSts,0);
// 
// // @ IL::Klemme15=0;
//}


  


on timer msStwAngleSweepTimer
{
  if($LwsAngle<@MEnv_StwAngleSweepMax_SET_FLT_1)
  {
  $LwsAngle = @MEnv_StwAngleSweepMin_SET_FLT_1+ sweepStwAngle;
  sweepStwAngle = sweepStwAngle + @MEnv_StwAngleSweepDel_SET_FLT_1;
  setTimer(msStwAngleSweepTimer, @MEnv_StwAngleSweepTime_SET_INT_1);
  }
  else
  {
    @MEnv_StwAngleSweep_SET_BOL_1=0;
  }
  
}

on timer msVehSpeedSweepTimer
{
  if($VehicleSpeedVSOSig<@MEnv_VehSpeedSweepMax_SET_INT_1)
  {
  $VehicleSpeedVSOSig = @MEnv_VehSpeedSweepMin_SET_INT_1+ sweepVehSpeed;
  sweepVehSpeed = sweepVehSpeed +  @MEnv_VehSpeedSweepDel_SET_INT_1 ;
  setTimer(msVehSpeedSweepTimer,  @MEnv_VehSpeedSweepTime_SET_INT_1);
  }
   else
  {
    @MEnv_VehSpeedSweep_SET_BOL_1=0;
  }
}
  
on envVar MEnv_StwAngleSweep_SET_BOL_1
{
  if(@this==1) setTimer(msStwAngleSweepTimer, @MEnv_StwAngleSweepTime_SET_INT_1);
  else cancelTimer(msStwAngleSweepTimer); sweepStwAngle=0;
}

on envVar MEnv_VehSpeedSweep_SET_BOL_1
{
  if(@this==1) setTimer(msVehSpeedSweepTimer,  @MEnv_VehSpeedSweepTime_SET_INT_1);
  else cancelTimer(msVehSpeedSweepTimer); sweepVehSpeed=0;
}

on envVar MEnv_open_all_doors
{
  if(@this==1)
  {
    $PsngrDoorSts =1;
    $DriverDoorSts =1;
    $LHRDoorSts =1;
    $RHRDoorSts =1;
    $RHatchSts =1;
    
  }
}

on envVar MEnv_close_all_doors
{
  if(@this==1)
  {
    $PsngrDoorSts =0;
    $DriverDoorSts =0;
    $LHRDoorSts =0;
    $RHRDoorSts =0;
    $RHatchSts =0;
    
  }
}


on envVar MEnv_Default_SET_BOL_1
{
  if(@this)
  {
      @IL::Klemme15 =1;
  }  
  
}

on envVar MEnv_IgnStatus_SET_INT_1
{
   $CmdIgnSts = @this;
}

on signal CmdIgnSts
{
  @MEnv_IgnStatus_GET_INT_1 = $CmdIgnSts;
  @MEnv_IgnStatus_SET_INT_1 = $CmdIgnSts;
 
}
on envVar MEnv_VehSpeed_SET_FLT_1
{
   
    $VehicleSpeedVSOSig = @MEnv_VehSpeed_SET_FLT_1;
}

on signal VehicleSpeedVSOSig
{
  @MEnv_VehSpeed_GET_FLT_1 = $VehicleSpeedVSOSig;
  @MEnv_VehSpeed_SET_FLT_1 = $VehicleSpeedVSOSig;
 
}


on signal EngineSpeed_W
{
    @MEnv_VehSpeed_GET_FLT_1 = $EngineSpeed_W;
}

on envVar MEnv_WheelSpeed_SET_FLT_1
{
  @MEnv_WheelSpeedFront_SET_FLT_1 = @MEnv_WheelSpeed_SET_FLT_1;
  @MEnv_WheelSpeedRear_SET_FLT_1 = @MEnv_WheelSpeed_SET_FLT_1;
  setSignal(LHFWheelSpeed, @MEnv_WheelSpeedFront_SET_FLT_1);
  setSignal(LHRWheelSpeed, @MEnv_WheelSpeedRear_SET_FLT_1);
  @MEnv_VehSpeed_SET_FLT_1 = @MEnv_WheelSpeed_SET_FLT_1;
}

on signal LHFWheelSpeed
{
   @MEnv_WheelSpeedFront_GET_FLT_1 = this;
}

on signal LHRWheelSpeed
{
   @MEnv_WheelSpeedRear_GET_FLT_1 = this;
}

on envVar MEnv_Gear_SET_INT_1
{
  
 $TargetGear =@this;
}

on signal TargetGear
{
  @MEnv_Gear_SET_INT_1 = $TargetGear;
}

on envVar MEnv_StwAngle_SET_FLT_1
{
  $LwsAngle= @this;
    
}

on signal LwsAngle
{
    @MEnv_StwAngle_GET_FLT_1 = this;
  @MEnv_StwAngle_SET_FLT_1= this;
}

on envvar MEnv_Vehicle_Configuration_SET_INT_1
{
  openPanel(" Vehicle_Controls");
}

on envVar MEnv_StwAngleCenter_SET_BOL_1
{
  @MEnv_StwAngle_SET_FLT_1=0;
}

on envVar MEnv_PAM_Config_SET_INT_1
{
  
}

on envVar MEnv_PamChmVolFrnt_SET_INT_1
{ 
  $PamChimeVolumeFront =@this ;
}

on signal PamChimeVolumeRear
{
  @MEnv_PamChmVolFrnt_GET_INT_1 =this;
}

on envVar MEnv_PamChmVolBk_SET_INT_1
{
  $PamChimeVolumeRear =@this ;
}

on signal PamChimeVolumeFront
{
  @MEnv_PamChmVolFrnt_GET_INT_1 = this;
}

on envVar MEnv_PAM_Brk_RqSts_SET_INT_1
{
  $RR_PAM_Brk_RqSts =@this ;
}

on signal CVPAM_FD_Control::RR_PAM_Brk_RqSts 
{
  @MEnv_PAM_Brk_RqSts_GET_INT_1 =this;
}

on envVar MEnv_PAM_Off_Status_SET_INT_1
{
  $PAM_Off_Status = @this;
}

on signal CVADAS::PAM_Off_Status
{
  @MEnv_PAM_Off_Status_GET_INT_1 =this;
}

on envVar MEnv_StopControlSts_SET_INT_1
{
  $PAM::RR_PAM_StopControlSts =@this;
}

on signal PAM::RR_PAM_StopControlSts
{
  @MEnv_StopControlSts_GET_INT_1 =this;
}



  on sysvar_update IL::Klemme15
{
  if(@this)
  {
        setsignal(CmdIgnSts,4);
        
   }     
  else
  {
       setsignal(CmdIgnSts,0);
        
  }
}
