/*@!Encoding:1252*/
includes
{
}

variables
{
char ErrorCodeString[50];
  
diagRequest _22200A_KeyOn_counter_EEPROM_Read                      diag_KeyOn;
diagRequest EngineeringParameters_Read                             diag_ReadProxi;
diagRequest CVADAS_0001_00000000_000._2E2023_PROXI_Data_1          diag_WriteProxi;
diagRequest _22102A_Check_EOL_configuration_data_Read              diag_CheckEOLConfigData;

diagRequest HardReset_Reset                                        diag_HardReset;
diagRequest ExtendedDiagnostic_Start                               diag_RequestExtended; // extended Diagnostic Session
diagRequest Programming_Start                                      diag_RequestProgramming; // Programming Diagnostic Session
diagRequest Level1Seed_Request                                     diag_RequestSeed_Leve1; // SecurityAccess_requestSeed (SecurityLevel 1)
diagRequest Level1Key_Send                                         diag_SendKey_Level1; // SecurityAccess_sendKey (SecurityLevel 1)
diagRequest Protected_Engineering_Access_Seed_Request              diag_RequestSeed_Leve5; // SecurityAccess_requestSeed (SecurityLevel 5)
diagRequest Protected_Engineering_Access_Key_Send                  diag_SendKey_Level5; // SecurityAccess_sendKey (SecurityLevel 5)
diagRequest Security_Access_Mode_101_RequestSeed_Request           diag_RequestSeed_Leve101; // SecurityAccess_requestSeed (SecurityLevel 101)
diagRequest Security_Access_Mode_101_SendKey_Send                  diag_SendKey_Level101; // SecurityAccess_sendKey (SecurityLevel 101)

diagRequest ECU_Input_Voltage_Read                                 diag_Read_InputVoltage; // Read Input Voltage
  
diagRequest _22F190_VIN_Original_Read                              diag_Read_VinOriginal; // VIN Original Read
diagRequest _22F1B0_VIN_Current_Read                               diag_Read_VinCurrent; // VIN Current Read
  
diagRequest EOL_Calibration_VPC_Current_Data_Write_Data            diag_Write_EOLCalibrationData; // Write EOL Calibration (VPC) Current Data
diagRequest Calibration_Data_Reset_Start                           diag_StartRoutine_CalibrationDataReset; // Routine Calibration Data Reset Start
diagRequest Current_Camera_Calibration_Data_Read_Data              diag_Read_CurrentCalibrationData; // Read Current Camera Calibration Data
  
diagRequest DEACTIVATION_OF_FAIL_SAFE_REACTIONS_Start              diag_StartRoutine_DeactivateFailSage; // Routine Deactivate of Fail Save Reactions Start
  
mstimer t_ClearSysMessage;          // timer used to clear the information from the system status bar.

//After extended Diagnostic Session Request
int AFTER_EXTENDED_REQUEST;
  // 0 = 
  // 1 = ECU Unlock Level 1
  // 2 = EMV Read Input Voltage
  // 3 = ECU Unlock Level 5
  // 4 = ECU Unlock Level 101
  // 5 = Complete Calibration
  // 99 = do nothing
  
//absolute Filepaths
char EcuConfigurator_absPathName[1000];
char EcuCalibrator_absPathName[1000];
char Config_absPath[1000];
  
//Initial Lock
int INITIAL_LOCK = 1;
mstimer t_Initial_Lock;
  
//EMV Test
msTimer t_Emv_AutoStart;
  msTimer t_Emv_InputVoltage;
  mstimer t_Emv_Backup_InputVoltage;
  int DTC_ERROR_COUNTER_LOCK_INT = 1;
  int buffer_EcuInputVoltage;
  
//Calibration Button
int buffer_UsedCalibration_Front;
int buffer_UsedCalibration_Left;
int buffer_UsedCalibration_Rear;
int buffer_UsedCalibration_Right;
mstimer t_DiagjobDelay;
int DiagjobDelay;
  // 1 = After Routine Calibration Data Reset
  // 2 = After Hardreset
  // 99 = Default
  
//Functional Request
byte Data_Byte[8];
int TesterPresentState;
mstimer t_ResetTesterPresent;
int RequestSignState; //0 = not set jet; 1 = Signs valid; 2 = Signs invalid
  
//Security Unlock Status
mstimer t_ResetSecUnlockStatusLEDs;
  
msTimer t_Emv_CheckUnlockState;
msTimer t_Emv_Backup_DeactivateFailsafe;
msTimer t_ResetUnlockButton;
  
int param,i;
int getProxiValues;
  
word CRC;
byte CRC1;
byte CRC2;
byte CRC3;
byte CRC4;
byte CRC5;
  
byte crc_array[5]={0,0,0,0,0};

int64 Table_CRC_16_CCITT[256] =
{
        0,  4489,  8978, 12955, 17956, 22445, 25910, 29887,
    35912, 40385, 44890, 48851, 51820, 56293, 59774, 63735,
     4225,   264, 13203,  8730, 22181, 18220, 30135, 25662,
    40137, 36160, 49115, 44626, 56045, 52068, 63999, 59510,
     8450, 12427,   528,  5017, 26406, 30383, 17460, 21949,
    44362, 48323, 36440, 40913, 60270, 64231, 51324, 55797,
    12675,  8202,  4753,   792, 30631, 26158, 21685, 17724,
    48587, 44098, 40665, 36688, 64495, 60006, 55549, 51572,
    16900, 21389, 24854, 28831,  1056,  5545, 10034, 14011,
    52812, 57285, 60766, 64727, 34920, 39393, 43898, 47859,
    21125, 17164, 29079, 24606,  5281,  1320, 14259,  9786,
    57037, 53060, 64991, 60502, 39145, 35168, 48123, 43634,
    25350, 29327, 16404, 20893,  9506, 13483,  1584,  6073,
    61262, 65223, 52316, 56789, 43370, 47331, 35448, 39921,
    29575, 25102, 20629, 16668, 13731,  9258,  5809,  1848,
    65487, 60998, 56541, 52564, 47595, 43106, 39673, 35696,
    33800, 38273, 42778, 46739, 49708, 54181, 57662, 61623,
     2112,  6601, 11090, 15067, 20068, 24557, 28022, 31999,
    38025, 34048, 47003, 42514, 53933, 49956, 61887, 57398,
     6337,  2376, 15315, 10842, 24293, 20332, 32247, 27774,
    42250, 46211, 34328, 38801, 58158, 62119, 49212, 53685,
    10562, 14539,  2640,  7129, 28518, 32495, 19572, 24061,
    46475, 41986, 38553, 34576, 62383, 57894, 53437, 49460,
    14787, 10314,  6865,  2904, 32743, 28270, 23797, 19836,
    50700, 55173, 58654, 62615, 32808, 37281, 41786, 45747,
    19012, 23501, 26966, 30943,  3168,  7657, 12146, 16123,
    54925, 50948, 62879, 58390, 37033, 33056, 46011, 41522,
    23237, 19276, 31191, 26718,  7393,  3432, 16371, 11898,
    59150, 63111, 50204, 54677, 41258, 45219, 33336, 37809,
    27462, 31439, 18516, 23005, 11618, 15595,  3696,  8185,
    63375, 58886, 54429, 50452, 45483, 40994, 37561, 33584,
    31687, 27214, 22741, 18780, 15843, 11370,  7921,  3960
};
 long size;
  byte Diag_Buffer[255];
 byte  Diag[218];
byte writeproxi[218]=
  {
        0x30,0x30,0x30,0x30,0x30,0x30,0x33,0x36,0x32,0x34,0x34,0x45,0x30,0x30,0x32,0x30,0x2D,0x30,0x32,0x20,0x20,0x20,0x22,0x03,0x17,0xCF,0x4D,0xC6,0xAD,0x18,
        0x41,0x24,0x81,0x0A,0xC0,0x18,0xAC,0x03,0x02,0xC1,0x51,0xCF,0x0D,0xC6,0x2D,0x18,0x40,0x24,0xF0,0x2A,0xCC,0x18,0x64,0x03,0x02,0x81,0x51,0x30,0xF0,0x3D,
        0xC1,0x86,0x80,0x09,0xD2,0x91,0x5B,0x68,0x10,0x55,0x11,0x58,0x00,0x08,0x00,0x00,0x42,0x04,0x3F,0xE3,0x29,0x01,0x03,0xC1,0x38,0x4E,0x00,0x48,0x08,0x00,
        0x22,0x00,0x00,0x84,0x01,0x0F,0x50,0x0A,0x50,0x09,0x0C,0x00,0x10,0x02,0x68,0x00,0x02,0x07,0x95,0x60,0x57,0x2C,0x58,0x66,0x18,0x00,0xD0,0x1C,0x3A,0x00,
        0x87,0xBF,0xF9,0x50,0x16,0xC0,0x00,0x00,0x22,0x0B,0x01,0x4F,0x1B,0x81,0x3E,0x04,0x00,0x00,0x00,0x82,0x00,0x00,0x00,0x06,0x18,0x24,0x00,0x89,0x80,0xA8,
        0x0F,0x50,0x66,0x11,0x3C,0x02,0x00,0x00,0xC1,0x00,0x00,0x20,0x00,0x6E,0x00,0x73,0x08,0x00,0x00,0x68,0x24,0x00,0x9A,0x1C,0x34,0x9E,0x2B,0x6A,0x80,0x00,
        0xCA,0x24,0x66,0x7F,0x09,0x40,0x00,0x00,0x00,0x00,0x00,0x00,0x00,0x0F,0x80,0x00,0x00,0x01,0x04,0x00,0x00,0x00,0x40,0x01,0x00,0x00,0x00,0x00,0x00,0x00,
        0xFC,0x00,0x02,0x00,0x00,0x00,0x00,0x00
  };
  
  
}

on start
{
  
  
    write("the byte value of 86 at on start is %x",writeproxi[86]);
    write("the byte value of 85 at on start is %x",writeproxi[85]);
    DiagSetTarget("CVADAS_0001_00000000_000");
  
    putValue(MEnv_CTNCandelaQualifier_SET_STG_14, "CVADAS_0001_00000000_000");
  
    putValue(MEnv_CandelaQualifier_SET_STG_3, "CVADAS_0001_00000000_000");
  
    setTimer(t_Initial_Lock, 50);
  
    @MEnv_DiagTesterPresent_SET_BOL_3 = diagGetTesterPresentState();

//initial values from the DBC---------------

//------------------------------------------
  
//initial values general--------------------
    AFTER_EXTENDED_REQUEST = 99;
  
    @MEnv_SessionFallbackTime_SET_INT = 5000;
//------------------------------------------´
    @MEnv_SendProxiString_SET_INT_3 = 0;
  
  	//SetDefaultProxi();  

}

on diagResponse Level1Seed_Request
{
    byte seed[4];
    
    byte gSeedArray[4];
    int gSeedArraySize    = 4;
    int gSecurityLevel    = 0x01;
    char gVariant[200]    = "common";
    char gOption[200]     = "option";
    byte gKeyArray[255];
    int  gMaxKeyArraySize = 255;
    DWORD gActualSize     = 0;
    char gDebugBuffer[2000];
    int x;
    
    if (this.IsPositiveResponse())
    {
        switch(AFTER_EXTENDED_REQUEST)
        {
            case 99:
            {
                // an other Mode calls this Job
            }
            break;
            
            case 1: // ECU Unlock
            {  
                diagGetParameterRaw (this, "Seed", seed, 4);

                //write("diagResponce SecuritySeed : %x, %x, %x, %x", seed[0], seed[1], seed[2], seed[3]);
                
                gSeedArray[0] = seed[0];
                gSeedArray[1] = seed[1];
                gSeedArray[2] = seed[2];
                gSeedArray[3] = seed[3];

                //write("Übergabe Seed: %x, %x, %x, %x", gSeedArray[0], gSeedArray[1], gSeedArray[2], gSeedArray[3]);

                x = DiagGenerateKeyFromSeed (gSeedArray, gSeedArraySize, gSecurityLevel, gVariant, gOption, gKeyArray, gMaxKeyArraySize, gActualSize);

                //write("ErrorCode Unlock Function: %d", x);
                //write("Calculated Key: %x, %x, %x, %x", gKeyArray[0], gKeyArray[1], gKeyArray[2], gKeyArray[3]);
                
                diagSetParameterRaw(diag_SendKey_Level1, "Key", gKeyArray, 4);
                diagSendRequest(diag_SendKey_Level1);
                
                AFTER_EXTENDED_REQUEST = 99;
            }
            break;
        }
    }
    else
    {
        //putvalue(MEnv_SysMessage_GET_STG_2, " Negative Response from Level 1 Seed Request!");
        write("Magna Warning: Negative Response from Level 1 Seed Request!");
    }
}

on diagResponse Protected_Engineering_Access_Seed_Request
{
    byte seed[4];
    
    byte gSeedArray[4];
    int gSeedArraySize    = 4;
    int gSecurityLevel    = 0x05;
    char gVariant[200]    = "common";
    char gOption[200]     = "option";
    byte gKeyArray[255];
    int  gMaxKeyArraySize = 255;
    DWORD gActualSize     = 0;
    char gDebugBuffer[2000];
    int x;
    
    if (this.IsPositiveResponse())
    {
        switch(AFTER_EXTENDED_REQUEST)
        {
            case 99:
            {
                // an other Mode calls this Job
            }
            break;
            
            case 3: // ECU Unlock Level 5
            {
                diagGetParameterRaw (this, "SecuritySeed", seed, 4);

                //write("diagResponce SecuritySeed : %x, %x, %x, %x", seed[0], seed[1], seed[2], seed[3]);
                
                gSeedArray[0] = seed[0];
                gSeedArray[1] = seed[1];
                gSeedArray[2] = seed[2];
                gSeedArray[3] = seed[3];

                //write("Übergabe Seed: %x, %x, %x, %x", gSeedArray[0], gSeedArray[1], gSeedArray[2], gSeedArray[3]);

                x = DiagGenerateKeyFromSeed (gSeedArray, gSeedArraySize, gSecurityLevel, gVariant, gOption, gKeyArray, gMaxKeyArraySize, gActualSize);

                //write("ErrorCode Unlock Function: %d", x);
                //write("Calculated Key: %x, %x, %x, %x", gKeyArray[0], gKeyArray[1], gKeyArray[2], gKeyArray[3]);
                
                diagSetParameterRaw(diag_SendKey_Level5, "Key", gKeyArray, 4);
                diagSendRequest(diag_SendKey_Level5);
                
                AFTER_EXTENDED_REQUEST = 99;
            }
            break;
        }
    }
    else
    {
//        putvalue(MEnv_SysMessage_GET_STG_2, " Negative Response from Level 5 Seed Request!");
//        write("Magna Warning: Negative Response from Level 5 Seed Request!");
    }
}

on diagResponse Security_Access_Mode_101_RequestSeed_Request
{
    byte seed[4];
    
    byte gSeedArray[4];
    int gSeedArraySize    = 4;
    int gSecurityLevel    = 0x65; // = 101
    char gVariant[200]    = "common";
    char gOption[200]     = "option";
    byte gKeyArray[255];
    int  gMaxKeyArraySize = 255;
    DWORD gActualSize     = 0;
    char gDebugBuffer[2000];
    int x;
    
    if (this.IsPositiveResponse())
    {
        switch(AFTER_EXTENDED_REQUEST)
        {
            case 99:
            {
                // an other Mode calls this Job
            }
            break;
            
            case 4: // ECU Unlock Level 101
            {
                diagGetParameterRaw (this, "SecuritySeed", seed, 4);
              
                //write("diagResponce SecuritySeed : %x, %x, %x, %x", seed[0], seed[1], seed[2], seed[3]);
                
                gSeedArray[0] = seed[0];
                gSeedArray[1] = seed[1];
                gSeedArray[2] = seed[2];
                gSeedArray[3] = seed[3];

                //write("Übergabe Seed: %x, %x, %x, %x", gSeedArray[0], gSeedArray[1], gSeedArray[2], gSeedArray[3]);

                x = DiagGenerateKeyFromSeed (gSeedArray, gSeedArraySize, gSecurityLevel, gVariant, gOption, gKeyArray, gMaxKeyArraySize, gActualSize);

                //write("ErrorCode Unlock Function: %d", x);
                //write("Calculated Key: %x, %x, %x, %x", gKeyArray[0], gKeyArray[1], gKeyArray[2], gKeyArray[3]);
                
                diagSetParameterRaw(diag_SendKey_Level101, "SecurityKey", gKeyArray, 4);
                diagSendRequest(diag_SendKey_Level101);
                
                AFTER_EXTENDED_REQUEST = 99;
            }
            break;
            
            case 5: // Complete Calibration
            {
                diagGetParameterRaw (this, "SecuritySeed", seed, 4);
              
                //write("diagResponce SecuritySeed : %x, %x, %x, %x", seed[0], seed[1], seed[2], seed[3]);
                
                gSeedArray[0] = seed[0];
                gSeedArray[1] = seed[1];
                gSeedArray[2] = seed[2];
                gSeedArray[3] = seed[3];

                //write("Übergabe Seed: %x, %x, %x", gSeedArray[0], gSeedArray[1], gSeedArray[2]);

                x = DiagGenerateKeyFromSeed (gSeedArray, gSeedArraySize, gSecurityLevel, gVariant, gOption, gKeyArray, gMaxKeyArraySize, gActualSize);

                //write("ErrorCode Unlock Function: %d", x);
                //write("Calculated Key: %x, %x, %x, %x", gKeyArray[0], gKeyArray[1], gKeyArray[2], gKeyArray[3]);
                
                diagSetParameterRaw(diag_SendKey_Level101, "SecurityKey", gKeyArray, 4);
                diagSendRequest(diag_SendKey_Level101);
            }
            break;
        }
    }
    else
    {
       //putvalue(MEnv_SysMessage_GET_STG_2, " Negative Response from Level 101 Seed Request!");
        write("Magna Warning: Negative Response from Level 101 Seed Request!");
    }
}

on diagResponse Level1Key_Send
{
    if(this.IsPositiveResponse())
    {
        //putvalue(MEnv_SysMessage_GET_STG_2," Level 1 ECU Unlocked Successfully!");
      
        @MEnv_DiagUnlockEcuLevel1_GET_BOL = 1;
    }
    else
    {
       // putvalue(MEnv_SysMessage_GET_STG_2," Level 1 ECU Unlocked Failed!");
    }
}

on diagResponse Protected_Engineering_Access_Key_Send
{
    if(this.IsPositiveResponse())
    {
        //putvalue(MEnv_SysMessage_GET_STG_2," Level 5 ECU Unlocked Successfully!");
      
        @MEnv_DiagUnlockEcuLevel5_GET_BOL = 1;
    }
    else
    {
       // putvalue(MEnv_SysMessage_GET_STG_2," Level 5 ECU Unlocked Failed!");
    }
}

on diagResponse Security_Access_Mode_101_SendKey_Send
{
    if(this.IsPositiveResponse())
    {
        //putvalue(MEnv_SysMessage_GET_STG_2," Level 101 ECU Unlocked Successfully!");
      
        @MEnv_DiagUnlockEcuLevel101_GET_B = 1;
        
        switch(AFTER_EXTENDED_REQUEST)
        {
            case 99:
            {
                // an other Mode calls this Job
            }
            break;
            
            case 5: // Complete Calibration
            {
                // Set EOL Parameter to a defined value
                diagSetParameter(diag_Write_EOLCalibrationData, "Cam_Angle_Corr_Pitch_Front", 1);
                diagSetParameter(diag_Write_EOLCalibrationData, "Cam_Angle_Corr_Pitch_Left", 2);
                diagSetParameter(diag_Write_EOLCalibrationData, "Cam_Angle_Corr_Pitch_Rear", 1);
                diagSetParameter(diag_Write_EOLCalibrationData, "Cam_Angle_Corr_Pitch_Right", 2);
                diagSetParameter(diag_Write_EOLCalibrationData, "Cam_Angle_Corr_Roll_Front", 1);
                diagSetParameter(diag_Write_EOLCalibrationData, "Cam_Angle_Corr_Roll_Left", 2);
                diagSetParameter(diag_Write_EOLCalibrationData, "Cam_Angle_Corr_Roll_Rear", 1);
                diagSetParameter(diag_Write_EOLCalibrationData, "Cam_Angle_Corr_Roll_Right", 2);
                diagSetParameter(diag_Write_EOLCalibrationData, "Cam_Angle_Corr_Yaw_Front", 1);
                diagSetParameter(diag_Write_EOLCalibrationData, "Cam_Angle_Corr_Yaw_Left", 2);
                diagSetParameter(diag_Write_EOLCalibrationData, "Cam_Angle_Corr_Yaw_Rear", 1);
                diagSetParameter(diag_Write_EOLCalibrationData, "Cam_Angle_Corr_Yaw_Right", 2);
                diagSetParameter(diag_Write_EOLCalibrationData, "Cam_Pos_Corr_X_Front", 1);
                diagSetParameter(diag_Write_EOLCalibrationData, "Cam_Pos_Corr_X_Left", 2);
                diagSetParameter(diag_Write_EOLCalibrationData, "Cam_Pos_Corr_X_Rear", 1);
                diagSetParameter(diag_Write_EOLCalibrationData, "Cam_Pos_Corr_X_Right", 2);
                diagSetParameter(diag_Write_EOLCalibrationData, "Cam_Pos_Corr_Y_Front", 1);
                diagSetParameter(diag_Write_EOLCalibrationData, "Cam_Pos_Corr_Y_Left", 2);
                diagSetParameter(diag_Write_EOLCalibrationData, "Cam_Pos_Corr_Y_Rear", 1);
                diagSetParameter(diag_Write_EOLCalibrationData, "Cam_Pos_Corr_Y_Right", 2);
                diagSetParameter(diag_Write_EOLCalibrationData, "Cam_Pos_Corr_Z_Front", 1);
                diagSetParameter(diag_Write_EOLCalibrationData, "Cam_Pos_Corr_Z_Left", 2);
                diagSetParameter(diag_Write_EOLCalibrationData, "Cam_Pos_Corr_Z_Rear", 1);
                diagSetParameter(diag_Write_EOLCalibrationData, "Cam_Pos_Corr_Z_Right", 2);
                
                // Set EOL Status to Successful
                diagSetParameter(diag_Write_EOLCalibrationData, "Calibration_Status_Front", 3);
                diagSetParameter(diag_Write_EOLCalibrationData, "Calibration_Status_Left", 3);
                diagSetParameter(diag_Write_EOLCalibrationData, "Calibration_Status_Rear", 3);
                diagSetParameter(diag_Write_EOLCalibrationData, "Calibration_Status_Right", 3);
              
                diagSendRequest(diag_Write_EOLCalibrationData);
            }
            break;
        }
    }
    else
    {
       enableControl("Main", "Calibration_Button", 1);
     
       // putvalue(MEnv_SysMessage_GET_STG_2," Level 101 ECU Unlocked Failed!");
    }
}

on diagResponse ExtendedDiagnostic_Start
{
	  if (this.IsPositiveResponse())
    {
        switch(AFTER_EXTENDED_REQUEST)
        {
            case 99:
            {
                // an other Mode calls this Job
            }
            break;
            
            case 0: // Network
            {
                
            }
            break;
           
            case 1: // Unlock ECU Level 1
            {
                diagSendRequest(diag_RequestSeed_Leve1);
            }
            break;
            
            case 3: // Unlock ECU Level 5
            {
                diagSendRequest(diag_RequestSeed_Leve5);
            }
            break;
            
            case 4: // Unlock ECU Level 101
            {
                diagSendRequest(diag_RequestSeed_Leve101);
            }
            break;
            
            case 5: // Complete Calibration
            {
                diagSendRequest(diag_RequestSeed_Leve101); // Unlock ECU Level 101 is necessary to write EOL Calibration Data
            }
            break;
        }
    }
    else
    {
        switch(AFTER_EXTENDED_REQUEST)
        {
            case 99:
            {
                // an other Mode calls this Job
            }
            break;
            
            case 0: // 
            {
                AFTER_EXTENDED_REQUEST = 99;
            }
            break;
            
            case 1: // ECU Unlock 1
            {
              // putvalue(MEnv_SysMessage_GET_STG_2, " Extended Session: Negative Response!");
               AFTER_EXTENDED_REQUEST = 99;
            }
            break;
            
            case 4: // ECU Unlock Level 101
            {
              // putvalue(MEnv_SysMessage_GET_STG_2, " Extended Session: Negative Response!");
                AFTER_EXTENDED_REQUEST = 99;
            }
            break;
            
            case 5: // Complete Calibration
            {
              // putvalue(MEnv_SysMessage_GET_STG_2, " Extended Session: Negative Response!");
                AFTER_EXTENDED_REQUEST = 99;
            }
            break;
        }
    }
}

on diagResponse Programming_Start
{
    if (this.IsPositiveResponse())
    {
        switch(AFTER_EXTENDED_REQUEST)
        {
            case 99:
            {
                // an other Mode calls this Job
            }
            break;
      
            case 1: // Unlock ECU Level 1
            {
                diagSendRequest(diag_RequestSeed_Leve1);
            }
            break;
                       
            case 3: // Unlock ECU Level 5
            {
                diagSendRequest(diag_RequestSeed_Leve5);
            }
            break;
        }
    }
    else
    {
        switch(AFTER_EXTENDED_REQUEST)
        {
            case 99:
            {
                // an other Mode calls this Job
            }
            break;

            case 3: // ECU Unlock Levle 5
            {
               //putvalue(MEnv_SysMessage_GET_STG_2, " Programming Session: Negative Response!");
                AFTER_EXTENDED_REQUEST = 99;
            }
            break;
        }
    }
}

on timer t_ClearSysMessage
{
   // putvalue(MEnv_SysMessage_GET_STG_2,"                                                                          ");
}

on envVar MEnv_DiagTesterPresent_SET_BOL_3
{
    if(@this == 1)
    {      
        DiagStartTesterPresent("_HALF_CUSW_9001_EI2685");
    }
    else
    {
        DiagStopTesterPresent("_HALF_CUSW_9001_EI2685");
    }
}

// ECU Unlock Level 1
//-----------------------------------------------------------
on envVar MEnv_DiagUnlockEcuLevel1_SET_BOL
{
    if(@this == 1)
    {
       // putvalue(MEnv_SysMessage_GET_STG_2,"");
        
        //Reset all Security Unlock Status LEDs
        @MEnv_DiagUnlockEcuLevel1_GET_BOL = 0;
        @MEnv_DiagUnlockEcuLevel5_GET_BOL = 0;
        @MEnv_DiagUnlockEcuLevel101_GET_B = 0;
      
        setTimer(t_ResetSecUnlockStatusLEDs, @MEnv_SessionFallbackTime_SET_INT);
      
        AFTER_EXTENDED_REQUEST = 1; // 1 = ECU Unlock Level 1
        
        DiagSendRequest(diag_RequestProgramming);
    }
    else
    {
        // button press - do nothing
    }
}
//-----------------------------------------------------------

// ECU Unlock Level 5
//-----------------------------------------------------------
on envVar MEnv_DiagUnlockEcuLevel5_SET_BOL
{
    if(@this == 1)
    {
       // putvalue(MEnv_SysMessage_GET_STG_2,"");
      
        //Reset all Security Unlock Status LEDs
        @MEnv_DiagUnlockEcuLevel1_GET_BOL = 0;
        @MEnv_DiagUnlockEcuLevel5_GET_BOL = 0;
        @MEnv_DiagUnlockEcuLevel101_GET_B = 0;
      
        setTimer(t_ResetSecUnlockStatusLEDs, @MEnv_SessionFallbackTime_SET_INT);
      
        AFTER_EXTENDED_REQUEST = 3; // 3 = ECU Unlock Level 5
      
        DiagSendRequest(diag_RequestExtended);
    }
    else
    {
        // button press - do nothing
    }
}
//-----------------------------------------------------------

// ECU Unlock Level 101
//-----------------------------------------------------------
on envVar MEnv_DiagUnlockEcuLevel101_SET_B
{
    if(@this == 1)
    {
       // putvalue(MEnv_SysMessage_GET_STG_2,"");
      
        //Reset all Security Unlock Status LEDs
        @MEnv_DiagUnlockEcuLevel1_GET_BOL = 0;
        @MEnv_DiagUnlockEcuLevel5_GET_BOL = 0;
        @MEnv_DiagUnlockEcuLevel101_GET_B = 0;
      
        setTimer(t_ResetSecUnlockStatusLEDs, @MEnv_SessionFallbackTime_SET_INT);
      
        AFTER_EXTENDED_REQUEST = 4; // 4 = ECU Unlock Level 101
      
        DiagSendRequest(diag_RequestExtended);
    }
    else
    {
        // button press - do nothing
    }
}
//-----------------------------------------------------------

//Reset Initial Lock
//-----------------------------------------------------------
on timer t_Initial_Lock
{
	  INITIAL_LOCK = 0;
}
//-----------------------------------------------------------

// Emv Panel
//---------------------------------------------
on envVar MEnv_EmvControl_SET_BOL_2
{
    if (@this == 1)
    {
        setTimer(t_Emv_AutoStart, 4000);
    }
    else
    {
        // do nothing
    }
}

on timer t_Emv_AutoStart
{
    @MEnv_EmvInputVoltMax_SET_FLT_3 = 15;
    @MEnv_EmvInputVoltMin_SET_FLT_3 = 9;
    @MEnv_EmvInVoltErrorC_GET_INT_3 = 0;
  
    setTimer(t_Emv_InputVoltage, 50);
}

on timer t_Emv_InputVoltage
{
    AFTER_EXTENDED_REQUEST = 2;
    diagSendRequest(diag_Read_InputVoltage);
  
    cancelTimer(t_Emv_Backup_InputVoltage); // if every thing is correct cancel the Backup Timer
    setTimer(t_Emv_Backup_InputVoltage, 5000); // start the Backup Timer again
}

on timer t_Emv_Backup_InputVoltage
{
    cancelTimer(t_Emv_InputVoltage); // make sure that the sequence is stoped first before start again
    setTimer(t_Emv_Backup_InputVoltage, 5000);
    setTimer(t_Emv_InputVoltage, 500);
}

on diagResponse ECU_Input_Voltage_Read
{
    if (this.IsPositiveResponse())
    {
        if (AFTER_EXTENDED_REQUEST == 2)  // EMV Read Input Voltage
        {
            @MEnv_EmvInputVoltage_GET_FLT_3 = diagGetParameter(this, "T15") / 10;
          
            //check that the input voltage is ok
            if((@MEnv_EmvInputVoltage_GET_FLT_3 >= @MEnv_EmvInputVoltMin_SET_FLT_3) && (@MEnv_EmvInputVoltage_GET_FLT_3 <= @MEnv_EmvInputVoltMax_SET_FLT_3))
            {
                @MEnv_EmvInputVoltLed_GET_BOL_3 = 1;
                DTC_ERROR_COUNTER_LOCK_INT = 1;
            }
            else
            {
                if (DTC_ERROR_COUNTER_LOCK_INT == 1)
                {
                    @MEnv_EmvInVoltErrorC_GET_INT_3 = @MEnv_EmvInVoltErrorC_GET_INT_3 + 1;
                    DTC_ERROR_COUNTER_LOCK_INT = 0;
                }
                else
                {
                    // do nothing
                }
                @MEnv_EmvInputVoltLed_GET_BOL_3 = 0;
            }
            //--------------------------------------------
            
            setTimer(t_Emv_InputVoltage, 2000);
            
            AFTER_EXTENDED_REQUEST = 99;
        }
        else
        {
            // an other mode calls this diagjob
        }
    }
    else
    {
        AFTER_EXTENDED_REQUEST = 99;
        write("Magna Warning: Diagjob #ECU Input Voltage Read# = negative Response");
    }
}
//---------------------------------------------

// Vin
//---------------------------------------------
on envVar MEnv_VinOriginalRead_SET_BOL_3
{
    if (@this == 1)
    {
        diagSendRequest(diag_Read_VinOriginal);
    }
    else
    {
        // do nothing
    }
}

on diagResponse _22F190_VIN_Original_Read
{
    char c[20];
  
    if (this.IsPositiveResponse())
    {
        diagGetParameter(this, "_VIN_Original_24", c, 20);
    }
    else
    {
        write("Magna Warning: Diagjob #VIN Original Read# = negative Response");
    }
    
   //putValue(MEnv_VinOriginal_GET_STG_3, c);
}

on envVar MEnv_VinCurrentRead_SET_BOL_3
{
    if (@this == 1)
    {
        diagSendRequest(diag_Read_VinCurrent);
    }
    else
    {
        // do nothing
    }
}

on diagResponse _22F1B0_VIN_Current_Read
{
    char c[20];
  
    if (this.IsPositiveResponse())
    {
        diagGetParameter(this, "_VIN_Current_24", c, 20);
    }
    else
    {
        write("Magna Warning: Diagjob #VIN Current Read# = negative Response");
    }
    
    putValue(MEnv_VinCurrent_GET_STG_3, c);
}
//---------------------------------------------

//Complete Calibration
//---------------------------------------------
on envVar MEnv_Calibration_SET_BOL_3
{
    if(@this == 1)
    {
        enableControl("Main", "Calibration_Button", 0);
      
      //  putvalue(MEnv_SysMessage_GET_STG_2,"");
      
        AFTER_EXTENDED_REQUEST = 5;
        diagSendRequest(diag_RequestExtended);
    }
    else
    {
        //do nothing
    }
}

on diagResponse EOL_Calibration_VPC_Current_Data_Write_Data
{
    if(this.IsPositiveResponse())
    {
        switch(AFTER_EXTENDED_REQUEST)
        {
            case 99:
            {
                // an other Mode calls this Job
            }
            break;
            
            case 5: // Complete Calibration
            {
                diagSetParameter(diag_StartRoutine_CalibrationDataReset, "Calibration_Data", 0x3);
                diagSetParameter(diag_StartRoutine_CalibrationDataReset, "Camera_Identifier", 0xFF);
              
                diagSendRequest(diag_StartRoutine_CalibrationDataReset);
            }
            break;
        }
    }
    else
    {
        enableControl("Main", "Calibration_Button", 1);
      
        //putvalue(MEnv_SysMessage_GET_STG_2," Magna Warning: Diagjob #EOL Calibration VPC Current Data Write# = negative Response!");
    }
}

on diagResponse Calibration_Data_Reset_Start
{
    if(this.IsPositiveResponse())
    {
        switch(AFTER_EXTENDED_REQUEST)
        {
            case 99:
            {
                // an other Mode calls this Job
            }
            break;
            
            case 5: // Complete Calibration
            {
                DiagjobDelay = 1;
              
                settimer(t_DiagjobDelay, 2000);
                
                //diagSendRequest(diag_HardReset);
            }
            break;
        }
    }
    else
    {
        enableControl("Main", "Calibration_Button", 1);
      
        //putvalue(MEnv_SysMessage_GET_STG_2," Magna Warning: Diagjob #Calibration Data Reset Start# = negative Response!");
    }
}

on timer t_DiagjobDelay
{
    if(DiagjobDelay == 1)
    {
        diagSendRequest(diag_HardReset);
    }
    else if (DiagjobDelay == 2)
    {
        diagSendRequest(diag_Read_CurrentCalibrationData);
    }
    else
    {
        // do nothing
    }
    
    DiagjobDelay = 99;
}
//---------------------------------------------

on diagResponse HardReset_Reset
{
    if(this.IsPositiveResponse())
    {
        switch(AFTER_EXTENDED_REQUEST)
        {
            case 99:
            {
                // an other Mode calls this Job
            }
            break;
            
            case 5: // Complete Calibration
            {
                DiagjobDelay = 2;
              
                settimer(t_DiagjobDelay, 2000);

                //diagSendRequest(diag_Read_CurrentCalibrationData);
            }
            break;
        }
    }
    else
    {
        enableControl("Main", "Calibration_Button", 1);
      
        //putvalue(MEnv_SysMessage_GET_STG_2," Magna Warning: Diagjob #Hard Reset# = negative Response!");
    }
}

on diagResponse Current_Camera_Calibration_Data_Read_Data
{
    if(this.IsPositiveResponse())
    {
        switch(AFTER_EXTENDED_REQUEST)
        {
            case 99:
            {
                // an other Mode calls this Job
            }
            break;
            
            case 5: // Complete Calibration
            {
                buffer_UsedCalibration_Front = diagGetParameter(this, "Front_Cam_Used_Calibration");
                buffer_UsedCalibration_Left = diagGetParameter(this, "LeftCam_Used_Calibration");
                buffer_UsedCalibration_Rear = diagGetParameter(this, "RearCam_Used_Calibration");
                buffer_UsedCalibration_Right = diagGetParameter(this, "RightCam_Used_Calibration");
                
                if ((buffer_UsedCalibration_Front == 1) && (buffer_UsedCalibration_Left == 1) && (buffer_UsedCalibration_Rear == 1) && (buffer_UsedCalibration_Right == 1)) // EOL Successful ?
                {
                    //putvalue(MEnv_SysMessage_GET_STG_2," Complete Calibration Successfull!");
                }
                else
                {
                  //  putvalue(MEnv_SysMessage_GET_STG_2," Complete Calibration Failed!");
                }
                
                AFTER_EXTENDED_REQUEST = 99;
            }
            break;
        }
    }
    else
    {
       // putvalue(MEnv_SysMessage_GET_STG_2," Magna Warning: Diagjob #Read Current Camera Calibration Data# = negative Response!");
    }
    enableControl("Main", "Calibration_Button", 1);
}

//Function to send out a Raw Byte Stream via Functional Address
//---------------------------------------------------------------------------------------

//Function Comment:
//To use this Function in other RBS you must change the 2 messages which are used here 
/*on envvar MEnv_FunctRequestSend_SET_BOL_3
{ 
    message UDS_I::DG_RQ_GLOBAL_UDS myFunctCANmsg = {DLC=8,DIR=TX};     // 1. message, Project dependend Functional Diagrequest Message 
    
    if (@this == 1)
    { 
        if (RequestSignState == 2) // check if Signs are invalid
        {
            putValue(MEnv_FunctResponce_GET_STG_3, "Signs are not valid!");
        }
        else // Signs are valid
        {
            putValue(MEnv_FunctResponce_GET_STG_3, "");
          
            if(diagGetTesterPresentState() == 1) // check if Tester Present is active
            {
                diagStopTesterPresent(); // stop Tester Present if it is active
                TesterPresentState = 1;
                setTimer(t_ResetTesterPresent, 1000);
            }
            else
            {
                TesterPresentState = 0;
                // do nothing
            }
            
            myFunctCANmsg.byte(0) = Data_Byte[0];
            myFunctCANmsg.byte(1) = Data_Byte[1];
            myFunctCANmsg.byte(2) = Data_Byte[2];
            myFunctCANmsg.byte(3) = Data_Byte[3];
            myFunctCANmsg.byte(4) = Data_Byte[4];
            myFunctCANmsg.byte(5) = Data_Byte[5];
            myFunctCANmsg.byte(6) = Data_Byte[6];
            myFunctCANmsg.byte(7) = Data_Byte[7];
            
            output(myFunctCANmsg); 
            
            @MEnv_FunctResponceState_GET_INT_3 = 0;
        }
    }
    else
    {
        //do nothing
    }
}*/

on envVar MEnv_FunctRequest_SET_STG_3
{
    char StringBuffer_char[25];
    int numberofchar;
    int numberofbyte;
    int k;
    
    numberofchar = 0;
    numberofbyte = 0;
  
    @MEnv_FunctResponceState_GET_INT_ = 0;
    
    //Clear Arrays
    //-------------------------------
    For(k = 0; k < elcount(StringBuffer_char); k++)
    {
        StringBuffer_char[k] = ' ';
    } 
    For(k = 0; k < elcount(Data_Byte); k++)
    {
        Data_Byte[k] = 0;
    }
    //-------------------------------

    getValue(MEnv_FunctRequest_SET_STG_3, StringBuffer_char);
    
    for(numberofchar = 0; numberofchar < strlen(StringBuffer_char) - 1; )
    {   
        if((StringBuffer_char[numberofchar] > 0x2F) && (StringBuffer_char[numberofchar] < 0x3A)) // check if current character is a number
        {
            RequestSignState = 1; // Sign valid
          
            Data_Byte[numberofbyte] = (StringBuffer_char[numberofchar] - 48);
        }
        else if((StringBuffer_char[numberofchar] > 0x40) && (StringBuffer_char[numberofchar] < 0x47)) // check if current character is an uppercase letter A-F
        { 
            RequestSignState = 1; // Sign valid
          
            Data_Byte[numberofbyte] = (StringBuffer_char[numberofchar] - 55);
        }
        else if((StringBuffer_char[numberofchar] > 0x60) && (StringBuffer_char[numberofchar] < 0x67)) // check if current character is an lowercase letter a-f
        {
            RequestSignState = 1; // Sign valid
          
            Data_Byte[numberofbyte] = (StringBuffer_char[numberofchar] - 87);
        }  
        else
        {
            RequestSignState = 2; // Signs not valid
          
            write("Magna Warning: Functional Request: string error, Byte %d is not a valid sign!", numberofchar);
            break;
        }
        
        Data_Byte[numberofbyte] = Data_Byte[numberofbyte] * 0x10; // high nibble
        
        numberofchar++; // next character
        
        if((StringBuffer_char[numberofchar] > 0x2F) && (StringBuffer_char[numberofchar] < 0x3A)) // check if current character is a number
        {
            RequestSignState = 1; // Sign valid
          
            Data_Byte[numberofbyte] = Data_Byte[numberofbyte] + (StringBuffer_char[numberofchar] - 48);
        }
        else if((StringBuffer_char[numberofchar] > 0x40) && (StringBuffer_char[numberofchar] < 0x47)) // check if current character is an uppercase letter A-F
        { 
            RequestSignState = 1; // Sign valid
          
            Data_Byte[numberofbyte] = Data_Byte[numberofbyte] + (StringBuffer_char[numberofchar] - 55);
        }
        else if((StringBuffer_char[numberofchar] > 0x60) && (StringBuffer_char[numberofchar] < 0x67)) // check if current character is an lowercase letter a-f
        {
            RequestSignState = 1; // Sign valid
          
            Data_Byte[numberofbyte] = Data_Byte[numberofbyte] + (StringBuffer_char[numberofchar] - 87);
        }
        else
        {
            RequestSignState = 2; // Signs not valid
          
            write("Magna Warning: Functional Request: string error, Byte %d is not a valid sign!", numberofchar);
            break;
        }
        
        numberofbyte++; // next data byte
        
        if (numberofchar < strlen(StringBuffer_char)-1) 
        {
            numberofchar++; // next character
          
            if (StringBuffer_char[numberofchar] != 0x20) // check if current character is a space
            {
                RequestSignState = 2; // Signs not valid
              
                write("Magna Warning: Functional Request: string error, Blanks not matching!");
                break;
            }
            else
            {
                RequestSignState = 1; // Sign valid
              
                numberofchar++; // skip space to next character
            }
        }
    }  
    
    // fill remaining bytes of data array with zeroes
    //-------------------------------
    for(; numberofbyte < 8; numberofbyte++)
    {
        Data_Byte[numberofbyte++] = 0;
    }
    //-------------------------------
}

/*on message D_RS_CVPM        // 2. message, Projekt dependend Diagresponce message  
{
    char ResponceBuffer[30];
    char ResponceBufferWithZeros[30];
  
    // to add Zeros in the ResponceBuffer
    int x;
    int i;
    int z;
  
    // to clear the arrays
    int k;
    
    x = 0;
    i = 0;
    z = 0;
  
    if((diagGetTesterPresentState() == 0) && (RequestSignState == 1)) // check that Tester Present is deactive and Signs are valid
    {
        //Clear Arrays
        //-------------------------------
        For(k = 0; k < elcount(ResponceBuffer); k++)
        {
            ResponceBuffer[k] = ' ';
        } 
        For(k = 0; k < elcount(ResponceBufferWithZeros) - 1; k++)
        {
            ResponceBufferWithZeros[k] = ' ';
        } 
        //-------------------------------
        
        //Byte to Char/String
        snprintf(ResponceBuffer,elcount(ResponceBufferWithZeros),"%x %x %x %x %x %x %x %x ", this.byte(0), this.byte(1), this.byte(2), this.byte(3), this.byte(4), this.byte(5), this.byte(6), this.byte(7));
        
        //Fill up with Zeros
        //-------------------------------
        for(i = 0; i < 8; i = i + 1)
        {
            if(ResponceBuffer[x + 1] == ' ')
            {
                ResponceBufferWithZeros[z] = '0';
                ResponceBufferWithZeros[z + 1] = ResponceBuffer[x];
                ResponceBufferWithZeros[z + 2] = ' ';
              
                z = z + 3;
              
                x = x + 2;
            }
            else
            {
                ResponceBufferWithZeros[z] = ResponceBuffer[x];
                ResponceBufferWithZeros[z + 1] = ResponceBuffer[x + 1];
                ResponceBufferWithZeros[z + 2] = ' ';
              
                z = z + 3;
              
                x = x + 3;
            }
        }
        //-------------------------------
        
        putValue(MEnv_FunctResponce_GET_STG_3, ResponceBufferWithZeros); // copy Responce String to Envvar
        
        if (this.byte(1)==0x7F) // negative response
        {     
             @MEnv_FunctResponceState_GET_INT_3 = 1;
        }
        else
        {
             @MEnv_FunctResponceState_GET_INT_3 = 2;
        }
    }
    
    if(TesterPresentState == 1) // Check if Tester Present was active on Send Request function via "MEnv_FunctRequestSend_SET_BOL_3"
    {
        cancelTimer(t_ResetTesterPresent);
        diagStartTesterPresent();
      
        TesterPresentState = 0;
    }
    else
    {
        // do nothing
    }
    
    
    //Security Unlock Status LED management
    if((this.byte(1) == 0x51) && (this.byte(2) == 01)) // positive Hardreset
    {
        @MEnv_DiagUnlockEcuLevel1_GET_BOL_3 = 0;
        @MEnv_DiagUnlockEcuLevel5_GET_BOL_3 = 0;
        @MEnv_DiagUnlockEcuLevel101_GET_BOL_3 = 0;
    }
    else if((this.byte(1) == 0x50) && (this.byte(2) == 01)) // positive Default Session
    {
        @MEnv_DiagUnlockEcuLevel1_GET_BOL_3 = 0;
        @MEnv_DiagUnlockEcuLevel5_GET_BOL_3 = 0;
        @MEnv_DiagUnlockEcuLevel101_GET_BOL_3 = 0;
    }
    else if((this.byte(1) == 0x50) && (this.byte(2) == 02)) // positive Programming Session
    {
        @MEnv_DiagUnlockEcuLevel1_GET_BOL_3 = 0;
        @MEnv_DiagUnlockEcuLevel101_GET_BOL_3 = 0;
    }
    else if((this.byte(1) == 0x50) && (this.byte(2) == 03)) // positive Extended Session
    {
        
    }
    
    cancelTimer(t_ResetSecUnlockStatusLEDs);
    
    setTimer(t_ResetSecUnlockStatusLEDs, @MEnv_SessionFallbackTime_SET_INT_3);
}*/

on timer t_ResetTesterPresent // in case of no Responce from the ECU, this Timer will make shure that the Testerpresent will active if it was active before
{
    if(TesterPresentState == 1)
    {
        diagStartTesterPresent();
        TesterPresentState = 0;
    }
    else
    {
        //do nothing
    }
}
//---------------------------------------------------------------------------------------

on message 0x794 // Physikal Diagrequest
{
    if((this.byte(1) == 0x11) && (this.byte(2) == 81)) // suppressed Hardreset
    {
        @MEnv_DiagUnlockEcuLevel1_GET_BOL = 0;
        @MEnv_DiagUnlockEcuLevel5_GET_BOL = 0;
        @MEnv_DiagUnlockEcuLevel101_GET_B = 0;
    }
    else if((this.byte(1) == 0x10) && (this.byte(2) == 81)) // suppressed Default Session
    {
        @MEnv_DiagUnlockEcuLevel1_GET_BOL = 0;
        @MEnv_DiagUnlockEcuLevel5_GET_BOL = 0;
        @MEnv_DiagUnlockEcuLevel101_GET_B = 0;
    }
    else if((this.byte(1) == 0x10) && (this.byte(2) == 82)) // suppressed Programming Session
    {
        @MEnv_DiagUnlockEcuLevel1_GET_BOL = 0;
        @MEnv_DiagUnlockEcuLevel101_GET_B = 0;
    }
    else if((this.byte(1) == 0x10) && (this.byte(2) == 83)) // suppressed Extended Session
    {
        
    }
    
    cancelTimer(t_ResetSecUnlockStatusLEDs);
    
    setTimer(t_ResetSecUnlockStatusLEDs, @MEnv_SessionFallbackTime_SET_INT);
}

on message 0x441 // Functional Diagrequest
{
    if((this.byte(1) == 0x11) && (this.byte(2) == 81)) // suppressed Hardreset
    {
        @MEnv_DiagUnlockEcuLevel1_GET_BOL = 0;
        @MEnv_DiagUnlockEcuLevel5_GET_BOL = 0;
        @MEnv_DiagUnlockEcuLevel101_GET_B = 0;
    }
    else if((this.byte(1) == 0x10) && (this.byte(2) == 81)) // suppressed Default Session
    {
        @MEnv_DiagUnlockEcuLevel1_GET_BOL = 0;
        @MEnv_DiagUnlockEcuLevel5_GET_BOL = 0;
        @MEnv_DiagUnlockEcuLevel101_GET_B = 0;
    }
    else if((this.byte(1) == 0x10) && (this.byte(2) == 82)) // suppressed Programming Session
    {
        @MEnv_DiagUnlockEcuLevel1_GET_BOL = 0;
        @MEnv_DiagUnlockEcuLevel101_GET_B = 0;
    }
    else if((this.byte(1) == 0x10) && (this.byte(2) == 83)) // suppressed Extended Session
    {
        
    }
    
    cancelTimer(t_ResetSecUnlockStatusLEDs);
    
    setTimer(t_ResetSecUnlockStatusLEDs, @MEnv_SessionFallbackTime_SET_INT);
}

on timer t_ResetSecUnlockStatusLEDs // timer to reset the Security Unlock Status LEDs if no Diagjob is requested
{
    @MEnv_DiagUnlockEcuLevel1_GET_BOL = 0;
    @MEnv_DiagUnlockEcuLevel5_GET_BOL = 0;
    @MEnv_DiagUnlockEcuLevel101_GET_B = 0;
}

on envVar MEnv_EmvDeactivateFailsafe_SET_B
{
    if(@this == 1)
    {
        @MEnv_EmvDeactivateFailsafe_GET_I = 0; // LED Blue
      
        @MEnv_DiagTesterPresent_SET_BOL_3 = 1; // start Tester Present
      
        @MEnv_DiagUnlockEcuLevel101_SET_B = 1; // Unlock ECU Level 101
      
        setTimer(t_ResetUnlockButton, 100);
      
        setTimer(t_Emv_CheckUnlockState, 500);
      
        setTimer(t_Emv_Backup_DeactivateFailsafe, 10000);
      
        enableControl("EMV", "EmvDeactivateFailsafe_Button", 0);
    }
    else
    {
        // do nothing
    }
}

on timer t_Emv_Backup_DeactivateFailsafe
{
    cancelTimer(t_Emv_CheckUnlockState);
  
    @MEnv_EmvDeactivateFailsafe_GET_I = 1; // LED Red
      
    enableControl("EMV", "EmvDeactivateFailsafe_Button", 1);
}

on timer t_Emv_CheckUnlockState
{
    if (@MEnv_DiagUnlockEcuLevel101_GET_B == 1)
    {
        diagSendRequest(diag_StartRoutine_DeactivateFailSage);
    }
    else
    {
        setTimer(t_Emv_CheckUnlockState, 500);
    }
}

on diagResponse DEACTIVATION_OF_FAIL_SAFE_REACTIONS_Start
{
    if (this.IsPositiveResponse())
    {
        @MEnv_EmvDeactivateFailsafe_GET_I = 2; // LED Green
    }
    else
    {
        @MEnv_EmvDeactivateFailsafe_GET_I = 1; // LED Red
    }
    
    enableControl("EMV", "EmvDeactivateFailsafe_Button", 1);
      
    cancelTimer(t_Emv_Backup_DeactivateFailsafe);
}

on timer t_ResetUnlockButton
{
    @MEnv_DiagUnlockEcuLevel101_SET_B = 0; // Reset the Unlock ECU Button
}

// PROXI Car Config 1
//-----------------------------------------------------------
on envVar MEnv_SendProxiString_SET_INT_3
{
    byte proxi[60];
  // byte writeproxi[218]; //{0x30, 0x30, 0x30, 0x30, 0x30, 0x30, 0x30, 0x39, 0x38, 0x34, 0x30, 0x45, 0x30, 0x30, 0x30, 0x31, 0x2D, 0x30, 0x34, 0x20, 0x20, 0x20, 0x19, 0x09, 0x25, 0x4F, 0x0C, 0x44, 0x45, 0x18, 0x40, 0x1D, 0x82, 0x2A, 0x40, 0x02, 0x00, 0x00, 0x00, 0x01, 0x00, 0x4F, 0x0C, 0x44, 0xC5, 0x18, 0x40, 0x1D, 0x82, 0x0A, 0x40, 0x02, 0x00, 0x00, 0x00, 0x00, 0x00, 0x33, 0x7A, 0xFD, 0xA1, 0x8E, 0x80, 0x08, 0x71, 0x71, 0x2A, 0x28, 0x57, 0x45, 0x10, 0x78, 0x00, 0x02, 0x00, 0x74, 0x52, 0x80, 0x7E, 0x03, 0x28, 0x00, 0x03, 0xC1, 0x30, 0x9D, 0x03, 0xCA, 0x60, 0xE9, 0x43, 0x00, 0x00, 0x86, 0x82, 0x0E, 0x96, 0x00, 0x00, 0x20, 0x14, 0xD4, 0x19, 0x08, 0x5D, 0xEB, 0x02, 0x03, 0x95, 0x40, 0x50, 0x28, 0x09, 0x2A, 0x18, 0x01, 0xD0, 0x94, 0x3B, 0x00, 0xE7, 0x88, 0x59, 0x00, 0x16, 0x00, 0x00, 0x00, 0x00, 0x00, 0x00, 0x00, 0x00, 0x00, 0x00, 0x00, 0x00, 0x00, 0x00, 0x00, 0x00, 0x00, 0x00, 0x00, 0x00, 0x00, 0x00, 0x00, 0x00, 0x00, 0x00, 0x00, 0x00, 0x00, 0x00, 0x00, 0x00, 0x00, 0x00, 0x00, 0x00, 0x00, 0x00, 0x00, 0x00, 0x00, 0x00, 0x00, 0x00, 0x00, 0x00, 0x00, 0x00, 0x00, 0x00, 0x00, 0x00, 0x00, 0x00, 0x00, 0x00, 0x00, 0x00, 0x00, 0x00, 0x00, 0x00, 0x00, 0x00, 0x00, 0x00, 0x00, 0x00, 0x00, 0x00, 0x00, 0x00, 0x00, 0x00, 0x00, 0x00, 0x00 ,0x00 ,0x00 ,0x00, 0x00, 0x00, 0x00, 0x00, 0x00, 0x00, 0x00 ,0x00 ,0x00, 0x00, 0x00, 0x00, 0x00, 0x00, 0x00, 0x00, 0x00, 0x00, 0x00, 0x00, 0x00, 0x00, 0x00, 0x00, 0x00, 0x00, 0x00, 0x00, 0x00, 0x00, 0x00, 0x00, 0x00, 0x00, 0x00, 0x00, 0x00, 0x00, 0x00, 0x00, 0x00, 0x00, 0x00, 0x00, 0x00, 0x00, 0x00, 0x00, 0x00, 0x00}; //{0x30, 0x30, 0x30, 0x30, 0x30, 0x30, 0x30, 0x39, 0x38, 0x34, 0x30, 0x45, 0x30, 0x30, 0x30, 0x31, 0x2D, 0x30, 0x34, 0x20, 0x20, 0x20, 0x19, 0x09, 0x25, 0x4F, 0x0C, 0x44, 0x45, 0x18, 0x40, 0x1D, 0x82, 0x2A, 0x40, 0x02, 0x00, 0x00, 0x00, 0x01, 0x00, 0x4F, 0x0C, 0x44, 0xC5, 0x18, 0x40, 0x1D, 0x82, 0x0A, 0x40, 0x02, 0x00, 0x00, 0x00, 0x00, 0x00, 0x33, 0x7A, 0xFD, 0xA1, 0x8E, 0x80, 0x08, 0x71, 0x71, 0x2A, 0x28, 0x57, 0x45, 0x10, 0x78, 0x00, 0x02, 0x00, 0x74, 0x52, 0x80, 0x7E, 0x03, 0x28, 0x00, 0x03, 0xC1, 0x30, 0x9D, 0x03, 0xCA, 0x60, 0xE9, 0x43, 0x00, 0x00, 0x86, 0x82, 0x0E, 0x96, 0x00, 0x00, 0x20, 0x14, 0xD4, 0x19, 0x08, 0x5D, 0xEB, 0x02, 0x03, 0x95, 0x40, 0x50, 0x28, 0x09, 0x2A, 0x18, 0x01, 0xD0, 0x94, 0x3B, 0x00, 0xE7, 0x88, 0x59, 0x5C, 0x16, 0xCA, 0x00, 0x00, 0x30, 0x0A, 0xBA, 0x2F, 0x3F, 0x01, 0x00, 0x00, 0x01, 0x00, 0x00, 0xF2, 0x40, 0x00, 0x00, 0x1A, 0x10, 0x00, 0x15, 0x84, 0x50, 0x05, 0x00, 0x00, 0x00, 0x00, 0x00, 0x00, 0x00, 0x0D, 0xC1, 0x00, 0x01, 0x00, 0x00, 0x20, 0x00, 0x70, 0x00, 0x00, 0x00, 0x66, 0x03, 0x00, 0x00, 0x00, 0x00, 0x80, 0x07, 0x40, 0x00, 0x00, 0x00, 0x00, 0x00, 0x00, 0x00, 0x00, 0x00, 0x00, 0x00, 0x00, 0x00, 0x00, 0x00, 0x00, 0x00, 0x00, 0x00, 0x00, 0x00, 0x00, 0x00, 0x00 ,0x00 ,0x00 ,0x00, 0x00, 0x00, 0x00, 0x00, 0x00, 0x00, 0x00 ,0x00 ,0x00, 0x00, 0x00, 0x00, 0x00, 0x00, 0x00, 0x00, 0x00, 0x00, 0x00, 0x00, 0x00, 0x00, 0x00, 0x00, 0x00, 0x00, 0x00, 0x00, 0x00, 0x00, 0x00, 0x00, 0x00, 0x00, 0x00, 0x00, 0x00, 0x00, 0x00, 0x00, 0x00, 0x00, 0x00, 0x00, 0x00, 0x00, 0x00, 0x00, 0x00, 0x00};
   byte CRC_proxi[193];
   int crc_proxi_counter,i;
 // @MEnv_FrwdFacCamera_GET_INT_3 = 1;
  if(@this==1)
  {
    byte writeproxi[218]=
  {
        0x30,0x30,0x30,0x30,0x30,0x30,0x33,0x36,0x32,0x34,0x34,0x45,0x30,0x30,0x32,0x30,0x2D,0x30,0x32,0x20,0x20,0x20,0x22,0x03,0x17,0xCF,0x4D,0xC6,0xAD,0x18,
        0x41,0x24,0x81,0x0A,0xC0,0x18,0xAC,0x03,0x02,0xC1,0x51,0xCF,0x0D,0xC6,0x2D,0x18,0x40,0x24,0xF0,0x2A,0xCC,0x18,0x64,0x03,0x02,0x81,0x51,0x30,0xF0,0x3D,
        0xC1,0x86,0x80,0x09,0xD2,0x91,0x5B,0x68,0x10,0x55,0x11,0x58,0x00,0x08,0x00,0x00,0x42,0x04,0x3F,0xE3,0x29,0x01,0x03,0xC1,0x38,0x4E,0x00,0x48,0x08,0x00,
        0x22,0x00,0x00,0x84,0x01,0x0F,0x50,0x0A,0x50,0x09,0x0C,0x00,0x10,0x02,0x68,0x00,0x02,0x07,0x95,0x60,0x57,0x2C,0x58,0x66,0x18,0x00,0xD0,0x1C,0x3A,0x00,
        0x87,0xBF,0xF9,0x50,0x16,0xC0,0x00,0x00,0x22,0x0B,0x01,0x4F,0x1B,0x81,0x3E,0x04,0x00,0x00,0x00,0x82,0x00,0x00,0x00,0x06,0x18,0x24,0x00,0x89,0x80,0xA8,
        0x0F,0x50,0x66,0x11,0x3C,0x02,0x00,0x00,0xC1,0x00,0x00,0x20,0x00,0x6E,0x00,0x73,0x08,0x00,0x00,0x68,0x24,0x00,0x9A,0x1C,0x34,0x9E,0x2B,0x6A,0x80,0x00,
        0xCA,0x24,0x66,0x7F,0x09,0x40,0x00,0x00,0x00,0x00,0x00,0x00,0x00,0x0F,0x80,0x00,0x00,0x01,0x04,0x00,0x00,0x00,0x40,0x01,0x00,0x00,0x00,0x00,0x00,0x00,
        0xFC,0x00,0x02,0x00,0x00,0x00,0x00,0x00
  };
  writeproxi[0] = 0x30;
  writeproxi[1] = 0x30;
  writeproxi[2] = 0x30;
  writeproxi[3] = 0x30;
  writeproxi[4] = 0x30;
  writeproxi[5] = 0x30;
  
 //  45 30 30 32 30 2d 30 32 20 20 20 22 03 17
  
  writeproxi[11] = 0x45;
  writeproxi[12] = 0x30;
  writeproxi[13] = 0x30;
  writeproxi[14] = 0x32;
  writeproxi[15] = 0x30;
  writeproxi[16] = 0x2D;
  writeproxi[17] = 0x30;
  writeproxi[18] = 0x32;
  writeproxi[19] = 0x20;
  writeproxi[20] = 0x20;
  writeproxi[21] = 0x20;
  writeproxi[22] = 0x22;
  writeproxi[23] = 0x03;
  writeproxi[24] = 0x17;

  
      //CAN_node_27
      //Mask byte (Byte = 29, start bit =3, length= 1, --.Mask byte = 0xF7
      writeproxi[28] = writeproxi[28] & 0xF7; //3bit=0
      writeproxi[28] = writeproxi[28] | (@MEnv_CANnode27_SET_INT_3<< 3);//Setting bit 3 = MEnv_CANnode27_SET_INT_3

      //CAN_node_63 
      //Mask byte (Byte = 33, start bit =7, length= 1, --.Mask byte = 7F
      writeproxi[32] = writeproxi[32] & 0x7F;
      writeproxi[32] = writeproxi[32] |( @MEnv_CANnode63_SET_INT_3<< 7);

      //CAN_node_67 
      //Mask byte (Byte = 34, start bit =3, length= 1, --.Mask byte = F7
      writeproxi[33] = writeproxi[33] & 0xF7;
      writeproxi[33] = writeproxi[33] |( @MEnv_CANnode67_SET_INT_3<< 3);

      //CAN_node_95
      //Mask byte (Byte = 37, start bit =7, length= 1, --.Mask byte = 7F
      writeproxi[36] = writeproxi[36] & 0x7F;
      writeproxi[36] = writeproxi[36] |( @MEnv_CANnode95_SET_INT_3<< 7);

      //stop_and_start  
      //Mask byte (Byte = 58, start bit =0, length= 1, --.Mask byte = FD
      writeproxi[57] = writeproxi[57] & 0xFD;
      writeproxi[57] = writeproxi[57] |( @MEnv_StopAndStart_SET_INT_3);

      //Driver_side 
      //Mask byte (Byte = 58, start bit =3, length= 1, --.Mask byte = F7
      writeproxi[57] = writeproxi[57] & 0xF7;
      writeproxi[57] = writeproxi[57] |(@MEnv_DriverSide_SET_INT_3<<3);
       
      //Tyre Size 
      //Mask byte (Byte = 64,65 start bit =0, length= 15, --.Mask byte = FF
      writeproxi[63] = writeproxi[63] & 0x0;
      writeproxi[63] = writeproxi[63] |((@MEnv_TyreSize_SET_INT_3 & 0xFF00) >> 8); 
      writeproxi[64] = writeproxi[64] & 0x0;
      writeproxi[64] = writeproxi[64] |(@MEnv_TyreSize_SET_INT_3 & 0xFF); 
    

      //digital_television
      //Mask byte (Byte = 69, start bit =5, length= 1, --.Mask byte = DF
      writeproxi[68] = writeproxi[68] & 0xDF;
      writeproxi[68] = writeproxi[68] |( @MEnv_DgtlTlvFtr_SET_INT_3<<5);

      //wheel_bus 
      //Mask byte (Byte = 71, start bit =4, length= 4, --.Mask byte = 0F
      writeproxi[70] = writeproxi[70] & 0x0F;
      writeproxi[70] = writeproxi[70] |(@MEnv_Wheelbase_SET_INT_3<<4 );

      //Rear_View_camera 
      //Mask byte (Byte = 86, start bit =0, length= 1, --.Mask byte =FE
      writeproxi[85] = writeproxi[85] & 0xFE;
      writeproxi[85] = writeproxi[85] |( @MEnv_RearViewCamera_SET_INT_3);

      //Park_with_stop
      //Mask byte (Byte = 86, start bit =6, length= 1, --.Mask byte =FD
      writeproxi[85] = writeproxi[85] & 0xBF;
      writeproxi[85] = writeproxi[85] |( @MEnv_ParkWithStop_SET_INT_3<< 6);

      //Steering_ratio_rack_pinion
      //Mask byte (Byte = 88, start bit =0, length= 2, --.Mask byte =FC
      writeproxi[87] = writeproxi[87] & 0xFC;
      writeproxi[87] = writeproxi[87] |( @MEnv_StrRtoRackPninTpe_SET_INT_3);

      //Drive_Type_varient
      //Mask byte (Byte = 91, start bit =5, length= 3, --.Mask byte =1F
      writeproxi[90] = writeproxi[90] & 0xEF;
      writeproxi[90] = writeproxi[90] |(@MEnv_DriveTypeVariant_SET_INT_3<<5);

      //Gear_box_type
      //Mask byte (Byte = 101, start bit =0, length= 3, --.Mask byte =F8
      writeproxi[100] = writeproxi[100] & 0xF8;
      writeproxi[100] = writeproxi[100] |(@MEnv_GearBoxType_SET_INT_3);

      //PAM_tunning_set
      //Mask byte (Byte = 104, start bit =0, length= 3, --.Mask byte =F8
      writeproxi[103] = writeproxi[103] & 0xF8;
      writeproxi[103] = writeproxi[103] |(@MEnv_PAMTuningSet_SET_INT_3);

            
      //Semi_Automatic_parking_system
      //Mask byte (Byte = 104, start bit =3, length=1 , --.Mask byte =F
      writeproxi[103] = writeproxi[103] & 0xF7;
      writeproxi[103] = writeproxi[103] |(@MEnv_SemiAutoParkSys_SET_INT_3 << 3);

    

      //vehicle_line_configuration
      //Mask byte (Byte = 105, start bit =0, length= 8, --.Mask byte =00
      writeproxi[104] = writeproxi[104] & 0x00;
      writeproxi[104] = writeproxi[104] |(@MEnv_VehLineConfig_SET);

      //Country_code
      //Mask byte (Byte = 107, start bit =0, length= 8, --.Mask byte =00
      writeproxi[106] = writeproxi[106] & 0x00;
      writeproxi[106] = writeproxi[106] | (@MEnv_CountryCode_SET_INT_3);

      //SRT
      //Mask byte (Byte = 111, start bit =7, length= 1, --.Mask byte =7F
      writeproxi[110] = writeproxi[110] & 0x7f;
      writeproxi[110] = writeproxi[110] |(@MEnv_SRT_SET_INT_3<<7);

      //PAM_Configuration
      //Mask byte (Byte = 118, start bit =4, length= 2, --.Mask byte =CF
      writeproxi[117] = writeproxi[117] & 0xCF;
      writeproxi[117] = writeproxi[117] |(@MEnv_PamConfig_SET_INT_3<<4);

      //Model_Year
      //Mask byte (Byte = 125, start bit =0, length= 8, --.Mask byte =00
      writeproxi[124] = writeproxi[124] & 0x00;
      writeproxi[124] = writeproxi[124] | (@MEnv_ModelYear_SET_INT_3 & 0xFF);

      //Hybrid_Type
      //Mask byte (Byte = 141, start bit =0, length= 4, --.Mask byte =F0
      writeproxi[140] = writeproxi[140] & 0xF0;
      writeproxi[140] = writeproxi[140] |(@MEnv_HybridType_SET_INT_3);

      //Pull_out_control
      //Mask byte (Byte = 150, start bit =5, length= 1, --.Mask byte =DF
      writeproxi[149] = writeproxi[149] & 0xDF;
      writeproxi[149] = writeproxi[149] |(@MEnv_PullOutCtrlPrst_SET_INT_3<<5);


      //surround_view_camera
      //Mask byte (Byte = 177, start bit =0, length= 1, --.Mask byte =FE
      writeproxi[176] = writeproxi[176] & 0xFE;
      writeproxi[176] = writeproxi[176] |(@MEnv_SurroundViewCam_SET_INT_3);

      //Forward_Facing_camera
      //Mask byte (Byte = 177, start bit =1, length= 1, --.Mask byte =FD
      writeproxi[176] = writeproxi[176] & 0xFD;
      writeproxi[176] = writeproxi[176] |(@MEnv_FrwdFacCamera_SET_INT_3<<1);

       
      //Autonomy_level
      //Mask byte (Byte = 177, start bit =2, length= 3, --.Mask byte =E3
      writeproxi[176] = writeproxi[176] & 0xE3;
      writeproxi[176] = writeproxi[176] |(@MEnv_AutonomyLevel_SET_INT_3<<2);


      //Full_autopark_system
      //Mask byte (Byte = 177, start bit =5, length= 1, --.Mask byte =DF
      writeproxi[176] = writeproxi[176] & 0xDF;
      writeproxi[176] = writeproxi[176]|(@MEnv_FullAutoParkSys_SET_INT_3<<5);

      //Radio_Display_type
      //Mask byte (Byte = 185, start bit =0, length= 4, --.Mask byte =F0
      writeproxi[184] = writeproxi[184] & 0xF0;
      writeproxi[184] = writeproxi[184] |(@MEnv_RadioDisplayType_SET_INT_3);

      //mirror type
      //Mask byte (Byte = 203, start bit =3, length= 2, --.Mask byte =E7
      writeproxi[202] = writeproxi[202] & 0xE7;
      writeproxi[202] = writeproxi[202] |(@MEnv_MirrorsType_SET_INT_3<<3);


      //Auxillary-Trail_Cam
      //Mask byte (Byte = 211, start bit =2, length= 1, --.Mask byte =FB
      writeproxi[210] = writeproxi[210] & 0xFB;
      writeproxi[210] = writeproxi[210] |(@MEnv_AuxiliaryTrailCam_SET_INT_3<<2);

      //Trail_reversesurround
      //Mask byte (Byte = 211, start bit =3, length= 1, --.Mask byte =F7
      writeproxi[210] = writeproxi[210] & 0xF7;
      writeproxi[210] = writeproxi[210] |(@MEnv_TrailReverseGuidPreset_SET<<3);

      //Trailer_Surround_presence
      //Mask byte (Byte = 211, start bit =6, length= 1, --.Mask byte =BF
      writeproxi[210] = writeproxi[210] & 0xBF;
      writeproxi[210] = writeproxi[210] |(@MEnv_TrailerSurroundPresence_SET<<6);

      //trailerRevSteeringPrest
      //Mask byte (Byte = 211, start bit =7, length= 1, --.Mask byte =7F
      writeproxi[210] = writeproxi[210] & 0x7F;
      writeproxi[210] = writeproxi[210] |(@MEnv_TrailerRevSteeringPrest_SET<<7);


      //TrailerHitchAssistPrest
      //Mask byte (Byte = 213, start bit =1, length= 1, --.Mask byte =FD
      writeproxi[212] = writeproxi[212] & 0xFD;
      writeproxi[212] = writeproxi[212] |(@MEnv_TrailerHitchAssistPrest_SET<<1);




  
        for(crc_proxi_counter = 25; crc_proxi_counter < 218; crc_proxi_counter++)
        {
            CRC_proxi[crc_proxi_counter - 25] = writeproxi[crc_proxi_counter];
         
        }
//        write("the byte value of 86 at  crc loop after is %x",writeproxi[86]);
//        
        write(" befor func CRC from String: %x, %x, %x, %x, %x, ", writeproxi[6], writeproxi[7], writeproxi[8], writeproxi[9], writeproxi[10]);
        
        CRC = 0;
        
        CRC = aProxiM_F_CRCPROXI(CRC_proxi, 193);
        
        write("%d", CRC);
        
        writeproxi[6] = crc_array[0];
        writeproxi[7] = crc_array[1];
        writeproxi[8] = crc_array[2];
        writeproxi[9] = crc_array[3];       
        writeproxi[10] = crc_array[4];  
        
        
        write("After func CRC from String: %x, %x, %x, %x, %x, ", writeproxi[6], writeproxi[7], writeproxi[8], writeproxi[9], writeproxi[10]);
        
//        //write("Calculated CRC: %x, %x, %x, %x, %x, ", writeproxi[6], writeproxi[7], writeproxi[8], writeproxi[9], writeproxi[10]);
//        for(i=0;i<218;i++)
//        {
//          write("MessageData=%d:  %x",i,writeproxi[i]);
//        }
//        write("the byte value of 86 at after crc is %x",writeproxi[86]);
//                write("the byte value of 85 at after crc is %x",writeproxi[85]);
        diagSetParameterRaw(diag_WriteProxi, "_Data_24", writeproxi, 218);
        diagSendRequest(diag_WriteProxi);
       
        
  }
  // putValue(MEnv_DiagData_SET_STG_3, writeproxi);
        @this = 0;
    
    
}
//-----------------------------------------------------------

on envVar MEnv_SetDefaultproxidata_SET_INT_3
{
        if(@this==1)
        {
          byte writeproxi[218]=
  {
        0x30,0x30,0x30,0x30,0x30,0x30,0x33,0x36,0x32,0x34,0x34,0x45,0x30,0x30,0x32,0x30,0x2D,0x30,0x32,0x20,0x20,0x20,0x22,0x03,0x17,0xCF,0x4D,0xC6,0xAD,0x18,
        0x41,0x24,0x81,0x0A,0xC0,0x18,0xAC,0x03,0x02,0xC1,0x51,0xCF,0x0D,0xC6,0x2D,0x18,0x40,0x24,0xF0,0x2A,0xCC,0x18,0x64,0x03,0x02,0x81,0x51,0x30,0xF0,0x3D,
        0xC1,0x86,0x80,0x09,0xD2,0x91,0x5B,0x68,0x10,0x55,0x11,0x58,0x00,0x08,0x00,0x00,0x42,0x04,0x3F,0xE3,0x29,0x01,0x03,0xC1,0x38,0x4E,0x00,0x48,0x08,0x00,
        0x22,0x00,0x00,0x84,0x01,0x0F,0x50,0x0A,0x50,0x09,0x0C,0x00,0x10,0x02,0x68,0x00,0x02,0x07,0x95,0x60,0x57,0x2C,0x58,0x66,0x18,0x00,0xD0,0x1C,0x3A,0x00,
        0x87,0xBF,0xF9,0x50,0x16,0xC0,0x00,0x00,0x22,0x0B,0x01,0x4F,0x1B,0x81,0x3E,0x04,0x00,0x00,0x00,0x82,0x00,0x00,0x00,0x06,0x18,0x24,0x00,0x89,0x80,0xA8,
        0x0F,0x50,0x66,0x11,0x3C,0x02,0x00,0x00,0xC1,0x00,0x00,0x20,0x00,0x6E,0x00,0x73,0x08,0x00,0x00,0x68,0x24,0x00,0x9A,0x1C,0x34,0x9E,0x2B,0x6A,0x80,0x00,
        0xCA,0x24,0x66,0x7F,0x09,0x40,0x00,0x00,0x00,0x00,0x00,0x00,0x00,0x0F,0x80,0x00,0x00,0x01,0x04,0x00,0x00,0x00,0x40,0x01,0x00,0x00,0x00,0x00,0x00,0x00,
        0xFC,0x00,0x02,0x00,0x00,0x00,0x00,0x00
  };

        diagSetParameterRaw(diag_WriteProxi, "_Data_24", writeproxi, 218);
        diagSendRequest(diag_WriteProxi);
        }
      
        putValue(MEnv_DiagData_SET_STG_3, writeproxi);

      @MEnv_SetDefaultproxidata_SET_INT_3 = 0;
        
        SetDefaultProxi();  
     // set_default_proxi_data();
        
}

on envVar MEnv_DiagData_SET_STG_3
{

}

/*on diagResponse EngineeringParameters_Read
{
    byte getproxiPAMConfig[1];
    byte getproxiSideDistWarn[1];
    byte getproxiSVC[1];
    byte getproxiCountry[1];
    byte getproxiDriverSide[1];
    byte getproxiSteering[1];
    byte getproxiGearBoxType[1];
    byte getproxiVehicleLine[1];
    byte getproxiWheelbaseLen[1];
    byte getproxiModelYear[1];
  
    int i;
  
//    @MEnv_SendProxiString_SET_INT_3 = 0;
  
	  if (this.IsPositiveResponse()) 
    {
        if(getProxiValues == 1)
        {
            diagGetParameterRaw(this, "Bitfield_2.PAM_Configuration", getproxiPAMConfig, 1);
            diagGetParameterRaw(this, "Bitfield_1.Side_Distance_Warning", getproxiSideDistWarn, 1);
            diagGetParameterRaw(this, "Bitfield_2.Surround_View_Camera", getproxiSVC, 1);
            diagGetParameterRaw(this, "Bitfield_1.Driver_Side", getproxiDriverSide, 1);
            diagGetParameterRaw(this, "Bitfield_1.Steering_Ratio_Rack_Pinion_Type", getproxiSteering, 1);
            diagGetParameterRaw(this, "Bitfield_2.Gear_Box_Type", getproxiGearBoxType, 1);
            diagGetParameterRaw(this, "_Vehicle_Line_Configuration_32", getproxiVehicleLine, 1);
            diagGetParameterRaw(this, "Bitfield_1.Wheelbase", getproxiWheelbaseLen, 1);
            diagGetParameterRaw(this, "Model_Year_1", getproxiModelYear, 1);
          
            @MEnv_DriverSide_GET_INT_3 = getproxiDriverSide[0];
            write("MEnv_DriverSide_GET_INT_3%x",@MEnv_DriverSide_GET_INT_3);
            write("getproxiDriverSide%x",getproxiDriverSide[0]);
            write("MEnv_DriverSide_SET_INT_3%x",@MEnv_DriverSide_SET_INT_3);
          
//          @MEnv_CarShapeConfiguration_GET_INT_3 = 1;
            @MEnv_Wheelbase_GET_INT_3 = getproxiWheelbaseLen[0];
            @MEnv_SideDistanceWarning_GET_INT_3 = getproxiSideDistWarn[0];
            @MEnv_SteeringRatioRackPinionType_GET_INT_3 = getproxiSteering[0];
            @MEnv_GearBoxType_GET_INT_3 = getproxiGearBoxType[0];
            @MEnv_VehicleLineConfiguration_GET_INT_3 = getproxiVehicleLine[0];
//          @MEnv_CountryCode_GET_INT_3 = getproxiCountry[0];
            @MEnv_PamConfiguration_GET_INT_3 = getproxiPAMConfig[0];
            @MEnv_ModelYear_GET_INT_3 = getproxiModelYear[0];
            @MEnv_SurroundViewCamera_GET_INT_3 = getproxiSVC[0];
           
            getProxiValues = 0;
        }
        else 
        {
            diagSendRequest(diag_KeyOn);
        }
        
    }
    else
    {      
        // do nothing
    }
}*/

on diagResponse  EngineeringParameters_Read
{
    size=this.GetPrimitiveSize();              // To get the size of the response
    this.GetPrimitiveData(Diag_Buffer,size);
  @MEnv_ModelYear_GET_INT_3=Diag_Buffer[124];
    if (this.IsPositiveResponse())
    {
      
       for(i=0;i<size;i++)
         {
             Diag[i]=Diag_Buffer[i];
         }
      //putValueToControl("Diag_Proxi","Diag_Output",Diag);
        putValue(MEnv_DiagData_SET_STG_3, Diag);
    }
    else
    {
      diagSendRequest(diag_KeyOn);
    }
}

/*on diagResponse _22200A_KeyOn_counter_EEPROM_Read
{
    byte proxi[255];
    byte writeproxi[255]; //{0x30, 0x30, 0x30, 0x30, 0x30, 0x30, 0x30, 0x39, 0x38, 0x34, 0x30, 0x45, 0x30, 0x30, 0x30, 0x31, 0x2D, 0x30, 0x34, 0x20, 0x20, 0x20, 0x19, 0x09, 0x25, 0x4F, 0x0C, 0x44, 0x45, 0x18, 0x40, 0x1D, 0x82, 0x2A, 0x40, 0x02, 0x00, 0x00, 0x00, 0x01, 0x00, 0x4F, 0x0C, 0x44, 0xC5, 0x18, 0x40, 0x1D, 0x82, 0x0A, 0x40, 0x02, 0x00, 0x00, 0x00, 0x00, 0x00, 0x33, 0x7A, 0xFD, 0xA1, 0x8E, 0x80, 0x08, 0x71, 0x71, 0x2A, 0x28, 0x57, 0x45, 0x10, 0x78, 0x00, 0x02, 0x00, 0x74, 0x52, 0x80, 0x7E, 0x03, 0x28, 0x00, 0x03, 0xC1, 0x30, 0x9D, 0x03, 0xCA, 0x60, 0xE9, 0x43, 0x00, 0x00, 0x86, 0x82, 0x0E, 0x96, 0x00, 0x00, 0x20, 0x14, 0xD4, 0x19, 0x08, 0x5D, 0xEB, 0x02, 0x03, 0x95, 0x40, 0x50, 0x28, 0x09, 0x2A, 0x18, 0x01, 0xD0, 0x94, 0x3B, 0x00, 0xE7, 0x88, 0x59, 0x00, 0x16, 0x00, 0x00, 0x00, 0x00, 0x00, 0x00, 0x00, 0x00, 0x00, 0x00, 0x00, 0x00, 0x00, 0x00, 0x00, 0x00, 0x00, 0x00, 0x00, 0x00, 0x00, 0x00, 0x00, 0x00, 0x00, 0x00, 0x00, 0x00, 0x00, 0x00, 0x00, 0x00, 0x00, 0x00, 0x00, 0x00, 0x00, 0x00, 0x00, 0x00, 0x00, 0x00, 0x00, 0x00, 0x00, 0x00, 0x00, 0x00, 0x00, 0x00, 0x00, 0x00, 0x00, 0x00, 0x00, 0x00, 0x00, 0x00, 0x00, 0x00, 0x00, 0x00, 0x00, 0x00, 0x00, 0x00, 0x00, 0x00, 0x00, 0x00, 0x00, 0x00, 0x00, 0x00, 0x00, 0x00, 0x00 ,0x00 ,0x00 ,0x00, 0x00, 0x00, 0x00, 0x00, 0x00, 0x00, 0x00 ,0x00 ,0x00, 0x00, 0x00, 0x00, 0x00, 0x00, 0x00, 0x00, 0x00, 0x00, 0x00, 0x00, 0x00, 0x00, 0x00, 0x00, 0x00, 0x00, 0x00, 0x00, 0x00, 0x00, 0x00, 0x00, 0x00, 0x00, 0x00, 0x00, 0x00, 0x00, 0x00, 0x00, 0x00, 0x00, 0x00, 0x00, 0x00, 0x00, 0x00, 0x00, 0x00, 0x00}; //{0x30, 0x30, 0x30, 0x30, 0x30, 0x30, 0x30, 0x39, 0x38, 0x34, 0x30, 0x45, 0x30, 0x30, 0x30, 0x31, 0x2D, 0x30, 0x34, 0x20, 0x20, 0x20, 0x19, 0x09, 0x25, 0x4F, 0x0C, 0x44, 0x45, 0x18, 0x40, 0x1D, 0x82, 0x2A, 0x40, 0x02, 0x00, 0x00, 0x00, 0x01, 0x00, 0x4F, 0x0C, 0x44, 0xC5, 0x18, 0x40, 0x1D, 0x82, 0x0A, 0x40, 0x02, 0x00, 0x00, 0x00, 0x00, 0x00, 0x33, 0x7A, 0xFD, 0xA1, 0x8E, 0x80, 0x08, 0x71, 0x71, 0x2A, 0x28, 0x57, 0x45, 0x10, 0x78, 0x00, 0x02, 0x00, 0x74, 0x52, 0x80, 0x7E, 0x03, 0x28, 0x00, 0x03, 0xC1, 0x30, 0x9D, 0x03, 0xCA, 0x60, 0xE9, 0x43, 0x00, 0x00, 0x86, 0x82, 0x0E, 0x96, 0x00, 0x00, 0x20, 0x14, 0xD4, 0x19, 0x08, 0x5D, 0xEB, 0x02, 0x03, 0x95, 0x40, 0x50, 0x28, 0x09, 0x2A, 0x18, 0x01, 0xD0, 0x94, 0x3B, 0x00, 0xE7, 0x88, 0x59, 0x5C, 0x16, 0xCA, 0x00, 0x00, 0x30, 0x0A, 0xBA, 0x2F, 0x3F, 0x01, 0x00, 0x00, 0x01, 0x00, 0x00, 0xF2, 0x40, 0x00, 0x00, 0x1A, 0x10, 0x00, 0x15, 0x84, 0x50, 0x05, 0x00, 0x00, 0x00, 0x00, 0x00, 0x00, 0x00, 0x0D, 0xC1, 0x00, 0x01, 0x00, 0x00, 0x20, 0x00, 0x70, 0x00, 0x00, 0x00, 0x66, 0x03, 0x00, 0x00, 0x00, 0x00, 0x80, 0x07, 0x40, 0x00, 0x00, 0x00, 0x00, 0x00, 0x00, 0x00, 0x00, 0x00, 0x00, 0x00, 0x00, 0x00, 0x00, 0x00, 0x00, 0x00, 0x00, 0x00, 0x00, 0x00, 0x00, 0x00, 0x00 ,0x00 ,0x00 ,0x00, 0x00, 0x00, 0x00, 0x00, 0x00, 0x00, 0x00 ,0x00 ,0x00, 0x00, 0x00, 0x00, 0x00, 0x00, 0x00, 0x00, 0x00, 0x00, 0x00, 0x00, 0x00, 0x00, 0x00, 0x00, 0x00, 0x00, 0x00, 0x00, 0x00, 0x00, 0x00, 0x00, 0x00, 0x00, 0x00, 0x00, 0x00, 0x00, 0x00, 0x00, 0x00, 0x00, 0x00, 0x00, 0x00, 0x00, 0x00, 0x00, 0x00, 0x00};
    byte CRC_proxi[230];
    int crc_proxi_counter;

    writeproxi[0] = 0x30;   //Configuration code format check (0x30 - 0x39)
    writeproxi[1] = 0x30;   //Configuration code format check (0x30 - 0x39)
    writeproxi[2] = 0x30;   //Configuration code format check (0x30 - 0x39)
    writeproxi[3] = 0x30;   //Configuration code format check (0x30 - 0x39)
    writeproxi[4] = 0x30;   //Configuration code format check (0x30 - 0x39)
    writeproxi[5] = 0x30;   //Configuration code format check (0x30 - 0x39)
    writeproxi[6] = 0x30;   //Configuration code format check (0x30 - 0x39)
    writeproxi[7] = 0x30;   //Configuration code format check (0x30 - 0x39)
    writeproxi[8] = 0x30;   //Configuration code format check (0x30 - 0x39)
    writeproxi[9] = 0x30;   //Configuration code format check (0x30 - 0x39)
    writeproxi[10] = 0x30;  //Configuration code format check (0x30 - 0x39)
    writeproxi[21] = 0x20;  //Date format check year
    writeproxi[22] = 0x19;  //Date format check year
    writeproxi[23] = 0x09;  //Date format check month (0<month<13)
    writeproxi[24] = 0x25;  //Date format check day (0<day<32)

    if(@MEnv_DriverSide_SET_INT_3 == 1)
    {
        writeproxi[57] = writeproxi[57] | 0x08;
    }
    else if (@MEnv_DriverSide_SET_INT_3 == 0)
    {
        writeproxi[57] = writeproxi[57] & 0x00;
    }
    
    if(@MEnv_Wheelbase_SET_INT_3 == 1)
    {
        writeproxi[70] = writeproxi[70] | 0xF0;
    }
    else if (@MEnv_Wheelbase_SET_INT_3 == 0)
    {
        writeproxi[70] = writeproxi[70] & 0x0F;
    }
    
    if(@MEnv_SideDistanceWarning_SET_INT_3 == 1)
    {
        writeproxi[85] = writeproxi[85] | 0x80;
    }
    else if (@MEnv_SideDistanceWarning_SET_INT_3 == 0)
    {
        writeproxi[85] = writeproxi[85] & 0x00;
    }
    
    switch(@MEnv_SteeringRatioRackPinionType_SET_INT_3)
    {
      case 0:
      {
          writeproxi[87] = writeproxi[87] & 0x00;
      }
      break;
      case 1:
      {
          writeproxi[87] = 0;
          writeproxi[87] = writeproxi[87] | 0x01;
      }
      break;
      case 2:
      {
          writeproxi[87] = 0;
          writeproxi[87] = writeproxi[87] | 0x02;
      }
      break;
    }
    
    switch(@MEnv_GearBoxType_SET_INT_3)
    {
      writeproxi[100] = 0;
      case 0:
      {
          writeproxi[100] = writeproxi[100] & 0x00;
      }
      break;
      case 1:
      {
          writeproxi[100] = 0;
          writeproxi[100] = writeproxi[100] | 0x01;
      }
      break;
      case 2:
      {
          writeproxi[100] = 0;
          writeproxi[100] = writeproxi[100] | 0x02;
      }
      break;
      case 3:
      {
          writeproxi[100] = 0;
          writeproxi[100] = writeproxi[100] | 0x03;
      }
      break;
      case 4:
      {
          writeproxi[100] = 0;
          writeproxi[100] = writeproxi[100] | 0x04;
      }
      break;
      case 5:
      {
          writeproxi[100] = 0;
          writeproxi[100] = writeproxi[100] | 0x05;
      }
      break;
    }
    
    switch(@MEnv_VehicleLineConfiguration_SET_INT_3)
    {
      case 0:
      {
          writeproxi[104] = writeproxi[104] & 0x00;
      }
      break;
      case 86:
      {
          writeproxi[104] = 0;
          writeproxi[104] = writeproxi[104] | 0x56;
      }
      break;
      case 93:
      {
          writeproxi[104] = 0;
          writeproxi[104] = writeproxi[104] | 0x5D;
      }
      break;
      case 98:
      {
          writeproxi[104] = 0;
          writeproxi[104] = writeproxi[104] | 0x62;
      }
      break;
      case 99:
      {
          writeproxi[104] = 0;
          writeproxi[104] = writeproxi[104] | 0x63;
      }
      break;
      case 106:
      {
          writeproxi[104] = 0;
          writeproxi[104] = writeproxi[104] | 0x6A;
      }
      break;
    }
    
    switch(@MEnv_PamConfiguration_SET_INT_3)
    {
      case 0:
      {
          writeproxi[117] = writeproxi[117] & 0x00;
      }
      break;
      case 1:
      {
          writeproxi[117] = writeproxi[117] | 0x10;
      }
      break;
    }
    
    switch(@MEnv_SurroundViewCamera_SET_INT_3)
    {
      case 0:
      {
          writeproxi[176] = writeproxi[176] & 0x00;
      }
      break;
      case 1:
      {
          writeproxi[176] = writeproxi[176] | 0x01;
      }
      break;
    }
    
//    writeproxi[57] = @MEnv_DriverSide_SET_INT_3;                    //Set value for Driver Side
//    writeproxi[70] = @MEnv_Wheelbase_SET_INT_3;                     //Set value for Wheelbase
//    writeproxi[85] = @MEnv_SideDistanceWarning_SET_INT_3;           //Set value for Side Distance Warning
//    writeproxi[87] = @MEnv_SteeringRatioRackPinionType_SET_INT_3;   //Set value for Steering Ratio Rack Pinion Type
//    writeproxi[100] = @MEnv_GearBoxType_SET_INT_3;                  //Set value for Gear Box Type
//    writeproxi[104] = @MEnv_VehicleLineConfiguration_SET_INT_3;     //Set value for Vehicle Line Configuration
//    writeproxi[117] = @MEnv_PamConfiguration_SET_INT_3;             //Set value for PAM Configuration
//    writeproxi[176] = @MEnv_SurroundViewCamera_SET_INT_3;           //Set value for Surround View Camera
    writeproxi[106] = @MEnv_CountryCode_SET_INT_3;                  //Set value for Country Code
    writeproxi[67] = @MEnv_CarShapeConfiguration_SET_INT_3;         //Set value for Car Shape Configuration
    writeproxi[124] = @MEnv_ModelYear_SET_INT_3;                    //Set value for Model Year

  
    for(crc_proxi_counter = 25; crc_proxi_counter < 255; crc_proxi_counter++)
    {
        CRC_proxi[crc_proxi_counter - 25] = writeproxi[crc_proxi_counter];
    }
    
    //write(": %x, %x, %x, %x, %x, ", writeproxi[6], writeproxi[7], writeproxi[8], writeproxi[9], writeproxi[10]);
    
    CRC = 0;CRC from String
    
    CRC = aProxiM_F_CRCPROXI(CRC_proxi, 230);
    
    //write("%d", CRC);
    
    if (CRC > 10000)
    {
        CRC1 = CRC / 10000;
        writeproxi[6] = CRC1 + 0x30;
        
        CRC2 = (CRC - (CRC1*10000)) /1000;
        writeproxi[7] = CRC2 + 0x30;
      
        CRC3 = (CRC - (CRC1*10000 + CRC2*1000)) /100;
        writeproxi[8] = CRC3 + 0x30;
      
        CRC4 = (CRC - (CRC1*10000 + CRC2*1000 + CRC3*100)) /10;
        writeproxi[9] = CRC4 + 0x30;
      
        CRC5 = (CRC - (CRC1*10000 + CRC2*1000 + CRC3*100 + CRC4*10)) /1;
        writeproxi[10] = CRC5 + 0x30;
    }
    else if (CRC > 1000)
    {
        writeproxi[6] = 0x30;
      
        CRC2 = CRC / 1000;  
        writeproxi[7] = CRC2 + 0x30;
        
        CRC3 = (CRC - (CRC2*1000)) /100;
        writeproxi[8] = CRC3 + 0x30;
      
        CRC4 = (CRC - (CRC2*1000 + CRC3*100)) /10;
        writeproxi[9] = CRC4 + 0x30;
        
        CRC5 = (CRC - (CRC2*1000 + CRC3*100 + CRC4*10)) /1;
        writeproxi[10] = CRC5 + 0x30;
    }
    else if (CRC > 100)
    {
        writeproxi[6] = 0x30;
        writeproxi[7] = 0x30;
                 
        CRC3 = CRC /100;
        writeproxi[8] = CRC3 + 0x30;
      
        CRC4 = (CRC - (CRC3*100)) /10;
        writeproxi[9] = CRC4 + 0x30;
        
        CRC5 = (CRC - (CRC3*100 + CRC4*10)) /1;
        writeproxi[10] = CRC5 + 0x30;
    }
    else if (CRC > 10)
    {
        writeproxi[6] = 0x30;
        writeproxi[7] = 0x30;
        writeproxi[8] = 0x30;
      
        CRC4 = CRC /10;
        writeproxi[9] = CRC4 + 0x30;
        
        CRC5 = (CRC - (CRC4*10)) /1;
        writeproxi[10] = CRC5 + 0x30;
    }
    else if (CRC > 1)
    {
        writeproxi[6] = 0x30;
        writeproxi[7] = 0x30;
        writeproxi[8] = 0x30;
        writeproxi[9] = 0x30;
        
        CRC5 = CRC /1;
        writeproxi[10] = CRC5 + 0x30;
    }
    else
    {
        writeproxi[6] = 0x30;
        writeproxi[7] = 0x30;
        writeproxi[8] = 0x30;
        writeproxi[9] = 0x30;
        writeproxi[10] = 0x30;
    }
    
    //write("Calculated CRC: %x, %x, %x, %x, %x, ", writeproxi[6], writeproxi[7], writeproxi[8], writeproxi[9], writeproxi[10]);
      
    
    diagSetParameterRaw(diag_WriteProxi, "_System_Configuration_PROXI_24", writeproxi, 255);
    diagSendRequest(diag_WriteProxi);
}*/

on diagResponse _2E2023_System_Configuration_PROXI_Write
{
    if(this.IsPositiveResponse())
    {
        diagSendRequest(diag_CheckEOLConfigData);
    }
    else
    {
      //do nothing
    }
}

on diagResponse _22102A_Check_EOL_configuration_data_Read
{
    if(this.IsPositiveResponse())
    {
        getProxiValues = 1;
        diagSendRequest(diag_ReadProxi);
    }
    else
    {
      //do nothing
    }
}
//on key 'c'
//
//{
//  byte bufferval[4];
//  bufferval[0] = 0xFB;
//   bufferval[1] = 0x80;
//    bufferval[2] = 0x78;
//    bufferval[3] = 0xF6;
//  CRC = 0;
//
// //byte crc_array[5]={0,0,0,0,0};
//  CRC = aProxiM_F_CRCPROXI(bufferval, 4);
//  write("Calculated Final CRC =   %X", CRC);
//  
//}

word aProxiM_F_CRCPROXI_old(byte PROXI_message[], int nBytes)
{
    byte data;
    word calculated_crc = 0;
    int byte_index;

    data = 0;
    calculated_crc = 0;
    byte_index = 0;
    /*
    ** Divide the PROXI_message by the polynomial, one byte at a time.
    */
    for (byte_index = 0; byte_index < nBytes; byte_index++)
    {
        data = PROXI_message[byte_index] ^ (byte)(calculated_crc & 0xff);
        calculated_crc = Table_CRC_16_CCITT[data] ^ (calculated_crc >> 8);
    }
   // write("calculated_crc is %d",calculated_crc);

    /*
    ** The final calculated_crc is the CRC.
    */
    return (calculated_crc);
}



on key 'm'
{
  //crc16(4);
   word crc = 0x0000;
  
  byte x[207]= {0xcf, 0x4d, 0xc6, 0xad, 0x18, 0x41, 0x24, 0x81, 0x0a, 0xc0, 0x18, 0xac, 0x03, 0x02, 0xc1, 0x51, 0xcf, 0x0d, 0xc6, 0x2d, 0x18, 0x40, 0x24, 0xf0, 0x2a, 0xcc, 0x18, 0x64, 0x03, 0x02, 0x81, 0x51, 0x30, 0xf0,
0x3d, 0xc1, 0x86, 0x80, 0x09, 0xd2, 0x91, 0x5b, 0x68, 0x10, 0x55, 0x11, 0x58, 0x00, 0x08, 0x00, 0x00, 0x42, 0x04, 0x3f, 0xe3, 0x29, 0x01, 0x03, 0xc1, 0x38, 0x4e, 0x00, 0x48, 0x08, 0x00, 0x22, 0x00, 0x00, 0x84, 0x01, 0x0f, 0x50, 0x0a, 0x50, 0x09, 0x0c, 0x00, 0x10, 0x02, 0x68, 0x00, 0x02, 0x07, 0x95, 0x60, 0x57, 0x2c, 0x58, 0x66, 0x18, 0x00, 0xd0, 0x1c, 0x3a, 0x00, 0x87, 0xbf,
0xf9, 0x50, 0x16, 0xc0, 0x00, 0x00, 0x22, 0x0b, 0x01, 0x4f, 0x1b, 0x81, 0x3e, 0x04, 0x00, 0x00, 0x00, 0x82, 0x00, 0x00, 0x00, 0x06, 0x18, 0x24, 0x00, 0x89, 0x80, 0xa8, 0x0f, 0x50, 0x66, 0x11, 0x3c, 0x02, 0x00, 0x00, 0xc1, 0x00, 0x00, 0x20, 0x00, 0x6e, 0x00, 0x73, 0x08, 0x00, 0x00, 0x68, 0x24, 0x00, 0x9a, 0x1c, 0x34, 0x9e, 0x2b, 0x6a, 0x80, 0x00, 0xca, 0x24, 0x66, 0x7f, 0x09,
0x40, 0x00, 0x00, 0x00, 0x00, 0x00, 0x00, 0x00, 0x0f, 0x80, 0x00, 0x00, 0x01, 0x04, 0x00, 0x00, 0x00, 0x40, 0x01, 0x00, 0x00, 0x00, 0x00, 0x00, 0x00, 0xfc, 0x00, 0x02, 0x00, 0x00, 0x00, 0x00, 0x00, 0x00, 0x00, 0x00, 0x00, 0x00, 0x00, 0x00, 0x00, 0x00, 0x00, 0x00, 0x00, 0x00, 0x00};

    
    
    crc = aProxiM_F_CRCPROXI(x, 193);
  write("Final  %X", crc);
  
  
//   for(i=4;i>0;i--)
//{
//        // Extract the last digit of N
//        crc_array[i] = crc % 10;
//        crc = crc / 10;
//    }
//  write("digits %d %d %d %d %d",crc_array[0],crc_array[1],crc_array[2],crc_array[3],crc_array[4]);  
//
//
//  crc = crc16_withstartindex(writeproxi,6, 217);
//  write("Final  %X", crc); 
//   for(i=4;i>0;i--)
//{
//        // Extract the last digit of N
//        crc_array[i] = crc % 10;
//        crc = crc / 10;
//    }
//  write("digits %d %d %d %d %d",crc_array[0],crc_array[1],crc_array[2],crc_array[3],crc_array[4]);  

}




word aProxiM_F_CRCPROXI(byte x[],int length)
{
  //1021  1 0001 0000 0010 0001
//8408  1000 0100 0000 1000 1
  
      int i, j,k;
      word data;
      word crc = 0x0000;
      word crc_poly =0x8408;
      //char crc_ch[10]="";
      
      word TempCRC = 0;
      word RemCRC = 0;
    //  write("%x %x %x %x %d", x[0], x[1], x[2], x[3],length );
      


     crc=0;
      if (length == 0)
            return (~crc);



     for(j=0;j<length;j++)
      {
        data=0xffff & x[j];
       
            for (i=0 ; i < 8; i++ )
            {
                  if ((crc & 0x0001) ^ (data & 0x0001))
                  {
                        crc = (crc >> 1) ^ crc_poly;
                  }
                       
                  else
                  {
                    crc >>= 1;
                  }
                  data >>= 1;  
            }
      }



//      crc = ~crc;
//      write("1  %X", crc);
//      data = crc;
//      write("2  %X", crc);
//      crc = (crc << 8) | (data >> 8 & 0xff);
//    if(crc<=9)  snprintf(crc_ch, elCount(crc_ch), "0000%d", crc);
//    else if(crc<=99) snprintf(crc_ch, elCount(crc_ch), "000%d", crc);
//    else if(crc<=999) snprintf(crc_ch, elCount(crc_ch), "00%d", crc);
//    else if(crc<=9999) snprintf(crc_ch, elCount(crc_ch), "0%d", crc);
//    write("aProxiM_F_CRCPROXI Final  %s", crc_ch);   
    
   // write ("CRC Byte value  %d",atol(crc_ch));
    TempCRC  = crc;//atol(crc_ch);
    RemCRC = TempCRC;
    TempCRC = TempCRC / 10000;
    // write ("CRC Byte value  %d",atol(crc_ch));
    crc_array [0] = TempCRC+ 0x30;
    
    TempCRC = RemCRC % 10000;
    RemCRC = TempCRC;
    TempCRC = RemCRC / 1000;
    crc_array [1] = TempCRC+ 0x30;
    
    TempCRC = RemCRC % 1000;
    RemCRC = TempCRC;
    TempCRC = RemCRC / 100;
    crc_array [2] = TempCRC+ 0x30;
    
    TempCRC = RemCRC % 100;
    RemCRC = TempCRC;
    TempCRC = RemCRC / 10;
    
    crc_array [3] = TempCRC+ 0x30;
    TempCRC = RemCRC % 10;
    RemCRC = TempCRC;
    TempCRC = RemCRC ;
    crc_array [4] = TempCRC + 0x30;
    for(k=0;k<5;k++)
    {
      
      write ("CRC Byte value [%d], = 0x%x",k,crc_array[k]);
    }
    
    return (crc);
    
}

/*
word crc16_withstartindex(byte x[], int start_index, int length)
{
  //1021  1 0001 0000 0010 0001
//8408  1000 0100 0000 1000 1
      int i, j;
      word data;
      word crc = 0x0000;
      word crc_poly =0x8408;
      write("%x %x %x %x", x[0], x[1], x[2], x[3]);
      //length=length-start_index-1;
      crc=0;
      if (length == 0)
            return (~crc);



     for(j=start_index;j<length;j++)
      {
        data=0xffff & x[j];
       
            for (i=0 ; i < 8; i++ )
            {
                  if ((crc & 0x0001) ^ (data & 0x0001))
                  {
                        crc = (crc >> 1) ^ crc_poly;
                  }
                       
                  else
                  {
                    crc >>= 1;
                  }
                  data >>= 1;  
            }
      }



//      crc = ~crc;
//      write("1  %X", crc);
//      data = crc;
//      write("2  %X", crc);
//      crc = (crc << 8) | (data >> 8 & 0xff);
      
    write("Final  %X", crc);      
      return (crc);
} 
*/

 
void set_default_proxi_data()
{
  @MEnv_CANnode27_SET_INT_3=1;
  @MEnv_CANnode63_GET_INT_3=1;
  @MEnv_CANnode67_SET_INT_3=1;
  @MEnv_CANnode95_SET_INT_3=1;
  @MEnv_StopAndStart_SET_INT_3=1;
  @MEnv_DriverSide_SET_INT_3=1;
  @MEnv_DgtlTlvFtr_SET_INT_3=0;
  @MEnv_Wheelbase_SET_INT_3=1;
  @MEnv_RearViewCamera_SET_INT_3=1;
  @MEnv_ParkWithStop_SET_INT_3=1;
  @MEnv_StrRtoRackPninTpe_SET_INT_3=0;
  @MEnv_DriveTypeVariant_SET_INT_3=0;
  @MEnv_GearBoxType_SET_INT_3=0;
  @MEnv_PAMTuningSet_SET_INT_3=0;
  @MEnv_SemiAutoParkSys_GET_INT_3=0;
  @MEnv_VehLineConfig_SET=0;
  @MEnv_CountryCode_SET_INT_3=0;
  @MEnv_SRT_SET_INT_3=0;
  @MEnv_PamConfig_SET_INT_3=0;
  @MEnv_ModelYear_SET_INT_3=0;
  @MEnv_HybridType_SET_INT_3=0;
  @MEnv_PullOutCtrlPrst_SET_INT_3=1;
  @MEnv_SurroundViewCam_SET_INT_3=1;
  @MEnv_FrwdFacCamera_SET_INT_3=1;
  @MEnv_AutonomyLevel_SET_INT_3=0;
  @MEnv_FullAutoParkSys_SET_INT_3=1;
  @MEnv_RadioDisplayType_SET_INT_3=1;
  @MEnv_MirrorsType_SET_INT_3=1;
  @MEnv_AuxiliaryTrailCam_SET_INT_3=1;
  @MEnv_TrailReverseGuidPreset_SET=1;
  @MEnv_TrailerSurroundPresence_SET=1;
  @MEnv_TrailerRevSteeringPrest_SET=1;
  @MEnv_TrailerHitchAssistPrest_SET=1;

  
  
}


void SetDefaultProxi()
{
  word TempParameterVal = 0;

  
TempParameterVal = writeproxi[28] & 0x08;
TempParameterVal = (TempParameterVal >> 3) & 0x01;
@MEnv_CANnode27_SET_INT_3 = TempParameterVal;
	  

TempParameterVal = writeproxi[32] & 0x80;
TempParameterVal = (TempParameterVal >> 7) & 0x01;
@MEnv_CANnode63_SET_INT_3 = TempParameterVal;


TempParameterVal = writeproxi[33] & 0x08;
TempParameterVal = (TempParameterVal >> 3) & 0x01;
@MEnv_CANnode67_SET_INT_3 = TempParameterVal;

TempParameterVal = writeproxi[36] & 0x80;
TempParameterVal = (TempParameterVal >> 7) & 0x01;
@MEnv_CANnode95_SET_INT_3= TempParameterVal;

TempParameterVal = writeproxi[57] & 0x01;
TempParameterVal = (TempParameterVal) & 0x01;
@MEnv_StopAndStart_SET_INT_3  = TempParameterVal;

TempParameterVal = writeproxi[57] & 0x08;
TempParameterVal = (TempParameterVal>>3) & 0x01;
@MEnv_DriverSide_SET_INT_3 = TempParameterVal;
  
TempParameterVal = writeproxi[63] & 0xFF;
TempParameterVal = TempParameterVal<<8;
TempParameterVal = (TempParameterVal & 0xFF00) | (writeproxi[64] & 0x00FF);
@MEnv_TyreSize_SET_INT_3 = TempParameterVal;

TempParameterVal = writeproxi[68] & 0x20;
TempParameterVal = (TempParameterVal>>3) & 0x01;
@MEnv_DgtlTlvFtr_SET_INT_3 = TempParameterVal;

TempParameterVal = writeproxi[70] & 0xF0;
TempParameterVal = (TempParameterVal>>4) & 0x0F;
@MEnv_Wheelbase_SET_INT_3 = TempParameterVal;

TempParameterVal = writeproxi[85] & 0x01;
TempParameterVal = (TempParameterVal>>0) & 0x01;
@MEnv_RearViewCamera_SET_INT_3 = TempParameterVal;

TempParameterVal = writeproxi[85] & 0x40;
TempParameterVal = (TempParameterVal>>6) & 0x01;
@MEnv_ParkWithStop_SET_INT_3 = TempParameterVal;

TempParameterVal = writeproxi[87] & 0x03;
TempParameterVal = (TempParameterVal>>0) & 0x01;
@MEnv_StrRtoRackPninTpe_SET_INT_3 = TempParameterVal;

TempParameterVal = writeproxi[90] & 0x10;
TempParameterVal = (TempParameterVal>>5) & 0x01;
@MEnv_DriveTypeVariant_SET_INT_3 = TempParameterVal;

TempParameterVal = writeproxi[100] & 0x07;
TempParameterVal = (TempParameterVal) & 0x07;
@MEnv_GearBoxType_SET_INT_3 = TempParameterVal;

TempParameterVal = writeproxi[103] & 0x07;
TempParameterVal = (TempParameterVal) & 0x01;
@MEnv_PAMTuningSet_SET_INT_3 = TempParameterVal;

TempParameterVal = writeproxi[103] & 0x08;
TempParameterVal = (TempParameterVal>>3) & 0x01;
@MEnv_SemiAutoParkSys_SET_INT_3 = TempParameterVal;

TempParameterVal = writeproxi[104] & 0xFF;
//TempParameterVal = (TempParameterVal) & 0x0F;
@MEnv_VehLineConfig_SET = TempParameterVal;

TempParameterVal = writeproxi[106] & 0xFF;
//TempParameterVal = (TempParameterVal) & 0x0F;
@MEnv_CountryCode_SET_INT_3 = TempParameterVal;

TempParameterVal = writeproxi[110] & 0x80;
TempParameterVal = (TempParameterVal>>7) & 0x07;
@MEnv_SRT_SET_INT_3 = TempParameterVal;


TempParameterVal = writeproxi[117] & 0x30;
TempParameterVal = (TempParameterVal>>4) & 0x07;
@MEnv_PamConfig_SET_INT_3= TempParameterVal;

TempParameterVal = writeproxi[124] & 0xFF;
//TempParameterVal = (TempParameterVal) & 0x01;
@MEnv_ModelYear_SET_INT_3 = TempParameterVal;

TempParameterVal = writeproxi[140] & 0x0F;
TempParameterVal = (TempParameterVal) & 0x0F;
@MEnv_HybridType_SET_INT_3 = TempParameterVal;

TempParameterVal = writeproxi[149] & 0x20;
TempParameterVal = (TempParameterVal>>5) & 0x07;
@MEnv_PullOutCtrlPrst_SET_INT_3 = TempParameterVal;

TempParameterVal = writeproxi[176] & 0x01;
TempParameterVal = (TempParameterVal) & 0x01;
@MEnv_SurroundViewCam_SET_INT_3 = TempParameterVal;

TempParameterVal = writeproxi[176] & 0x02;
TempParameterVal = (TempParameterVal>>1) & 0x01;
@MEnv_FrwdFacCamera_SET_INT_3 = TempParameterVal;
//write ("MEnv_Forward_facing_camera_SET_INT_1 = %d", TempParameterVal);
  
TempParameterVal = writeproxi[176] & 0x1C;
TempParameterVal = (TempParameterVal>>2) & 0x07;
@MEnv_AutonomyLevel_SET_INT_3 = TempParameterVal;

TempParameterVal = writeproxi[176] & 0x20;
TempParameterVal = (TempParameterVal>>5) & 0x01;
@MEnv_FullAutoParkSys_SET_INT_3 = TempParameterVal;

 // write ("MEnv_Forward_facing_camera_SET_INT_1 = %d", TempParameterVal);
  
  
TempParameterVal = writeproxi[184] & 0x0F;
TempParameterVal = (TempParameterVal) & 0x0F;
@MEnv_RadioDisplayType_SET_INT_3 = TempParameterVal;

TempParameterVal = writeproxi[202] & 0x18;
TempParameterVal = (TempParameterVal>>3) & 0x07;
@MEnv_MirrorsType_SET_INT_3 = TempParameterVal;

TempParameterVal = writeproxi[210] & 0x04;
TempParameterVal = (TempParameterVal>>2) & 0x01;
@MEnv_AuxiliaryTrailCam_SET_INT_3 = TempParameterVal;

TempParameterVal = writeproxi[210] & 0x08;
TempParameterVal = (TempParameterVal>>3) & 0x01;
@MEnv_TrailReverseGuidPreset_SET = TempParameterVal;

TempParameterVal = writeproxi[210] & 0x40;
TempParameterVal = (TempParameterVal>>6) & 0x01;
@MEnv_TrailerSurroundPresence_SET = TempParameterVal;

TempParameterVal = writeproxi[210] & 0x80;
TempParameterVal = (TempParameterVal>>7) & 0x01;
@MEnv_TrailerRevSteeringPrest_SET = TempParameterVal;

TempParameterVal = writeproxi[212] & 0x02;
TempParameterVal = (TempParameterVal>>1) & 0x01;
@MEnv_TrailerHitchAssistPrest_SET = TempParameterVal;
}














