/*@!Encoding:1252*/
includes
{
  // Import required CAPL include files
  //--- begin generated part --- Block start #Hdr_Includes#; do not delete this line and do not add application code in this code block!
  /* #ChannelStart# |CAN2| #BusStart# |FDCAN14| */
  /* #ChannelEnd# |CAN2| #BusEnd# |FDCAN14| */
  //--- end generated part --- Block end #Hdr_Includes#; do not delete this line! Add application code below this line.
  //--- begin generated part --- Block start #Body_Includes#; do not delete this line and do not add application code in this code block!
  /* #ChannelStart# |CAN2| #BusStart# |FDCAN14| */
  #include "..\CAPL\Vector-IL-KL30-Helper_CAN2.cin"
  #include "Cin_Files\CRC_CVADAS.cin"
  #include "..\CAPL\Vector-NM-Panel-Helper_CAN2.cin"
  #include "..\CAPL\Vector-NM-ASR-Helper_CAN2.cin"
  /* #ChannelEnd# |CAN2| #BusEnd# |FDCAN14| */
  //--- end generated part --- Block end #Body_Includes#; do not delete this line! Add application code below this line.
}

variables
{
  // Define global variables for this CAPL file

  /*--- #GenHeader Begin# --- begin generated comment ---
  | Generated on Friday, January 12, 2024, 14:48:24
  | By ModelGenerator for Vector 1.5.4.10, ModelGeneratorVectorDLL 1.5.4.41
  | Package Vector 4.0.21
  | Target Bus: FDCAN14; Channel: CAN2; DB Cluster: PDT24_FDCAN14;
  | From Database: PDT24_FDCAN14.dbc
  | CANoe Version 15.4.35.0
    --- #GenHeader End  # --- end generated comment --- */

  char gECU[256] = "BSM";
  //--- begin generated part --- Block start #Hdr_GlobalVariables#; do not delete this line and do not add application code in this code block!
  /* #ChannelStart# |CAN2| #BusStart# |FDCAN14| */
  /* #ChannelEnd# |CAN2| #BusEnd# |FDCAN14| */
  //--- end generated part --- Block end #Hdr_GlobalVariables#; do not delete this line! Add application code below this line.
  //--- begin generated part --- Block start #Body_GlobalVariables#; do not delete this line and do not add application code in this code block!
  /* #ChannelStart# |CAN2| #BusStart# |FDCAN14| */
  char gCAN2BusName[256] = "FDCAN14";
  int gCAN2Channel = 2; //// The channel the bus is attached to

  long gCAN2DisturbanceMode;
  long gCAN2DisturbanceCount;
  long gCAN2DisturbanceValue;
  long gCAN2DisturbanceContinueMode;
  double gCAN2DisturbancePeriod;
  /* #ChannelEnd# |CAN2| #BusEnd# |FDCAN14| */
  //--- end generated part --- Block end #Body_GlobalVariables#; do not delete this line! Add application code below this line.
}

on preStart
{
  // Initialize CAPL includes and node's modules/DLLs
  //--- begin generated part --- Block start #Hdr_OnInit#; do not delete this line and do not add application code in this code block!
  /* #ChannelStart# |CAN2| #BusStart# |FDCAN14| */
  /* #ChannelEnd# |CAN2| #BusEnd# |FDCAN14| */
  //--- end generated part --- Block end #Hdr_OnInit#; do not delete this line! Add application code below this line.
  //--- begin generated part --- Block start #Body_OnInit#; do not delete this line and do not add application code in this code block!
  /* #ChannelStart# |CAN2| #BusStart# |FDCAN14| */
  ILCAN2_OnInit();
  NMCAN2_OnInit();
  /* #ChannelEnd# |CAN2| #BusEnd# |FDCAN14| */
  //--- end generated part --- Block end #Body_OnInit#; do not delete this line! Add application code below this line.
}

on start
{
  // Start CAPL includes and node's modules/DLLs
  //--- begin generated part --- Block start #Hdr_OnStart#; do not delete this line and do not add application code in this code block!
  /* #ChannelStart# |CAN2| #BusStart# |FDCAN14| */
  /* #ChannelEnd# |CAN2| #BusEnd# |FDCAN14| */
  //--- end generated part --- Block end #Hdr_OnStart#; do not delete this line! Add application code below this line.
  //--- begin generated part --- Block start #Body_OnStart#; do not delete this line and do not add application code in this code block!
  /* #ChannelStart# |CAN2| #BusStart# |FDCAN14| */
  ILCAN2_OnStart();
  NMCAN2_OnStart();
  /* #ChannelEnd# |CAN2| #BusEnd# |FDCAN14| */
  //--- end generated part --- Block end #Body_OnStart#; do not delete this line! Add application code below this line.
}

on preStop
{
  // Prepare stopping
  //--- begin generated part --- Block start #Hdr_OnStopping#; do not delete this line and do not add application code in this code block!
  /* #ChannelStart# |CAN2| #BusStart# |FDCAN14| */
  /* #ChannelEnd# |CAN2| #BusEnd# |FDCAN14| */
  //--- end generated part --- Block end #Hdr_OnStopping#; do not delete this line! Add application code below this line.
  //--- begin generated part --- Block start #Body_OnStopping#; do not delete this line and do not add application code in this code block!
  /* #ChannelStart# |CAN2| #BusStart# |FDCAN14| */
  /* #ChannelEnd# |CAN2| #BusEnd# |FDCAN14| */
  //--- end generated part --- Block end #Body_OnStopping#; do not delete this line! Add application code below this line.
}

on stopMeasurement
{
  // Stop actions
  //--- begin generated part --- Block start #Hdr_OnStop#; do not delete this line and do not add application code in this code block!
  /* #ChannelStart# |CAN2| #BusStart# |FDCAN14| */
  /* #ChannelEnd# |CAN2| #BusEnd# |FDCAN14| */
  //--- end generated part --- Block end #Hdr_OnStop#; do not delete this line! Add application code below this line.
  //--- begin generated part --- Block start #Body_OnStop#; do not delete this line and do not add application code in this code block!
  /* #ChannelStart# |CAN2| #BusStart# |FDCAN14| */
  /* #ChannelEnd# |CAN2| #BusEnd# |FDCAN14| */
  //--- end generated part --- Block end #Body_OnStop#; do not delete this line! Add application code below this line.
}

void StartSim(dword busContext, int busActive, int mode)
{
  // Called when ... due to ...
  //   mode == 1: ILControlResume
  //   mode == 2: ILControlStart
  //   mode == 3: ILControlSimulationOn
  //--- begin generated part --- Block start #Hdr_StartSim#; do not delete this line and do not add application code in this code block!
  /* #ChannelStart# |CAN2| #BusStart# |FDCAN14| */
  /* #ChannelEnd# |CAN2| #BusEnd# |FDCAN14| */
  //--- end generated part --- Block end #Hdr_StartSim#; do not delete this line! Add application code below this line.
  //write("[%.6f %NODE_NAME%] StartSim(0x%X, %d, %d)", TimeNowNS()/1e9, busContext, busActive, mode);
  //--- begin generated part --- Block start #Body_StartSim#; do not delete this line and do not add application code in this code block!
  /* #ChannelStart# |CAN2| #BusStart# |FDCAN14| */
  /* #ChannelEnd# |CAN2| #BusEnd# |FDCAN14| */
  //--- end generated part --- Block end #Body_StartSim#; do not delete this line! Add application code below this line.
}

void StopSim(dword busContext, int busActive, int mode)
{
  // Called when ... due to ...
  //   mode == 1: ILControlWait
  //   mode == 2: ILControlStop
  //   mode == 3: ILControlSimulationOff
  //--- begin generated part --- Block start #Hdr_StopSim#; do not delete this line and do not add application code in this code block!
  /* #ChannelStart# |CAN2| #BusStart# |FDCAN14| */
  /* #ChannelEnd# |CAN2| #BusEnd# |FDCAN14| */
  //--- end generated part --- Block end #Hdr_StopSim#; do not delete this line! Add application code below this line.
  //write("[%.6f %NODE_NAME%] StopSim(0x%X, %d, %d)", TimeNowNS()/1e9, busContext, busActive, mode);
  //--- begin generated part --- Block start #Body_StopSim#; do not delete this line and do not add application code in this code block!
  /* #ChannelStart# |CAN2| #BusStart# |FDCAN14| */
  /* #ChannelEnd# |CAN2| #BusEnd# |FDCAN14| */
  //--- end generated part --- Block end #Body_StopSim#; do not delete this line! Add application code below this line.
}

on sysvar_update sysvar::IL::Klemme15
{
  // Handle system state variable
  //--- begin generated part --- Block start #Hdr_KL15_Klemme15#; do not delete this line and do not add application code in this code block!
  /* #ChannelStart# |CAN2| #BusStart# |FDCAN14| */
  /* #ChannelEnd# |CAN2| #BusEnd# |FDCAN14| */
  //--- end generated part --- Block end #Hdr_KL15_Klemme15#; do not delete this line! Add application code below this line.
  //--- begin generated part --- Block start #Body_KL15_Klemme15#; do not delete this line and do not add application code in this code block!
  /* #ChannelStart# |CAN2| #BusStart# |FDCAN14| */
  ILCAN2_OnEnvKlemme15(@this);
  /* #ChannelEnd# |CAN2| #BusEnd# |FDCAN14| */
  //--- end generated part --- Block end #Body_KL15_Klemme15#; do not delete this line! Add application code below this line.
}

on sysvar_update sysvar::IL::Klemme30
{
  // Handle system state variable
  //--- begin generated part --- Block start #Hdr_KL30_Klemme30#; do not delete this line and do not add application code in this code block!
  /* #ChannelStart# |CAN2| #BusStart# |FDCAN14| */
  /* #ChannelEnd# |CAN2| #BusEnd# |FDCAN14| */
  //--- end generated part --- Block end #Hdr_KL30_Klemme30#; do not delete this line! Add application code below this line.
  //--- begin generated part --- Block start #Body_KL30_Klemme30#; do not delete this line and do not add application code in this code block!
  /* #ChannelStart# |CAN2| #BusStart# |FDCAN14| */
  ILCAN2_OnEnvKlemme30(@this);
  /* #ChannelEnd# |CAN2| #BusEnd# |FDCAN14| */
  //--- end generated part --- Block end #Body_KL30_Klemme30#; do not delete this line! Add application code below this line.
}

//dword applILTxPending(long aId, dword aDlc, byte data[])
//{
 // dword ret = 1;
 // //--- begin generated part --- Block start #Hdr_applILTxPending#; do not delete this line and do not add application code in this code block!
  /* #ChannelStart# |CAN2| #BusStart# |FDCAN14| */
  /* #ChannelEnd# |CAN2| #BusEnd# |FDCAN14| */
  //--- end generated part --- Block end #Hdr_applILTxPending#; do not delete this line! Add application code below this line.
 // //--- begin generated part --- Block start #Body_applILTxPending#; do not delete this line and do not add application code in this code block!
  /* #ChannelStart# |CAN2| #BusStart# |FDCAN14| */
  /* #ChannelEnd# |CAN2| #BusEnd# |FDCAN14| */
  //--- end generated part --- Block end #Body_applILTxPending#; do not delete this line! Add application code below this line.
  //return ret;
//}

void Nm_NetworkStartInd()
{
  // Callback of CAN AUTOSAR NM DLL
  dword lBusContext;
  //--- begin generated part --- Block start #Hdr_Nm_NetworkStartInd#; do not delete this line and do not add application code in this code block!
  /* #ChannelStart# |CAN2| #BusStart# |FDCAN14| */
  /* #ChannelEnd# |CAN2| #BusEnd# |FDCAN14| */
  //--- end generated part --- Block end #Hdr_Nm_NetworkStartInd#; do not delete this line! Add application code below this line.
  lBusContext = GetBusContext();
  //--- begin generated part --- Block start #Body_Nm_NetworkStartInd#; do not delete this line and do not add application code in this code block!
  /* #ChannelStart# |CAN2| #BusStart# |FDCAN14| */
  if (lBusContext == gNMCAN2_BusContext) NMCAN2_IndNetworkStart();
  /* #ChannelEnd# |CAN2| #BusEnd# |FDCAN14| */
  //--- end generated part --- Block end #Body_Nm_NetworkStartInd#; do not delete this line! Add application code below this line.
  SetBusContext(lBusContext);
}

void Nm_NetworkModeInd()
{
  // Callback of CAN AUTOSAR NM DLL
  dword lBusContext;
  //--- begin generated part --- Block start #Hdr_Nm_NetworkModeInd#; do not delete this line and do not add application code in this code block!
  /* #ChannelStart# |CAN2| #BusStart# |FDCAN14| */
  /* #ChannelEnd# |CAN2| #BusEnd# |FDCAN14| */
  //--- end generated part --- Block end #Hdr_Nm_NetworkModeInd#; do not delete this line! Add application code below this line.
  lBusContext = GetBusContext();
  //--- begin generated part --- Block start #Body_Nm_NetworkModeInd#; do not delete this line and do not add application code in this code block!
  /* #ChannelStart# |CAN2| #BusStart# |FDCAN14| */
  if (lBusContext == gNMCAN2_BusContext) NMCAN2_IndNetworkMode();
  /* #ChannelEnd# |CAN2| #BusEnd# |FDCAN14| */
  //--- end generated part --- Block end #Body_Nm_NetworkModeInd#; do not delete this line! Add application code below this line.
  SetBusContext(lBusContext);
}

void Nm_NetworkTimeoutInd()
{
  // Callback of CAN AUTOSAR NM DLL
  dword lBusContext;
  //--- begin generated part --- Block start #Hdr_Nm_NetworkTimeoutInd#; do not delete this line and do not add application code in this code block!
  /* #ChannelStart# |CAN2| #BusStart# |FDCAN14| */
  /* #ChannelEnd# |CAN2| #BusEnd# |FDCAN14| */
  //--- end generated part --- Block end #Hdr_Nm_NetworkTimeoutInd#; do not delete this line! Add application code below this line.
  lBusContext = GetBusContext();
  //--- begin generated part --- Block start #Body_Nm_NetworkTimeoutInd#; do not delete this line and do not add application code in this code block!
  /* #ChannelStart# |CAN2| #BusStart# |FDCAN14| */
  if (lBusContext == gNMCAN2_BusContext) NMCAN2_IndNetworkTimeout();
  /* #ChannelEnd# |CAN2| #BusEnd# |FDCAN14| */
  //--- end generated part --- Block end #Body_Nm_NetworkTimeoutInd#; do not delete this line! Add application code below this line.
  SetBusContext(lBusContext);
}

void Nm_PrepareBusSleepModeInd()
{
  // Callback of CAN AUTOSAR NM DLL
  dword lBusContext;
  //--- begin generated part --- Block start #Hdr_Nm_PrepareBusSleepModeInd#; do not delete this line and do not add application code in this code block!
  /* #ChannelStart# |CAN2| #BusStart# |FDCAN14| */
  /* #ChannelEnd# |CAN2| #BusEnd# |FDCAN14| */
  //--- end generated part --- Block end #Hdr_Nm_PrepareBusSleepModeInd#; do not delete this line! Add application code below this line.
  lBusContext = GetBusContext();
  //--- begin generated part --- Block start #Body_Nm_PrepareBusSleepModeInd#; do not delete this line and do not add application code in this code block!
  /* #ChannelStart# |CAN2| #BusStart# |FDCAN14| */
  if (lBusContext == gNMCAN2_BusContext) NMCAN2_IndPrepareBusSleepMode();
  /* #ChannelEnd# |CAN2| #BusEnd# |FDCAN14| */
  //--- end generated part --- Block end #Body_Nm_PrepareBusSleepModeInd#; do not delete this line! Add application code below this line.
  SetBusContext(lBusContext);
}

void Nm_BusSleepModeInd()
{
  // Callback of CAN AUTOSAR NM DLL
  dword lBusContext;
  //--- begin generated part --- Block start #Hdr_Nm_BusSleepModeInd#; do not delete this line and do not add application code in this code block!
  /* #ChannelStart# |CAN2| #BusStart# |FDCAN14| */
  /* #ChannelEnd# |CAN2| #BusEnd# |FDCAN14| */
  //--- end generated part --- Block end #Hdr_Nm_BusSleepModeInd#; do not delete this line! Add application code below this line.
  lBusContext = GetBusContext();
  //--- begin generated part --- Block start #Body_Nm_BusSleepModeInd#; do not delete this line and do not add application code in this code block!
  /* #ChannelStart# |CAN2| #BusStart# |FDCAN14| */
  if (lBusContext == gNMCAN2_BusContext) NMCAN2_IndBusSleepMode();
  /* #ChannelEnd# |CAN2| #BusEnd# |FDCAN14| */
  //--- end generated part --- Block end #Body_Nm_BusSleepModeInd#; do not delete this line! Add application code below this line.
  SetBusContext(lBusContext);
}

void Nm_StateChangeNotification(long previousState, long currentState)
{
  // Callback of CAN AUTOSAR NM DLL
  dword lBusContext;
  //--- begin generated part --- Block start #Hdr_Nm_StateChangeNotification#; do not delete this line and do not add application code in this code block!
  /* #ChannelStart# |CAN2| #BusStart# |FDCAN14| */
  /* #ChannelEnd# |CAN2| #BusEnd# |FDCAN14| */
  //--- end generated part --- Block end #Hdr_Nm_StateChangeNotification#; do not delete this line! Add application code below this line.
  lBusContext = GetBusContext();
  //--- begin generated part --- Block start #Body_Nm_StateChangeNotification#; do not delete this line and do not add application code in this code block!
  /* #ChannelStart# |CAN2| #BusStart# |FDCAN14| */
  if (lBusContext == gNMCAN2_BusContext) NMCAN2_IndStateChangeNotification(previousState, currentState);
  /* #ChannelEnd# |CAN2| #BusEnd# |FDCAN14| */
  //--- end generated part --- Block end #Body_Nm_StateChangeNotification#; do not delete this line! Add application code below this line.
  SetBusContext(lBusContext);
}

/**************************** DLC Fault Injection ****************************/

on sysvar_update DLC_FAULT_INJECTION::SVar_BRAKE_FD_1_DLCFault_Value_14_SET
{
  if (@this >= 10)
  {
    if (@DLC_FAULT_INJECTION::SVar_BRAKE_FD_1_14_DLCFlt_Injctn_SET == 1)
    {
      ILFaultInjectionSetMsgDlc(BRAKE_FD_1, @DLC_FAULT_INJECTION::SVar_BRAKE_FD_1_DLCFault_Value_14_SET);
    }
    
    else
    {
      ILFaultInjectionResetMsgDlc(BRAKE_FD_1);
    }
  }
  
  else
  {
    ILFaultInjectionResetMsgDlc(BRAKE_FD_1);
  }
}

on sysvar_update DLC_FAULT_INJECTION::SVar_BRAKE_FD_2_DLCFault_Value_14_SET
{
  if (@this >= 10)
  {
    if (@DLC_FAULT_INJECTION::SVar_BRAKE_FD_2_14_DLCFlt_Injctn_SET == 1)
    {
      ILFaultInjectionSetMsgDlc(BRAKE_FD_2, @DLC_FAULT_INJECTION::SVar_BRAKE_FD_2_DLCFault_Value_14_SET);
    }
    
    else
    {
      ILFaultInjectionResetMsgDlc(BRAKE_FD_2);
    }
  }
  
  else
  {
    ILFaultInjectionResetMsgDlc(BRAKE_FD_2);
  }
}

on sysvar_update DLC_FAULT_INJECTION::SVar_BRAKE_FD_3_DLCFault_Value_14_SET
{
  if (@this >= 10)
  {
    if (@DLC_FAULT_INJECTION::SVar_BRAKE_FD_3_14_DLCFlt_Injctn_SET== 1)
    {
      ILFaultInjectionSetMsgDlc(BRAKE_FD_3, @DLC_FAULT_INJECTION::SVar_BRAKE_FD_3_DLCFault_Value_14_SET);
    }
    
    else
    {
      ILFaultInjectionResetMsgDlc(BRAKE_FD_3);
    }
  }
  
  else
  {
    ILFaultInjectionResetMsgDlc(BRAKE_FD_3);
  }
}

on sysvar_update DLC_FAULT_INJECTION::SVar_BRAKE_FD_4_DLCFault_Value_14_SET
{
  if (@this >= 10 )
  {
    if (@DLC_FAULT_INJECTION::SVar_BRAKE_FD_4_14_DLCFlt_Injctn_SET== 1)
    {
      ILFaultInjectionSetMsgDlc(BRAKE_FD_4, @DLC_FAULT_INJECTION::SVar_BRAKE_FD_4_DLCFault_Value_14_SET);
    }
    
    else
    {
      ILFaultInjectionResetMsgDlc(BRAKE_FD_4);
    }
  }
  
  else
  {
    ILFaultInjectionResetMsgDlc(BRAKE_FD_4);
  }
}

on sysvar_update DLC_FAULT_INJECTION::SVar_BRAKE_FD_5_DLCFault_Value_14_SET
{
  if (@this >= 10 )
  {
    if (@DLC_FAULT_INJECTION::SVar_BRAKE_FD_5_14_DLCFlt_Injctn_SET == 1)
    {
      ILFaultInjectionSetMsgDlc(BRAKE_FD_5, @DLC_FAULT_INJECTION::SVar_BRAKE_FD_5_DLCFault_Value_14_SET);
    }
    
    else
    {
      ILFaultInjectionResetMsgDlc(BRAKE_FD_5);
    }
  }
  
  else
  {
    ILFaultInjectionResetMsgDlc(BRAKE_FD_5);
  }
}

on sysvar_update DLC_FAULT_INJECTION::SVar_BRAKE_FD_6_DLCFault_Value_14_SET
{
  if (@this >= 10 )
  {
    if (@DLC_FAULT_INJECTION::SVar_BRAKE_FD_6_DLCFlt_Injctn_SET == 1)
    {
      ILFaultInjectionSetMsgDlc(BRAKE_FD_6, @DLC_FAULT_INJECTION::SVar_BRAKE_FD_6_DLCFault_Value_14_SET);
    }
    
    else
    {
      ILFaultInjectionResetMsgDlc(BRAKE_FD_6);
    }
  }
  
  else
  {
    ILFaultInjectionResetMsgDlc(BRAKE_FD_6);
  }
}

on sysvar_update DLC_FAULT_INJECTION::SVar_BRAKE_FD_7_DLCFault_Value_14_SET
{
  if (@this >= 10 )
  {
    if (@DLC_FAULT_INJECTION::SVar_BRAKE_FD_7_DLCFlt_Injctn_SET == 1)
    {
      ILFaultInjectionSetMsgDlc(BRAKE_FD_7, @DLC_FAULT_INJECTION::SVar_BRAKE_FD_7_DLCFault_Value_14_SET);
    }
    
    else
    {
      ILFaultInjectionResetMsgDlc(BRAKE_FD_7);
    }
  }
  
  else
  {
    ILFaultInjectionResetMsgDlc(BRAKE_FD_7);
  }
}

on sysvar_update DLC_FAULT_INJECTION::SVar_NM_BSM_DLCFault_Value_14_SET
{
  if (@this >= 10 )
  {
    if (@DLC_FAULT_INJECTION::SVar_NM_BSM_DLCFlt_Injctn_SET == 1)
    {
      ILFaultInjectionSetMsgDlc(NM_BSM, @DLC_FAULT_INJECTION::SVar_NM_BSM_DLCFault_Value_14_SET);
    }
    
    else
    {
      ILFaultInjectionResetMsgDlc(NM_BSM);
    }
  }
  
  else
  {
    ILFaultInjectionResetMsgDlc(NM_BSM);
  }
}

//--- begin generated part --- Block start <#Helper_Functions#> do not delete this line and do not add application code in this code block!
/* #ChannelStart# |CAN2| #BusStart# |FDCAN14| */
/* #ChannelEnd# |CAN2| #BusEnd# |FDCAN14| */
//--- end generated part --- Block end <#Helper_Functions#> do not delete this line! Add application code below this line.

//--- begin generated part --- Block start <#SysVar_Handler#> do not delete this line and do not add application code in this code block!
/* #ChannelStart# |CAN2| #BusStart# |FDCAN14| */
on sysvar_update sysvar::IL_CAN2::NODES::N_BSM::EnableNode
{
  ILCAN2_Enable(@this && @sysvar::IL_CAN2::enable_AllNodes);
}

on sysvar_update sysvar::IL_CAN2::enable_AllNodes
{
  ILCAN2_Enable(@this && @sysvar::IL_CAN2::NODES::N_BSM::EnableNode);
}

on sysvar_update sysvar::NM_CAN2::NODES::N_BSM::DeactivateNM
{
  if( @this == 1 || @sysvar::NM_CAN2::StateControl::DeactivateNM == 1)
  {
    NMCAN2_Enable(0);
  }
  else
  {
    NMCAN2_Enable(1);
  }
}

on sysvar_update sysvar::NM_CAN2::StateControl::DeactivateNM
{
  if( @this == 1 || @sysvar::NM_CAN2::NODES::N_BSM::DeactivateNM == 1)
  {
    NMCAN2_Enable(0);
  }
  else
  {
    NMCAN2_Enable(1);
  }
}

on sysvar_update sysvar::IL_CAN2::NODES::N_BSM::MESSAGES::BRAKE_FD_1::TIMINGS::EnableCyclic
{
  if (@this == 1)
  {
    SetBusContext(gILCAN2_BusContext);
    ILFaultInjectionEnableMsg  (FDCAN14::BSM::BRAKE_FD_1);
  }
  else
  {
    SetBusContext(gILCAN2_BusContext);
    ILFaultInjectionDisableMsg (FDCAN14::BSM::BRAKE_FD_1);
  }
}

on sysvar_update sysvar::IL_CAN2::NODES::N_BSM::MESSAGES::BRAKE_FD_1::TIMINGS::SetNormalCycle
{
  if (@this == 1 && @sysvar::IL_CAN2::NODES::N_BSM::MESSAGES::BRAKE_FD_1::TIMINGS::EnableCyclic)
  {
    @sysvar::IL_CAN2::NODES::N_BSM::MESSAGES::BRAKE_FD_1::TIMINGS::SelectedPeriod = 0;
  }
}

on sysvar_update sysvar::IL_CAN2::NODES::N_BSM::MESSAGES::BRAKE_FD_1::TIMINGS::SetNewCycleContinously
{
  if (@this == 1 && @sysvar::IL_CAN2::NODES::N_BSM::MESSAGES::BRAKE_FD_1::TIMINGS::EnableCyclic)
  {
    @sysvar::IL_CAN2::NODES::N_BSM::MESSAGES::BRAKE_FD_1::TIMINGS::SelectedPeriod = -1;
  }
}

on sysvar_update sysvar::IL_CAN2::NODES::N_BSM::MESSAGES::BRAKE_FD_1::TIMINGS::SelectedPeriod
{
  if (@this == 0 && @sysvar::IL_CAN2::NODES::N_BSM::MESSAGES::BRAKE_FD_1::TIMINGS::EnableCyclic)
  {
    SetBusContext(gILCAN2_BusContext);
    gCAN2DisturbancePeriod = @sysvar::IL_CAN2::NODES::N_BSM::MESSAGES::BRAKE_FD_1::TIMINGS::NormalCyclePeriod;
    ILFaultInjectionResetMsgCycleTime(FDCAN14::BSM::BRAKE_FD_1);
  }
  else if (@this == 1 && @sysvar::IL_CAN2::NODES::N_BSM::MESSAGES::BRAKE_FD_1::TIMINGS::EnableCyclic)
  {
    SetBusContext(gILCAN2_BusContext);
    gCAN2DisturbancePeriod = @sysvar::IL_CAN2::NODES::N_BSM::MESSAGES::BRAKE_FD_1::TIMINGS::ActiveCyclePeriod;
    ILFaultInjectionSetMsgCycleTime(FDCAN14::BSM::BRAKE_FD_1, gCAN2DisturbancePeriod);
  }
  else if (@this == -1 && @sysvar::IL_CAN2::NODES::N_BSM::MESSAGES::BRAKE_FD_1::TIMINGS::EnableCyclic)
  {
    SetBusContext(gILCAN2_BusContext);
    gCAN2DisturbancePeriod = @sysvar::IL_CAN2::NODES::N_BSM::MESSAGES::BRAKE_FD_1::TIMINGS::CyclePeriod;
    ILFaultInjectionSetMsgCycleTime(FDCAN14::BSM::BRAKE_FD_1, gCAN2DisturbancePeriod);
  }
}

on sysvar_update sysvar::IL_CAN2::NODES::N_BSM::MESSAGES::BRAKE_FD_1::TIMINGS::SendOnce
{
  if (@this == 1)
  {
    SetBusContext(gILCAN2_BusContext);
    ILSetMsgEvent(FDCAN14::BSM::BRAKE_FD_1);
  }
}

on sysvar_update sysvar::IL_CAN2::NODES::N_BSM::MESSAGES::BRAKE_FD_2::TIMINGS::EnableCyclic
{
  if (@this == 1)
  {
    SetBusContext(gILCAN2_BusContext);
    ILFaultInjectionEnableMsg  (FDCAN14::BSM::BRAKE_FD_2);
  }
  else
  {
    SetBusContext(gILCAN2_BusContext);
    ILFaultInjectionDisableMsg (FDCAN14::BSM::BRAKE_FD_2);
  }
}

on sysvar_update sysvar::IL_CAN2::NODES::N_BSM::MESSAGES::BRAKE_FD_2::TIMINGS::SetNormalCycle
{
  if (@this == 1 && @sysvar::IL_CAN2::NODES::N_BSM::MESSAGES::BRAKE_FD_2::TIMINGS::EnableCyclic)
  {
    @sysvar::IL_CAN2::NODES::N_BSM::MESSAGES::BRAKE_FD_2::TIMINGS::SelectedPeriod = 0;
  }
}

on sysvar_update sysvar::IL_CAN2::NODES::N_BSM::MESSAGES::BRAKE_FD_2::TIMINGS::SetNewCycleContinously
{
  if (@this == 1 && @sysvar::IL_CAN2::NODES::N_BSM::MESSAGES::BRAKE_FD_2::TIMINGS::EnableCyclic)
  {
    @sysvar::IL_CAN2::NODES::N_BSM::MESSAGES::BRAKE_FD_2::TIMINGS::SelectedPeriod = -1;
  }
}

on sysvar_update sysvar::IL_CAN2::NODES::N_BSM::MESSAGES::BRAKE_FD_2::TIMINGS::SelectedPeriod
{
  if (@this == 0 && @sysvar::IL_CAN2::NODES::N_BSM::MESSAGES::BRAKE_FD_2::TIMINGS::EnableCyclic)
  {
    SetBusContext(gILCAN2_BusContext);
    gCAN2DisturbancePeriod = @sysvar::IL_CAN2::NODES::N_BSM::MESSAGES::BRAKE_FD_2::TIMINGS::NormalCyclePeriod;
    ILFaultInjectionResetMsgCycleTime(FDCAN14::BSM::BRAKE_FD_2);
  }
  else if (@this == 1 && @sysvar::IL_CAN2::NODES::N_BSM::MESSAGES::BRAKE_FD_2::TIMINGS::EnableCyclic)
  {
    SetBusContext(gILCAN2_BusContext);
    gCAN2DisturbancePeriod = @sysvar::IL_CAN2::NODES::N_BSM::MESSAGES::BRAKE_FD_2::TIMINGS::ActiveCyclePeriod;
    ILFaultInjectionSetMsgCycleTime(FDCAN14::BSM::BRAKE_FD_2, gCAN2DisturbancePeriod);
  }
  else if (@this == -1 && @sysvar::IL_CAN2::NODES::N_BSM::MESSAGES::BRAKE_FD_2::TIMINGS::EnableCyclic)
  {
    SetBusContext(gILCAN2_BusContext);
    gCAN2DisturbancePeriod = @sysvar::IL_CAN2::NODES::N_BSM::MESSAGES::BRAKE_FD_2::TIMINGS::CyclePeriod;
    ILFaultInjectionSetMsgCycleTime(FDCAN14::BSM::BRAKE_FD_2, gCAN2DisturbancePeriod);
  }
}

on sysvar_update sysvar::IL_CAN2::NODES::N_BSM::MESSAGES::BRAKE_FD_2::TIMINGS::SendOnce
{
  if (@this == 1)
  {
    SetBusContext(gILCAN2_BusContext);
    ILSetMsgEvent(FDCAN14::BSM::BRAKE_FD_2);
  }
}

on sysvar_update sysvar::IL_CAN2::NODES::N_BSM::MESSAGES::BRAKE_FD_3::TIMINGS::EnableCyclic
{
  if (@this == 1)
  {
    SetBusContext(gILCAN2_BusContext);
    ILFaultInjectionEnableMsg  (FDCAN14::BSM::BRAKE_FD_3);
  }
  else
  {
    SetBusContext(gILCAN2_BusContext);
    ILFaultInjectionDisableMsg (FDCAN14::BSM::BRAKE_FD_3);
  }
}

on sysvar_update sysvar::IL_CAN2::NODES::N_BSM::MESSAGES::BRAKE_FD_3::TIMINGS::SetNormalCycle
{
  if (@this == 1 && @sysvar::IL_CAN2::NODES::N_BSM::MESSAGES::BRAKE_FD_3::TIMINGS::EnableCyclic)
  {
    @sysvar::IL_CAN2::NODES::N_BSM::MESSAGES::BRAKE_FD_3::TIMINGS::SelectedPeriod = 0;
  }
}

on sysvar_update sysvar::IL_CAN2::NODES::N_BSM::MESSAGES::BRAKE_FD_3::TIMINGS::SetNewCycleContinously
{
  if (@this == 1 && @sysvar::IL_CAN2::NODES::N_BSM::MESSAGES::BRAKE_FD_3::TIMINGS::EnableCyclic)
  {
    @sysvar::IL_CAN2::NODES::N_BSM::MESSAGES::BRAKE_FD_3::TIMINGS::SelectedPeriod = -1;
  }
}

on sysvar_update sysvar::IL_CAN2::NODES::N_BSM::MESSAGES::BRAKE_FD_3::TIMINGS::SelectedPeriod
{
  if (@this == 0 && @sysvar::IL_CAN2::NODES::N_BSM::MESSAGES::BRAKE_FD_3::TIMINGS::EnableCyclic)
  {
    SetBusContext(gILCAN2_BusContext);
    gCAN2DisturbancePeriod = @sysvar::IL_CAN2::NODES::N_BSM::MESSAGES::BRAKE_FD_3::TIMINGS::NormalCyclePeriod;
    ILFaultInjectionResetMsgCycleTime(FDCAN14::BSM::BRAKE_FD_3);
  }
  else if (@this == 1 && @sysvar::IL_CAN2::NODES::N_BSM::MESSAGES::BRAKE_FD_3::TIMINGS::EnableCyclic)
  {
    SetBusContext(gILCAN2_BusContext);
    gCAN2DisturbancePeriod = @sysvar::IL_CAN2::NODES::N_BSM::MESSAGES::BRAKE_FD_3::TIMINGS::ActiveCyclePeriod;
    ILFaultInjectionSetMsgCycleTime(FDCAN14::BSM::BRAKE_FD_3, gCAN2DisturbancePeriod);
  }
  else if (@this == -1 && @sysvar::IL_CAN2::NODES::N_BSM::MESSAGES::BRAKE_FD_3::TIMINGS::EnableCyclic)
  {
    SetBusContext(gILCAN2_BusContext);
    gCAN2DisturbancePeriod = @sysvar::IL_CAN2::NODES::N_BSM::MESSAGES::BRAKE_FD_3::TIMINGS::CyclePeriod;
    ILFaultInjectionSetMsgCycleTime(FDCAN14::BSM::BRAKE_FD_3, gCAN2DisturbancePeriod);
  }
}

on sysvar_update sysvar::IL_CAN2::NODES::N_BSM::MESSAGES::BRAKE_FD_3::TIMINGS::SendOnce
{
  if (@this == 1)
  {
    SetBusContext(gILCAN2_BusContext);
    ILSetMsgEvent(FDCAN14::BSM::BRAKE_FD_3);
  }
}

on sysvar_update sysvar::IL_CAN2::NODES::N_BSM::MESSAGES::BRAKE_FD_4::TIMINGS::EnableCyclic
{
  if (@this == 1)
  {
    SetBusContext(gILCAN2_BusContext);
    ILFaultInjectionEnableMsg  (FDCAN14::BSM::BRAKE_FD_4);
  }
  else
  {
    SetBusContext(gILCAN2_BusContext);
    ILFaultInjectionDisableMsg (FDCAN14::BSM::BRAKE_FD_4);
  }
}

on sysvar_update sysvar::IL_CAN2::NODES::N_BSM::MESSAGES::BRAKE_FD_4::TIMINGS::SetNormalCycle
{
  if (@this == 1 && @sysvar::IL_CAN2::NODES::N_BSM::MESSAGES::BRAKE_FD_4::TIMINGS::EnableCyclic)
  {
    @sysvar::IL_CAN2::NODES::N_BSM::MESSAGES::BRAKE_FD_4::TIMINGS::SelectedPeriod = 0;
  }
}

on sysvar_update sysvar::IL_CAN2::NODES::N_BSM::MESSAGES::BRAKE_FD_4::TIMINGS::SetNewCycleContinously
{
  if (@this == 1 && @sysvar::IL_CAN2::NODES::N_BSM::MESSAGES::BRAKE_FD_4::TIMINGS::EnableCyclic)
  {
    @sysvar::IL_CAN2::NODES::N_BSM::MESSAGES::BRAKE_FD_4::TIMINGS::SelectedPeriod = -1;
  }
}

on sysvar_update sysvar::IL_CAN2::NODES::N_BSM::MESSAGES::BRAKE_FD_4::TIMINGS::SelectedPeriod
{
  if (@this == 0 && @sysvar::IL_CAN2::NODES::N_BSM::MESSAGES::BRAKE_FD_4::TIMINGS::EnableCyclic)
  {
    SetBusContext(gILCAN2_BusContext);
    gCAN2DisturbancePeriod = @sysvar::IL_CAN2::NODES::N_BSM::MESSAGES::BRAKE_FD_4::TIMINGS::NormalCyclePeriod;
    ILFaultInjectionResetMsgCycleTime(FDCAN14::BSM::BRAKE_FD_4);
  }
  else if (@this == 1 && @sysvar::IL_CAN2::NODES::N_BSM::MESSAGES::BRAKE_FD_4::TIMINGS::EnableCyclic)
  {
    SetBusContext(gILCAN2_BusContext);
    gCAN2DisturbancePeriod = @sysvar::IL_CAN2::NODES::N_BSM::MESSAGES::BRAKE_FD_4::TIMINGS::ActiveCyclePeriod;
    ILFaultInjectionSetMsgCycleTime(FDCAN14::BSM::BRAKE_FD_4, gCAN2DisturbancePeriod);
  }
  else if (@this == -1 && @sysvar::IL_CAN2::NODES::N_BSM::MESSAGES::BRAKE_FD_4::TIMINGS::EnableCyclic)
  {
    SetBusContext(gILCAN2_BusContext);
    gCAN2DisturbancePeriod = @sysvar::IL_CAN2::NODES::N_BSM::MESSAGES::BRAKE_FD_4::TIMINGS::CyclePeriod;
    ILFaultInjectionSetMsgCycleTime(FDCAN14::BSM::BRAKE_FD_4, gCAN2DisturbancePeriod);
  }
}

on sysvar_update sysvar::IL_CAN2::NODES::N_BSM::MESSAGES::BRAKE_FD_4::TIMINGS::SendOnce
{
  if (@this == 1)
  {
    SetBusContext(gILCAN2_BusContext);
    ILSetMsgEvent(FDCAN14::BSM::BRAKE_FD_4);
  }
}

on sysvar_update sysvar::IL_CAN2::NODES::N_BSM::MESSAGES::BRAKE_FD_5::TIMINGS::EnableCyclic
{
  if (@this == 1)
  {
    SetBusContext(gILCAN2_BusContext);
    ILFaultInjectionEnableMsg  (FDCAN14::BSM::BRAKE_FD_5);
  }
  else
  {
    SetBusContext(gILCAN2_BusContext);
    ILFaultInjectionDisableMsg (FDCAN14::BSM::BRAKE_FD_5);
  }
}

on sysvar_update sysvar::IL_CAN2::NODES::N_BSM::MESSAGES::BRAKE_FD_5::TIMINGS::SetNormalCycle
{
  if (@this == 1 && @sysvar::IL_CAN2::NODES::N_BSM::MESSAGES::BRAKE_FD_5::TIMINGS::EnableCyclic)
  {
    @sysvar::IL_CAN2::NODES::N_BSM::MESSAGES::BRAKE_FD_5::TIMINGS::SelectedPeriod = 0;
  }
}

on sysvar_update sysvar::IL_CAN2::NODES::N_BSM::MESSAGES::BRAKE_FD_5::TIMINGS::SetNewCycleContinously
{
  if (@this == 1 && @sysvar::IL_CAN2::NODES::N_BSM::MESSAGES::BRAKE_FD_5::TIMINGS::EnableCyclic)
  {
    @sysvar::IL_CAN2::NODES::N_BSM::MESSAGES::BRAKE_FD_5::TIMINGS::SelectedPeriod = -1;
  }
}

on sysvar_update sysvar::IL_CAN2::NODES::N_BSM::MESSAGES::BRAKE_FD_5::TIMINGS::SelectedPeriod
{
  if (@this == 0 && @sysvar::IL_CAN2::NODES::N_BSM::MESSAGES::BRAKE_FD_5::TIMINGS::EnableCyclic)
  {
    SetBusContext(gILCAN2_BusContext);
    gCAN2DisturbancePeriod = @sysvar::IL_CAN2::NODES::N_BSM::MESSAGES::BRAKE_FD_5::TIMINGS::NormalCyclePeriod;
    ILFaultInjectionResetMsgCycleTime(FDCAN14::BSM::BRAKE_FD_5);
  }
  else if (@this == 1 && @sysvar::IL_CAN2::NODES::N_BSM::MESSAGES::BRAKE_FD_5::TIMINGS::EnableCyclic)
  {
    SetBusContext(gILCAN2_BusContext);
    gCAN2DisturbancePeriod = @sysvar::IL_CAN2::NODES::N_BSM::MESSAGES::BRAKE_FD_5::TIMINGS::ActiveCyclePeriod;
    ILFaultInjectionSetMsgCycleTime(FDCAN14::BSM::BRAKE_FD_5, gCAN2DisturbancePeriod);
  }
  else if (@this == -1 && @sysvar::IL_CAN2::NODES::N_BSM::MESSAGES::BRAKE_FD_5::TIMINGS::EnableCyclic)
  {
    SetBusContext(gILCAN2_BusContext);
    gCAN2DisturbancePeriod = @sysvar::IL_CAN2::NODES::N_BSM::MESSAGES::BRAKE_FD_5::TIMINGS::CyclePeriod;
    ILFaultInjectionSetMsgCycleTime(FDCAN14::BSM::BRAKE_FD_5, gCAN2DisturbancePeriod);
  }
}

on sysvar_update sysvar::IL_CAN2::NODES::N_BSM::MESSAGES::BRAKE_FD_5::TIMINGS::SendOnce
{
  if (@this == 1)
  {
    SetBusContext(gILCAN2_BusContext);
    ILSetMsgEvent(FDCAN14::BSM::BRAKE_FD_5);
  }
}

on sysvar_update sysvar::IL_CAN2::NODES::N_BSM::MESSAGES::BRAKE_FD_6::TIMINGS::EnableCyclic
{
  if (@this == 1)
  {
    SetBusContext(gILCAN2_BusContext);
    ILFaultInjectionEnableMsg  (FDCAN14::BSM::BRAKE_FD_6);
  }
  else
  {
    SetBusContext(gILCAN2_BusContext);
    ILFaultInjectionDisableMsg (FDCAN14::BSM::BRAKE_FD_6);
  }
}

on sysvar_update sysvar::IL_CAN2::NODES::N_BSM::MESSAGES::BRAKE_FD_6::TIMINGS::SetNormalCycle
{
  if (@this == 1 && @sysvar::IL_CAN2::NODES::N_BSM::MESSAGES::BRAKE_FD_6::TIMINGS::EnableCyclic)
  {
    @sysvar::IL_CAN2::NODES::N_BSM::MESSAGES::BRAKE_FD_6::TIMINGS::SelectedPeriod = 0;
  }
}

on sysvar_update sysvar::IL_CAN2::NODES::N_BSM::MESSAGES::BRAKE_FD_6::TIMINGS::SetNewCycleContinously
{
  if (@this == 1 && @sysvar::IL_CAN2::NODES::N_BSM::MESSAGES::BRAKE_FD_6::TIMINGS::EnableCyclic)
  {
    @sysvar::IL_CAN2::NODES::N_BSM::MESSAGES::BRAKE_FD_6::TIMINGS::SelectedPeriod = -1;
  }
}

on sysvar_update sysvar::IL_CAN2::NODES::N_BSM::MESSAGES::BRAKE_FD_6::TIMINGS::SelectedPeriod
{
  if (@this == 0 && @sysvar::IL_CAN2::NODES::N_BSM::MESSAGES::BRAKE_FD_6::TIMINGS::EnableCyclic)
  {
    SetBusContext(gILCAN2_BusContext);
    gCAN2DisturbancePeriod = @sysvar::IL_CAN2::NODES::N_BSM::MESSAGES::BRAKE_FD_6::TIMINGS::NormalCyclePeriod;
    ILFaultInjectionResetMsgCycleTime(FDCAN14::BSM::BRAKE_FD_6);
  }
  else if (@this == 1 && @sysvar::IL_CAN2::NODES::N_BSM::MESSAGES::BRAKE_FD_6::TIMINGS::EnableCyclic)
  {
    SetBusContext(gILCAN2_BusContext);
    gCAN2DisturbancePeriod = @sysvar::IL_CAN2::NODES::N_BSM::MESSAGES::BRAKE_FD_6::TIMINGS::ActiveCyclePeriod;
    ILFaultInjectionSetMsgCycleTime(FDCAN14::BSM::BRAKE_FD_6, gCAN2DisturbancePeriod);
  }
  else if (@this == -1 && @sysvar::IL_CAN2::NODES::N_BSM::MESSAGES::BRAKE_FD_6::TIMINGS::EnableCyclic)
  {
    SetBusContext(gILCAN2_BusContext);
    gCAN2DisturbancePeriod = @sysvar::IL_CAN2::NODES::N_BSM::MESSAGES::BRAKE_FD_6::TIMINGS::CyclePeriod;
    ILFaultInjectionSetMsgCycleTime(FDCAN14::BSM::BRAKE_FD_6, gCAN2DisturbancePeriod);
  }
}

on sysvar_update sysvar::IL_CAN2::NODES::N_BSM::MESSAGES::BRAKE_FD_6::TIMINGS::SendOnce
{
  if (@this == 1)
  {
    SetBusContext(gILCAN2_BusContext);
    ILSetMsgEvent(FDCAN14::BSM::BRAKE_FD_6);
  }
}

on sysvar_update sysvar::IL_CAN2::NODES::N_BSM::MESSAGES::BRAKE_FD_7::TIMINGS::EnableCyclic
{
  if (@this == 1)
  {
    SetBusContext(gILCAN2_BusContext);
    ILFaultInjectionEnableMsg  (FDCAN14::BSM::BRAKE_FD_7);
  }
  else
  {
    SetBusContext(gILCAN2_BusContext);
    ILFaultInjectionDisableMsg (FDCAN14::BSM::BRAKE_FD_7);
  }
}

on sysvar_update sysvar::IL_CAN2::NODES::N_BSM::MESSAGES::BRAKE_FD_7::TIMINGS::SetNormalCycle
{
  if (@this == 1 && @sysvar::IL_CAN2::NODES::N_BSM::MESSAGES::BRAKE_FD_7::TIMINGS::EnableCyclic)
  {
    @sysvar::IL_CAN2::NODES::N_BSM::MESSAGES::BRAKE_FD_7::TIMINGS::SelectedPeriod = 0;
  }
}

on sysvar_update sysvar::IL_CAN2::NODES::N_BSM::MESSAGES::BRAKE_FD_7::TIMINGS::SetNewCycleContinously
{
  if (@this == 1 && @sysvar::IL_CAN2::NODES::N_BSM::MESSAGES::BRAKE_FD_7::TIMINGS::EnableCyclic)
  {
    @sysvar::IL_CAN2::NODES::N_BSM::MESSAGES::BRAKE_FD_7::TIMINGS::SelectedPeriod = -1;
  }
}

on sysvar_update sysvar::IL_CAN2::NODES::N_BSM::MESSAGES::BRAKE_FD_7::TIMINGS::SelectedPeriod
{
  if (@this == 0 && @sysvar::IL_CAN2::NODES::N_BSM::MESSAGES::BRAKE_FD_7::TIMINGS::EnableCyclic)
  {
    SetBusContext(gILCAN2_BusContext);
    gCAN2DisturbancePeriod = @sysvar::IL_CAN2::NODES::N_BSM::MESSAGES::BRAKE_FD_7::TIMINGS::NormalCyclePeriod;
    ILFaultInjectionResetMsgCycleTime(FDCAN14::BSM::BRAKE_FD_7);
  }
  else if (@this == 1 && @sysvar::IL_CAN2::NODES::N_BSM::MESSAGES::BRAKE_FD_7::TIMINGS::EnableCyclic)
  {
    SetBusContext(gILCAN2_BusContext);
    gCAN2DisturbancePeriod = @sysvar::IL_CAN2::NODES::N_BSM::MESSAGES::BRAKE_FD_7::TIMINGS::ActiveCyclePeriod;
    ILFaultInjectionSetMsgCycleTime(FDCAN14::BSM::BRAKE_FD_7, gCAN2DisturbancePeriod);
  }
  else if (@this == -1 && @sysvar::IL_CAN2::NODES::N_BSM::MESSAGES::BRAKE_FD_7::TIMINGS::EnableCyclic)
  {
    SetBusContext(gILCAN2_BusContext);
    gCAN2DisturbancePeriod = @sysvar::IL_CAN2::NODES::N_BSM::MESSAGES::BRAKE_FD_7::TIMINGS::CyclePeriod;
    ILFaultInjectionSetMsgCycleTime(FDCAN14::BSM::BRAKE_FD_7, gCAN2DisturbancePeriod);
  }
}

on sysvar_update sysvar::IL_CAN2::NODES::N_BSM::MESSAGES::BRAKE_FD_7::TIMINGS::SendOnce
{
  if (@this == 1)
  {
    SetBusContext(gILCAN2_BusContext);
    ILSetMsgEvent(FDCAN14::BSM::BRAKE_FD_7);
  }
}

on sysvar_update sysvar::NM_CAN2::NODES::N_BSM::OpenNodePanel
{
  OpenNodePanel("FDCAN14::BSM", 1);
}

on sysvar_update sysvar::NM_CAN2::StateControl::CloseNodePanels
{
  OpenNodePanel("FDCAN14::BSM", 0);
}

/* #ChannelEnd# |CAN2| #BusEnd# |FDCAN14| */
//--- end generated part --- Block end <#SysVar_Handler#> do not delete this line! Add application code below this line.

//--- begin generated part --- Block start <#MsgUpdateFcns#> do not delete this line and do not add application code in this code block!
/* #ChannelStart# |CAN2| #BusStart# |FDCAN14| */
/* #ChannelEnd# |CAN2| #BusEnd# |FDCAN14| */
//--- end generated part --- Block end <#MsgUpdateFcns#> do not delete this line! Add application code below this line.

