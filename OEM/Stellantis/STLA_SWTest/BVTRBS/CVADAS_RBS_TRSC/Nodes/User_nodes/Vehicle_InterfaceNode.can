/*@!Encoding:1252*/
includes
{
  
}

variables
{
  msTimer msVehSpeedSweepTimer;
  msTimer msStwAngleSweepTimer, msTimer_FT_PAMRequestSts, msTimer_PAMRequestSts, msTimer_APARequestSts;
  int sweepVehSpeed=0;
  int sweepStwAngle=0;
  Timer IGN_ON;
  Timer CANreset;
  msTimer msCANresetreturn;
}


on start
{
  
  @MEnv_StwAngleSweep_SET_BOL_1 = 0;
  @MEnv_StwAngleSweepDel_SET_FLT_1 = 1;
  @MEnv_StwAngleSweepMax_SET_FLT_1 = 720;
  @MEnv_StwAngleSweepMin_SET_FLT_1 = -720;
  @MEnv_StwAngleSweepTime_SET_INT_1 = 100;
  @MEnv_VehSpeedSweep_SET_BOL_1 = 0;
  @MEnv_VehSpeedSweepDel_SET_INT_1 = 1;
  @MEnv_VehSpeedSweepMax_SET_INT_1 = 511.875;
  @MEnv_VehSpeedSweepMin_SET_INT_1 = 0;
  @MEnv_VehSpeedSweepTime_SET_INT_1 = 100;
  // Default button pressed on Start
  @IL::Klemme15 =1;
  @IL::Klemme30 = 1;
  @MEnv_IgnStatus_SET_INT_1 = 0;
 
  setSignal(ESS_ENG_ST_W,3);
  setSignal(EngineSts_W,2);
  setSignal(SBR1RowDriverSeatSts, 2);
  //For DTC C41800
  setSignal(REF_VEH_SPEED, 0);
  setSignal(VehicleStandStillSts, 0);
  setSignal(LHR_Spin, 0);
  setSignal(RHR_Spin, 0);
  setSignal(EPBSts, 0);
  setSignal(LatAcceleration_BSM, 0);
  setSignal(LongAcceleration_BSM, 0);
  setSignal(YawRate_BSM, 0);
  setSignal(LongAccelerationOffset_BSM, 0);
  setSignal(LatAccelerationOffset_BSM, 0);
  
  
  //For DTC C42000
  setSignal(LwsAngle, 0);
  setSignal(LwsSpeed, 0);
  setSignal(EPS_SteeringTouchStat, 1);
  
  
  // For DTC C42200
  setSignal(ShiftLeverPositionReq, 3);
  setSignal(TurnIndicatorSts, 0);
  setSignal(ExternalTemperature, 0);
  setSignal(LanguageSelection, 2);
  setSignal(TargetGear, 0);
  setSignal(TRANS_ADAS_Inhibit, 1);
  setSignal(VIN_MSG, 0);
  setSignal(FL_Lvl, 0);
  setSignal(FR_Lvl, 0);
  setSignal(RL_Lvl, 0);
  setSignal(RR_Lvl, 0);
  setSignal(FL_Lvl_Adj, 1);
  setSignal(FR_Lvl_Adj, 1);
  setSignal(RL_Lvl_Adj, 1);
  setSignal(RR_Lvl_Adj, 1);
  setSignal(GearEngagedForDisplay, 0);
  setSignal(Shifter_ADAS_Inhibit, 1);
  setTimer (IGN_ON, 6);
  setTimer (CANreset, 1);  // Setting this timer to reset CAN 2 and CAN 14 IL control reset.
  resetFault();
  
}

//on stopMeasurement
//{
//  // setsignal(CmdIgnSts,0);
// 
// // @ IL::Klemme15=0;
//}


  


on timer msStwAngleSweepTimer
{
  if($LwsAngle<@MEnv_StwAngleSweepMax_SET_FLT_1)
  {
  $LwsAngle = @MEnv_StwAngleSweepMin_SET_FLT_1+ sweepStwAngle;
  sweepStwAngle = sweepStwAngle + @MEnv_StwAngleSweepDel_SET_FLT_1;
  setTimer(msStwAngleSweepTimer, @MEnv_StwAngleSweepTime_SET_INT_1);
  }
  else
  {
    @MEnv_StwAngleSweep_SET_BOL_1=0;
  }
}
  
on timer msVehSpeedSweepTimer
{
  if($VehicleSpeedVSOSig<@MEnv_VehSpeedSweepMax_SET_INT_1)
  {
  $VehicleSpeedVSOSig = @MEnv_VehSpeedSweepMin_SET_INT_1+ sweepVehSpeed;
  sweepVehSpeed = sweepVehSpeed +  @MEnv_VehSpeedSweepDel_SET_INT_1 ;
  setTimer(msVehSpeedSweepTimer,  @MEnv_VehSpeedSweepTime_SET_INT_1);
  }
   else
  {
    @MEnv_VehSpeedSweep_SET_BOL_1=0;
  }
}

on timer CANreset
{
  @sysvar::IL_CAN1::enable_AllNodes = 0;
  @sysvar::IL_CAN2::enable_AllNodes = 0;
  setTimer(msCANresetreturn, 1);
}

on timer IGN_ON
{
  @IL::Klemme15 = 1;
  @IL::Klemme30 = 1;
  @MEnv_IgnStatus_SET_INT_1 = 4;

  
}

on timer msCANresetreturn
{
  @sysvar::IL_CAN1::enable_AllNodes = 1;
  @sysvar::IL_CAN2::enable_AllNodes = 1;
  
  @IL::Klemme15 =1;
  @IL::Klemme30 = 1;
}

on sysvar_update DLC_FAULT_INJECTION::ResetFault
{
  if (@this == 1)
  {
    resetFault();
  }
}

void resetFault()
{
  @DLC_FAULT_INJECTION::SVar_ASCM_FD_2_DLCFlt_Injctn_SET = 0;
  @DLC_FAULT_INJECTION::SVar_TRANSM_FD_1_DLCFlt_Injctn_SET = 0;
  @DLC_FAULT_INJECTION::SVar_ENGINE_FD_7_DLCFlt_Injctn_SET = 0;
  @DLC_FAULT_INJECTION::SVar_ENGINE_FD_5_DLCFlt_Injctn_SET = 0;
  @DLC_FAULT_INJECTION::SVar_ENGINE_FD_2_DLCFlt_Injctn_SET = 0;
  @DLC_FAULT_INJECTION::SVar_DRIVETRAIN_FD_3_DLCFlt_Injctn_SET = 0;
  @DLC_FAULT_INJECTION::SVar_CFG_DATA_CODE_REQUEST_DLCFlt_Injctn_SET = 0;
  @DLC_FAULT_INJECTION::SVar_BRAKE_FD_5_DLCFlt_Injctn_SET = 0;
  @DLC_FAULT_INJECTION::SVar_VIN_DLCFlt_Injctn_SET = 0;
  @DLC_FAULT_INJECTION::SVar_PDC_INFO_FD_BCM_DLCFlt_Injctn_SET = 0;
  @DLC_FAULT_INJECTION::SVar_NM_BCM_DLCFlt_Injctn_SET = 0;
  @DLC_FAULT_INJECTION::SVar_BRAKE_FD_4_DLCFlt_Injctn_SET = 0;
  @DLC_FAULT_INJECTION::SVar_BRAKE_FD_3_DLCFlt_Injctn_SET = 0;
  @DLC_FAULT_INJECTION::SVar_BRAKE_FD_2_DLCFlt_Injctn_SET = 0;
  @DLC_FAULT_INJECTION::SVar_BRAKE_FD_1_DLCFlt_Injctn_SET = 0;
  @DLC_FAULT_INJECTION::SVar_BCM_FD_9_DLCFlt_Injctn_SET = 0;
  @DLC_FAULT_INJECTION::SVar_PDC_INFO_FD_ORC_DLCFlt_Injctn_SET = 0;
  @DLC_FAULT_INJECTION::SVar_ORC_FD_1_DLCFlt_Injctn_SET = 0;
  @DLC_FAULT_INJECTION::SVar_NM_ORC_DLCFlt_Injctn_SET = 0;
  @DLC_FAULT_INJECTION::SVar_TELEMATIC_FD_5_DLCFlt_Injctn_SET = 0;
  @DLC_FAULT_INJECTION::SVar_TELEMATIC_FD_14_DLCFlt_Injctn_SET = 0;
  @DLC_FAULT_INJECTION::SVar_TELEMATIC_FD_11_DLCFlt_Injctn_SET = 0;
  @DLC_FAULT_INJECTION::SVar_PDC_INFO_FD_SGW_DLCFlt_Injctn_SET = 0;
  @DLC_FAULT_INJECTION::SVar_NM_SGW_DLCFlt_Injctn_SET = 0;
  @DLC_FAULT_INJECTION::SVar_DIAGNOSTIC_REQUEST_PAM_DLCFlt_Injctn_SET = 0;
  @DLC_FAULT_INJECTION::SVar_DIAGNOSTIC_REQUEST_FUNCTIONAL_DLCFlt_Injctn_SET = 0;
  @DLC_FAULT_INJECTION::SVar_DIAGNOSTIC_REQUEST_FUNC_FOTA_DLCFlt_Injctn_SET = 0;
  @DLC_FAULT_INJECTION::SVar_DIAGNOSTIC_REQUEST_FD_PAM_DLCFlt_Injctn_SET = 0;
  @DLC_FAULT_INJECTION::SVar_DIAGNOSTIC_REQUEST_FD_FUNCTIONAL_DLCFlt_Injctn_SET = 0;
  @DLC_FAULT_INJECTION::SVar_TRANSM_FD_4_DLCFlt_Injctn_SET = 0;
  @DLC_FAULT_INJECTION::SVar_PDC_INFO_FD_ADCM_DLCFlt_Injctn_SET = 0;
  @DLC_FAULT_INJECTION::SVar_IPC_VEHICLE_SETUP_DLCFlt_Injctn_SET = 0;
  @DLC_FAULT_INJECTION::SVar_BCM_FD_7_DLCFlt_Injctn_SET = 0;
  @DLC_FAULT_INJECTION::SVar_BCM_FD_3_DLCFlt_Injctn_SET = 0;
  @DLC_FAULT_INJECTION::SVar_BCM_FD_29_DLCFlt_Injctn_SET = 0;
  @DLC_FAULT_INJECTION::SVar_BCM_FD_27_DLCFlt_Injctn_SET = 0;
  @DLC_FAULT_INJECTION::SVar_BCM_FD_2_DLCFlt_Injctn_SET = 0;
  @DLC_FAULT_INJECTION::SVar_TRANSM_FD_2_DLCFlt_Injctn_SET = 0;
  @DLC_FAULT_INJECTION::SVar_IPC_FD_1_DLCFlt_Injctn_SET = 0;
  @DLC_FAULT_INJECTION::SVar_BCM_FD_12_DLCFlt_Injctn_SET = 0;
  @DLC_FAULT_INJECTION::SVar_BCM_FD_10_DLCFlt_Injctn_SET = 0;
  @DLC_FAULT_INJECTION::SVar_ASCM_FD_1_DLCFlt_Injctn_SET = 0;
  @DLC_FAULT_INJECTION::SVar_AGSM_FD_2_DLCFlt_Injctn_SET = 0;
  @DLC_FAULT_INJECTION::SVar_TRSKM_FD_1_DLCFlt_Injctn_SET = 0;
  @DLC_FAULT_INJECTION::SVar_PDC_INFO_FD_TRLR_REV_DLCFlt_Injctn_SET = 0;
  @DLC_FAULT_INJECTION::SVar_NM_TRLR_REV_DLCFlt_Injctn_SET = 0;
  @DLC_FAULT_INJECTION::SVar_PDC_INFO_FD_EPS_DLCFlt_Injctn_SET = 0;
  @DLC_FAULT_INJECTION::SVar_NM_EPS_DLCFlt_Injctn_SET = 0;
  @DLC_FAULT_INJECTION::SVar_EPS_FD_2_DLCFlt_Injctn_SET = 0;
  @DLC_FAULT_INJECTION::SVar_EPS_FD_1_DLCFlt_Injctn_SET = 0;
  @DLC_FAULT_INJECTION::SVar_NM_BSM2_DLCFlt_Injctn_SET = 0;
  @DLC_FAULT_INJECTION::SVar_PDC_INFO_FD_BSM2_DLCFlt_Injctn_SET = 0;
  @DLC_FAULT_INJECTION::SVar_PDC_INFO_FD_CADM2_DLCFlt_Injctn_SET = 0;
  @DLC_FAULT_INJECTION::SVar_NM_CADM2_DLCFlt_Injctn_SET = 0;
  @DLC_FAULT_INJECTION::SVar_GLOB_NAV_FD_C2_DLCFlt_Injctn_SET = 0;
  @DLC_FAULT_INJECTION::SVar_ADAS_FD_INFO_C2_DLCFlt_Injctn_SET = 0;
  
  
  
  
   @DLC_FAULT_INJECTION::SVar_ASCM_FD_2_DLCFault_Value_SET = 0;
  @DLC_FAULT_INJECTION::SVar_TRANSM_FD_1_DLCFault_Value_SET = 0;
  @DLC_FAULT_INJECTION::SVar_ENGINE_FD_7_DLCFault_Value_SET = 0;
  @DLC_FAULT_INJECTION::SVar_ENGINE_FD_5_DLCFault_Value_SET = 0;
  @DLC_FAULT_INJECTION::SVar_ENGINE_FD_2_DLCFault_Value_SET = 0;
  @DLC_FAULT_INJECTION::SVar_DRIVETRAIN_FD_3_DLCFault_Value_SET = 0;
  @DLC_FAULT_INJECTION::SVar_CFG_DATA_CODE_REQUEST_DLCFault_Value_SET = 0;
  @DLC_FAULT_INJECTION::SVar_BRAKE_FD_5_DLCFault_Value_SET = 0;
  @DLC_FAULT_INJECTION::SVar_VIN_DLCFault_Value_SET = 0;
  @DLC_FAULT_INJECTION::SVar_PDC_INFO_FD_BCM_DLCFault_Value_SET = 0;
  @DLC_FAULT_INJECTION::SVar_NM_BCM_DLCFault_Value_SET = 0;
  @DLC_FAULT_INJECTION::SVar_BRAKE_FD_4_DLCFault_Value_SET = 0;
  @DLC_FAULT_INJECTION::SVar_BRAKE_FD_3_DLCFault_Value_SET = 0;
  @DLC_FAULT_INJECTION::SVar_BRAKE_FD_2_DLCFault_Value_SET = 0;
  @DLC_FAULT_INJECTION::SVar_BRAKE_FD_1_DLCFault_Value_SET = 0;
  @DLC_FAULT_INJECTION::SVar_BCM_FD_9_DLCFault_Value_SET = 0;
  @DLC_FAULT_INJECTION::SVar_PDC_INFO_FD_ORC_DLCFault_Value_SET = 0;
  @DLC_FAULT_INJECTION::SVar_ORC_FD_1_DLCFault_Value_SET = 0;
  @DLC_FAULT_INJECTION::SVar_NM_ORC_DLCFault_Value_SET = 0;
  @DLC_FAULT_INJECTION::SVar_TELEMATIC_FD_5_DLCFault_Value_SET = 0;
  @DLC_FAULT_INJECTION::SVar_TELEMATIC_FD_14_DLCFault_Value_SET = 0;
  @DLC_FAULT_INJECTION::SVar_TELEMATIC_FD_11_DLCFault_Value_SET = 0;
  @DLC_FAULT_INJECTION::SVar_PDC_INFO_FD_SGW_DLCFault_Value_SET = 0;
  @DLC_FAULT_INJECTION::SVar_NM_SGW_DLCFault_Value_SET = 0;
  @DLC_FAULT_INJECTION::SVar_DIAGNOSTIC_REQUEST_PAM_DLCFault_Value_SET = 0;
  @DLC_FAULT_INJECTION::SVar_DIAGNOSTIC_REQUEST_FUNCTIONAL_DLCFault_Value_SET = 0;
  @DLC_FAULT_INJECTION::SVar_DIAGNOSTIC_REQUEST_FUNC_FOTA_DLCFault_Value_SET = 0;
  @DLC_FAULT_INJECTION::SVar_DIAGNOSTIC_REQUEST_FD_PAM_DLCFault_Value_SET = 0;
  @DLC_FAULT_INJECTION::SVar_DIAGNOSTIC_REQUEST_FD_FUNCTIONAL_DLCFault_Value_SET = 0;
  @DLC_FAULT_INJECTION::SVar_TRANSM_FD_4_DLCFault_Value_SET = 0;
  @DLC_FAULT_INJECTION::SVar_PDC_INFO_FD_ADCM_DLCFault_Value_SET = 0;
  @DLC_FAULT_INJECTION::SVar_IPC_VEHICLE_SETUP_DLCFault_Value_SET = 0;
  @DLC_FAULT_INJECTION::SVar_BCM_FD_7_DLCFault_Value_SET = 0;
  @DLC_FAULT_INJECTION::SVar_BCM_FD_3_DLCFault_Value_SET = 0;
  @DLC_FAULT_INJECTION::SVar_BCM_FD_29_DLCFault_Value_SET = 0;
  @DLC_FAULT_INJECTION::SVar_BCM_FD_27_DLCFault_Value_SET = 0;
  @DLC_FAULT_INJECTION::SVar_BCM_FD_2_DLCFault_Value_SET = 0;
  @DLC_FAULT_INJECTION::SVar_TRANSM_FD_2_DLCFault_Value_SET = 0;
  @DLC_FAULT_INJECTION::SVar_IPC_FD_1_DLCFault_Value_SET = 0;
  @DLC_FAULT_INJECTION::SVar_BCM_FD_12_DLCFault_Value_SET = 0;
  @DLC_FAULT_INJECTION::SVar_BCM_FD_10_DLCFault_Value_SET = 0;
  @DLC_FAULT_INJECTION::SVar_ASCM_FD_1_DLCFault_Value_SET= 0;
  @DLC_FAULT_INJECTION::SVar_AGSM_FD_2_DLCFault_Value_SET = 0;
  @DLC_FAULT_INJECTION::SVar_TRSKM_FD_1_DLCFault_Value_SET = 0;
  @DLC_FAULT_INJECTION::SVar_PDC_INFO_FD_TRLR_REV_DLCFault_Value_SET = 0;
  @DLC_FAULT_INJECTION::SVar_NM_TRLR_REV_DLCFault_Value_SET = 0;
  @DLC_FAULT_INJECTION::SVar_PDC_INFO_FD_EPS_DLCFault_Value_SET = 0;
  @DLC_FAULT_INJECTION::SVar_NM_EPS_DLCFault_Value_SET = 0;
  @DLC_FAULT_INJECTION::SVar_EPS_FD_2_DLCFault_Value_SET = 0;
  @DLC_FAULT_INJECTION::SVar_EPS_FD_1_DLCFault_Value_SET = 0;
  @DLC_FAULT_INJECTION::SVar_NM_BSM2_DLCFault_Value_SET = 0;
  @DLC_FAULT_INJECTION::SVar_PDC_INFO_FD_BSM2_DLCFault_Value_SET = 0;
  @DLC_FAULT_INJECTION::SVar_PDC_INFO_FD_CADM2_DLCFault_Value_SET = 0;
  @DLC_FAULT_INJECTION::SVar_NM_CADM2_DLCFault_Value_SET = 0;
  @DLC_FAULT_INJECTION::SVar_GLOB_NAV_FD_C2_DLCFault_Value_SET = 0;
  @DLC_FAULT_INJECTION::SVar_ADAS_FD_INFO_C2_DLCFault_Value_SET = 0;
  
  
  
  
}

on envVar MEnv_StwAngleSweep_SET_BOL_1
{
  if(@this==1) setTimer(msStwAngleSweepTimer, @MEnv_StwAngleSweepTime_SET_INT_1);
  else cancelTimer(msStwAngleSweepTimer); sweepStwAngle=0;
}

on envVar MEnv_VehSpeedSweep_SET_BOL_1
{
  if(@this==1) setTimer(msVehSpeedSweepTimer,  @MEnv_VehSpeedSweepTime_SET_INT_1);
  else cancelTimer(msVehSpeedSweepTimer); sweepVehSpeed=0;
}

on envVar MEnv_open_all_doors
{
  if(@this==1)
  {
    $PsngrDoorSts =1;
    $DriverDoorSts =1;
    $LHRDoorSts =1;
    $RHRDoorSts =1;
    $RHatchSts =1;
    
  }
}

on envVar MEnv_close_all_doors
{
  if(@this==1)
  {
    $PsngrDoorSts =0;
    $DriverDoorSts =0;
    $LHRDoorSts =0;
    $RHRDoorSts =0;
    $RHatchSts =0;
    
  }
}


on envVar MEnv_Default_SET_BOL_1
{
  if(@this)
  {
      @IL::Klemme15 =1;
      @IL::Klemme30 = 1;
      @MEnv_IgnStatus_SET_INT_1 = 4;
  }  
  
}

on envVar MEnv_IgnStatus_SET_INT_1
{
   $CmdIgnSts = @this;
}

on signal CmdIgnSts
{
  @MEnv_IgnStatus_GET_INT_1 = $CmdIgnSts;
  //@MEnv_IgnStatus_SET_INT_1 = $CmdIgnSts;
 
}
on envVar MEnv_VehSpeed_SET_FLT_1
{
   
    $VehicleSpeedVSOSig = @MEnv_VehSpeed_SET_FLT_1;
}

on signal VehicleSpeedVSOSig
{
  @MEnv_VehSpeed_GET_FLT_1 = $VehicleSpeedVSOSig;
  @MEnv_VehSpeed_SET_FLT_1 = $VehicleSpeedVSOSig;
 
}


on signal EngineSpeed_W
{
    @MEnv_VehSpeed_GET_FLT_1 = $EngineSpeed_W;
}

on envVar MEnv_WheelSpeed_SET_FLT_1
{
  @MEnv_WheelSpeedFront_SET_FLT_1 = @MEnv_WheelSpeed_SET_FLT_1;
  @MEnv_WheelSpeedRear_SET_FLT_1 = @MEnv_WheelSpeed_SET_FLT_1;
  setSignal(LHFWheelSpeed, @MEnv_WheelSpeedFront_SET_FLT_1);
  setSignal(LHRWheelSpeed, @MEnv_WheelSpeedRear_SET_FLT_1);
  @MEnv_VehSpeed_SET_FLT_1 = @MEnv_WheelSpeed_SET_FLT_1;
}

on signal LHFWheelSpeed
{
   @MEnv_WheelSpeedFront_GET_FLT_1 = this;
}

on signal LHRWheelSpeed
{
   @MEnv_WheelSpeedRear_GET_FLT_1 = this;
}

on envVar MEnv_Gear_SET_INT_1
{
  
 $TargetGear =@this;
}

on signal TargetGear
{
  @MEnv_Gear_SET_INT_1 = $TargetGear;
}

on envVar MEnv_StwAngle_SET_FLT_1
{
  $LwsAngle= @this;
    
}

on signal LwsAngle
{
    @MEnv_StwAngle_GET_FLT_1 = this;
  @MEnv_StwAngle_SET_FLT_1= this;
}

on envvar MEnv_Vehicle_Configuration_SET_INT_1
{
  openPanel(" Vehicle_Controls");
}

on envVar MEnv_StwAngleCenter_SET_BOL_1
{
  @MEnv_StwAngle_SET_FLT_1=0;
}

on envVar MEnv_PAM_Config_SET_INT_1
{
  
}

on envVar MEnv_PamChmVolFrnt_SET_INT_1
{ 
  $PamChimeVolumeFront =@this ;
}

on signal PamChimeVolumeRear
{
  @MEnv_PamChmVolFrnt_GET_INT_1 =this;
}

on envVar MEnv_PamChmVolBk_SET_INT_1
{
  $PamChimeVolumeRear =@this ;
}

on signal PamChimeVolumeFront
{
  @MEnv_PamChmVolFrnt_GET_INT_1 = this;
}

on envVar MEnv_PAM_Brk_RqSts_SET_INT_1
{
  $RR_PAM_Brk_RqSts =@this ;
}

on signal CVPAM_FD_Control::RR_PAM_Brk_RqSts 
{
  @MEnv_PAM_Brk_RqSts_GET_INT_1 =this;
}

on envVar MEnv_PAM_Off_Status_SET_INT_1
{
  $PAM_Off_Status = @this;
}

on signal CVADAS::PAM_Off_Status
{
  @MEnv_PAM_Off_Status_GET_INT_1 =this;
}

on envVar MEnv_StopControlSts_SET_INT_1
{
  $PAM::RR_PAM_StopControlSts =@this;
}

on signal PAM::RR_PAM_StopControlSts
{
  @MEnv_StopControlSts_GET_INT_1 =this;
}

//on sysvar User_Node::CM_TCH_STAT_SET_INT_1
//{
//  $TELEMATIC_FD_5::CM_TCH_STAT=@User_Node::CM_TCH_STAT_SET_INT_1;
//  $TELEMATIC_FD_5::CM_TCH_X_COORD=@User_Node::X_Cordinate_SET_INT_1;
//  $TELEMATIC_FD_5::CM_TCH_Y_COORD=@User_Node::Y_Cordinate_SET_INT_1;
//}


  on sysvar_update IL::Klemme15
{
  if(@this)
  {
        //setsignal(CmdIgnSts,4);
        
   }     
  else
  {
      // setsignal(CmdIgnSts,0);
        
  }
}


on sysvar User_Node::Set_PreCondition_FPA
{
  setsignal(CmdIgnSts, 4);
  setSignal(GearEngaged, 1);
  setSignal(VehicleSpeedVSOSig, 6);
  setSignal(Shifter_ADAS_Inhibit, 1);
  setSignal(EngineSts_W, 2);
  setSignal(Active_Park_Mode, 0);
  setSignal(TRANS_ADAS_Inhibit, 1);
  setSignal(EPBSts,0);
  setSignal(TrailerConnectionSts, 0);
  setSignal(TCASERANGESTATUS, 2);
  setSignal(ITBM_TrlrStat, 0);
 @MEnv_close_all_doors = 1;
  
}
on sysvar User_Node::ENABLE_FPA
{
  setSignal (FT_PAMRequestSts, 1);
  setTimer(msTimer_FT_PAMRequestSts, 1000); 
  
  
}
on timer msTimer_FT_PAMRequestSts
{
  $FT_PAMRequestSts = 0;
}

//on signal FT_PAMRequestSts
//{
//  if(FT_PAMRequestSts == 1)
//  {
//      setTimer(msTimer_FT_PAMRequestSts, 1000); 
//  }
//}

on sysvar User_Node::Set_PreCondition_RPA
{
  setsignal(CmdIgnSts, 4);
  setSignal(GearEngaged, 1);
  setSignal(VehicleSpeedVSOSig, 6);
  setSignal(Shifter_ADAS_Inhibit, 1);
  setSignal(EngineSts_W, 2);
  setSignal(Active_Park_Mode, 0);
  setSignal(TRANS_ADAS_Inhibit, 1);
  setSignal(EPBSts,0);
  setSignal(TrailerConnectionSts, 0);
  setSignal(TCASERANGESTATUS, 2);
  setSignal(ITBM_TrlrStat, 0);
 @MEnv_close_all_doors = 1;
}
on sysvar User_Node::ENABLE_RPA
{
  setSignal (PAMRequestSts, 1);
  setTimer(msTimer_PAMRequestSts, 1000); 
}
on timer msTimer_PAMRequestSts
{
  $PAMRequestSts = 0;
}



on sysvar User_Node::Set_PreCondition_Full_Autopark
{
  setsignal(CmdIgnSts, 4);
  setSignal(GearEngaged, 1);
  setSignal(VehicleSpeedVSOSig, 6);
  setSignal(Shifter_ADAS_Inhibit, 1);
  setSignal(EngineSts_W, 2);
  setSignal(Active_Park_Mode, 0);
  setSignal(TRANS_ADAS_Inhibit, 1);
  setSignal(EPBSts,0);
  setSignal(TrailerConnectionSts, 0);
  setSignal(TCASERANGESTATUS, 2);
  setSignal(ITBM_TrlrStat, 0);
 @MEnv_close_all_doors = 1;
}
on sysvar User_Node::ENABLE_AutoPark
{
  setSignal (APARequestSts, 1);
  setTimer(msTimer_APARequestSts, 1000); 
}
on timer msTimer_APARequestSts
{
  $APARequestSts = 0;
}