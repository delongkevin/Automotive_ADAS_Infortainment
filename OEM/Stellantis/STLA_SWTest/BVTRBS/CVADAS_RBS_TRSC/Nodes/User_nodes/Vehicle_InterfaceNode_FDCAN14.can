/*@!Encoding:1252*/
includes
{
  
}

variables
{
  
}

on start
{
  setSignal(EPS_SteeringTouchStat, 1);
  setSignal(SBR1RowDriverSeatSts, 2);
  setSignal(EPS_THA_SteeringTorqueResp, 2);
  //For DTC C41800
//  setSignal(REF_VEH_SPEED, 0);
//  setSignal(VehicleStandStillSts, 0);
//  setSignal(LHR_Spin, 0);
//  setSignal(RHR_Spin, 0);
//  setSignal(EPBSts, 0);
//  setSignal(LatAccelerationFailSts_BSM, 0);
//  setSignal(LongAccelerationFailSts_BSM, 0);
//  setSignal(YawRateFailSts_BSM, 0);
//  setSignal(LHF_Spin, 0);
//  setSignal(LHF_WheelSensorFailSts, 0);
//  setSignal(LHR_WheelSensorFailSts, 0);
//  setSignal(RHF_Spin, 0);
//  setSignal(RHF_WheelSensorFailSts, 0);
//  setSignal(RHR_WheelSensorFailSts, 0);
//  setSignal(PAM_Brk_Rq_RspSts, 0);
//  setSignal(ESC_TRSC_Brk_Resp, 0);
//  setSignal(BSM_THA_Brk_Resp, 0);
  
    //For DTC C41800
  setSignal(REF_VEH_SPEED, 0);
  setSignal(VehicleStandStillSts, 0);
  setSignal(LHR_Spin, 0);
  setSignal(RHR_Spin, 0);
  setSignal(EPBSts, 0);
  setSignal(LatAcceleration_BSM, 0);
  setSignal(LongAcceleration_BSM, 0);
  setSignal(YawRate_BSM, 0);
  setSignal(YawRateOffset_BSM, 0);
  setSignal(LongAccelerationOffset_BSM, 0);
  setSignal(LatAccelerationOffset_BSM, 0);
  setSignal(LwsAngleOffset_BSM, 0);
  setSignal(ExternalBrkRequestsDisabled ,0);
  setSignal(EngineSts_W, 2);
  setSignal(ESS_ENG_ST_W, 3);
  resetFault();
  
  // For DTC C42200
  
}

on sysvar User_Node::Set_PreCondition_FPA
{
  setSignal(ParkingInterventionSts, 1);
}

on sysvar User_Node::Set_PreCondition_RPA
{
  setSignal(ParkingInterventionSts, 1);
}

on sysvar User_Node::Set_PreCondition_Full_Autopark
{
  setSignal(ParkingInterventionSts, 1);
}

on sysvar_update DLC_FAULT_INJECTION::ResetFault_14
{
  if (@this == 1)
  {
    resetFault();
  }
}

void resetFault()
{ 
  @DLC_FAULT_INJECTION::SVar_NM_BSM2_DLCFlt_Injctn_SET = 0;
  @DLC_FAULT_INJECTION::SVar_NM_BSM2_14DLCFlt_Injctn_SET = 0;
   @DLC_FAULT_INJECTION::SVar_NM_BSM2_DLCFault_Value_14_SET = 0;
  
  @DLC_FAULT_INJECTION::SVar_NM_ORC_DLCFlt_Injctn_SET = 0;
  @DLC_FAULT_INJECTION::SVar_NM_ORC_14DLCFlt_Injctn_SET = 0;
  @DLC_FAULT_INJECTION::SVar_NM_ORC_DLCFault_Value_14_SET = 0;
  
  @DLC_FAULT_INJECTION::SVar_NM_CADM_DLCFlt_Injctn_SET = 0;
  @DLC_FAULT_INJECTION::SVar_NM_CADM_DLCFault_Value_14_SET = 0;
  
  @DLC_FAULT_INJECTION::SVar_ADAS_FD_INFO_DLCFlt_Injctn_SET = 0;
   @DLC_FAULT_INJECTION::SVar_ADAS_FD_INFO_DLCFault_Value_14_SET = 0;
  
  @DLC_FAULT_INJECTION::SVar_PT_TORQUE_FD_1_DLCFlt_Injctn_SET = 0;
  @DLC_FAULT_INJECTION::SVar_PT_TORQUE_FD_1_DLCFault_Value_14_SET = 0;
  
  @DLC_FAULT_INJECTION::SVar_NM_ECM_DLCFlt_Injctn_SET = 0;
   @DLC_FAULT_INJECTION::SVar_NM_ECM_DLCFault_Value_14_SET= 0;
  
 
  @DLC_FAULT_INJECTION::SVar_ENGINE_FD_5_DLCFlt_Injctn_SET = 0;
  @DLC_FAULT_INJECTION::SVar_ENGINE_FD_5_14_DLCFlt_Injctn_SET = 0;
  @DLC_FAULT_INJECTION::SVar_ENGINE_FD_5_DLCFault_Value_14_SET = 0;
  
  
  @DLC_FAULT_INJECTION::SVar_ENGINE_FD_3_DLCFlt_Injctn_SET = 0;
  @DLC_FAULT_INJECTION::SVar_ENGINE_FD_3_DLCFault_Value_14_SET = 0;
  
  
  @DLC_FAULT_INJECTION::SVar_ENGINE_FD_2_DLCFlt_Injctn_SET = 0;
  @DLC_FAULT_INJECTION::SVar_ENGINE_FD_2_14_DLCFlt_Injctn_SET = 0;
  @DLC_FAULT_INJECTION::SVar_ENGINE_FD_2_DLCFault_Value_14_SET = 0;
  
  @DLC_FAULT_INJECTION::SVar_NM_EPS_DLCFlt_Injctn_SET = 0;
  @DLC_FAULT_INJECTION::SVar_NM_EPS14_DLCFlt_Injctn_SET= 0;
  @DLC_FAULT_INJECTION::SVar_NM_EPS_DLCFault_Value_14_SET= 0;
  
  @DLC_FAULT_INJECTION::SVar_EPS_FD_2_DLCFlt_Injctn_SET = 0;
  @DLC_FAULT_INJECTION::SVar_EPS_FD_2_14_DLCFlt_Injctn_SET = 0;
  @DLC_FAULT_INJECTION::SVar_EPS_FD_2_DLCFault_Value_14_SET = 0;
  
  
  @DLC_FAULT_INJECTION::SVar_EPS_FD_1_DLCFlt_Injctn_SET = 0;
  @DLC_FAULT_INJECTION::SVar_EPS_FD_1_14_DLCFlt_Injctn_SET = 0;
   @DLC_FAULT_INJECTION::SVar_EPS_FD_1_DLCFault_Value_14_SET= 0;
 
  
  @DLC_FAULT_INJECTION::SVar_NM_BSM_DLCFlt_Injctn_SET = 0;
   @DLC_FAULT_INJECTION::SVar_NM_BSM_DLCFault_Value_14_SET = 0;
  
  @DLC_FAULT_INJECTION::SVar_BRAKE_FD_7_DLCFlt_Injctn_SET = 0;
  @DLC_FAULT_INJECTION::SVar_BRAKE_FD_7_DLCFault_Value_14_SET = 0;
  
  
  @DLC_FAULT_INJECTION::SVar_BRAKE_FD_6_DLCFlt_Injctn_SET = 0;
   @DLC_FAULT_INJECTION::SVar_BRAKE_FD_6_DLCFault_Value_14_SET = 0;
  
  
  @DLC_FAULT_INJECTION::SVar_BRAKE_FD_5_DLCFlt_Injctn_SET = 0;
  @DLC_FAULT_INJECTION::SVar_BRAKE_FD_5_14_DLCFlt_Injctn_SET= 0;
  @DLC_FAULT_INJECTION::SVar_BRAKE_FD_5_DLCFault_Value_14_SET= 0;
  
  @DLC_FAULT_INJECTION::SVar_BRAKE_FD_4_DLCFlt_Injctn_SET = 0;
  @DLC_FAULT_INJECTION::SVar_BRAKE_FD_4_14_DLCFlt_Injctn_SET= 0;
  @DLC_FAULT_INJECTION::SVar_BRAKE_FD_4_DLCFault_Value_14_SET= 0;
  
  
  @DLC_FAULT_INJECTION::SVar_BRAKE_FD_3_DLCFlt_Injctn_SET = 0;
  @DLC_FAULT_INJECTION::SVar_BRAKE_FD_3_14_DLCFlt_Injctn_SET = 0;
  @DLC_FAULT_INJECTION::SVar_BRAKE_FD_3_DLCFault_Value_14_SET= 0;
  
  
  @DLC_FAULT_INJECTION::SVar_BRAKE_FD_2_DLCFlt_Injctn_SET = 0;
  @DLC_FAULT_INJECTION::SVar_BRAKE_FD_2_14_DLCFlt_Injctn_SET = 0;
  @DLC_FAULT_INJECTION::SVar_BRAKE_FD_2_DLCFault_Value_14_SET= 0;
  
  
  @DLC_FAULT_INJECTION::SVar_BRAKE_FD_1_DLCFlt_Injctn_SET = 0;
  @DLC_FAULT_INJECTION::SVar_BRAKE_FD_1_14_DLCFlt_Injctn_SET = 0;
   @DLC_FAULT_INJECTION::SVar_BRAKE_FD_1_DLCFault_Value_14_SET = 0;
  
  @DLC_FAULT_INJECTION::SVar_ENGINE_FD_7_14_DLCFlt_Injctn_SET1 = 0;
  @DLC_FAULT_INJECTION::SVar_ENGINE_FD_7_DLCFault_Value_14_SET1 = 0;
}