includes
{
  // Import required CAPL include files
  //--- begin generated part --- Block start #Hdr_Includes#; do not delete this line and do not add application code in this code block!
  /* #ChannelStart# |CAN2| #BusStart# |FDCAN2| */
  /* #ChannelEnd# |CAN2| #BusEnd# |FDCAN2| */
  //--- end generated part --- Block end #Hdr_Includes#; do not delete this line! Add application code below this line.
  //--- begin generated part --- Block start #Body_Includes#; do not delete this line and do not add application code in this code block!
  /* #ChannelStart# |CAN2| #BusStart# |FDCAN2| */
  #include "..\CAPL\Vector-NM-Panel-Helper_CAN2.cin"
  #include "..\CAPL\Vector-IL-KL15-Helper_CAN2.cin"
  /* #ChannelEnd# |CAN2| #BusEnd# |FDCAN2| */
  //--- end generated part --- Block end #Body_Includes#; do not delete this line! Add application code below this line.
}

variables
{
  // Define global variables for this CAPL file

  /*--- #GenHeader Begin# --- begin generated comment ---
  | Generated on Monday, November 27, 2023, 12:59:57
  | By ModelGenerator for Vector 1.5.4.10, ModelGeneratorVectorDLL 1.5.4.41
  | Package Vector 4.0.21
  | Target Bus: FDCAN2; Channel: CAN2; DB Cluster: PDT24_FDCAN2;
  | From Database: PDT24_FDCAN2.dbc
  | CANoe Version 15.4.35.0
    --- #GenHeader End  # --- end generated comment --- */

  char gECU[256] = "PAM";
  //--- begin generated part --- Block start #Hdr_GlobalVariables#; do not delete this line and do not add application code in this code block!
  /* #ChannelStart# |CAN2| #BusStart# |FDCAN2| */
  /* #ChannelEnd# |CAN2| #BusEnd# |FDCAN2| */
  //--- end generated part --- Block end #Hdr_GlobalVariables#; do not delete this line! Add application code below this line.
  //--- begin generated part --- Block start #Body_GlobalVariables#; do not delete this line and do not add application code in this code block!
  /* #ChannelStart# |CAN2| #BusStart# |FDCAN2| */
  char gCAN2BusName[256] = "FDCAN2";
  int gCAN2Channel = 2; //// The channel the bus is attached to

  long gCAN2DisturbanceMode;
  long gCAN2DisturbanceCount;
  long gCAN2DisturbanceValue;
  long gCAN2DisturbanceContinueMode;
  double gCAN2DisturbancePeriod;
  /* #ChannelEnd# |CAN2| #BusEnd# |FDCAN2| */
  //--- end generated part --- Block end #Body_GlobalVariables#; do not delete this line! Add application code below this line.
}

on preStart
{
  // Initialize CAPL includes and node's modules/DLLs
  //--- begin generated part --- Block start #Hdr_OnInit#; do not delete this line and do not add application code in this code block!
  /* #ChannelStart# |CAN2| #BusStart# |FDCAN2| */
  /* #ChannelEnd# |CAN2| #BusEnd# |FDCAN2| */
  //--- end generated part --- Block end #Hdr_OnInit#; do not delete this line! Add application code below this line.
  //--- begin generated part --- Block start #Body_OnInit#; do not delete this line and do not add application code in this code block!
  /* #ChannelStart# |CAN2| #BusStart# |FDCAN2| */
  ILCAN2_OnInit();
  /* #ChannelEnd# |CAN2| #BusEnd# |FDCAN2| */
  //--- end generated part --- Block end #Body_OnInit#; do not delete this line! Add application code below this line.
}

on start
{
  // Start CAPL includes and node's modules/DLLs
  //--- begin generated part --- Block start #Hdr_OnStart#; do not delete this line and do not add application code in this code block!
  /* #ChannelStart# |CAN2| #BusStart# |FDCAN2| */
  /* #ChannelEnd# |CAN2| #BusEnd# |FDCAN2| */
  //--- end generated part --- Block end #Hdr_OnStart#; do not delete this line! Add application code below this line.
  //--- begin generated part --- Block start #Body_OnStart#; do not delete this line and do not add application code in this code block!
  /* #ChannelStart# |CAN2| #BusStart# |FDCAN2| */
  ILCAN2_OnStart();
  /* #ChannelEnd# |CAN2| #BusEnd# |FDCAN2| */
  //--- end generated part --- Block end #Body_OnStart#; do not delete this line! Add application code below this line.
}

on preStop
{
  // Prepare stopping
  //--- begin generated part --- Block start #Hdr_OnStopping#; do not delete this line and do not add application code in this code block!
  /* #ChannelStart# |CAN2| #BusStart# |FDCAN2| */
  /* #ChannelEnd# |CAN2| #BusEnd# |FDCAN2| */
  //--- end generated part --- Block end #Hdr_OnStopping#; do not delete this line! Add application code below this line.
  //--- begin generated part --- Block start #Body_OnStopping#; do not delete this line and do not add application code in this code block!
  /* #ChannelStart# |CAN2| #BusStart# |FDCAN2| */
  /* #ChannelEnd# |CAN2| #BusEnd# |FDCAN2| */
  //--- end generated part --- Block end #Body_OnStopping#; do not delete this line! Add application code below this line.
}

on stopMeasurement
{
  // Stop actions
  //--- begin generated part --- Block start #Hdr_OnStop#; do not delete this line and do not add application code in this code block!
  /* #ChannelStart# |CAN2| #BusStart# |FDCAN2| */
  /* #ChannelEnd# |CAN2| #BusEnd# |FDCAN2| */
  //--- end generated part --- Block end #Hdr_OnStop#; do not delete this line! Add application code below this line.
  //--- begin generated part --- Block start #Body_OnStop#; do not delete this line and do not add application code in this code block!
  /* #ChannelStart# |CAN2| #BusStart# |FDCAN2| */
  /* #ChannelEnd# |CAN2| #BusEnd# |FDCAN2| */
  //--- end generated part --- Block end #Body_OnStop#; do not delete this line! Add application code below this line.
}

void StartSim(dword busContext, int busActive, int mode)
{
  // Called when ... due to ...
  //   mode == 1: ILControlResume
  //   mode == 2: ILControlStart
  //   mode == 3: ILControlSimulationOn
  //--- begin generated part --- Block start #Hdr_StartSim#; do not delete this line and do not add application code in this code block!
  /* #ChannelStart# |CAN2| #BusStart# |FDCAN2| */
  /* #ChannelEnd# |CAN2| #BusEnd# |FDCAN2| */
  //--- end generated part --- Block end #Hdr_StartSim#; do not delete this line! Add application code below this line.
  //write("[%.6f %NODE_NAME%] StartSim(0x%X, %d, %d)", TimeNowNS()/1e9, busContext, busActive, mode);
  //--- begin generated part --- Block start #Body_StartSim#; do not delete this line and do not add application code in this code block!
  /* #ChannelStart# |CAN2| #BusStart# |FDCAN2| */
  /* #ChannelEnd# |CAN2| #BusEnd# |FDCAN2| */
  //--- end generated part --- Block end #Body_StartSim#; do not delete this line! Add application code below this line.
}

void StopSim(dword busContext, int busActive, int mode)
{
  // Called when ... due to ...
  //   mode == 1: ILControlWait
  //   mode == 2: ILControlStop
  //   mode == 3: ILControlSimulationOff
  //--- begin generated part --- Block start #Hdr_StopSim#; do not delete this line and do not add application code in this code block!
  /* #ChannelStart# |CAN2| #BusStart# |FDCAN2| */
  /* #ChannelEnd# |CAN2| #BusEnd# |FDCAN2| */
  //--- end generated part --- Block end #Hdr_StopSim#; do not delete this line! Add application code below this line.
  //write("[%.6f %NODE_NAME%] StopSim(0x%X, %d, %d)", TimeNowNS()/1e9, busContext, busActive, mode);
  //--- begin generated part --- Block start #Body_StopSim#; do not delete this line and do not add application code in this code block!
  /* #ChannelStart# |CAN2| #BusStart# |FDCAN2| */
  /* #ChannelEnd# |CAN2| #BusEnd# |FDCAN2| */
  //--- end generated part --- Block end #Body_StopSim#; do not delete this line! Add application code below this line.
}

on sysvar_update sysvar::IL::Klemme15
{
  // Handle system state variable
  //--- begin generated part --- Block start #Hdr_KL15_Klemme15#; do not delete this line and do not add application code in this code block!
  /* #ChannelStart# |CAN2| #BusStart# |FDCAN2| */
  /* #ChannelEnd# |CAN2| #BusEnd# |FDCAN2| */
  //--- end generated part --- Block end #Hdr_KL15_Klemme15#; do not delete this line! Add application code below this line.
  //--- begin generated part --- Block start #Body_KL15_Klemme15#; do not delete this line and do not add application code in this code block!
  /* #ChannelStart# |CAN2| #BusStart# |FDCAN2| */
  ILCAN2_OnEnvKlemme15(@this);
  /* #ChannelEnd# |CAN2| #BusEnd# |FDCAN2| */
  //--- end generated part --- Block end #Body_KL15_Klemme15#; do not delete this line! Add application code below this line.
}

on sysvar_update sysvar::IL::Klemme30
{
  // Handle system state variable
  //--- begin generated part --- Block start #Hdr_KL30_Klemme30#; do not delete this line and do not add application code in this code block!
  /* #ChannelStart# |CAN2| #BusStart# |FDCAN2| */
  /* #ChannelEnd# |CAN2| #BusEnd# |FDCAN2| */
  //--- end generated part --- Block end #Hdr_KL30_Klemme30#; do not delete this line! Add application code below this line.
  //--- begin generated part --- Block start #Body_KL30_Klemme30#; do not delete this line and do not add application code in this code block!
  /* #ChannelStart# |CAN2| #BusStart# |FDCAN2| */
  ILCAN2_OnEnvKlemme30(@this);
  /* #ChannelEnd# |CAN2| #BusEnd# |FDCAN2| */
  //--- end generated part --- Block end #Body_KL30_Klemme30#; do not delete this line! Add application code below this line.
}

dword applILTxPending(long aId, dword aDlc, byte data[])
{
  dword ret = 1;
  //--- begin generated part --- Block start #Hdr_applILTxPending#; do not delete this line and do not add application code in this code block!
  /* #ChannelStart# |CAN2| #BusStart# |FDCAN2| */
  /* #ChannelEnd# |CAN2| #BusEnd# |FDCAN2| */
  //--- end generated part --- Block end #Hdr_applILTxPending#; do not delete this line! Add application code below this line.
  //--- begin generated part --- Block start #Body_applILTxPending#; do not delete this line and do not add application code in this code block!
  /* #ChannelStart# |CAN2| #BusStart# |FDCAN2| */
  /* #ChannelEnd# |CAN2| #BusEnd# |FDCAN2| */
  //--- end generated part --- Block end #Body_applILTxPending#; do not delete this line! Add application code below this line.
  return ret;
}

//--- begin generated part --- Block start <#Helper_Functions#> do not delete this line and do not add application code in this code block!
/* #ChannelStart# |CAN2| #BusStart# |FDCAN2| */
/* #ChannelEnd# |CAN2| #BusEnd# |FDCAN2| */
//--- end generated part --- Block end <#Helper_Functions#> do not delete this line! Add application code below this line.

//--- begin generated part --- Block start <#SysVar_Handler#> do not delete this line and do not add application code in this code block!
/* #ChannelStart# |CAN2| #BusStart# |FDCAN2| */
on sysvar_update sysvar::IL_CAN2::NODES::N_PAM::EnableNode
{
  ILCAN2_Enable(@this && @sysvar::IL_CAN2::enable_AllNodes);
}

on sysvar_update sysvar::IL_CAN2::enable_AllNodes
{
  ILCAN2_Enable(@this && @sysvar::IL_CAN2::NODES::N_PAM::EnableNode);
}

on sysvar_update sysvar::IL_CAN2::NODES::N_PAM::MESSAGES::CFG_DATA_CODE_RSP_PAM::TIMINGS::EnableCyclic
{
  if (@this == 1)
  {
    SetBusContext(gILCAN2_BusContext);
    ILFaultInjectionEnableMsg  (FDCAN2::PAM::CFG_DATA_CODE_RSP_PAM);
  }
  else
  {
    SetBusContext(gILCAN2_BusContext);
    ILFaultInjectionDisableMsg (FDCAN2::PAM::CFG_DATA_CODE_RSP_PAM);
  }
}

on sysvar_update sysvar::IL_CAN2::NODES::N_PAM::MESSAGES::CFG_DATA_CODE_RSP_PAM::TIMINGS::SetNormalCycle
{
  if (@this == 1 && @sysvar::IL_CAN2::NODES::N_PAM::MESSAGES::CFG_DATA_CODE_RSP_PAM::TIMINGS::EnableCyclic)
  {
    @sysvar::IL_CAN2::NODES::N_PAM::MESSAGES::CFG_DATA_CODE_RSP_PAM::TIMINGS::SelectedPeriod = 0;
  }
}

on sysvar_update sysvar::IL_CAN2::NODES::N_PAM::MESSAGES::CFG_DATA_CODE_RSP_PAM::TIMINGS::SetNewCycleContinously
{
  if (@this == 1 && @sysvar::IL_CAN2::NODES::N_PAM::MESSAGES::CFG_DATA_CODE_RSP_PAM::TIMINGS::EnableCyclic)
  {
    @sysvar::IL_CAN2::NODES::N_PAM::MESSAGES::CFG_DATA_CODE_RSP_PAM::TIMINGS::SelectedPeriod = -1;
  }
}

on sysvar_update sysvar::IL_CAN2::NODES::N_PAM::MESSAGES::CFG_DATA_CODE_RSP_PAM::TIMINGS::SelectedPeriod
{
  if (@this == 0 && @sysvar::IL_CAN2::NODES::N_PAM::MESSAGES::CFG_DATA_CODE_RSP_PAM::TIMINGS::EnableCyclic)
  {
    SetBusContext(gILCAN2_BusContext);
    gCAN2DisturbancePeriod = @sysvar::IL_CAN2::NODES::N_PAM::MESSAGES::CFG_DATA_CODE_RSP_PAM::TIMINGS::NormalCyclePeriod;
    ILFaultInjectionResetMsgCycleTime(FDCAN2::PAM::CFG_DATA_CODE_RSP_PAM);
  }
  else if (@this == 1 && @sysvar::IL_CAN2::NODES::N_PAM::MESSAGES::CFG_DATA_CODE_RSP_PAM::TIMINGS::EnableCyclic)
  {
    SetBusContext(gILCAN2_BusContext);
    gCAN2DisturbancePeriod = @sysvar::IL_CAN2::NODES::N_PAM::MESSAGES::CFG_DATA_CODE_RSP_PAM::TIMINGS::ActiveCyclePeriod;
    ILFaultInjectionSetMsgCycleTime(FDCAN2::PAM::CFG_DATA_CODE_RSP_PAM, gCAN2DisturbancePeriod);
  }
  else if (@this == -1 && @sysvar::IL_CAN2::NODES::N_PAM::MESSAGES::CFG_DATA_CODE_RSP_PAM::TIMINGS::EnableCyclic)
  {
    SetBusContext(gILCAN2_BusContext);
    gCAN2DisturbancePeriod = @sysvar::IL_CAN2::NODES::N_PAM::MESSAGES::CFG_DATA_CODE_RSP_PAM::TIMINGS::CyclePeriod;
    ILFaultInjectionSetMsgCycleTime(FDCAN2::PAM::CFG_DATA_CODE_RSP_PAM, gCAN2DisturbancePeriod);
  }
}

on sysvar_update sysvar::IL_CAN2::NODES::N_PAM::MESSAGES::CFG_DATA_CODE_RSP_PAM::TIMINGS::SendOnce
{
  if (@this == 1)
  {
    SetBusContext(gILCAN2_BusContext);
    ILSetMsgEvent(FDCAN2::PAM::CFG_DATA_CODE_RSP_PAM);
  }
}

on sysvar_update sysvar::IL_CAN2::NODES::N_PAM::MESSAGES::CVPAM_FD_Control::TIMINGS::EnableCyclic
{
  if (@this == 1)
  {
    SetBusContext(gILCAN2_BusContext);
    ILFaultInjectionEnableMsg  (FDCAN2::PAM::CVPAM_FD_Control);
  }
  else
  {
    SetBusContext(gILCAN2_BusContext);
    ILFaultInjectionDisableMsg (FDCAN2::PAM::CVPAM_FD_Control);
  }
}

on sysvar_update sysvar::IL_CAN2::NODES::N_PAM::MESSAGES::CVPAM_FD_Control::TIMINGS::SetNormalCycle
{
  if (@this == 1 && @sysvar::IL_CAN2::NODES::N_PAM::MESSAGES::CVPAM_FD_Control::TIMINGS::EnableCyclic)
  {
    @sysvar::IL_CAN2::NODES::N_PAM::MESSAGES::CVPAM_FD_Control::TIMINGS::SelectedPeriod = 0;
  }
}

on sysvar_update sysvar::IL_CAN2::NODES::N_PAM::MESSAGES::CVPAM_FD_Control::TIMINGS::SetNewCycleContinously
{
  if (@this == 1 && @sysvar::IL_CAN2::NODES::N_PAM::MESSAGES::CVPAM_FD_Control::TIMINGS::EnableCyclic)
  {
    @sysvar::IL_CAN2::NODES::N_PAM::MESSAGES::CVPAM_FD_Control::TIMINGS::SelectedPeriod = -1;
  }
}

on sysvar_update sysvar::IL_CAN2::NODES::N_PAM::MESSAGES::CVPAM_FD_Control::TIMINGS::SelectedPeriod
{
  if (@this == 0 && @sysvar::IL_CAN2::NODES::N_PAM::MESSAGES::CVPAM_FD_Control::TIMINGS::EnableCyclic)
  {
    SetBusContext(gILCAN2_BusContext);
    gCAN2DisturbancePeriod = @sysvar::IL_CAN2::NODES::N_PAM::MESSAGES::CVPAM_FD_Control::TIMINGS::NormalCyclePeriod;
    ILFaultInjectionResetMsgCycleTime(FDCAN2::PAM::CVPAM_FD_Control);
  }
  else if (@this == 1 && @sysvar::IL_CAN2::NODES::N_PAM::MESSAGES::CVPAM_FD_Control::TIMINGS::EnableCyclic)
  {
    SetBusContext(gILCAN2_BusContext);
    gCAN2DisturbancePeriod = @sysvar::IL_CAN2::NODES::N_PAM::MESSAGES::CVPAM_FD_Control::TIMINGS::ActiveCyclePeriod;
    ILFaultInjectionSetMsgCycleTime(FDCAN2::PAM::CVPAM_FD_Control, gCAN2DisturbancePeriod);
  }
  else if (@this == -1 && @sysvar::IL_CAN2::NODES::N_PAM::MESSAGES::CVPAM_FD_Control::TIMINGS::EnableCyclic)
  {
    SetBusContext(gILCAN2_BusContext);
    gCAN2DisturbancePeriod = @sysvar::IL_CAN2::NODES::N_PAM::MESSAGES::CVPAM_FD_Control::TIMINGS::CyclePeriod;
    ILFaultInjectionSetMsgCycleTime(FDCAN2::PAM::CVPAM_FD_Control, gCAN2DisturbancePeriod);
  }
}

on sysvar_update sysvar::IL_CAN2::NODES::N_PAM::MESSAGES::CVPAM_FD_Control::TIMINGS::SendOnce
{
  if (@this == 1)
  {
    SetBusContext(gILCAN2_BusContext);
    ILSetMsgEvent(FDCAN2::PAM::CVPAM_FD_Control);
  }
}

on sysvar_update sysvar::IL_CAN2::NODES::N_PAM::MESSAGES::CVPAM_FD_Info::TIMINGS::EnableCyclic
{
  if (@this == 1)
  {
    SetBusContext(gILCAN2_BusContext);
    ILFaultInjectionEnableMsg  (FDCAN2::PAM::CVPAM_FD_Info);
  }
  else
  {
    SetBusContext(gILCAN2_BusContext);
    ILFaultInjectionDisableMsg (FDCAN2::PAM::CVPAM_FD_Info);
  }
}

on sysvar_update sysvar::IL_CAN2::NODES::N_PAM::MESSAGES::CVPAM_FD_Info::TIMINGS::SetNormalCycle
{
  if (@this == 1 && @sysvar::IL_CAN2::NODES::N_PAM::MESSAGES::CVPAM_FD_Info::TIMINGS::EnableCyclic)
  {
    @sysvar::IL_CAN2::NODES::N_PAM::MESSAGES::CVPAM_FD_Info::TIMINGS::SelectedPeriod = 0;
  }
}

on sysvar_update sysvar::IL_CAN2::NODES::N_PAM::MESSAGES::CVPAM_FD_Info::TIMINGS::SetNewCycleContinously
{
  if (@this == 1 && @sysvar::IL_CAN2::NODES::N_PAM::MESSAGES::CVPAM_FD_Info::TIMINGS::EnableCyclic)
  {
    @sysvar::IL_CAN2::NODES::N_PAM::MESSAGES::CVPAM_FD_Info::TIMINGS::SelectedPeriod = -1;
  }
}

on sysvar_update sysvar::IL_CAN2::NODES::N_PAM::MESSAGES::CVPAM_FD_Info::TIMINGS::SelectedPeriod
{
  if (@this == 0 && @sysvar::IL_CAN2::NODES::N_PAM::MESSAGES::CVPAM_FD_Info::TIMINGS::EnableCyclic)
  {
    SetBusContext(gILCAN2_BusContext);
    gCAN2DisturbancePeriod = @sysvar::IL_CAN2::NODES::N_PAM::MESSAGES::CVPAM_FD_Info::TIMINGS::NormalCyclePeriod;
    ILFaultInjectionResetMsgCycleTime(FDCAN2::PAM::CVPAM_FD_Info);
  }
  else if (@this == 1 && @sysvar::IL_CAN2::NODES::N_PAM::MESSAGES::CVPAM_FD_Info::TIMINGS::EnableCyclic)
  {
    SetBusContext(gILCAN2_BusContext);
    gCAN2DisturbancePeriod = @sysvar::IL_CAN2::NODES::N_PAM::MESSAGES::CVPAM_FD_Info::TIMINGS::ActiveCyclePeriod;
    ILFaultInjectionSetMsgCycleTime(FDCAN2::PAM::CVPAM_FD_Info, gCAN2DisturbancePeriod);
  }
  else if (@this == -1 && @sysvar::IL_CAN2::NODES::N_PAM::MESSAGES::CVPAM_FD_Info::TIMINGS::EnableCyclic)
  {
    SetBusContext(gILCAN2_BusContext);
    gCAN2DisturbancePeriod = @sysvar::IL_CAN2::NODES::N_PAM::MESSAGES::CVPAM_FD_Info::TIMINGS::CyclePeriod;
    ILFaultInjectionSetMsgCycleTime(FDCAN2::PAM::CVPAM_FD_Info, gCAN2DisturbancePeriod);
  }
}

on sysvar_update sysvar::IL_CAN2::NODES::N_PAM::MESSAGES::CVPAM_FD_Info::TIMINGS::SendOnce
{
  if (@this == 1)
  {
    SetBusContext(gILCAN2_BusContext);
    ILSetMsgEvent(FDCAN2::PAM::CVPAM_FD_Info);
  }
}

on sysvar_update sysvar::IL_CAN2::NODES::N_PAM::MESSAGES::DIAGNOSTIC_ROE_FD_PAM::TIMINGS::EnableCyclic
{
  if (@this == 1)
  {
    SetBusContext(gILCAN2_BusContext);
    ILFaultInjectionEnableMsg  (FDCAN2::PAM::DIAGNOSTIC_ROE_FD_PAM);
  }
  else
  {
    SetBusContext(gILCAN2_BusContext);
    ILFaultInjectionDisableMsg (FDCAN2::PAM::DIAGNOSTIC_ROE_FD_PAM);
  }
}

on sysvar_update sysvar::IL_CAN2::NODES::N_PAM::MESSAGES::DIAGNOSTIC_ROE_FD_PAM::TIMINGS::SetNormalCycle
{
  if (@this == 1 && @sysvar::IL_CAN2::NODES::N_PAM::MESSAGES::DIAGNOSTIC_ROE_FD_PAM::TIMINGS::EnableCyclic)
  {
    @sysvar::IL_CAN2::NODES::N_PAM::MESSAGES::DIAGNOSTIC_ROE_FD_PAM::TIMINGS::SelectedPeriod = 0;
  }
}

on sysvar_update sysvar::IL_CAN2::NODES::N_PAM::MESSAGES::DIAGNOSTIC_ROE_FD_PAM::TIMINGS::SetNewCycleContinously
{
  if (@this == 1 && @sysvar::IL_CAN2::NODES::N_PAM::MESSAGES::DIAGNOSTIC_ROE_FD_PAM::TIMINGS::EnableCyclic)
  {
    @sysvar::IL_CAN2::NODES::N_PAM::MESSAGES::DIAGNOSTIC_ROE_FD_PAM::TIMINGS::SelectedPeriod = -1;
  }
}

on sysvar_update sysvar::IL_CAN2::NODES::N_PAM::MESSAGES::DIAGNOSTIC_ROE_FD_PAM::TIMINGS::SelectedPeriod
{
  if (@this == 0 && @sysvar::IL_CAN2::NODES::N_PAM::MESSAGES::DIAGNOSTIC_ROE_FD_PAM::TIMINGS::EnableCyclic)
  {
    SetBusContext(gILCAN2_BusContext);
    gCAN2DisturbancePeriod = @sysvar::IL_CAN2::NODES::N_PAM::MESSAGES::DIAGNOSTIC_ROE_FD_PAM::TIMINGS::NormalCyclePeriod;
    ILFaultInjectionResetMsgCycleTime(FDCAN2::PAM::DIAGNOSTIC_ROE_FD_PAM);
  }
  else if (@this == 1 && @sysvar::IL_CAN2::NODES::N_PAM::MESSAGES::DIAGNOSTIC_ROE_FD_PAM::TIMINGS::EnableCyclic)
  {
    SetBusContext(gILCAN2_BusContext);
    gCAN2DisturbancePeriod = @sysvar::IL_CAN2::NODES::N_PAM::MESSAGES::DIAGNOSTIC_ROE_FD_PAM::TIMINGS::ActiveCyclePeriod;
    ILFaultInjectionSetMsgCycleTime(FDCAN2::PAM::DIAGNOSTIC_ROE_FD_PAM, gCAN2DisturbancePeriod);
  }
  else if (@this == -1 && @sysvar::IL_CAN2::NODES::N_PAM::MESSAGES::DIAGNOSTIC_ROE_FD_PAM::TIMINGS::EnableCyclic)
  {
    SetBusContext(gILCAN2_BusContext);
    gCAN2DisturbancePeriod = @sysvar::IL_CAN2::NODES::N_PAM::MESSAGES::DIAGNOSTIC_ROE_FD_PAM::TIMINGS::CyclePeriod;
    ILFaultInjectionSetMsgCycleTime(FDCAN2::PAM::DIAGNOSTIC_ROE_FD_PAM, gCAN2DisturbancePeriod);
  }
}

on sysvar_update sysvar::IL_CAN2::NODES::N_PAM::MESSAGES::DIAGNOSTIC_ROE_FD_PAM::TIMINGS::SendOnce
{
  if (@this == 1)
  {
    SetBusContext(gILCAN2_BusContext);
    ILSetMsgEvent(FDCAN2::PAM::DIAGNOSTIC_ROE_FD_PAM);
  }
}

on sysvar_update sysvar::IL_CAN2::NODES::N_PAM::MESSAGES::DIAGNOSTIC_ROE_PAM::TIMINGS::EnableCyclic
{
  if (@this == 1)
  {
    SetBusContext(gILCAN2_BusContext);
    ILFaultInjectionEnableMsg  (FDCAN2::PAM::DIAGNOSTIC_ROE_PAM);
  }
  else
  {
    SetBusContext(gILCAN2_BusContext);
    ILFaultInjectionDisableMsg (FDCAN2::PAM::DIAGNOSTIC_ROE_PAM);
  }
}

on sysvar_update sysvar::IL_CAN2::NODES::N_PAM::MESSAGES::DIAGNOSTIC_ROE_PAM::TIMINGS::SetNormalCycle
{
  if (@this == 1 && @sysvar::IL_CAN2::NODES::N_PAM::MESSAGES::DIAGNOSTIC_ROE_PAM::TIMINGS::EnableCyclic)
  {
    @sysvar::IL_CAN2::NODES::N_PAM::MESSAGES::DIAGNOSTIC_ROE_PAM::TIMINGS::SelectedPeriod = 0;
  }
}

on sysvar_update sysvar::IL_CAN2::NODES::N_PAM::MESSAGES::DIAGNOSTIC_ROE_PAM::TIMINGS::SetNewCycleContinously
{
  if (@this == 1 && @sysvar::IL_CAN2::NODES::N_PAM::MESSAGES::DIAGNOSTIC_ROE_PAM::TIMINGS::EnableCyclic)
  {
    @sysvar::IL_CAN2::NODES::N_PAM::MESSAGES::DIAGNOSTIC_ROE_PAM::TIMINGS::SelectedPeriod = -1;
  }
}

on sysvar_update sysvar::IL_CAN2::NODES::N_PAM::MESSAGES::DIAGNOSTIC_ROE_PAM::TIMINGS::SelectedPeriod
{
  if (@this == 0 && @sysvar::IL_CAN2::NODES::N_PAM::MESSAGES::DIAGNOSTIC_ROE_PAM::TIMINGS::EnableCyclic)
  {
    SetBusContext(gILCAN2_BusContext);
    gCAN2DisturbancePeriod = @sysvar::IL_CAN2::NODES::N_PAM::MESSAGES::DIAGNOSTIC_ROE_PAM::TIMINGS::NormalCyclePeriod;
    ILFaultInjectionResetMsgCycleTime(FDCAN2::PAM::DIAGNOSTIC_ROE_PAM);
  }
  else if (@this == 1 && @sysvar::IL_CAN2::NODES::N_PAM::MESSAGES::DIAGNOSTIC_ROE_PAM::TIMINGS::EnableCyclic)
  {
    SetBusContext(gILCAN2_BusContext);
    gCAN2DisturbancePeriod = @sysvar::IL_CAN2::NODES::N_PAM::MESSAGES::DIAGNOSTIC_ROE_PAM::TIMINGS::ActiveCyclePeriod;
    ILFaultInjectionSetMsgCycleTime(FDCAN2::PAM::DIAGNOSTIC_ROE_PAM, gCAN2DisturbancePeriod);
  }
  else if (@this == -1 && @sysvar::IL_CAN2::NODES::N_PAM::MESSAGES::DIAGNOSTIC_ROE_PAM::TIMINGS::EnableCyclic)
  {
    SetBusContext(gILCAN2_BusContext);
    gCAN2DisturbancePeriod = @sysvar::IL_CAN2::NODES::N_PAM::MESSAGES::DIAGNOSTIC_ROE_PAM::TIMINGS::CyclePeriod;
    ILFaultInjectionSetMsgCycleTime(FDCAN2::PAM::DIAGNOSTIC_ROE_PAM, gCAN2DisturbancePeriod);
  }
}

on sysvar_update sysvar::IL_CAN2::NODES::N_PAM::MESSAGES::DIAGNOSTIC_ROE_PAM::TIMINGS::SendOnce
{
  if (@this == 1)
  {
    SetBusContext(gILCAN2_BusContext);
    ILSetMsgEvent(FDCAN2::PAM::DIAGNOSTIC_ROE_PAM);
  }
}

on sysvar_update sysvar::IL_CAN2::NODES::N_PAM::MESSAGES::PDC_INFO_FD_PAM::TIMINGS::EnableCyclic
{
  if (@this == 1)
  {
    SetBusContext(gILCAN2_BusContext);
    ILFaultInjectionEnableMsg  (FDCAN2::PAM::PDC_INFO_FD_PAM);
  }
  else
  {
    SetBusContext(gILCAN2_BusContext);
    ILFaultInjectionDisableMsg (FDCAN2::PAM::PDC_INFO_FD_PAM);
  }
}

on sysvar_update sysvar::IL_CAN2::NODES::N_PAM::MESSAGES::PDC_INFO_FD_PAM::TIMINGS::SetNormalCycle
{
  if (@this == 1 && @sysvar::IL_CAN2::NODES::N_PAM::MESSAGES::PDC_INFO_FD_PAM::TIMINGS::EnableCyclic)
  {
    @sysvar::IL_CAN2::NODES::N_PAM::MESSAGES::PDC_INFO_FD_PAM::TIMINGS::SelectedPeriod = 0;
  }
}

on sysvar_update sysvar::IL_CAN2::NODES::N_PAM::MESSAGES::PDC_INFO_FD_PAM::TIMINGS::SetNewCycleContinously
{
  if (@this == 1 && @sysvar::IL_CAN2::NODES::N_PAM::MESSAGES::PDC_INFO_FD_PAM::TIMINGS::EnableCyclic)
  {
    @sysvar::IL_CAN2::NODES::N_PAM::MESSAGES::PDC_INFO_FD_PAM::TIMINGS::SelectedPeriod = -1;
  }
}

on sysvar_update sysvar::IL_CAN2::NODES::N_PAM::MESSAGES::PDC_INFO_FD_PAM::TIMINGS::SelectedPeriod
{
  if (@this == 0 && @sysvar::IL_CAN2::NODES::N_PAM::MESSAGES::PDC_INFO_FD_PAM::TIMINGS::EnableCyclic)
  {
    SetBusContext(gILCAN2_BusContext);
    gCAN2DisturbancePeriod = @sysvar::IL_CAN2::NODES::N_PAM::MESSAGES::PDC_INFO_FD_PAM::TIMINGS::NormalCyclePeriod;
    ILFaultInjectionResetMsgCycleTime(FDCAN2::PAM::PDC_INFO_FD_PAM);
  }
  else if (@this == 1 && @sysvar::IL_CAN2::NODES::N_PAM::MESSAGES::PDC_INFO_FD_PAM::TIMINGS::EnableCyclic)
  {
    SetBusContext(gILCAN2_BusContext);
    gCAN2DisturbancePeriod = @sysvar::IL_CAN2::NODES::N_PAM::MESSAGES::PDC_INFO_FD_PAM::TIMINGS::ActiveCyclePeriod;
    ILFaultInjectionSetMsgCycleTime(FDCAN2::PAM::PDC_INFO_FD_PAM, gCAN2DisturbancePeriod);
  }
  else if (@this == -1 && @sysvar::IL_CAN2::NODES::N_PAM::MESSAGES::PDC_INFO_FD_PAM::TIMINGS::EnableCyclic)
  {
    SetBusContext(gILCAN2_BusContext);
    gCAN2DisturbancePeriod = @sysvar::IL_CAN2::NODES::N_PAM::MESSAGES::PDC_INFO_FD_PAM::TIMINGS::CyclePeriod;
    ILFaultInjectionSetMsgCycleTime(FDCAN2::PAM::PDC_INFO_FD_PAM, gCAN2DisturbancePeriod);
  }
}

on sysvar_update sysvar::IL_CAN2::NODES::N_PAM::MESSAGES::PDC_INFO_FD_PAM::TIMINGS::SendOnce
{
  if (@this == 1)
  {
    SetBusContext(gILCAN2_BusContext);
    ILSetMsgEvent(FDCAN2::PAM::PDC_INFO_FD_PAM);
  }
}

on sysvar_update sysvar::NM_CAN2::NODES::N_PAM::OpenNodePanel
{
  OpenNodePanel("FDCAN2::PAM", 1);
}

on sysvar_update sysvar::NM_CAN2::StateControl::CloseNodePanels
{
  OpenNodePanel("FDCAN2::PAM", 0);
}

/* #ChannelEnd# |CAN2| #BusEnd# |FDCAN2| */
//--- end generated part --- Block end <#SysVar_Handler#> do not delete this line! Add application code below this line.

//--- begin generated part --- Block start <#MsgUpdateFcns#> do not delete this line and do not add application code in this code block!
/* #ChannelStart# |CAN2| #BusStart# |FDCAN2| */
/* #ChannelEnd# |CAN2| #BusEnd# |FDCAN2| */
//--- end generated part --- Block end <#MsgUpdateFcns#> do not delete this line! Add application code below this line.

