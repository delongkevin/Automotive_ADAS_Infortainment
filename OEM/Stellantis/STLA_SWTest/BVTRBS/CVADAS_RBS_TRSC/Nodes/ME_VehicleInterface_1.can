/*@!Encoding:1252*/
/*@!Encoding:1252*/
variables
{
// Global variables used for WheelSpeed
int WhlSpd_FL_Backup;
int WhlSpd_FR_Backup;
int WhlSpd_RL_Backup;
int WhlSpd_RR_Backup;

// View switch variables
int VIEWLOCK                    = 0;
  
//Steering wheel fault
int CENTER                      = 0;

//#Sweep#
  //Steering Wheel Angle
msTimer t_StwAngle_Sweep;
int STEERINGDIRECTION           = 1;
int ANGLE;
  //Speed
msTimer t_VehSpeed_Sweep;
int SPEEDDIRECTION           = 1;
int SPEED;
  
  //View Switch
msTimer t_ViewSwitch_Sweep;
int Repeat_Count;

  //Display Resolution
msTimer t_SetDisplayRes;
int SetDisplayResState = 0;

  //Set back Camera Display State
msTimer t_ResetCameraDisplayState;
  
    
//Messages Control:
  //Fault Value:
float ODOMETER_FAULT = 1677721.5; // SNA = 0xFFFFFF
float VEHSPEED_FAULT = 511.9921875; //SNA = 0xFFFF
float STWANGLE_FAULT = 6143.5; // SNA = 0x3FFF
float BATTERYVOLT_FAULT = 25.5; // SNA = 0xFF
int IGNITION_FAULT = 7;
int NETCFGSTATINT_FAULT = 3;
int VCBODYSTYLE_FAULT = 0xF;
int VCCOUNTRY_FAULT = 0x1F;
int VCMODELYEAR_FAULT = 2063;
int VCVEHLINE_FAULT = 0xFF;
int VCCHASSISTYPE_FAULT = 0x7F;
int VCVEHCFG1STAT_FAULT = 3;
int VCVEHCFG3STAT_FAULT = 3;
int VCVEHCFG5STAT_FAULT = 3;
int VCVEHCFG7STAT_FAULT = 3;
int CMTCHSTAT_FAULT = 7;
word TOUCHX_FAULT = 65535; // SNA = 0xFFFF
word TOUCHY_FAULT = 65535; // SNA = 0xFFFF
int VCVEHCFG2STAT_FAULT = 3;
int VCSPECIALPKGIC_FAULT = 255; // 0xFF
int VCVEHCFG8STAT_FAULT = 3;
int VCLHDRHD_FAULT = 3;
int TGWCAMERADISPSTAT_FAULT = 0xF;

  //Fault Backup Buffer
float ODOMETER_BUFFER;
int VEHSPEED_BUFFER;
int STWANGLE_BUFFER;
int REVGEAR_BUFFER;
float BATTERYVOLT_BUFFER;
int VCBODYSTYLE_BUFFER;
int NETCFGSTATINT_BUFFER;
int VCCOUNTRY_BUFFER;
int VCMODELYEAR_BUFFER;
int VCVEHLINE_BUFFER;
int VCVEHCFG1STAT_BUFFER;
int VCVEHCFG3STAT_BUFFER;
int VCVEHCFG5STAT_BUFFER;
int VCVEHCFG7STAT_BUFFER;
int VCVEHCFGFEATURE_BUFFER;
int CMTCHSTAT_BUFFER;
int TOUCHX_BUFFER;
int TOUCHY_BUFFER;
int TGWDISPSTAT_BUFFER;
int GEARAUTOMATIC_BUFFER;
int IGNSTATUS_BUFFER;
int VCCHASSISTYPE;
int VCVEHCFG2STAT_BUFFER;
int VCSPECIALPKGIC_BUFFER;
int VCVEHCFG8STAT_BUFFER;
int VCLHDRHD_BUFFER;
int TGWCAMERADISPSTAT_BUFFER;
  
//Default
mstimer t_DefaultDelay;
  
//Display Control
//mstimer t_Touch;
int touch_count;
msTimer t_ResetViewSwitchButtons;
  
//message CM_CTRL TouchMsg; // this msg must forced without IL
//message TGW_A1 DisplayStateMsg; // this msg must forced without IL
  
//Vin
qword VIN_BUFFER;
int VIN_BUFFER1;
qword VIN_SET_BUFFER;
  
int ASCMSTATUS_BUFFER;
int LEVELFL_BUFFER;
int LEVELFR_BUFFER;
int LEVELRL_BUFFER;
int LEVELRR_BUFFER;
  
msTimer t_Emc_AutoMode; // related to the Task 3018688
msTimer t_Emc_AutoMode_Delay;
msTimer t_ResetViewButtonState;
msTimer t_ResetTouch;
msTimer t_TouchCommand;
}

on preStart
{
  
}

on start
{
//initial values from the DBC---------------

//------------------------------------------
  
//initial values general--------------------
    @MEnv_StwAngleSweepTime_SET_INT_1 = 60;  
    @MEnv_StwAngleSweepMin_SET_INT_1 = -500;
    @MEnv_StwAngleSweepMax_SET_INT_1 = 500;
    @MEnv_StwAngleSweepDel_SET_INT_1 = 8;
    @MEnv_StwAngleSweep_SET_INT_1 = 0; 
    @MEnv_EmvViewSweepTime_SET_INT_1 = 2000;
    @MEnv_EmvViewSweep_SET_BOL_1 = 0;
  
    @MEnv_SweepRearAndTop_SET_BOL_1 = 1;
    @MEnv_SweepRearCross_SET_BOL_1 = 1;
    @MEnv_SweepFrontCross_SET_BOL_1 = 1;
    @MEnv_SweepFrontAndTop_SET_BOL_1 = 1;
    @MEnv_SweepTowBallView_SET_BOL_1 = 1;
    @MEnv_ViewSwitchSweepTime_SET_INT_1 = 1000;
  
    @MEnv_VehSpeedSweepTime_SET_INT_1 = 2000;  
    @MEnv_VehSpeedSweepMin_SET_INT_1 = 0;
    @MEnv_VehSpeedSweepMax_SET_INT_1 = 60;
    @MEnv_VehSpeedSweepDel_SET_INT_1 = 10;
    @MEnv_VehSpeedSweep_SET_BOL_1 = 0; 

    @MEnv_DisplayRes_SET_INT_1 = 0xFF; // undefined
//------------------------------------------
  
//initial variant
    @MEnv_DefaultVariant_SET_INT_1 = 7; // Vehicle Variant JT
  
  
    @MEnv_EmvMode_SET_INT_2 = 0;
}

on preStop
{
    @MEnv_Default_SET_BOL_1 = 0;
}

on envVar MEnv_Default_SET_BOL_1
{
    // Sets all MAGNA ENVs and SYSVARs to valid values
    if(@this == 1)
    {
        //PROXI string default values
        @MEnv_DriverSide_SET_INT_3 = 0;
        @MEnv_Wheelbase_SET_INT_3 = 1;
        @MEnv_SideDistanceWarning_SET_INT_3 = 1;
        @MEnv_SteeringRatioRackPinionType_SET_INT_3 = 2;
        @MEnv_GearBoxType_SET_INT_3 = 4;
        @MEnv_VehicleLineConfiguration_SET_INT_3 = 93;
        @MEnv_PamConfiguration_SET_INT_3 = 1;
        @MEnv_SurroundViewCamera_SET_INT_3 = 1;
        @MEnv_CountryCode_SET_INT_3 = 2;
        @MEnv_CarShapeConfiguration_SET_INT_3 = 8;
        @MEnv_ModelYear_SET_INT_3 = 0x15;
      
        @MEnv_SendProxiString_SET_INT_3 = 1;
      
        //---------------------------------------------
      
        ANGLE = @MEnv_StwAngle_SET_INT_1;
      
        enableControl("Main", "DefaultVariant_TrackBar", 0);
      
        @MEnv_ActivateAllNodes_SET_BOL_2 = 1; // start the nodes
      
        @MEnv_StwAngle_SET_INT_1 = 0;
        @MEnv_StwAngleSensor_SET_INT_1 = 0; // OK
        @MEnv_VehSpeed_SET_FLT_1 = 0;
        @MEnv_TransmissionType_SET_INT_1 = 0; // Automatic
        @MEnv_VcVehCfg7Stat_SET_INT_1 = 1;
        @MEnv_VcSvcPrsnt_SET_INT_1 = 1;
        @MEnv_VcBodyStyle_SET_INT_1 = 7; // 4DP
        @MEnv_VcCountry_SET_INT_1 = 2; // USA
        @MEnv_VcModelYear_SET_INT_1 = 2019;
        @MEnv_VcVehCfg1Stat_SET_INT_1 = 1;
        @MEnv_NetCfgStatInt_SET_INT_1 = 1;
        @MEnv_VcVehCfg3Stat_SET_INT_1 = 1;
        @MEnv_VcChassisType_SET_INT_1 = 0;
        @MEnv_Odo_SET_FLT_1 = 0;
        @MEnv_GearAutomatic_SET_INT_1 = 0; // LVR_P
        @MEnv_BatteryVolt_SET_FLT_1 = 12;
        @MEnv_BatteryVoltFlt_SET_BOL_1 = 0;
        @MEnv_IgnStatus_SET_INT_1 = 4;
//        @EnvClamp15 = 1;
//        @EnvClamp30 = 1;
        @MEnv_VcVehCfg2Stat_SET_INT_1 = 1;
        @MEnv_VcVehCfg8Stat_SET_INT_1 = 1;
        @MEnv_VcWhlBaseLength_SET_INT_1 = 2;
        @MEnv_VcSteeringCfactor_SET_INT_1 = 0;
        @MEnv_AscmStatus_SET_INT_1 = 4;
        @MEnv_VcVehCfg5Stat_SET_INT_1 = 1;
        @MEnv_VcOFFroadCamera_SET_INT_1 = 1;
      
        @MEnv_AuxCameraStat_SET_INT_1 = 0;
        @MEnv_VcAuxTrailerCamPrsnt_SET_BOL_1 = 0;
        @MEnv_VcSpecialPkgIc_SET_INT_1 = 0;
      
        switch(@MEnv_DefaultVariant_SET_INT_1)
        {
            case 0: // Vehicle Variant DF
            {
                @MEnv_VcVehLine_SET_INT_1 = 48;
              
                @MEnv_VcWhlBaseLength_SET_INT_1 = 9;
                @MEnv_VcSteeringCfactor_SET_INT_1 = 1;
                @MEnv_VcRrDuallyPrsnt_SET_INT_1 = 0;  
                break;
            }
            case 1: // Vehicle Variant DD
            {
                @MEnv_VcVehLine_SET_INT_1 = 32;
              
                @MEnv_VcWhlBaseLength_SET_INT_1 = 8;
                @MEnv_VcSteeringCfactor_SET_INT_1 = 1;
                @MEnv_VcRrDuallyPrsnt_SET_INT_1 = 0;  
                break;
            }
            case 2: // Vehicle Variant DP
            {
                @MEnv_VcVehLine_SET_INT_1 = 33;
              
                @MEnv_VcWhlBaseLength_SET_INT_1 = 11;
                @MEnv_VcSteeringCfactor_SET_INT_1 = 2;
                @MEnv_VcRrDuallyPrsnt_SET_INT_1 = 1;  
                break;
            }
            case 3: // Vehicle Variant Magna Jeep
            {
                @MEnv_VcVehLine_SET_INT_1 = 254;
              
                @MEnv_VcWhlBaseLength_SET_INT_1 = 2;
                @MEnv_VcSteeringCfactor_SET_INT_1 = 0;
                @MEnv_VcRrDuallyPrsnt_SET_INT_1 = 0;  
                break;
            }
            /*
            case 4: // Vehicle Variant DT
            {
                @MEnv_VcVehLine_SET_INT_1 = 53;
                break;
            }
            */
            case 5: // Vehicle Variant D2
            {
                @MEnv_VcVehLine_SET_INT_1 = 31;
              
                @MEnv_VcWhlBaseLength_SET_INT_1 = 5;
                @MEnv_VcSteeringCfactor_SET_INT_1 = 0;
                @MEnv_VcRrDuallyPrsnt_SET_INT_1 = 0;  
                break;
            }
            case 6: // Vehicle Variant DJ
            {
                @MEnv_VcVehLine_SET_INT_1 = 34;
              
                @MEnv_VcWhlBaseLength_SET_INT_1 = 2;
                @MEnv_VcSteeringCfactor_SET_INT_1 = 0;
                @MEnv_VcRrDuallyPrsnt_SET_INT_1 = 0;              
                break;
            }
            case 7: // Vehicle Variant JT
            {
                @MEnv_VcVehLine_SET_INT_1 = 55;
              
                @MEnv_VcWhlBaseLength_SET_INT_1 = 2;
                @MEnv_VcSteeringCfactor_SET_INT_1 = 0;
                @MEnv_VcRrDuallyPrsnt_SET_INT_1 = 0;              
                break;
            }
            case 99: // no Variant choosed
            {
                write("Magna Warning: No Default Variant is choosed!");
                break;
            }
        }
        
        @MEnv_DisplayRes_SET_INT_1 = 0xFF; // undefined
      
        setTimer(t_DefaultDelay, 5000); // Delay to initilize the Signals after the Nodes are started
    }
    else
    {
        // ignore button release
    }
}

on timer t_DefaultDelay
{
char vindata_buffer[20];
  
    // = getSignal(APPL_ECU_CVPM); Diganosis Signal
   // @MEnv_BatteryVolt_GET_FLT_1 = getSignal(BatteryVoltageLevel);
//    @MEnv_CFGFeature_GET_INT_1 = getSignal(CFG_FEATURE);
//    @MEnv_CfgSet_GET_INT_1 = getSignal(CFG_SET);
//    @MEnv_CfgStatRq_GET_INT_1 = getSignal(CFG_STAT_RQ);
    @MEnv_CmTchStat_GET_INT_1 = getSignal(CM_TCH_STAT);
    @MEnv_CmTchXCoord_GET_INT_1 = getSignal(CM_TCH_X_COORD);
    @MEnv_CmTchYCoord_GET_INT_1 = getSignal(CM_TCH_Y_COORD);
    @MEnv_IgnStatus_GET_INT_1 = getSignal(CmdIgnSts);
    // = getSignal(D_RQ_CVPM); Diagnosis Signal
    // = getSignal(DG_RQ_GLOBAL_UDS); Diagnosis Signal
      @MEnv_DoorDrv_GET_INT_1 = getSignal(DriverDoorSts);
      @MEnv_DoorRl_GET_INT_1 = getSignal(LHRDoorSts);
    @MEnv_Language_GET_INT_1 = getSignal(LanguageSelection);
//      @MEnv_StwAngle_GET_INT_1 = getSignal(LWSAngle);
//      @MEnv_StwAngleSensor_GET_INT_1 = getSignal(LWSFailSts);
//    @MEnv_NetCfgStatInt_GET_INT_1 = getSignal(NET_CFG_STAT_INT);
    @MEnv_Odo_GET_FLT_1 = getSignal(TotalOdometer);
    @MEnv_GearAutomatic_GET_INT_1 = getSignal(ShiftLeverPosition );
    @MEnv_DoorPsg_GET_INT_1 = getSignal(PsngrDoorSts);
    @MEnv_ParkAidWarnFc_GET_INT_1 = getSignal(Alert_CHF);
    @MEnv_ParkAidWarnFl_GET_INT_1 = getSignal(Alert_CHR);
    @MEnv_ParkAidWarnFr_GET_INT_1 = getSignal(Alert_LHF);
    @MEnv_ParkAidWarnRc_GET_INT_1 = getSignal(Alert_LHR);
    @MEnv_ParkAidWarnRl_GET_INT_1 = getSignal(Alert_RHF);
    @MEnv_ParkAidWarnRr_GET_INT_1 = getSignal(Alert_RHR);
    @MEnv_DoorRr_GET_INT_1 = getSignal(RHRDoorSts);
   // @MEnv_RevGear_GET_INT_1 = getSignal(ReverseGearSts);
    //@MEnv_DisplayStatus_GET_INT_1 = getSignal(SVC_DisplaySts);
    //@MEnv_SvcSoftButton_GET_BOL_1 = getSignal(SVC_SoftBtn_Rq);
//    @MEnv_DisplayStatus_GET_INT_1 = getSignal(TGW_DISP_STAT);
    @MEnv_DoorDeckLid_GET_INT_1 = getSignal(RHatchSts);
//    @MEnv_VcBodyStyle_GET_INT_1 = getSignal(VC_BODY_STYLE);
//    @MEnv_VcChassisType_GET_INT_1 = getSignal(VC_ChassisType);
    //@MEnv_VcCountry_GET_INT_1 = getSignal(LanguageSelection);
//    @MEnv_VcModelYear_GET_INT_1 = getSignal(VC_MODEL_YEAR);
//    @MEnv_VcSvcPrsnt_GET_INT_1 = getSignal(VC_SVC_Prsnt);
//    @MEnv_VcTcaseTyp_GET_INT_1 = getSignal(VC_TcaseTyp);
//    @MEnv_VcTransEquipped_GET_INT_1 = getSignal(VC_Trans_Equipped);
//    @MEnv_VcVehLine_GET_INT_1 = getSignal(VC_VEH_LINE);
//    @MEnv_VcVehCfg1Stat_GET_INT_1 = getSignal(VC_VehCfg1_Stat);
//    @MEnv_VcVehCfg2Stat_GET_INT_1 = getSignal(VC_VehCfg2_Stat);
//    @MEnv_VcVehCfg3Stat_GET_INT_1 = getSignal(VC_VehCfg3_Stat);
//    @MEnv_VcVehCfg7Stat_GET_INT_1 = getSignal(VC_VehCfg7_Stat);
//    @MEnv_VcVehCfg8Stat_GET_INT_1 = getSignal(VC_VehCfg8_Stat);
    @MEnv_VehSpeed_GET_FLT_1 = getSignal(VehicleSpeedVSOSig);
    @MEnv_VinData_GET_INT_1 = getRawSignal(VIN_DATA); // handled by other function
    @MEnv_VinMsg_GET_INT_1 = getSignal(VIN_MSG);
    //@MEnv_VcWhlBaseLength_GET_INT_1 = getSignal(VC_WHL_BASE_LENGTH);
    //@MEnv_AscmStatus_GET_INT_1 = getSignal(ASCM_Stat);
  
    //Set DisplayResolution to default resolution.
    //This will trigger event to send out to ECU
    @MEnv_DisplayRes_SET_INT_1 = 0;
  
    if(@MEnv_EmvControl_SET_BOL_2 == 1)
    {
        setTimer(t_Emc_AutoMode, 500); // related to the Task 3018688
    }
    else
    {
        //do nothing
    }
}

on envVar MEnv_IgnStatus_SET_INT_1
{
    setSignal(CmdIgnSts, @this);
}

on signal CmdIgnSts
{
    @MEnv_IgnStatus_GET_INT_1 = this;
}

on envVar MEnv_IgnStatusFlt_SET_BOL_1
{
    if(@this==1)    // checkbox checked
    {
        IGNSTATUS_BUFFER = @MEnv_IgnStatus_SET_INT_1;
        @MEnv_IgnStatus_SET_INT_1 = IGNITION_FAULT;
    }
    else
    {
        //checkbox unchecked, put last value before fault
        @MEnv_IgnStatus_SET_INT_1 = IGNSTATUS_BUFFER;
    }
}

on envVar MEnv_WhlSpdFlFlt_SET_BOL_1
{
    if(@this==1)    // checkbox checked
    {
        WhlSpd_FL_Backup = @MEnv_WhlSpdFl_SET_INT_1;
        @MEnv_WhlSpdFl_SET_INT_1 = 0x7FFF;
    }
    else
    {
        //checkbox unchecked, put last value before fault
        @MEnv_WhlSpdFl_SET_INT_1 = WhlSpd_FL_Backup;
    }
}

on envVar MEnv_WhlSpdFrFlt_SET_BOL_1
{
    if(@this == 1)    // checkbox checked
    {
        WhlSpd_FR_Backup = @MEnv_WhlSpdFr_SET_INT_1;
        @MEnv_WhlSpdFr_SET_INT_1 = 0x7FFF;
    }
    else
    {
        //checkbox unchecked, put last value before fault
        @MEnv_WhlSpdFr_SET_INT_1 = WhlSpd_FR_Backup;
    }
}

on envVar MEnv_WhlSpdRlFlt_SET_BOL_1
{
    if(@this == 1)    // checkbox checked
    {
        WhlSpd_RL_Backup = @MEnv_WhlSpdRl_SET_INT_1;
        @MEnv_WhlSpdRl_SET_INT_1 = 0x7FFF;
    }
    else
    {
        //checlbox unchecked, put last value before fault
        @MEnv_WhlSpdRl_SET_INT_1 = WhlSpd_RL_Backup;
    }
}

on envVar MEnv_WhlSpdRrFlt_SET_BOL_1
{
    if(@this == 1)    // checkbox checked
    {
        WhlSpd_RR_Backup = @MEnv_WhlSpdRr_SET_INT_1;
        @MEnv_WhlSpdRr_SET_INT_1 = 0x7FFF;
    }
    else
    {
        //checlbox unchecked, put last value before fault
        @MEnv_WhlSpdRr_SET_INT_1 = WhlSpd_RR_Backup;
    }
}

on envVar MEnv_VehSpeed_SET_FLT_1
{
    setsignal(VehicleSpeedVSOSig, @this);
}

on envVar MEnv_VehSpeedFlt_SET_BOL_1
{
    if (@this == 1)
    {
        VEHSPEED_BUFFER = @MEnv_VehSpeed_GET_FLT_1;
      
        enableControl("Main", "Speed_TrackBar", 0);
        enableControl("Main", "Speed_Input/Output", 0); 
      
        @MEnv_VehSpeed_SET_FLT_1 = VEHSPEED_FAULT;
    }
    else
    {
        @MEnv_VehSpeed_SET_FLT_1 = VEHSPEED_BUFFER;
      
        enableControl("Main", "Speed_TrackBar", 1);
        enableControl("Main", "Speed_Input/Output", 1); 
    }
}

on signal VehicleSpeedVSOSig
{
    @MEnv_VehSpeed_GET_FLT_1 = this;
}

//Speed: #Sweep#

on envVar MEnv_VehSpeedSweep_SET_BOL_1
{
	  if (@this == 1)
    {
        if (@MEnv_VehSpeedSweepTime_SET_INT_1 != 0)
        {
            setTimer(t_VehSpeed_Sweep, @MEnv_VehSpeedSweepTime_SET_INT_1);
        }
        else
        {
            write(" Magna Warning: Speed Sweep time = %d, please enter a valid timer value! ", @MEnv_VehSpeedSweepTime_SET_INT_1);
        }
    }
    else
    {
        cancelTimer(t_VehSpeed_Sweep);
    }
}

on timer t_VehSpeed_Sweep
{
    @MEnv_VehSpeedFlt_SET_BOL_1 = 0;
  
    if (SPEEDDIRECTION == 1)
    {
        SPEED = @MEnv_VehSpeed_SET_FLT_1 + @MEnv_VehSpeedSweepDel_SET_INT_1;
      
        if (SPEED >= @MEnv_VehSpeedSweepMax_SET_INT_1)
        {
            SPEED = @MEnv_VehSpeedSweepMax_SET_INT_1;
            SPEEDDIRECTION = -1;
        }
        else
        {
            // take the calculated ANGLE value
        }
    }
    else if (SPEEDDIRECTION == -1)
    {
        SPEED = @MEnv_VehSpeed_SET_FLT_1 - @MEnv_VehSpeedSweepDel_SET_INT_1;
        
        if (SPEED <= @MEnv_VehSpeedSweepMin_SET_INT_1)
        {
            SPEED = @MEnv_VehSpeedSweepMin_SET_INT_1;
            SPEEDDIRECTION = 1;
        }
        else
        {
            // take the calculated SPEED value
        }
    }
    else 
    {
        write(" Magna Warning: Speed Direction is not correct: %d! ", SPEEDDIRECTION);
    }
    
    @MEnv_VehSpeed_SET_FLT_1 = SPEED;
    
    setTimer(t_VehSpeed_Sweep, @MEnv_VehSpeedSweepTime_SET_INT_1);
}

// Gear
//-----------------------------------------------------------
on envVar MEnv_GearManual_SET_INT_1
{
   // setSignal(NeutralSwSts, @this);
}

//on signal NeutralSwSts
//{
//    @MEnv_GearManual_GET_INT_1 = getSignal(NeutralSwSts);
//  
//  /*
//    if (@MEnv_GearManual_GET_INT_1 == 82) // Reverse Gear active
//    {
//        @MEnv_RevGear_SET_INT_1 = 1;
//    }
//    else
//    {
//        @MEnv_RevGear_SET_INT_1 = 0;
//    }
//  */
//}

on envVar MEnv_GearAutomatic_SET_INT_1
{
    setSignal(ShiftLeverPosition , @this);
}

on signal ShiftLeverPosition 
{
    @MEnv_GearAutomatic_GET_INT_1 = getSignal(ShiftLeverPosition);
  
  
    if (@MEnv_GearAutomatic_GET_INT_1 == 1)
    {
        @MEnv_RevGear_SET_INT_1 = 1;
    }
    else
    {
        @MEnv_RevGear_SET_INT_1 = 0;
    }
  
}

on envVar MEnv_RevGear_SET_INT_1
{
    //setSignal(ReverseGearSts, @this);
    //setSignal(ReverseGearSts, 3);
}



//on envVar MEnv_TransmissionType_SET_INT_1
//{
//    setSignal(VC_Trans_Equipped, @this); //Signal Control 0 = Automatic and 1 = Manual
//}

//on signal VC_Trans_Equipped
//{
//    @MEnv_TabControlTransType_SET_INT_1 = this + 1; //Signal Control 0 = Automatic and 1 = Manual -> Tab Control 1 = Automatic and 2 = Manual
//    @MEnv_TransmissionType_GET_INT_1 = this;
//}
//-----------------------------------------------------------

// Odometer
//-----------------------------------------------------------
on envVar MEnv_Odo_SET_FLT_1
{
    setSignal(TotalOdometer, @this);
}

on signal TotalOdometer
{
    @MEnv_Odo_GET_FLT_1 = this;
}

on envVar MEnv_OdoFlt_SET_BOL_1
{
    if (@this == 1)
    {
        ODOMETER_BUFFER = @MEnv_Odo_GET_FLT_1;
      
        enableControl("Main", "Odometer_Input/Output", 0);
      
        @MEnv_Odo_SET_FLT_1 = ODOMETER_FAULT;
    }
    else
    {
        @MEnv_Odo_SET_FLT_1 = ODOMETER_BUFFER;
      
        enableControl("Main", "Odometer_Input/Output", 1);
    }
}
//-----------------------------------------------------------

// Battery Voltage
//-----------------------------------------------------------
on envVar MEnv_BatteryVolt_SET_FLT_1
{
    //setSignal(BatteryVoltageLevel, @this);
}

//on signal BatteryVoltageLevel
//{
//    @MEnv_BatteryVolt_GET_FLT_1 = this;
//}

on envVar MEnv_BatteryVoltFlt_SET_BOL_1
{
    if (@this == 1)
    {
        BATTERYVOLT_BUFFER = @MEnv_BatteryVolt_GET_FLT_1;
      
        enableControl("Main", "BatteryVolt_Input/Output", 0);
      
        @MEnv_BatteryVolt_SET_FLT_1 = BATTERYVOLT_FAULT;
    }
    else
    {
        @MEnv_BatteryVolt_SET_FLT_1 = BATTERYVOLT_BUFFER;
      
        enableControl("Main", "BatteryVolt_Input/Output", 1);
    }
}
//-----------------------------------------------------------

on key 's'
{   
    
}

on stopMeasurement
{
    enableControl("Main", "DefaultVariant_TrackBar", 1);
}

//Steering Wheel Angle
//-----------------------------------------------------------
on envVar MEnv_StwAngle_SET_INT_1
{
	  //setSignal(LWSAngle, @this);
}

on envVar MEnv_StwAngleFlt_SET_BOL_1
{
    if(@this == 1)
    {
        STWANGLE_BUFFER = @MEnv_StwAngle_GET_INT_1;
      
        enableControl("Main", "StwAngle_Center_Button", 0);
        enableControl("Main", "StwAngle_TrackBar", 0);
        enableControl("Main", "StwAngle_Input/Output", 0);
      
        @MEnv_StwAngle_SET_INT_1 = STWANGLE_FAULT;
    }
    else
    {
        @MEnv_StwAngle_SET_INT_1 = STWANGLE_BUFFER;
      
        enableControl("Main", "StwAngle_Center_Button", 1);
        enableControl("Main", "StwAngle_TrackBar", 1);
        enableControl("Main", "StwAngle_Input/Output", 1);
    }
}

on envVar MEnv_StwAngleCenter_SET_BOL_1
{
    if (@this == 1)
    {
	      @MEnv_StwAngle_SET_INT_1 = CENTER;
    }
}


//Steering Wheel Angle: #Sweep#

on envVar MEnv_StwAngleSweep_SET_INT_1
{
	  if (@this == 1)
    {
        if (@MEnv_StwAngleSweepTime_SET_INT_1 != 0)
        {
            setTimer(t_StwAngle_Sweep, @MEnv_StwAngleSweepTime_SET_INT_1);
        }
        else
        {
            write(" Magna Warning: Sweep time = %d, please enter a valid timer value! ", @MEnv_StwAngleSweepTime_SET_INT_1);
        }
    }
    else
    {
        cancelTimer(t_StwAngle_Sweep);
    }
}

on timer t_StwAngle_Sweep
{
    @MEnv_StwAngleFlt_SET_BOL_1 = 0;
  
    if (STEERINGDIRECTION == 1)
    {
        ANGLE = @MEnv_StwAngle_SET_INT_1 + @MEnv_StwAngleSweepDel_SET_INT_1;
      
        if (ANGLE >= @MEnv_StwAngleSweepMax_SET_INT_1)
        {
            ANGLE = @MEnv_StwAngleSweepMax_SET_INT_1;
            STEERINGDIRECTION = -1;
        }
        else
        {
            // take the calculated ANGLE value
        }
    }
    else if (STEERINGDIRECTION == -1)
    {
        ANGLE = @MEnv_StwAngle_SET_INT_1 - @MEnv_StwAngleSweepDel_SET_INT_1;
        
        if (ANGLE <= @MEnv_StwAngleSweepMin_SET_INT_1)
        {
            ANGLE = @MEnv_StwAngleSweepMin_SET_INT_1;
            STEERINGDIRECTION = 1;
        }
        else
        {
            // take the calculated ANGLE value
        }
    }
    else 
    {
        write(" Magna Warning: Steering Direction is not correct: %d! ", STEERINGDIRECTION);
    }
    
    @MEnv_StwAngle_SET_INT_1 = ANGLE;
    
    setTimer(t_StwAngle_Sweep, @MEnv_StwAngleSweepTime_SET_INT_1);
}

on envVar MEnv_StwAngleSensor_SET_INT_1
{
   // setSignal(LWSFailSts, @this);
}
//-----------------------------------------------------------

//PTS Control
//-----------------------------------------------------------

//SET:
on envVar MEnv_AllVpaOverlays_SET_INT_1
{
    @MEnv_ParkAidWarnFl_SET_INT_1 = @this;
    @MEnv_ParkAidWarnFc_SET_INT_1 = @this;
    @MEnv_ParkAidWarnFr_SET_INT_1 = @this;
    @MEnv_ParkAidWarnRl_SET_INT_1 = @this;
    @MEnv_ParkAidWarnRc_SET_INT_1 = @this;
    @MEnv_ParkAidWarnRr_SET_INT_1 = @this;
}

on envVar MEnv_ParkAidWarnFl_SET_INT_1
{
	  setSignal(Alert_CHR, @this);
}

on envVar MEnv_ParkAidWarnFc_SET_INT_1
{
	  setSignal(Alert_CHF, @this);
}

on envVar MEnv_ParkAidWarnFr_SET_INT_1
{
	  setSignal(Alert_LHF, @this);
}

on envVar MEnv_ParkAidWarnRl_SET_INT_1
{
	  setSignal(Alert_RHF, @this);
}

on envVar MEnv_ParkAidWarnRc_SET_INT_1
{
	  setSignal(Alert_LHR, @this);
} 

on envVar MEnv_ParkAidWarnRr_SET_INT_1
{
	  setSignal(Alert_RHR, @this);
}

//GET:

on signal Alert_CHR
{
	  @MEnv_ParkAidWarnFl_GET_INT_1 = this;
}

on signal Alert_CHF
{
	  @MEnv_ParkAidWarnFc_GET_INT_1 = this;
}

on signal Alert_LHF
{
	  @MEnv_ParkAidWarnFr_GET_INT_1 = this;
}

on signal Alert_RHF
{
	  @MEnv_ParkAidWarnRl_GET_INT_1 = this;
}

on signal Alert_LHR
{
	  @MEnv_ParkAidWarnRc_GET_INT_1 = this;
}

on signal Alert_RHR
{
	  @MEnv_ParkAidWarnRr_GET_INT_1 = this;
}
//-----------------------------------------------------------

//Doors
//-----------------------------------------------------------
on envVar MEnv_DoorDrv_SET_INT_1
{
    setSignal(DriverDoorSts, @this);
}

on envVar MEnv_DoorPsg_SET_INT_1
{
    setSignal(PsngrDoorSts, @this);
}

on envVar MEnv_DoorRl_SET_INT_1
{
	  setSignal(LHRDoorSts, @this);
}

on envVar MEnv_DoorRr_SET_INT_1
{
	  setSignal(RHRDoorSts, @this);
}


on envVar MEnv_DoorDeckLid_SET_INT_1
{
    setSignal(RHatchSts, @this);
}


on envVar MEnv_Door_SET_INT_1
{
	  switch (@this) 
    {
        case (1):         //CLS 
        {
            @MEnv_DoorFl_SET_INT_1 = 0;
            @MEnv_DoorFr_SET_INT_1 = 0;
            @MEnv_DoorRl_SET_INT_1 = 0;
            @MEnv_DoorRr_SET_INT_1 = 0;
            @MEnv_DoorDrv_SET_INT_1 = 0;
            @MEnv_DoorPsg_SET_INT_1 = 0;
        }
        break;
        
        case (2):         // OPN
        {
            @MEnv_DoorFl_SET_INT_1 = 1;
            @MEnv_DoorFr_SET_INT_1 = 1;
            @MEnv_DoorRl_SET_INT_1 = 1;
            @MEnv_DoorRr_SET_INT_1 = 1;
            @MEnv_DoorDrv_SET_INT_1 = 1;
            @MEnv_DoorPsg_SET_INT_1 = 1;
        }
        break;
        
        case (3):         // SNA
        {
            @MEnv_DoorFl_SET_INT_1 = 3;
            @MEnv_DoorFr_SET_INT_1 = 3;
            @MEnv_DoorRl_SET_INT_1 = 3;
            @MEnv_DoorRr_SET_INT_1 = 3;
            @MEnv_DoorDrv_SET_INT_1 = 3;
            @MEnv_DoorPsg_SET_INT_1 = 3;
        }
        break;
    }
}

on signal DriverDoorSts
{
    @MEnv_DoorDrv_GET_INT_1 = this;
}

on signal PsngrDoorSts
{
    @MEnv_DoorPsg_GET_INT_1 = this;
}

on signal LHRDoorSts
{
	  @MEnv_DoorRl_GET_INT_1 = this;
}

on signal RHRDoorSts
{
	  @MEnv_DoorRr_GET_INT_1 = this;
}

on signal RHatchSts
{
    @MEnv_DoorDeckLid_GET_INT_1 = this;
}

//-----------------------------------------------------------

//Display Control
//-----------------------------------------------------------

on envVar MEnv_Touch_SET_INT_1
{
    switch(@this)
    {
        case 0: // Jump back to Not Pressed
        {
            setSignal(CM_TCH_STAT, 0);         
            setSignal(CM_TCH_X_COORD, 0);
            setSignal(CM_TCH_Y_COORD, 0);
        }
        break;
        
        
        case 1: // Rear & Top
        {
            @MEnv_EmvViewState_GET_INT_1 = 1;
            if (@MEnv_DisplayRes_SET_INT_1 == 0)  //RES_DT_1024x768
            {
              setSignal(CM_TCH_X_COORD, 410);
              setSignal(CM_TCH_Y_COORD, 700);
            }
            else                                  //RES_DT_640x480 and all others
            {
              setSignal(CM_TCH_X_COORD, 258);
              setSignal(CM_TCH_Y_COORD, 437);
            }
            setSignal(CM_TCH_STAT, 1);
        }
        break;
        
        
        case 2: // Rear Cross
        {
            @MEnv_EmvViewState_GET_INT_1 = 2;
            if (@MEnv_DisplayRes_SET_INT_1 == 0)  //RES_DT_1024x768
            {
              setSignal(CM_TCH_X_COORD, 550);
              setSignal(CM_TCH_Y_COORD, 700);
            }
            else                                  //RES_DT_640x480 and all others
            {
              setSignal(CM_TCH_X_COORD, 344);
              setSignal(CM_TCH_Y_COORD, 437);
            }
            setSignal(CM_TCH_STAT, 1);
        }
        break;
        
        
        case 3: // Front Cross
        {
            @MEnv_EmvViewState_GET_INT_1 = 3;
            if (@MEnv_DisplayRes_SET_INT_1 == 0)  //RES_DT_1024x768
            {
              setSignal(CM_TCH_X_COORD, 690);
              setSignal(CM_TCH_Y_COORD, 700);
            }
            else                                  //RES_DT_640x480 and all others
            {
               setSignal(CM_TCH_X_COORD, 430);
               setSignal(CM_TCH_Y_COORD, 437);
            }
            setSignal(CM_TCH_STAT, 1);
        }
        break;
        
        
        case 4: // Front and Top
        {
            @MEnv_EmvViewState_GET_INT_1 = 4;
            if (@MEnv_DisplayRes_SET_INT_1 == 0)  //RES_DT_1024x768
            {
              setSignal(CM_TCH_X_COORD, 820);
              setSignal(CM_TCH_Y_COORD, 700);
            }
            else                                  //RES_DT_640x480 and all others
            {
               setSignal(CM_TCH_X_COORD, 515);
               setSignal(CM_TCH_Y_COORD, 437);
            }
            setSignal(CM_TCH_STAT, 1);
        }
        break;
        
        
        case 5: // Cancel
        {           
            if (@MEnv_DisplayRes_SET_INT_1 == 0)  //RES_DT_1024x768
            {
              setSignal(CM_TCH_X_COORD, 960);
              setSignal(CM_TCH_Y_COORD, 60);
            }
            else                                  //RES_DT_640x480 and all others
            {
               setSignal(CM_TCH_X_COORD, 600);
               setSignal(CM_TCH_Y_COORD, 30);
            }
            setSignal(CM_TCH_STAT, 1);
        }
        break;
        
        
        case 6: // TowBall View
        {           
            if (@MEnv_DisplayRes_SET_INT_1 == 0)  //RES_DT_1024x768
            {
              setSignal(CM_TCH_X_COORD, 960);
              setSignal(CM_TCH_Y_COORD, 700);
            }
            else                                  //RES_DT_640x480 and all others
            {
               setSignal(CM_TCH_X_COORD, 600);
               setSignal(CM_TCH_Y_COORD, 430);
            }
            setSignal(CM_TCH_STAT, 1);
        }
        break;
        
        
        case 7: // Zoom Button  -----------------------------------------------------------------
        {           
            if (@MEnv_DisplayRes_SET_INT_1 == 0)  //RES_DT_1024x768
            {
              setSignal(CM_TCH_X_COORD, 13);
              setSignal(CM_TCH_Y_COORD, 14);
            }
            else                                  //RES_DT_640x480 and all others
            {
               setSignal(CM_TCH_X_COORD, 30);
               setSignal(CM_TCH_Y_COORD, 30);
            }
            setSignal(CM_TCH_STAT, 1);
        }
        break;
        
        /*
        case 8: // CHMSL Button  -----------------------------------------------------------------
        {           
            if (@MEnv_DisplayRes_SET_INT_1 == 0)  //RES_DT_1024x768
            {
              setSignal(CM_TCH_X_COORD, 98);
              setSignal(CM_TCH_Y_COORD, 61);
            }
            else                                  //RES_DT_640x480 and all others
            {
               setSignal(CM_TCH_X_COORD, 30);
               setSignal(CM_TCH_Y_COORD, 30);
            }
            setSignal(CM_TCH_STAT, 1);
        }
        break;
        */
        /*
        case 9: // TRGV Button  -----------------------------------------------------------------
        {           
            if (@MEnv_DisplayRes_SET_INT_1 == 0)  //RES_DT_1024x768
            {
              setSignal(CM_TCH_X_COORD, 281);
              setSignal(CM_TCH_Y_COORD, 61);
            }
            else                                  //RES_DT_640x480 and all others
            {
               setSignal(CM_TCH_X_COORD, 30);
               setSignal(CM_TCH_Y_COORD, 30);
            }
            setSignal(CM_TCH_STAT, 1);
        }
        break;
        */
        
        case 10: // BUNRV Button  -----------------------------------------------------------------
        {           
            if (@MEnv_DisplayRes_SET_INT_1 == 0)  //RES_DT_1024x768
            {
              setSignal(CM_TCH_X_COORD, 98);
              setSignal(CM_TCH_Y_COORD, 61);
            }
            else                                  //RES_DT_640x480 and all others
            {
               setSignal(CM_TCH_X_COORD, 30);
               setSignal(CM_TCH_Y_COORD, 30);
            }
            setSignal(CM_TCH_STAT, 1);
        }
        break;
        
        /*
        case 11: // Aux Button  -----------------------------------------------------------------
        {           
            if (@MEnv_DisplayRes_SET_INT_1 == 0)  //RES_DT_1024x768
            {
              setSignal(CM_TCH_X_COORD, 281);
              setSignal(CM_TCH_Y_COORD, 168);
            }
            else                                  //RES_DT_640x480 and all others
            {
               setSignal(CM_TCH_X_COORD, 30);
               setSignal(CM_TCH_Y_COORD, 30);
            }
            setSignal(CM_TCH_STAT, 1);
        }
        break;
        */
        /*
        case 12: // TRG Left Button  -----------------------------------------------------------------
        {           
            if (@MEnv_DisplayRes_SET_INT_1 == 0)  //RES_DT_1024x768
            {
              setSignal(CM_TCH_X_COORD, 307);
              setSignal(CM_TCH_Y_COORD, 631);
            }
            else                                  //RES_DT_640x480 and all others
            {
               setSignal(CM_TCH_X_COORD, 30);
               setSignal(CM_TCH_Y_COORD, 30);
            }
            setSignal(CM_TCH_STAT, 1);
        }
        break;
        */
        /*
        case 13: // TRG Right Button  -----------------------------------------------------------------
        {           
            if (@MEnv_DisplayRes_SET_INT_1 == 0)  //RES_DT_1024x768
            {
              setSignal(CM_TCH_X_COORD, 716);
              setSignal(CM_TCH_Y_COORD, 631);
            }
            else                                  //RES_DT_640x480 and all others
            {
               setSignal(CM_TCH_X_COORD, 30);
               setSignal(CM_TCH_Y_COORD, 30);
            }
            setSignal(CM_TCH_STAT, 1);
        }
        break;
        */
        /*
        case 14: // CHMSL Up Button  -----------------------------------------------------------------
        {           
            if (@MEnv_DisplayRes_SET_INT_1 == 0)  //RES_DT_1024x768
            {
              setSignal(CM_TCH_X_COORD, 154);
              setSignal(CM_TCH_Y_COORD, 563);
            }
            else                                  //RES_DT_640x480 and all others
            {
               setSignal(CM_TCH_X_COORD, 30);
               setSignal(CM_TCH_Y_COORD, 30);
            }
            setSignal(CM_TCH_STAT, 1);
        }
        break;
        */
        /*
        case 15: // CHMSL Down Button  -----------------------------------------------------------------
        {           
            if (@MEnv_DisplayRes_SET_INT_1 == 0)  //RES_DT_1024x768
            {
              setSignal(CM_TCH_X_COORD, 154);
              setSignal(CM_TCH_Y_COORD, 697);
            }
            else                                  //RES_DT_640x480 and all others
            {
               setSignal(CM_TCH_X_COORD, 30);
               setSignal(CM_TCH_Y_COORD, 30);
            }
            setSignal(CM_TCH_STAT, 1);
        }
        break;
        */
        /*
        case 16: // CHMSL Left Button  -----------------------------------------------------------------
        {           
            if (@MEnv_DisplayRes_SET_INT_1 == 0)  //RES_DT_1024x768
            {
              setSignal(CM_TCH_X_COORD, 87);
              setSignal(CM_TCH_Y_COORD, 630);
            }
            else                                  //RES_DT_640x480 and all others
            {
               setSignal(CM_TCH_X_COORD, 30);
               setSignal(CM_TCH_Y_COORD, 30);
            }
            setSignal(CM_TCH_STAT, 1);
        }
        break;
        */
        /*
        case 17: // CHMSL Right Button  -----------------------------------------------------------------
        {           
            if (@MEnv_DisplayRes_SET_INT_1 == 0)  //RES_DT_1024x768
            {
              setSignal(CM_TCH_X_COORD, 221);
              setSignal(CM_TCH_Y_COORD, 630);
            }
            else                                  //RES_DT_640x480 and all others
            {
               setSignal(CM_TCH_X_COORD, 30);
               setSignal(CM_TCH_Y_COORD, 30);
            }
            setSignal(CM_TCH_STAT, 1);
        }
        break;
        */
        /*
        case 18: // CHMSL Accept Button  -----------------------------------------------------------------
        {           
            if (@MEnv_DisplayRes_SET_INT_1 == 0)  //RES_DT_1024x768
            {
              setSignal(CM_TCH_X_COORD, 891);
              setSignal(CM_TCH_Y_COORD, 674);
            }
            else                                  //RES_DT_640x480 and all others
            {
               setSignal(CM_TCH_X_COORD, 30);
               setSignal(CM_TCH_Y_COORD, 30);
            }
            setSignal(CM_TCH_STAT, 1);
        }
        break;
        */
        case 19: // FFCV Button  -----------------------------------------------------------------
        {           
            if (@MEnv_DisplayRes_SET_INT_1 == 0)  //RES_DT_1024x768
            {
              setSignal(CM_TCH_X_COORD, 281);
              setSignal(CM_TCH_Y_COORD, 61);
            }
            else                                  //RES_DT_640x480 and all others
            {
               setSignal(CM_TCH_X_COORD, 30);
               setSignal(CM_TCH_Y_COORD, 30);
            }
            setSignal(CM_TCH_STAT, 1);
        }
        break;
        
        case 20: // Clean Camera Button  -----------------------------------------------------------------
        {           
            if (@MEnv_DisplayRes_SET_INT_1 == 0)  //RES_DT_1024x768
            {
              setSignal(CM_TCH_X_COORD, 891);
              setSignal(CM_TCH_Y_COORD, 675);
            }
            else                                  //RES_DT_640x480 and all others
            {
               setSignal(CM_TCH_X_COORD, 30);
               setSignal(CM_TCH_Y_COORD, 30);
            }
            setSignal(CM_TCH_STAT, 1);
        }
        break;
        
        default:
        {
            write("Magna Warning: Wrong value for Touch (Display Control)!");
        }
        break;
    }
}


on timer t_ResetViewSwitchButtons // reset the Viewswitch Buttons to 0
{
    @MEnv_Touch_SET_INT_1 = 0;
}

on envVar MEnv_TouchState_SET_INT_1
{
    setSignal(CM_TCH_STAT, @this);
}

on signal CM_TCH_STAT
{
    @MEnv_TouchState_GET_INT_1 = this;
    @MEnv_CmTchStat_GET_INT_1 = this;
}

on envVar MEnv_TouchX_SET_INT_1
{
    setSignal(CM_TCH_X_COORD, @this);
}

on signal CM_TCH_X_COORD
{
    @MEnv_TouchX_GET_INT_1 = this;
}

on envVar MEnv_TouchY_SET_INT_1
{
    setSignal(CM_TCH_Y_COORD, @this);
}

on signal CM_TCH_Y_COORD
{
    @MEnv_TouchY_GET_INT_1 = this;
}

  //Display
// Configuration for CVPM-Display-Resolution
on envVar MEnv_DisplayRes_SET_INT_1
{
//  write("Configuration for CVPM-Display-Resolution");
    if(@this == 0) //RES_DT_1024x768
    {
        closePanel("DisplayResolution");
        //Enable / disable soft-buttons on display
        setControlVisibility("DisplayControl", "Zoom_Button", 1);
        setControlVisibility("DisplayControl", "Cancel_Button", 1);
        setControlVisibility("DisplayControl", "RearAndTop_Button", 1);
        setControlVisibility("DisplayControl", "RearCross_Button", 1);
        setControlVisibility("DisplayControl", "FrontCross_Button", 1);
        setControlVisibility("DisplayControl", "FrontAndTop_Button", 1);
        setControlVisibility("DisplayControl", "BackupRear_Button", 1);
      setControlVisibility("DisplayControl", "CHMSL_Button", 1);
      setControlVisibility("DisplayControl", "TRGV_Button", 1);
      setControlVisibility("DisplayControl", "BUNRV_Button", 1);
      setControlVisibility("DisplayControl", "Aux_Button", 1);
      setControlVisibility("DisplayControl", "CHMSL_Discription", 1);
      setControlVisibility("DisplayControl", "TRGLeft_Button", 1);
      setControlVisibility("DisplayControl", "TRGRight_Button", 1);
      setControlVisibility("DisplayControl", "TRG_Discription", 1);
      setControlVisibility("DisplayControl", "CHMSLAccept_Button", 1);
        //Enable/disable Sweep functions and buttons
        setControlVisibility("DisplayControl", "GroupSweepControls", 1);
      
        //set coordinates which are send in timer
        @MEnv_DisplayResX_SET_INT_1 = 1024;
        @MEnv_DisplayResY_SET_INT_1 = 768;
      
        //start timer to trigger sendMsg event with ButtonPressed (TCH_PSD)
        SetDisplayResState = 0;
        setTimer(t_SetDisplayRes, 10);
    }
    else if(@this == 1) //RES_RU_640x480
    {
        closePanel("DisplayResolution");
        //Enable / disable soft-buttons on display
        setControlVisibility("DisplayControl", "Zoom_Button", 1);
        setControlVisibility("DisplayControl", "Cancel_Button", 1);
        setControlVisibility("DisplayControl", "RearAndTop_Button", 1);
        setControlVisibility("DisplayControl", "RearCross_Button", 1);
        setControlVisibility("DisplayControl", "FrontCross_Button", 1);
        setControlVisibility("DisplayControl", "FrontAndTop_Button", 1);
        setControlVisibility("DisplayControl", "BackupRear_Button", 1);
      setControlVisibility("DisplayControl", "CHMSL_Button", 1);
      setControlVisibility("DisplayControl", "TRGV_Button", 1);
      setControlVisibility("DisplayControl", "BUNRV_Button", 1);
      setControlVisibility("DisplayControl", "Aux_Button", 1);
      setControlVisibility("DisplayControl", "CHMSL_Discription", 1);
      setControlVisibility("DisplayControl", "TRGLeft_Button", 1);
      setControlVisibility("DisplayControl", "TRGRight_Button", 1);
      setControlVisibility("DisplayControl", "TRG_Discription", 1);
      setControlVisibility("DisplayControl", "CHMSLAccept_Button", 1);
        //Enable/disable Sweep functions and buttons
        setControlVisibility("DisplayControl", "GroupSweepControls", 1);
      
        //set coordinates which are send in timer
        @MEnv_DisplayResX_SET_INT_1 = 640;
        @MEnv_DisplayResY_SET_INT_1 = 480;
      
        //start timer to trigger sendMsg event with ButtonPressed (TCH_PSD)
        SetDisplayResState = 0;
        setTimer(t_SetDisplayRes, 10);
    }
    else if(@this == 2) //RES_MANUAL_SELECTED
    {
        // Activate panel to set desired resolution
        openPanel("DisplayResolution");
    }
}

on envVar MEnv_ManualDisplayRes_SET_INT_1
{
    if(@this == 1) //MANUAL_SEND_PRESSED
    {
        //Enable / disable soft-buttons on display
        setControlVisibility("DisplayControl", "Zoom_Button", 0);
        setControlVisibility("DisplayControl", "Cancel_Button", 0);
        setControlVisibility("DisplayControl", "RearAndTop_Button", 0);
        setControlVisibility("DisplayControl", "RearCross_Button", 0);
        setControlVisibility("DisplayControl", "FrontCross_Button", 0);
        setControlVisibility("DisplayControl", "FrontAndTop_Button", 0);
        setControlVisibility("DisplayControl", "BackupRear_Button", 0);
      setControlVisibility("DisplayControl", "CHMSL_Button", 0);
      setControlVisibility("DisplayControl", "TRGV_Button", 0);
      setControlVisibility("DisplayControl", "BUNRV_Button", 0);
      setControlVisibility("DisplayControl", "Aux_Button", 0);
      setControlVisibility("DisplayControl", "CHMSL_Discription", 0);
      setControlVisibility("DisplayControl", "TRGLeft_Button", 0);
      setControlVisibility("DisplayControl", "TRGRight_Button", 0);
      setControlVisibility("DisplayControl", "TRG_Discription", 0);
      setControlVisibility("DisplayControl", "CHMSLAccept_Button", 0);
        //Enable/disable Sweep functions and buttons
        setControlVisibility("DisplayControl", "GroupSweepControls", 0);
        @MEnv_SweepTowBallView_SET_BOL_1 = 0;
        @MEnv_SweepFrontAndTop_SET_BOL_1 = 0;
        @MEnv_SweepFrontCross_SET_BOL_1 = 0;
        @MEnv_SweepRearCross_SET_BOL_1 = 0;
        @MEnv_SweepRearAndTop_SET_BOL_1 = 0;
      
        //start timer to trigger sendMsg event with ButtonPressed (TCH_PSD)
        //@MEnv_DisplayRes_Val... are always set directly from panel
        SetDisplayResState = 0;
        setTimer(t_SetDisplayRes, 10);
    }
    else
    {
        // Do nothing for @this == 0 (MANUAL_SEND_RELEASED)
    }
}

//The timer creates the sequence to set the display resolution (see PTC task 218252)
on timer t_SetDisplayRes
{
    switch (SetDisplayResState)
    {
        default:
        {
            write("Magna Warning: Wrong value for the Variable *SetDisplayResState*!");
            break;
        }
        case 0:
        {
            setSignal(CM_TCH_STAT, 0); //TCH_NOT_PSD
          
            setTimer(this, 30);
            break;
        }
        case 1:
        {
            setSignal(CM_TCH_X_COORD, @MEnv_DisplayResX_SET_INT_1);
            setSignal(CM_TCH_Y_COORD, @MEnv_DisplayResY_SET_INT_1);
            setSignal(CM_TCH_STAT, 4); //TCH_CFG_RES
            
            setTimer(this, 30);
            break;
        }
        case 2:
        {
            setSignal(CM_TCH_STAT, 0); //TCH_NOT_PSD
          
            setTimer(this, 30);
            break;
        }
        case 3:
        {
            setSignal(CM_TCH_STAT, 6); //TCH_CFG_MAX
          
            setTimer(this, 30);
            break;
        }
        case 4:
        {
            setSignal(CM_TCH_STAT, 0); //TCH_NOT_PSD

            setTimer(this, 30);
            break;
        }
        case 5:
        {
            setSignal(CM_TCH_X_COORD, 0);
            setSignal(CM_TCH_Y_COORD, 0);
            setSignal(CM_TCH_STAT, 5); //TCH_CFG_OFFSET
          
            setTimer(this, 30);
            break;
        }
        case 6:
        {
            setSignal(CM_TCH_STAT, 0); //TCH_NOT_PSD
            break;
        }
    }
    SetDisplayResState++;
}

on envVar MEnv_ViewButtonState_SET_INT_1
{
    switch (@this)
    {
        case 1:
        {
            @MEnv_CameraDisplaySts2_SET_INT_1 = 1;
            
            //@MEnv_DisplayStatus_SET_INT_1 = 7; replaced by @MEnv_TGWCameraDispSts_SET_INT_1 = 4;
            @MEnv_TGWCameraDispSts_SET_INT_1 = 4;
            setTimer(t_ResetCameraDisplayState, 30);
            break; 
        }
        case 2:
        {
            @MEnv_CameraDisplaySts2_SET_INT_1 = 2;
          
            //@MEnv_DisplayStatus_SET_INT_1 = 7; replaced by @MEnv_TGWCameraDispSts_SET_INT_1 = 4;
            @MEnv_TGWCameraDispSts_SET_INT_1 = 4;
            setTimer(t_ResetCameraDisplayState, 30);
            break; 
        }
        case 3:
        {
            @MEnv_CameraDisplaySts2_SET_INT_1 = 3;
          
            //@MEnv_DisplayStatus_SET_INT_1 = 7; replaced by @MEnv_TGWCameraDispSts_SET_INT_1 = 4;
            @MEnv_TGWCameraDispSts_SET_INT_1 = 4;
            setTimer(t_ResetCameraDisplayState, 30);
            break; 
        }
        case 4:
        {
            @MEnv_CameraDisplaySts2_SET_INT_1 = 4;
          
            //@MEnv_DisplayStatus_SET_INT_1 = 7; replaced by @MEnv_TGWCameraDispSts_SET_INT_1 = 4;
            @MEnv_TGWCameraDispSts_SET_INT_1 = 4;
            setTimer(t_ResetCameraDisplayState, 30);
            break; 
        }
    }
}

on timer t_ResetCameraDisplayState
{
    @MEnv_CameraDisplaySts2_SET_INT_1 = 0;
}


  //View Switch Sweep
on envVar MEnv_ViewSwitchSweep_SET_BOL_1
{
    if(@this == 1)
    {
        if(@MEnv_ViewSwitchSweepTime_SET_INT_1 > 80) // 75 ms are the minimum
        {
            Repeat_Count = 1;
          
            setTimer(t_ViewSwitch_Sweep, @MEnv_ViewSwitchSweepTime_SET_INT_1);
        }
        else
        {
            //putvalue(MEnv_SysMessage_GET_STG_2, "Warning: The Time between View Switch Sweep is to short!");
            write("Magna Warning: The Time between View Switch Sweep is to short!");
        }
    }
    else
    {
        cancelTimer(t_ViewSwitch_Sweep);
    }
}

on timer t_ViewSwitch_Sweep
{
    for(;;)
    {
        if(Repeat_Count == 1) // Rear and Top
        {
            if(@MEnv_SweepRearAndTop_SET_BOL_1 == 1)
            {
                Repeat_Count = Repeat_Count + 1;
              
                @MEnv_Touch_SET_INT_1 = 1;
                //write("Rear and Top");
              
                setTimer(t_ResetViewSwitchButtons, 40);
              
                break;
            }
            else
            {
                Repeat_Count = Repeat_Count + 1;
            }
        }
        else if(Repeat_Count == 2) // Rear Cross
        {
            if(@MEnv_SweepRearCross_SET_BOL_1 == 1)
            {
                Repeat_Count = Repeat_Count + 1;
              
                @MEnv_Touch_SET_INT_1 = 2;
                //write("Rear Cross");
              
                setTimer(t_ResetViewSwitchButtons, 40);
              
                break;
            }
            else
            {
                Repeat_Count = Repeat_Count + 1;
            }
        }
        else if(Repeat_Count == 3) // Front Cross
        {
            if(@MEnv_SweepFrontCross_SET_BOL_1 == 1)
            {
                Repeat_Count = Repeat_Count + 1;
              
                @MEnv_Touch_SET_INT_1 = 3;
                //write("Front Cross");
              
                setTimer(t_ResetViewSwitchButtons, 40);
              
                break;
            }
            else
            {
                Repeat_Count = Repeat_Count + 1;
            }
        }
        else if(Repeat_Count == 4) // Front and Top
        {
            if(@MEnv_SweepFrontAndTop_SET_BOL_1 == 1)
            {
                Repeat_Count = Repeat_Count + 1;
              
                @MEnv_Touch_SET_INT_1 = 4;
                //write("Front and Top");
              
                setTimer(t_ResetViewSwitchButtons, 40);
              
                break;
            }
            else
            {
                Repeat_Count = Repeat_Count + 1;
            }
        }
        else if(Repeat_Count == 5) // Tow Ball View
        {
            if(@MEnv_SweepTowBallView_SET_BOL_1 == 1)
            {
                Repeat_Count = 10;
              
                @MEnv_Touch_SET_INT_1 = 6;
                //write("TowBall View");
              
                setTimer(t_ResetViewSwitchButtons, 40);
              
                break;
            }
            else
            {
                Repeat_Count = Repeat_Count + 1;
            }
        }
        else if(Repeat_Count == 10) // Cancel Button
        {
            Repeat_Count = 1;
          
            @MEnv_Touch_SET_INT_1 = 5;
            //write("Cancel Button");
          
            setTimer(t_ResetViewSwitchButtons, 40);
          
            break;
        }
        else
        {
            Repeat_Count = 1;
        }
        
        if ((@MEnv_SweepRearAndTop_SET_BOL_1 == 0) && (@MEnv_SweepRearCross_SET_BOL_1 == 0) && (@MEnv_SweepFrontCross_SET_BOL_1 == 0) && (@MEnv_SweepFrontAndTop_SET_BOL_1 == 0) && (@MEnv_SweepTowBallView_SET_BOL_1 == 0))
        {
            //putvalue(MEnv_SysMessage_GET_STG_2, "Warning: There is no View active for the View Switch Sweep function!");
            write("Warning: There is no View active for the View Switch Sweep function!");
            
            @MEnv_ViewSwitchSweep_SET_BOL_1 = 0; // deactivate the View Switch Mode, else the loop could crash the system.
          
            break;
        }
    }
  
    if(@MEnv_ViewSwitchSweepTime_SET_INT_1 > 80) // 75 ms are the minimum
    {
        setTimer(t_ViewSwitch_Sweep, @MEnv_ViewSwitchSweepTime_SET_INT_1);
    }
    else
    {
       // putvalue(MEnv_SysMessage_GET_STG_2, "Warning: The Time between View Switch Sweep is to short!");
        write("Magna Warning: The Time between View Switch Sweep is to short!");
    }
}
//-----------------------------------------------------------

//signal change
//-----------------------------------------------------------
//on envVar MEnv_VcBodyStyle_SET_INT_1
//{
//    setSignal(VC_BODY_STYLE,@this);;                              
//}
//
//on signal VC_BODY_STYLE
//{
//    @MEnv_VcBodyStyle_GET_INT_1 = this;
//}

on envVar MEnv_VcBodyStyleFlt_SET_BOL_1
{
    if(@this==1)    // checkbox checked
    {
        VCBODYSTYLE_BUFFER = @MEnv_VcBodyStyle_GET_INT_1;
        @MEnv_VcBodyStyle_SET_INT_1 = VCBODYSTYLE_FAULT;
    }
    else
    {
        //checkbox unchecked, put last value before fault
        @MEnv_VcBodyStyle_SET_INT_1 = VCBODYSTYLE_BUFFER;
    }
}

//on envVar MEnv_NetCfgStatInt_SET_INT_1
//{
//    setSignal(NET_CFG_STAT_INT,@this);                              
//}
//
//on signal NET_CFG_STAT_INT
//{
//    @MEnv_NetCfgStatInt_GET_INT_1 = this;
//}

on envVar MEnv_NetCfgStatIntFlt_SET_BOL_1
{
    if(@this==1)    // checkbox checked
    {
        NETCFGSTATINT_BUFFER = @MEnv_NetCfgStatInt_GET_INT_1;
        @MEnv_NetCfgStatInt_SET_INT_1 = NETCFGSTATINT_FAULT;
    }
    else
    {
        //checkbox unchecked, put last value before fault
        @MEnv_NetCfgStatInt_SET_INT_1 = NETCFGSTATINT_BUFFER;
    }
}

//on envVar MEnv_VcCountry_SET_INT_1
//{
//    setSignal(LanguageSelection,@this);                             
//}
//
//on signal LanguageSelection
//{
//    @MEnv_VcCountry_GET_INT_1 = this;
//}

//on envVar MEnv_VcCountryFlt_SET_BOL_1
//{
//    if(@this==1)    // checkbox checked
//    {
//        VCCOUNTRY_BUFFER = @MEnv_VcCountry_GET_INT_1;
//        @MEnv_VcCountry_SET_INT_1 = VCCOUNTRY_FAULT;
//    }
//    else
//    {
//        //checkbox unchecked, put last value before fault
//        @MEnv_VcCountry_SET_INT_1 = VCCOUNTRY_BUFFER;
//    }
//}   

//on envVar MEnv_VcModelYear_SET_INT_1
//{
//    setSignal(VC_MODEL_YEAR,@this);                              
//}

//on signal VC_MODEL_YEAR
//{
//    @MEnv_VcModelYear_GET_INT_1 = this;
//}

on envVar MEnv_VcModelYearFlt_SET_BOL_1
{
    if(@this==1)    // checkbox checked
    {
        VCMODELYEAR_BUFFER = @MEnv_VcModelYear_GET_INT_1;
        @MEnv_VcModelYear_SET_INT_1 = VCMODELYEAR_FAULT;
    }
    else
    {
        //checkbox unchecked, put last value before fault
        @MEnv_VcModelYear_SET_INT_1 = VCMODELYEAR_BUFFER;
    }
}   

//on envVar MEnv_VcVehLine_SET_INT_1
//{
//    setSignal(VC_VEH_LINE,@this);                              
//}

//on signal VC_VEH_LINE
//{
//    @MEnv_VcVehLine_GET_INT_1 = this;
//}

on envVar MEnv_VcVehLineFlt_SET_BOL_1
{
    if(@this==1)    // checkbox checked
    {
        VCVEHLINE_BUFFER = @MEnv_VcVehLine_GET_INT_1;
        @MEnv_VcVehLine_SET_INT_1 = VCVEHLINE_FAULT;
    }
    else
    {
        //checkbox unchecked, put last value before fault
        @MEnv_VcVehLine_SET_INT_1 = VCVEHLINE_BUFFER;
    }
}   

//on envVar MEnv_VcVehCfg1Stat_SET_INT_1
//{
//    setSignal(VC_VehCfg1_Stat, @this);                              
//}

//on signal VC_VehCfg1_Stat
//{
//    @MEnv_VcVehCfg1Stat_GET_INT_1 = this;
//}

on envVar MEnv_VcVehCfg1StatFlt_SET_BOL_1
{
    if(@this==1)    // checkbox checked
    {
       VCVEHCFG1STAT_BUFFER = @MEnv_VcVehCfg1Stat_GET_INT_1;
        @MEnv_VcVehCfg1Stat_SET_INT_1 = VCVEHCFG1STAT_FAULT;
    }
    else
    {
        //checkbox unchecked, put last value before fault
        @MEnv_VcVehCfg1Stat_SET_INT_1 = VCVEHCFG1STAT_BUFFER;
    }
}

//on envVar MEnv_VcVehCfg3Stat_SET_INT_1
//{
//    setSignal(VC_VehCfg3_Stat,@this);                             
//}

//on signal VC_VehCfg3_Stat
//{
//    @MEnv_VcVehCfg3Stat_GET_INT_1 = this;
//}

on envVar MEnv_VcVehCfg3StatFlt_SET_BOL_1
{
    if(@this==1)    // checkbox checked
    {
       VCVEHCFG3STAT_BUFFER = @MEnv_VcVehCfg3Stat_GET_INT_1;
        @MEnv_VcVehCfg3Stat_SET_INT_1 = VCVEHCFG3STAT_FAULT;
    }
    else
    {
        //checkbox unchecked, put last value before fault
        @MEnv_VcVehCfg3Stat_SET_INT_1 = VCVEHCFG3STAT_BUFFER;
    }
} 

//on envVar MEnv_VcVehCfg5Stat_SET_INT_1
//{
//    setSignal(VC_VehCfg5_Stat,@this);                              
//}

//on signal VC_VehCfg5_Stat
//{
//    @MEnv_VcVehCfg5Stat_GET_INT_1 = this;
//}

on envVar MEnv_VcVehCfg5StatFlt_SET_BOL_1
{
    if(@this==1)    // checkbox checked
    {
       VCVEHCFG5STAT_BUFFER = @MEnv_VcVehCfg5Stat_GET_INT_1;
        @MEnv_VcVehCfg5Stat_SET_INT_1 = VCVEHCFG5STAT_FAULT;
    }
    else
    {
        //checkbox unchecked, put last value before fault
        @MEnv_VcVehCfg5Stat_SET_INT_1 = VCVEHCFG5STAT_BUFFER;
    }
}

//on envVar MEnv_VcVehCfg7Stat_SET_INT_1
//{
//    setSignal(VC_VehCfg7_Stat,@this);                             
//}

//on signal VC_VehCfg7_Stat
//{
//    @MEnv_VcVehCfg7Stat_GET_INT_1 = this;
//}

on envVar MEnv_VcVehCfg7StatFlt_SET_BOL_1
{
    if(@this==1)    // checkbox checked
    {
       VCVEHCFG7STAT_BUFFER = @MEnv_VcVehCfg7Stat_GET_INT_1;
        @MEnv_VcVehCfg7Stat_SET_INT_1 = VCVEHCFG7STAT_FAULT;
    }
    else
    {
        //checkbox unchecked, put last value before fault
        @MEnv_VcVehCfg7Stat_SET_INT_1 = VCVEHCFG7STAT_BUFFER;
    }
}  

on envVar MEnv_SVCGridlines_SET_BOL_1
{
    if (@this == 1)
    {
        @MEnv_CFGFeature_SET_INT_1 = 0x71; // 0x71 is the value for SVCGridlines
    }
    else
    {
        // do nothing
    }
}

//on envVar MEnv_CFGFeature_SET_INT_1
//{
//    setSignal(CFG_FEATURE,@this);                             
//}

//on signal CFG_FEATURE
//{
//    @MEnv_CFGFeature_GET_INT_1 = this;
//}

//on envVar MEnv_CfgSet_SET_INT_1
//{
//    setSignal(CFG_SET,@this);                             
//}

//on signal CFG_SET
//{
//    @MEnv_CfgSet_GET_INT_1 = this;
//}

//on envVar MEnv_CfgStatRq_SET_INT_1
//{
//    setSignal(CFG_STAT_RQ,@this);                             
//}

//on signal CFG_STAT_RQ
//{
//    @MEnv_CfgStatRq_GET_INT_1 = this;
//}

//on envVar MEnv_VcChassisType_SET_INT_1
//{
//    setSignal(VC_ChassisType, @this);
//}

//on signal VC_ChassisType
//{
//    @MEnv_VcChassisType_GET_INT_1 = this;
//}

on envVar MEnv_VcChassisTypeFlt_SET_BOL_1
{
    if(@this==1)    // checkbox checked
    {
       VCCHASSISTYPE = @MEnv_VcChassisType_GET_INT_1;
        @MEnv_VcChassisType_SET_INT_1 = 0x7F;
    }
    else
    {
        //checkbox unchecked, put last value before fault
        @MEnv_VcChassisType_SET_INT_1 = VCCHASSISTYPE;
    }
}  

//on envVar MEnv_VcTcaseTyp_SET_INT_1
//{
//    setSignal(VC_TcaseTyp, @this);
//}

//on signal VC_TcaseTyp
//{
//    @MEnv_VcTcaseTyp_GET_INT_1 = this;
//}

//on envVar MEnv_VcSvcPrsnt_SET_INT_1
//{
//    setSignal(VC_SVC_Prsnt, @this);
//}

//on signal VC_SVC_Prsnt
//{
//    @MEnv_VcSvcPrsnt_GET_INT_1 = this;
//}

on envVar MEnv_CmTchStat_SET_INT_1
{
    setSignal(CM_TCH_STAT, @this);
}

on envVar MEnv_CmTchStatFlt_SET_BOL_1
{
    if(@this==1)    // checkbox checked
    {
       CMTCHSTAT_BUFFER = @MEnv_CmTchStat_GET_INT_1;
        @MEnv_CmTchStat_SET_INT_1 = 0x7;
    }
    else
    {
        //checkbox unchecked, put last value before fault
        @MEnv_CmTchStat_SET_INT_1 = CMTCHSTAT_BUFFER;
    }
}  

on envVar MEnv_TouchXFlt_SET_BOL_1
{
    if(@this == 1)    // checkbox checked
    {
       TOUCHX_BUFFER = @MEnv_TouchX_GET_INT_1;
        @MEnv_TouchX_SET_INT_1 = TOUCHX_FAULT;
    }
    else
    {
        //checkbox unchecked, put last value before fault
        @MEnv_TouchX_SET_INT_1 = TOUCHX_BUFFER;
    }
} 

on envVar MEnv_TouchYFlt_SET_BOL_1
{
    if(@this == 1)    // checkbox checked
    {
       TOUCHY_BUFFER = @MEnv_TouchY_GET_INT_1;
        @MEnv_TouchY_SET_INT_1 = TOUCHY_FAULT;
    }
    else
    {
        //checkbox unchecked, put last value before fault
        @MEnv_TouchY_SET_INT_1 = TOUCHY_BUFFER;
    }
} 

//on envVar MEnv_DisplayStatus_SET_INT_1
//{
//    setSignal(TGW_DISP_STAT, @this);
//}

//on signal TGW_DISP_STAT
//{
//    @MEnv_DisplayStatus_GET_INT_1 = this;
//}

on envVar MEnv_DisplayStatusFlt_SET_BOL_1
{
    if(@this==1)    // checkbox checked
    {
       TGWDISPSTAT_BUFFER = @MEnv_DisplayStatus_GET_INT_1;
        @MEnv_DisplayStatus_SET_INT_1 = 0xF;
    }
    else
    {
        //checkbox unchecked, put last value before fault
        @MEnv_DisplayStatus_SET_INT_1 = TGWDISPSTAT_BUFFER;
    }
}

on envVar MEnv_Language_SET_INT_1
{
    setSignal(LanguageSelection, @this);
}

on signal LanguageSelection
{
    @MEnv_Language_GET_INT_1 = this;
}
//-----------------------------------------------------------

// VIN
//-----------------------------------------------------------
on message VIN
{
    byte b_set[20];
    char c_set[20];
  
    getValue(MEnv_Vin_SET_STG_1, c_set);
  
    b_set[0] = c_set[0];
    b_set[1] = c_set[1];
    b_set[2] = c_set[2];
    b_set[3] = c_set[3];
    b_set[4] = c_set[4];
    b_set[5] = c_set[5];
    b_set[6] = c_set[6];
    b_set[7] = c_set[7];
    b_set[8] = c_set[8];
    b_set[9] = c_set[9];
    b_set[10] = c_set[10];
    b_set[11] = c_set[11];
    b_set[12] = c_set[12];
    b_set[13] = c_set[13];
    b_set[14] = c_set[14];
    b_set[15] = c_set[15];
    b_set[16] = c_set[16];
  
    if (@MEnv_VinMsgFlt_SET_BOL_2 == 1)
    {
        setSignal(VIN_MSG, 3);
    }
    else
    {
        if(getSignal(VIN_MSG) == 0)
        {
            VIN_SET_BUFFER = 0x00;
            VIN_SET_BUFFER = b_set[7];
            VIN_SET_BUFFER = VIN_SET_BUFFER << 8;
            VIN_SET_BUFFER = VIN_SET_BUFFER + b_set[8];// || VIN_SET_BUFFER;
            VIN_SET_BUFFER = VIN_SET_BUFFER << 8;
            VIN_SET_BUFFER = VIN_SET_BUFFER + b_set[9];// || VIN_SET_BUFFER;
            VIN_SET_BUFFER = VIN_SET_BUFFER << 8;
            VIN_SET_BUFFER = VIN_SET_BUFFER + b_set[10];// || VIN_SET_BUFFER;
            VIN_SET_BUFFER = VIN_SET_BUFFER << 8;
            VIN_SET_BUFFER = VIN_SET_BUFFER + b_set[11];// || VIN_SET_BUFFER;
            VIN_SET_BUFFER = VIN_SET_BUFFER << 8;
            VIN_SET_BUFFER = VIN_SET_BUFFER + b_set[12];// || VIN_SET_BUFFER;
            VIN_SET_BUFFER = VIN_SET_BUFFER << 8;
            VIN_SET_BUFFER = VIN_SET_BUFFER + b_set[13];// || VIN_SET_BUFFER;
          
            setRawSignal(VIN_DATA, VIN_SET_BUFFER);
            setSignal(VIN_MSG, 1);
        }
        else if(getSignal(VIN_MSG) == 1)
        {
            VIN_SET_BUFFER = 0x00;
            VIN_SET_BUFFER = b_set[14];
            VIN_SET_BUFFER = VIN_SET_BUFFER << 8;
            VIN_SET_BUFFER = VIN_SET_BUFFER + b_set[15];// || VIN_SET_BUFFER;
            VIN_SET_BUFFER = VIN_SET_BUFFER << 8;
            VIN_SET_BUFFER = VIN_SET_BUFFER + b_set[16];// || VIN_SET_BUFFER;
            VIN_SET_BUFFER = VIN_SET_BUFFER << 8;
            VIN_SET_BUFFER = VIN_SET_BUFFER + 0x00;// || VIN_SET_BUFFER;
            VIN_SET_BUFFER = VIN_SET_BUFFER << 8;
            VIN_SET_BUFFER = VIN_SET_BUFFER + 0x00;// || VIN_SET_BUFFER;
            VIN_SET_BUFFER = VIN_SET_BUFFER << 8;
            VIN_SET_BUFFER = VIN_SET_BUFFER + 0x00;// || VIN_SET_BUFFER;
            VIN_SET_BUFFER = VIN_SET_BUFFER << 8;
            VIN_SET_BUFFER = VIN_SET_BUFFER + 0x00;// || VIN_SET_BUFFER;
          
            setRawSignal(VIN_DATA, VIN_SET_BUFFER);
            setSignal(VIN_MSG, 2);
        }
        else if(getSignal(VIN_MSG) == 2)
        {   
            VIN_SET_BUFFER = 0x00;
            VIN_SET_BUFFER = b_set[0];
            VIN_SET_BUFFER = VIN_SET_BUFFER << 8;
            VIN_SET_BUFFER = VIN_SET_BUFFER + b_set[1];// || VIN_SET_BUFFER;
            VIN_SET_BUFFER = VIN_SET_BUFFER << 8;
            VIN_SET_BUFFER = VIN_SET_BUFFER + b_set[2];// || VIN_SET_BUFFER;
            VIN_SET_BUFFER = VIN_SET_BUFFER << 8;
            VIN_SET_BUFFER = VIN_SET_BUFFER + b_set[3];// || VIN_SET_BUFFER;
            VIN_SET_BUFFER = VIN_SET_BUFFER << 8;
            VIN_SET_BUFFER = VIN_SET_BUFFER + b_set[4];// || VIN_SET_BUFFER;
            VIN_SET_BUFFER = VIN_SET_BUFFER << 8;
            VIN_SET_BUFFER = VIN_SET_BUFFER + b_set[5];// || VIN_SET_BUFFER;
            VIN_SET_BUFFER = VIN_SET_BUFFER << 8;
            VIN_SET_BUFFER = VIN_SET_BUFFER + b_set[6];// || VIN_SET_BUFFER;
          
            setRawSignal(VIN_DATA, VIN_SET_BUFFER);
            setSignal(VIN_MSG, 0);
        }
        else
        {
            setSignal(VIN_MSG, 0);
        }
    }
}

on signal VIN_MSG
{
    byte b[20];
    char c[20];
  
    @MEnv_VinMsg_GET_INT_1 = this;
  
    VIN_BUFFER = getRawSignal(VIN_DATA);
    
    if (this == 0)
    {
        b[0] = VIN_BUFFER >> 48;
        b[1] = VIN_BUFFER >> 40;
        b[2] = VIN_BUFFER >> 32;
        b[3] = VIN_BUFFER >> 24;
        b[4] = VIN_BUFFER >> 16;
        b[5] = VIN_BUFFER >> 8;
        b[6] = VIN_BUFFER >> 0;
    }
    else if (this == 1)
    {
        b[7] = VIN_BUFFER >> 48;
        b[8] = VIN_BUFFER >> 40;
        b[9] = VIN_BUFFER >> 32;
        b[10] = VIN_BUFFER >> 24;
        b[11] = VIN_BUFFER >> 16;
        b[12] = VIN_BUFFER >> 8;
        b[13] = VIN_BUFFER >> 0;
    }
    else if (this == 2)
    {
        b[14] = VIN_BUFFER >> 48;
        b[15] = VIN_BUFFER >> 40;
        b[16] = VIN_BUFFER >> 32;
        //b[3] = VIN_BUFFER >> 24;
        //b[4] = VIN_BUFFER >> 16;
        //b[5] = VIN_BUFFER >> 8;
        //b[6] = VIN_BUFFER >> 0;
    }
    
    c[0] = b[0];
    c[1] = b[1];
    c[2] = b[2];
    c[3] = b[3];
    c[4] = b[4];
    c[5] = b[5];
    c[6] = b[6];
    c[7] = b[7];
    c[8] = b[8];
    c[9] = b[9];
    c[10] = b[10];
    c[11] = b[11];
    c[12] = b[12];
    c[13] = b[13];
    c[14] = b[14];
    c[15] = b[15];
    c[16] = b[16];
    
    putValue(MEnv_Vin_GET_STG_1, c);
}
//-----------------------------------------------------------

on message *
{
int init_state[100];  
  
    switch(this.id)
    {
        case 0x3E6: // Steering Wheel Angle
        {
            if (init_state[0] == 0)
            {
                //setSignal(LWSAngle, @MEnv_StwAngle_SET_INT_1);

                //setSignal(LWSFailSts, @MEnv_StwAngleSensor_SET_INT_1);
              
                setSignal(ShiftLeverPosition , @MEnv_GearAutomatic_SET_INT_1);
              
                init_state[0] = 1;
            }
        }
        break;
        
        case 0x322: // Vehicle Speed
        {
            if (init_state[1] == 0)
            {
                setsignal(VehicleSpeedVSOSig, @MEnv_VehSpeed_SET_FLT_1);
              
                init_state[1] = 1;
            }
        }
        break;
        
        case 0x381: // Gear
        {
            if (init_state[2] == 0)
            {
//                setsignal(VC_Trans_Equipped, @MEnv_TransmissionType_SET_INT_1); // Signal Control 0 = Automatic and 1 = Manual

//                setsignal(VC_VehCfg7_Stat, @MEnv_VcVehCfg7Stat_SET_INT_1);

//                setSignal(VC_SVC_Prsnt, @MEnv_VcSvcPrsnt_SET_INT_1);
              
                init_state[2] = 1;
            }
        }
        break;
        
        case 0x5BC: // Vehicle Config
        {
            if (init_state[3] == 0)
            {
//                setsignal(VC_BODY_STYLE, @MEnv_VcBodyStyle_SET_INT_1);

                setsignal(LanguageSelection, @MEnv_VcCountry_SET_INT_1);

//                setsignal(VC_MODEL_YEAR, @MEnv_VcModelYear_SET_INT_1);
              
//                setsignal(VC_VEH_LINE, @MEnv_VcVehLine_SET_INT_1);

//                setsignal(VC_VehCfg1_Stat, @MEnv_VcVehCfg1Stat_SET_INT_1);
                              
                init_state[3] = 1;
            }
        }
        break;
        
        case 0x3E3: // Net Config
        {
            if (init_state[4] == 0)
            {
//                setsignal(NET_CFG_STAT_INT, @MEnv_NetCfgStatInt_SET_INT_1);
                                            
                init_state[4] = 1;
            }
        }
        break;
        
        case 0x3EA: // VehCfg3
        {
            if (init_state[5] == 0)
            {
//                setsignal(VC_VehCfg3_Stat, @MEnv_VcVehCfg3Stat_SET_INT_1);

//                setSignal(VC_ChassisType, @MEnv_VcChassisType_SET_INT_1);
                                                          
                init_state[5] = 1;
            }
        }
        break;
        
        case 0x3D2: // GW_C4
        {
            if (init_state[6] == 0)
            {
                //setSignal(ODO, @MEnv_Odo_SET_FLT_1);
                                                                        
                init_state[6] = 1;
            }
        }
        break;
        
        case 0x332: // GW_C_I3
        {
            if (init_state[7] == 0)
            {
                setSignal(ShiftLeverPosition , @MEnv_GearAutomatic_SET_INT_1);
                                                                                      
                init_state[7] = 1;
            }
        }
        break;
        
        case 0x46C: // CBC_I3
        {
            if (init_state[8] == 0)
            {
               // setSignal(BatteryVoltageLevel, @MEnv_BatteryVolt_SET_FLT_1);
                     
                setSignal(CmdIgnSts, @MEnv_IgnStatus_SET_INT_1);
              
                init_state[8] = 1;
            }
        }
        break;
        
        case 0x122: // CBC_I4
        {
            if (init_state[9] == 0)
            {
                setSignal(CmdIgnSts, @MEnv_IgnStatus_SET_INT_1);
                                                                                                    
                init_state[9] = 1;
            }
        }
        break; 
        
        case 0x3E9: // VehCfg2
        {
            if (init_state[10] == 0)
            {
//                setsignal(VC_VehCfg2_Stat, @MEnv_VcVehCfg2Stat_SET_INT_1);
              
//                setSignal(VC_SpecialPKG_IC, @MEnv_VcSpecialPkgIc_SET_INT_1);
              
                init_state[10] = 1;
            }
        }
        break;
        
        case 0x38A: // VehCfg8
        {
            if (init_state[11] == 0)
            {
//                setsignal(VC_VehCfg8_Stat, @MEnv_VcVehCfg8Stat_SET_INT_1);

                //setSignal(VC_WHL_BASE_LENGTH, @MEnv_VcWhlBaseLength_SET_INT_1);
              
//                setSignal(VC_Steering_Cfactor, @MEnv_VcSteeringCfactor_SET_INT_1);
                
//                setSignal(VC_OFFroad_Camera, @MEnv_VcOFFroadCamera_SET_INT_1);
              
                init_state[11] = 1;
            }
        }
        break;
        
        case 0x2E0: // GW_C_I_11
        {
            if (init_state[12] == 0)
            {
                //setsignal(ASCM_Stat, @MEnv_AscmStatus_SET_INT_1);
              
                init_state[12] = 1;
            }
        }
        break;
        
        case 0x44A: // VehCfg5
        {
            if (init_state[13] == 0)
            {
//                setsignal(VC_VehCfg5_Stat, @MEnv_VcVehCfg5Stat_SET_INT_1);
              
//                setSignal(VC_RR_DuallyPrsnt, @MEnv_VcRrDuallyPrsnt_SET_INT_1);
              
                init_state[13] = 1;
            }
        }
        break;
    }
}

on envVar MEnv_HeadUnitInitialization_SET_BOL_1
{
    if(@this == 1)
    {
//        setSignal(AC_Stat, 1);
//        setSignal(ACC_DLY_ACT, 1);
//        setSignal(ACC_DLY_TIME, 3);
//        setSignal(AHB_ENBL, 1);
//        setSignal(AMB_TEMP_AVG_C, 20);
//        setSignal(AMB_TEMP_AVG_F, 68);
//        setSignal(AMP_DSS_STAT, 1);
//        setSignal(AMP_EQ, 53);
//        setSignal(AS_CHIME_TYPE, 0);
//        setSignal(AS_LF_CHIME_RQ, 0);
//        setSignal(AS_RF_CHIME_RQ, 0);
//        setSignal(AUTO_LK, 1);
//        setSignal(AUTO_STAT, 0);
//        setSignal(AUTO_UNLK, 1);
        //setSignal(AutoParkSts, 0);
       // setSignal(Batt_ST_Crit, 0);
//        setSignal(BSM_CFG_STAT, 2);
        //setSignal(BSM_CFG_STAT_TeenKey, 2);
//        setSignal(BSM_CHIME_TYPE, 0);
//        setSignal(BSM_LF_CHIME_RQ, 0);
//        setSignal(BSM_LR_CHIME_RQ, 0);
//        setSignal(BSM_SRV_RQ, 0);
        //setSignal(CapacityUnit, 2);
        //setSignal(CFG_AUTO_WPR, 1);
       // setSignal(CMP_DIR, 0);
        //setSignal(ConfigSts, 2);
       // setSignal(ConsumptionUnit, 3);
        //setSignal(CSOPlgChimeEnableDisableSts, 1);
//        setSignal(DAY_LGT_MD, 1);
        //setSignal(DCSD_DISP_STAT, 1);
        ////setSignal(DistanceUnit, 1);
        //setSignal(DR_ALR, 1);
//        setSignal(DR_LK_STAT, 2);
//        setSignal(DRL_ON, 0);
        //setSignal(DynamicGridResp, 1);
        //setSignal(DynamicGridRespSts, 1);
//        setSignal(E_CALL_BtnStat, 3);
        //setSignal(EASY_EXIT, 1);
//        setSignal(EBL_Stat, 0);
//        setSignal(EC_AudTel1A, 56);
//        setSignal(EC_AudTel1B, 144641);
//        setSignal(EC_AudTel2, 488636418);
//        setSignal(EC_AudTel3A, 0);
//        setSignal(EC_ECUCfg3_Stat, 1);
//        setSignal(EC_ECUCfg16_Stat, 1);
//        setSignal(EC_MirrStat, 3);
//        setSignal(EngCoolTemp, 24);
//        setSignal(EngRPM, 0);
//        setSignal(FCW_BrkOn, 0);
        //setSignal(FCWBrkTeen, 1);
//        setSignal(FCWSetting, 2);
        //setSignal(FCWSettingTeen, 2);
//        setSignal(FCWState, 1);
//        setSignal(FL_HS_STAT, 0);
        //setSignal(FL_VS_STAT, 0);
//        setSignal(FLASH_LK, 1);
//        setSignal(FR_HS_STAT, 0);
        //setSignal(FR_VS_STAT, 0);
//        setSignal(FT_DRV_ATC_TEMP, 72);
//        setSignal(FT_DRV_MTC_TEMP, 127);
//        setSignal(FT_HVAC_BLW_FN_SP, 1);
//        setSignal(FT_HVAC_CTRL_STAT, 4);
//        setSignal(FT_HVAC_MD_STAT, 8);
//        setSignal(FT_PSG_ATC_TEMP, 72);
        //setSignal(FT_PSG_MTC_TEMP, 127);
        //setSignal(HALF_CHIME_REP_RATESts, 0);
        //setSignal(HALF_CHIME_TYPESts, 15);
        //setSignal(HALF_LF_CHIME_RQSts, 0);
        //setSignal(HALF_RF_CHIME_RQSts, 0);
        //setSignal(Hands_Free_PLG_Enbl, 1);
        //setSignal(Hands_Free_SLDR_Enbl, 0);
//        setSignal(HL_DLY_TIME, 30);
//        setSignal(HL_WPR, 1);
//        setSignal(HSA_EN, 1);
        //setSignal(HSW_Stat, 0);
//        setSignal(ICS_btn_0, 0);
//        setSignal(ICS_btn_1, 0);
//        setSignal(ICS_btn_5, 0);
        //setSignal(ICS_btn_9, 0);
//        setSignal(ICS_btn_24, 0);
        //setSignal(ICS_btn_26, 0);
        //setSignal(ICS_btn_27, 0);
        //setSignal(ICS_btn_28, 0);
        //setSignal(ICS_btn_29, 0);
//        setSignal(ICS_btn_30, 0);
//        setSignal(ICS_btn_31, 0);
//        setSignal(ICS_FT_HVAC_MD_Cntrl, 0);
//        setSignal(ICS_KNOB1_DIR, 0);
//        setSignal(ICS_KNOB1_VAL, 0);
//        setSignal(ICS_KNOB2_DIR, 0);
//        setSignal(ICS_KNOB2_VAL, 0);
//        setSignal(ICS_KNOB3_DIR, 0);
//        setSignal(ICS_KNOB3_VAL, 0);
//        setSignal(IGN_OFF_TIME_LNG, 1038);
//        setSignal(ILL_APRCH_TIME, 30);
        //setSignal(ImageDefeatRQSts, 0);
//        setSignal(KeyInIgn, 2);
        //setSignal(KeySense_SetSpdOpt, 0);
//        setSignal(LT_DIST, 0);
//        setSignal(MAX_ACSts, 0);
//        setSignal(NET_CFG_STAT_PT, 1);
//        setSignal(PANEL_INTS, 0);
//        setSignal(PE_ENABLE, 1);
        //setSignal(PN14_Key_Off_Load_Shed, 0);
//        setSignal(PN14_LS_Actv, 0);
//        setSignal(PN14_LS_Lvl7, 0);
//        setSignal(PNC_ALM_ACT, 0);
//        setSignal(PowerUnit, 2);
//        setSignal(PressureUnit, 2);
//        setSignal(PRNDL_DISP, 80);
        //setSignal(PTS_CFG_STAT, 2);
        //setSignal(PTS_CFG_STAT_TeenKey, 2);
//        setSignal(PTS_CHIME_REP_RATE, 0);
//        setSignal(PTS_CHIME_TYPE, 0);
//        setSignal(PTS_FT_VOL, 0);
        //setSignal(PTS_FT_VOL_TeenKey, 2);
//        setSignal(PTS_LF_CHIME_RQ, 0);
//        setSignal(PTS_LR_CHIME_RQ, 0);
//        setSignal(PTS_RF_CHIME_RQ, 0);
//        setSignal(PTS_RR_CHIME_RQ, 0);
//        setSignal(PTS_RR_VOL, 0);
        //setSignal(PTS_RR_VOL_TeenKey, 1);
        //setSignal(R_ATC_TEMP, 126);
        //setSignal(R_HVAC_BLW_FN_SP, 4);
        //setSignal(R_HVAC_CTRL_STAT, 4);
        //setSignal(R_HVAC_LkOut, 0);
        //setSignal(R_HVAC_MD_STAT, 4);
        //setSignal(R_MTC_TEMP, 127);
//        setSignal(RECIRC_STAT, 0);
//        setSignal(RemStActv, 0);
//        setSignal(RemStEnbl_DCS, 0);
//        setSignal(RemStNrmlStEnbl_DCS, 1);
        //setSignal(RKE_MEM, 1);
//        setSignal(RKE_ONE_PRESS_ENBL, 1);
        //setSignal(RR_PTS_StopControlSts, 0);
        //setSignal(RR_PTS_StopControlStsTeen, 0);
//        setSignal(RT_DIST, 0);
        //setSignal(SBR_MuteRq, 0);
        //setSignal(ServiceModeSts, 0);
//        setSignal(SHIP_STAT, 0);
        //setSignal(SLD_DR_Chime_Enbl, 0);
//        setSignal(SOUND_LK_1ST_2ND, 1);
//        setSignal(SOUND_RS, 1);
//        setSignal(SpeedUnit, 1);
//        setSignal(StTyp, 0);
//        setSignal(SURR_AVAIL, 1);
//        setSignal(SYNC_STAT, 0);
        //setSignal(TeenKeyPrsnt, 0);
        //setSignal(TemperatureUnit, 1);
        //setSignal(TextDisplay, 0);
        //setSignal(TILT_IN_REV_D, 0);
        //setSignal(TorqueIntensitySts, 7);
//        setSignal(TorqueUnit, 1);
//        setSignal(U_CALL_BtnStat, 3);
//        setSignal(VC_ACC_DLY_CSO, 1);
//        setSignal(VC_AUTO_HB_CSO, 1);
//        setSignal(VC_AUTO_PRK_CSO, 1);
//        setSignal(VC_BLIND_SPOT_CSO, 1);  
//        setSignal(VC_CAPACITY_CSO, 0);
//        setSignal(VC_CHMCM_Prsnt, 0);
//        setSignal(VC_CLK_DSP_CSO, 0);
//        setSignal(VC_CMP_DISP, 1);
//        setSignal(VC_CMRA_GRDLNS_CSO, 0);
//        setSignal(VC_CONS_CSO, 1);
//        setSignal(VC_DCS_CSO, 2);
//        setSignal(VC_DISTANCE_CSO, 1);
//        setSignal(VC_DR_LK_CSO, 1);
//        setSignal(VC_DR_UNLK_CSO, 1);
//        setSignal(VC_DRL_CSO, 1);
//        setSignal(VC_DSBL_CLK_DISP, 0);
//        setSignal(VC_EASY_EXIT_CSO, 1);
//        setSignal(VC_EPB_SERV_CSO, 1);
//        setSignal(VC_FCW_BRK_CSO, 1);
//        setSignal(VC_FCW_CSO, 2);
//        setSignal(VC_FCW_SW_CSO, 1);
//        setSignal(VC_FLSH_LMP_LK_CSO, 1);
//        setSignal(VC_FLSH_LMP_SLDR_CSO, 1);
//        setSignal(VC_FUEL_CAP, 72);
//        setSignal(VC_HANDS_FREE_LFT_CSO, 1);
//        setSignal(VC_HANDS_FREE_SLDR_CSO, 1);  
//        setSignal(VC_HdRstPrsnt, 1);
//        setSignal(VC_HL_OFF_DLY_CSO, 1);
//        setSignal(VC_HL_WPR_CSO, 1);
//        setSignal(VC_HRN_RMT_LK_CSO, 2);
//        setSignal(VC_HRN_RMT_ST_CSO, 1);
//        setSignal(VC_HSA_CSO, 1);
//        setSignal(VC_HVAC_Config, 5);
//        setSignal(VC_ILL_APPRCH_CSO, 1);
//        setSignal(VC_IntEC_MIRR, 1);
//        setSignal(VC_LDW_TRQ_CSO, 1);
//        setSignal(VC_LDW_WRN_CSO, 1);
//        setSignal(VC_LHD_RHD, 1);
//        setSignal(VC_NAV_TRN_CSO, 0);
//        setSignal(VC_PE_CSO, 1);
//        setSignal(VC_PLG_CHM_CSO, 1);
//        setSignal(VC_POWER_CSO, 0);
//        setSignal(VC_PRESSURE_CSO, 1);
//        setSignal(VC_PRK_AST_BRK_CSO, 1);
//        setSignal(VC_PRK_AST_CSO, 1);
//        setSignal(VC_PRK_FT_VOL_CSO, 1);
//        setSignal(VC_PRK_RR_VOL_CSO, 1);
//        setSignal(VC_RAIN_WPR_CSO, 1);
//        setSignal(VC_REAR_CMRA_CSO, 0);  
//        setSignal(VC_REAR_CMRA_DLY_CSO, 0);
//        setSignal(VC_RemStPrsnt, 1);
//        setSignal(VC_RKE_MEM_CSO, 1);
//        setSignal(VC_RKE_UNLK_CSO, 1);
//        setSignal(VC_RVCM_Prsnt, 0);
//        setSignal(VC_SLD_DR_ALRT_CSO, 1);
//        setSignal(VC_SPEED_CSO, 1);
//        setSignal(VC_SRT_PRSNT, 0);
//        setSignal(VC_SVC_DELAY_CSO, 1);
//        setSignal(VC_SVC_GRIDLINES_CSO, 1);
//        setSignal(VC_TEEN_AUTO_HB_CSO, 0);
//        setSignal(VC_TEEN_BLIND_SPOT_CSO, 1);
//        setSignal(VC_TEEN_FCW_BRK_CSO, 1);
//        setSignal(VC_TEEN_FCW_SENS_CSO, 1);
//        setSignal(VC_TEEN_FT_PRK_VOL_CSO, 1);
//        setSignal(VC_TEEN_FUEL_POPUP_CSO, 0);
//        setSignal(VC_TEEN_FUEL_WRN_CSO, 0);
//        setSignal(VC_TEEN_LGHT_WPR_CSO, 0);
//        setSignal(VC_TEEN_MAX_SPEED_CSO, 1);
//        setSignal(VC_TEEN_PRK_ASST_CSO, 1);
//        setSignal(VC_TEEN_RAIN_WPR_CSO, 0);
//        setSignal(VC_TEEN_RR_PRK_VOL_CSO, 1);
//        setSignal(VC_TEMP_CSO, 1);  
//        setSignal(VC_TEMP_DISP, 1);
//        setSignal(VC_TIRE_CIRCUMF, 2302);
//        setSignal(VC_TLT_MRR_CSO, 1);
//        setSignal(VC_TORQUE_CSO, 0);
//        setSignal(VC_VEH_BRAND, 1);
//        setSignal(VC_VehCfg2_Stat, 1);
//        setSignal(VC_VehCfg4_Stat, 1);
//        setSignal(VC_VehCfg5_Stat, 1);
//        setSignal(VC_VehCfg6_Stat, 1);
//        setSignal(VC_VehCfgCSO1_Stat, 1);
//        setSignal(VC_VehCfgCSO2_Stat, 1);
//        setSignal(VC_XWD, 0);
//        setSignal(VehSpd_MPH, 1);
//        setSignal(VehSpdDisp, 0);
        //setSignal(VRM_AUD_MD_CAB, 0);
        //setSignal(VRM_Audio_Active, 0);
        //setSignal(VRM_H_SIZE, 1600);
        //setSignal(VRM_IR1_AUD_MD, 0);  
        //setSignal(VRM_IR2_AUD_MD, 0);
        //setSignal(VRM_IR3_AUD_MD, 0);
        //setSignal(VRM_JUMP_FUNC, 0);
        //setSignal(VRM_PT_CAB_DR, 0);
        //setSignal(VRM_RDC2_STAT, 0);
        //setSignal(VRM_RQ1, 0);
        //setSignal(VRM_RQ2, 0);
        //setSignal(VRM_RQ3, 0);
        //setSignal(VRM_RSP, 0);
        //setSignal(VRM_V_SIZE, 1152);
        //setSignal(VRM_Video_Active, 0);
//        setSignal(WhlPlsCnt_FL, 0);
//        setSignal(WhlPlsCnt_FR, 0);
//        setSignal(WhlPlsCnt_RL, 0);
//        setSignal(WhlPlsCnt_RR, 0);
    }
    else
    {
        
    }
}

/*
on envVar MEnv_AscmStatus_SET_INT_1
{
    setSignal(ASCM_Stat, @this);
}

on signal ASCM_Stat
{
    @MEnv_AscmStatus_GET_INT_1 = this;
}
*/

on envVar MEnv_AscmStatusFlt_SET_BOL_1
{
    if(@this==1)    // checkbox checked
    {
       ASCMSTATUS_BUFFER = @MEnv_AscmStatus_GET_INT_1;
        @MEnv_AscmStatus_SET_INT_1 = 0x0F;
    }
    else
    {
        //checkbox unchecked, put last value before fault
        @MEnv_AscmStatus_SET_INT_1 = ASCMSTATUS_BUFFER;
    }
} 
/*
on envVar MEnv_LevelRl_SET_INT_1
{
    setSignal(RL_Lvl, @this);
}

on signal RL_Lvl
{
    @MEnv_LevelRl_GET_INT_1 = this;
}
*/
on envVar MEnv_LevelRlFlt_SET_BOL_1
{
    if(@this==1)    // checkbox checked
    {
       LEVELRL_BUFFER = @MEnv_LevelRl_GET_INT_1;
        @MEnv_LevelRl_SET_INT_1 = 155;
    }
    else
    {
        //checkbox unchecked, put last value before fault
        @MEnv_LevelRl_SET_INT_1 = LEVELRL_BUFFER;
    }
} 
/*
on envVar MEnv_LevelRr_SET_INT_1
{
    setSignal(RR_Lvl, @this);
}

on signal RR_Lvl
{
    @MEnv_LevelRr_GET_INT_1 = this;
}
*/
on envVar MEnv_LevelRrFlt_SET_BOL_1
{
    if(@this==1)    // checkbox checked
    {
       LEVELRR_BUFFER = @MEnv_LevelRr_GET_INT_1;
        @MEnv_LevelRr_SET_INT_1 = 155;
    }
    else
    {
        //checkbox unchecked, put last value before fault
        @MEnv_LevelRr_SET_INT_1 = LEVELRR_BUFFER;
    }
} 
//-----------------------------------------------------------

on envVar MEnv_CameraDisplaySts2_SET_INT_1
{
    setSignal(CameraDisplaySts, @this);
}

on signal CameraDisplaySts
{
    @MEnv_CameraDisplaySts2_GET_INT_1 = this;
}

//on envVar MEnv_VcVehCfg2Stat_SET_INT_1
//{
//    setSignal(VC_VehCfg2_Stat, @this);
//}

//on signal VC_VehCfg2_Stat
//{
//    @MEnv_VcVehCfg2Stat_GET_INT_1 = this;
//}

on envVar MEnv_VcVehCfg2StatFlt_SET_BOL_1
{
    if(@this==1)    // checkbox checked
    {
        VCVEHCFG2STAT_BUFFER = @MEnv_VcVehCfg2Stat_GET_INT_1;
        @MEnv_VcVehCfg2Stat_SET_INT_1 = VCVEHCFG2STAT_FAULT;
    }
    else
    {
        //checkbox unchecked, put last value before fault
        @MEnv_VcVehCfg2Stat_SET_INT_1 = VCVEHCFG2STAT_BUFFER;
    }
}

//on envVar MEnv_VcSpecialPkgIc_SET_INT_1
//{
//    setSignal(VC_SpecialPKG_IC, @this);
//}

//on signal VC_SpecialPKG_IC
//{
//    @MEnv_VcSpecialPkgIc_GET_INT_1 = this;
//}

on envVar MEnv_VcSpecialPkgIcFlt_SET_BOL_1
{
    if(@this==1)    // checkbox checked
    {
        VCSPECIALPKGIC_BUFFER = @MEnv_VcSpecialPkgIc_GET_INT_1;
        @MEnv_VcSpecialPkgIc_SET_INT_1 = VCSPECIALPKGIC_FAULT;
    }
    else
    {
        //checkbox unchecked, put last value before fault
        @MEnv_VcSpecialPkgIc_SET_INT_1 = VCSPECIALPKGIC_BUFFER;
    }
}

//on envVar MEnv_VcVehCfg8Stat_SET_INT_1
//{
//    setSignal(VC_VehCfg8_Stat, @this);
//}

//on signal VC_VehCfg8_Stat
//{
//    @MEnv_VcVehCfg8Stat_GET_INT_1 = this;
//}

on envVar MEnv_VcVehCfg8StatFlt_SET_BOL_1
{
    if(@this==1)    // checkbox checked
    {
        VCVEHCFG8STAT_BUFFER = @MEnv_VcVehCfg8Stat_GET_INT_1;
        @MEnv_VcVehCfg8Stat_SET_INT_1 = VCVEHCFG8STAT_FAULT;
    }
    else
    {
        //checkbox unchecked, put last value before fault
        @MEnv_VcVehCfg8Stat_SET_INT_1 = VCVEHCFG8STAT_BUFFER;
    }
}
/*
on envVar MEnv_VcWhlBaseLength_SET_INT_1
{
    setSignal(VC_WHL_BASE_LENGTH, @this);
}

on signal VC_WHL_BASE_LENGTH
{
    @MEnv_VcWhlBaseLength_GET_INT_1 = this;
}
*/
//on envVar MEnv_NetCfgAscm_SET_INT_1
//{
//    setSignal(NetCfg_ASCM, @this);
//}

//on signal NetCfg_ASCM
//{
//    @MEnv_NetCfgAscm_GET_INT_1 = this;
//}

//on envVar MEnv_VcLhdRhd_SET_INT_1
//{
//    setSignal(VC_LHD_RHD, @this);
//}

//on signal VC_LHD_RHD
//{
//    @MEnv_VcLhdRhd_GET_INT_1 = this;
//}

on envVar MEnv_VcLhdRhdFlt_SET_BOL_1
{
    if(@this==1)    // checkbox checked
    {
        VCLHDRHD_BUFFER = @MEnv_VcLhdRhd_GET_INT_1;
        @MEnv_VcLhdRhd_SET_INT_1 = VCLHDRHD_FAULT;
    }
    else
    {
        //checkbox unchecked, put last value before fault
        @MEnv_VcLhdRhd_SET_INT_1 = VCLHDRHD_BUFFER;
    }
}

//on envVar MEnv_VcSteeringCfactor_SET_INT_1
//{
//    setSignal(VC_Steering_Cfactor, @this);
//}

//on signal VC_Steering_Cfactor
//{
//    @MEnv_VcSteeringCfactor_GET_INT_1 = this;
//}

on envVar MEnv_TGWCameraDispSts_SET_INT_1
{
    setSignal(TGW_CAMERA_DISP_STAT, @this);
}

on signal TGW_CAMERA_DISP_STAT
{
    @MEnv_TGWCameraDispSts_GET_INT_1 = this;
}

on envVar MEnv_TGWCameraDispStsFlt_SET_BOL_1
{
    if(@this==1)    // checkbox checked
    {
        TGWCAMERADISPSTAT_BUFFER = @MEnv_TGWCameraDispSts_GET_INT_1;
        @MEnv_TGWCameraDispSts_SET_INT_1 = TGWCAMERADISPSTAT_FAULT;
    }
    else
    {
        //checkbox unchecked, put last value before fault
        @MEnv_TGWCameraDispSts_SET_INT_1 = TGWCAMERADISPSTAT_BUFFER;
    }
}

//----------------------------------------------------------------
on timer t_Emc_AutoMode // related to the Task 3018688
{
    @MEnv_ViewButtonState_SET_INT_1 = 1;
    setTimer(t_ResetViewButtonState, 50);
  
    setTimer(t_Emc_AutoMode_Delay, 500);
}

on timer t_Emc_AutoMode_Delay
{
    @MEnv_StwAngleSweep_SET_INT_1 = 1;

    if (@MEnv_EmvMode_SET_INT_2 == 1) // 360 Mode
    {
        @MEnv_ViewSwitchSweep_SET_BOL_1 = 1;
    }
    else if (@MEnv_EmvMode_SET_INT_2 == 2) // CHMSL Mode
    {
        @MEnv_VcDgtlChmslCamPrsnt_SET_INT_1 = 1;
      
        setTimer(t_TouchCommand, 1000); // to insert a delay, because 1. the Size of the panel is send and after this it should chang the view earliest
    }
}

on envVar MEnv_EmvMode_SET_INT_2
{
    if(@this == 1) // 360 Mode
    {
        @MEnv_SweepRearAndTop_SET_BOL_1 = 1;
        @MEnv_SweepRearCross_SET_BOL_1 = 0;
        @MEnv_SweepFrontCross_SET_BOL_1 = 0;
        @MEnv_SweepFrontAndTop_SET_BOL_1 = 1;
        @MEnv_SweepTowBallView_SET_BOL_1 = 0;
    }
    else if (@this == 2) // CHMSL Mode
    {
        /*
        @MEnv_SweepRearAndTop_SET_BOL_1 = 1;
        @MEnv_SweepRearCross_SET_BOL_1 = 0;
        @MEnv_SweepFrontCross_SET_BOL_1 = 0;
        @MEnv_SweepFrontAndTop_SET_BOL_1 = 0;
        @MEnv_SweepTowBallView_SET_BOL_1 = 1;
        */
    }
    else
    {
        // do nothing
    }
}

on timer t_ResetViewButtonState
{
    @MEnv_ViewButtonState_SET_INT_1 = 0;
}

on timer t_ResetTouch
{
    @MEnv_ViewButtonState_SET_INT_1 = 0;
}

on timer t_TouchCommand
{
    @MEnv_ViewButtonState_SET_INT_1 = 4; // CHMSL_NV (View 4)
      
    setTimer(t_ResetTouch, 50);
  
    setTimer(t_TouchCommand, 2000);
}
//----------------------------------------------------------------

on signal DisplayView2
{
    @MEnv_DisplayView3_GET_INT_1 = this;
}
/*
on envVar MEnv_VcDgtlChmslCamPrsnt_SET_INT_1
{
    setSignal(VC_Dgtl_CHMSL_Cam_Prsnt, @this);
}

on signal VC_Dgtl_CHMSL_Cam_Prsnt
{
    @MEnv_VcDgtlChmslCamPrsnt_GET_INT_1 = this;
}

on envVar MEnv_VcTrlrRevGuidancePrsnt_SET_INT_1
{
    setSignal(VC_Trlr_Rev_Guidance_Prsnt, @this);
}

on signal VC_Trlr_Rev_Guidance_Prsnt
{
    @MEnv_VcTrlrRevGuidancePrsnt_GET_INT_1 = this;
}
*/
//on envVar MEnv_VcOFFroadCamera_SET_INT_1
//{
//    setSignal(VC_OFFroad_Camera, @this);
//}

//on signal VC_OFFroad_Camera
//{
//    @MEnv_VcOFFroadCamera_GET_INT_1 = this;
//}
/*
on envVar MEnv_VcBoxDelete_SET_INT_1
{
    setSignal(VC_Box_Delete, @this);
}

on signal VC_Box_Delete
{
    @MEnv_VcBoxDelete_GET_INT_1 = this;
}

on envVar MEnv_AuxCameraStat_SET_INT_1
{
    setSignal(AUX_CAMERA_STAT, @this);
}

on signal AUX_CAMERA_STAT
{
    @MEnv_AuxCameraStat_GET_INT_1 = this;
}

on envVar MEnv_VcAuxTrailerCamPrsnt_SET_BOL_1
{
    setSignal(VC_Aux_Trailer_Cam_Prsnt, @this);
}

on signal VC_Aux_Trailer_Cam_Prsnt
{
    @MEnv_VcAuxTrailerCamPrsnt_GET_BOL_1 = this;
}
*/
//on envVar MEnv_VcRrDuallyPrsnt_SET_INT_1
//{
//    setSignal(VC_RR_DuallyPrsnt, @this);
//}

//on signal VC_RR_DuallyPrsnt
//{
//    @MEnv_VcRrDuallyPrsnt_GET_INT_1 = this;
//}

on envVar MEnv_SVCGuidelines_SET_INT_1
{
    setsignal(SVC_Guidelines, @this);
}

on signal SVC_Guidelines
{
    @MEnv_SVCGuidelines_GET_INT_1 = this;
}