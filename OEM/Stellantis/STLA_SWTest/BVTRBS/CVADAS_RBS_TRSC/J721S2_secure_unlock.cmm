;;;;;;;;;;;;;;;;;;;;;;;;;;;;;;;;;;;;;;;;;;;;;;;;;;;;;;;;;;;;;;;;;;;;;;;;;;;;;;
; Unlock HS device to allow test execution
; 14 Oct 21 - Richard Woodruff - Adapt J7ES for J721S2.
; 10 Jun 22 - Richard Woodruff - Add debug and diag parameterization
; 08 Oct 22 - Richard Woodruff - Remove copy-past-else error, increase waits
;;;;;;;;;;;;;;;;;;;;;;;;;;;;;;;;;;;;;;;;;;;;;;;;;;;;;;;;;;;;;;;;;;;;;;;;;;;;;;
;
; Script INPUT PARMS: (DIAG, DEBUG, FS, SE)

; pre-conditions:
;  - A valid certificate has been generated which is available
;    -- Use the device UID to create a certificate suitable for unlocking
;  For Flashing & limited Diagnostics
;    - EMU0=0,EMU1=1 at time CPU is released from reset.
;      -- Force states by {EVM DIP switches, resistor pulls, debugger-IO forces}
; post-condition
;  - HS device is unlocked.  JTAG can be used, Tests loaded, Functional boot initiated

 PRIVATE &parameters
 ENTRY %LINE &parameters
 &parameters=STRing.UPpeR("&parameters")

 ;Uncomment next line when not calling with parameters.
 ;&parameters="DEBUG SE"

 PRIVATE &param_diag &param_debug &param_fs &param_se
 &param_diag=(STRing.SCAN("&parameters","DIAG",0)!=-1)
 &param_debug=(STRing.SCAN("&parameters","DEBUG",0)!=-1)
 &param_fs=(STRing.SCAN("&parameters","FS",0)!=-1)
 &param_se=(STRing.SCAN("&parameters","SE",0)!=-1)

 IF !&param_diag&&!&param_debug
   PRINT "defaulting to debug"

 ; Add Linux or Windows paths to cert
 &opath="../certificate"
;&opath="/opt"

 LOCAL &scmd &cert
 
 ; limited to M4 directed board diagnostics 
 IF (&param_diag)
 (
   IF !&param_fs&&!&param_se
     PRINT "defaulting to fs"
   IF (&param_se)
     &cert="debug_unlock_cert.bin"
   ELSE
     &cert="debug_unlock_cert.bin"
   &scmd=0x35131696       ; WIR_COMMAND_OVERRIDE_REQUEST
 )
 ELSE
 (
   &cert="debug_unlock_cert.bin"
   &scmd=0x4968B2E9      ; COMMAND_UNLOCK_REQUEST
 )

 system.down
 RESet
 SYStem.RESet
 area.create A000 100 1000
 area.clear
 area

 IF (&param_diag)
 (
   &DRIVEIO="yes"  ; debugger or DIP switch to WIR
   IF ("&DRIVEIO"=="yes")
   (
    ; Have debugger drive EMU0=0,EMU1=1 
    DIALOG.OK "Power down board then hit OK"
    JTAG.PIN ENable  ; output enable the LB driver
    DIAG 3403 3      ; Force DBGREQ (high) to set EMU0 Low on LB headers which invert
    DIALOG.OK "Now Power up board then hit OK"
   )
 )

 SYStem.cpu J721S2-CM4-0
 SYStem.Option EnReset OFF
 SYStem.Option.MemStatusCheck.on
 SYStem.Mode PREPARE
 data.Set EDBG:0x400003f0 %Long 0x00190000    ; Unlock APs

; prepare cert for target usage
 LOCAL &certsize &certwords &certaddr &rslt
 &certsize=OS.FILE.SIZE("&cert")
 &certsize=((&certsize+4)&(~(4-1)))          ; round up to word boundary
 &certwords=(&certsize/4)
 &certaddr=0x0
 data.set VM:&certaddr++(&certsize-1) %Long 0x0
 data.load.binary "&cert" VM:&certaddr
 
; Issue command with certificate
 data.set EDBG:0x40000604 %Long (1<<16.)     ; TXCRL->Len 1 word
 wait 1mS
 data.set EDBG:0x40000600 %Long &scmd        ; TXDR->COMMAND
 wait 1mS

 WHILE &certwords>0x0
 (
    data.set EDBG:0x40000604 %Long (&certwords<<16.)
    wait 1mS
    &certval=Data.Long(VM:&certaddr)
    data.set EDBG:0x40000600 %Long %LE &certval
    &certaddr=&certaddr+4
    &certwords=&certwords-1
    wait 1mS
 )

 wait 10mS

 &rslt=Data.Long(EDBG:0x40000608)            ; final response in RXDR
 print "unlock response was:0x"+FORMAT.HEX(4.,&rslt)
 print "data.dump eapb:0x0 should have values not ?????? on success" 
 data.dump eapb:0x0  ; rom table should show up on a dump

quit

