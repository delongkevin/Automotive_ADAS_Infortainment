/*@!Encoding:1252*/

includes
{
  #include "..\..\AutomationDependent\ProjectSpecific\GenLib_Includes.cin"
  #include "..\..\AutomationDependent\PowerSupply_libraries\Power_ctrl.can"
  #include "../../config.cin"
}

variables
{
  char chTestDescription[500];
  char chActionText[500];
  char chExpectedText[500];
  char chTestTitle[100];
  char canIdValue[256];
  int result;
  char searchString[256];
  char command[256];
  byte CANA_Wakeup[8] =  {0x08,0x08,0x00,0x00,0x00,0x00,0x00,0x01};
  byte CANA_Wakeup_1[8] =  {0x00,0x00,0x00,0x00,0x00,0x00,0x00,0x01};
  byte CANA_Wakeup_2[8] =  {0x08,0x00,0x00,0x00,0x00,0x00,0x00,0x00};
  byte CANB_Wakeup[4] =  {0x00,0x00,0x01,0x00};
  int Stress =0;
  long CANID[70] = {0x00000401, 0x00000301, 0x00000201, 0x00000042, 0x0000039E, 0x00000211, 0x00000212, 0x0000039D, 0x0000020D, 0x0000039B, 0x0000003E, 0x000002B3, 0x00000398, 0x000000BA, 0x00000397, 0x00000270, 0x00000585, 0x0000056B, 0x0000052C, 0x000002D7, 0x00000523, 0x00000568, 0x00000522, 0x00000505, 0x00000593, 0x00000594, 0x00000582, 0x000005A4, 0x000000B6, 0x00000584, 0x000003C3, 0x000003C4, 0x000003C2, 0x000002D5, 0x000003A2, 0x000002D6, 0x0000057F, 0x00000590, 0x000005A1, 0x000005F9, 0x000000C0, 0x000002BF, 0x000003AA, 0x000003B1, 0x00000596, 0x000005C9, 0x000003A5, 0x0000003F, 0x000003A6, 0x000005D2, 0x000004F0, 0x00000599, 0x0000006F, 0x000005CA, 0x000005CB, 0x000005BA, 0x0000059B, 0x00000293, 0x000004E1, 0x000004DC, 0x000000AF, 0x000000AE, 0x00000595, 0x000005C4, 0x00000140, 0x000002D8, 0xC0000100, 0x00007000, 0x00000140, 0x00000140 };
  byte dat_64byte[64] = {0xAA,0x55,0xAA,0x55,0xAA,0x55,0xAA,0x55,0xAA,0x55,0xAA,0x55,0xAA,0x55,0xAA,0x55,0xAA,0x55,0xAA,0x55,0xAA,0x55,0xAA,0x55,0xAA,0x55,0xAA,0x55,0xAA,0x55,0xAA,0x55,0xAA,0x55,0xAA,0x55,0xAA,0x55,0xAA,0x55,0xAA,0x55,0xAA,0x55,0xAA,0x55,0xAA,0x55,0xAA,0x55,0xAA,0x55,0xAA,0x55,0xAA,0x55,0xAA,0x55,0xAA,0x55,0xAA,0x55,0xAA,0x55};
  
  message 0x123 msg_2; // Define the CAN message with ID 0x123
  message 0x456 msg_8; // Define the CAN message with ID 0x456
  
  msTimer periodicTimer_CAN2; // Define a timer variable
  msTimer periodicTimer_CAN8; // Define a timer variable
  msTimer periodicTimer_Multiple;
  msTimer periodic_error_8;
  msTimer periodic_error_2;
}

on timer periodicTimer_CAN2 {
  // Set the data for the CAN message
  msg_2.byte(0) = 0x08;
  msg_2.byte(1) = 0x00;
  msg_2.byte(2) = 0x00;
  msg_2.byte(3) = 0x00;
  msg_2.byte(4) = 0x00;
  msg_2.byte(5) = 0x00;
  msg_2.byte(6) = 0x00;
  msg_2.byte(7) = 0x01;

  // Set the DLC for the CAN message
  msg_2.dlc = 8;
  msg_2.can = 1;
  // Send the CAN message
   output(msg_2);

  // Restart the timer for the next period
  setTimer(periodicTimer_CAN2, 1);
  
}


on timer periodicTimer_CAN8 {
  // Set the data for the CAN message
  msg_8.byte(0) = 0x00;
  msg_8.byte(1) = 0x00;
  msg_8.byte(2) = 0x01;
  msg_8.byte(3) = 0x00;
  
  // Set the DLC for the CAN message
  msg_8.dlc = 4;
  msg_8.can = 2;
  // Send the CAN message
  output(msg_8);
  
  // Restart the timer for the next period
  setTimer(periodicTimer_CAN8, 1);
  
}

on timer periodicTimer_Multiple {
 
  msg_2.byte(0) = 0x08;
  msg_2.byte(1) = 0x00;
  msg_2.byte(2) = 0x00;
  msg_2.byte(3) = 0x00;
  msg_2.byte(4) = 0x00;
  msg_2.byte(5) = 0x00;
  msg_2.byte(6) = 0x00;
  msg_2.byte(7) = 0x01;

  // Set the DLC for the CAN message
  msg_2.dlc = 8;
  msg_2.can = 1;
  
  // Set the data for the CAN message
  msg_8.byte(0) = 0x00;
  msg_8.byte(1) = 0x00;
  msg_8.byte(2) = 0x01;
  msg_8.byte(3) = 0x00;
  
  // Set the DLC for the CAN message
  msg_8.dlc = 4;
  msg_8.can = 2;
  
  // Send the CAN message
   output(msg_2);

  // Send the CAN message
  output(msg_8);
  output(msg_2);

  // Restart the timer for the next period
  setTimer(periodicTimer_Multiple, 1);
  
}

on timer periodic_error_8 {

  canOutputErrorFrame(CAN2.errorFrame, 12, 0);
  // Restart the timer for the next period
  setTimer(periodic_error_8, 1);
  
}


on timer periodic_error_2 {

  canOutputErrorFrame(CAN1.errorFrame, 12, 0);
  // Restart the timer for the next period
  setTimer(periodic_error_2, 1);
  
}

testcase Verify_that_the_GetHWIO_e_WakeupSigSt_reports_Last_wakeup_event_is_equal_to_0_if_the_wakeup_events_are_not_detected()
{
  /***************************************************************************************************************/    
                                                // Variable Definition
  /***************************************************************************************************************/ 
  

  
  /***************************************************************************************************************/    
                                               // Local Values
  /***************************************************************************************************************/ 
  

  
  /***************************************************************************************************************/    
                                              // Test Case Info
  /***************************************************************************************************************/
  setWriteDbgLevel(DebugOff);
  snprintf( chTestTitle, elCount(chTestTitle), "Verify_that_the_GetHWIO_e_WakeupSigSt_reports_Last_wakeup_event_is_equal_to_0_if_the_wakeup_events_are_not_detected" );
  snprintf( chTestDescription, elCount(chTestDescription), "Purpose:To check the GetHWIO_e_WakeupSigSt interface  ");
  TestCaseAddInfo( chTestTitle, "TC_L30SW_Q-36712263", chTestDescription );

  /***************************************************************************************************************/    
                                              // Start of Test Case
  /***************************************************************************************************************/
  
  /***************************************************************************************************************/    
                                              // Test Step 0 PRECONDITIONS
  /***************************************************************************************************************/
   snprintf( chActionText, elCount(chActionText), "Flash the Software and ECU is running "); 
  snprintf( chExpectedText, elCount(chExpectedText), "Ecu is should be in running state"); 
  TestStepAddActionExpected( chActionText, chExpectedText );
  
  A_DBGR_BreakpointDeleteAll();
  A_DBGR_R();
  A_DBGR_Go_Safe();
  /***************************************************************************************************************/    
                                              // Test Step 1 Set a breakpoint at line return ( uint8 )wakeEvent;
  /***************************************************************************************************************/
  snprintf( chActionText, elCount(chActionText), "Set Breakpoint in Test_GetHWIO_e_WakeupSigSt\\33 "); 
  snprintf( chExpectedText, elCount(chExpectedText), "verify is Breakpoint Set Test_GetHWIO_e_WakeupSigSt\\33"); 
  
  A_DBGR_BreakpointSet("Test_GetHWIO_e_WakeupSigSt\\33");

  snprintf( chActionText, elCount(chActionText), "verify Breakpoint should hit in Test_GetHWIO_e_WakeupSigSt\\33 "); 
  snprintf( chExpectedText, elCount(chExpectedText), "Breakpoint hit in Test_GetHWIO_e_WakeupSigSt\\33 function"); 
  
  E_DBGR_BreakpointCheckForHalt("Test_GetHWIO_e_WakeupSigSt\\33");
  
  /***************************************************************************************************************/    
                                              // Test Step 2 verify is wakeEvent having 0.
  /***************************************************************************************************************/
  snprintf( chActionText, elCount(chActionText), "Configure wakeEvent values "); 
  snprintf( chExpectedText, elCount(chExpectedText), "verify Configure wakeEvent values"); 
  TestStepAddActionExpected( chActionText, chExpectedText );
  E_DBGR_VariableCheck("wakeEvent",0,Equal);
  
}

testcase Verify_that_the_software_reports_wkupPwrOn_for_GetHWIO_e_WakeupSigSt_function_when_the_wakeup_event_detected_is_Battery_wakeup()
{
  /***************************************************************************************************************/    
                                                // Variable Definition
  /***************************************************************************************************************/ 
  

  
  /***************************************************************************************************************/    
                                               // Local Values
  /***************************************************************************************************************/ 
  

  
  /***************************************************************************************************************/    
                                              // Test Case Info
  /***************************************************************************************************************/
  setWriteDbgLevel(DebugOff);
  snprintf( chTestTitle, elCount(chTestTitle), "Verify_that_the_software_reports_wkupPwrOn_for_GetHWIO_e_WakeupSigSt_function_when_the_wakeup_event_detected_is_Battery_wakeup" );
  snprintf( chTestDescription, elCount(chTestDescription), "Purpose:To check the GetHWIO_e_WakeupSigSt interface ");
  TestCaseAddInfo( chTestTitle, "TC_L30SW_Q-36542354", chTestDescription );

  /***************************************************************************************************************/    
                                              // Start of Test Case
  /***************************************************************************************************************/
  
  /***************************************************************************************************************/    
                                              // Test Step 0 PRECONDITIONS
  /***************************************************************************************************************/
  snprintf( chActionText, elCount(chActionText), "Flash the Software and ECU is running "); 
  snprintf( chExpectedText, elCount(chExpectedText), "ECU should be in running state"); 
  TestStepAddActionExpected( chActionText, chExpectedText );
  
  A_DBGR_BreakpointDeleteAll();
  
  snprintf( chActionText, elCount(chActionText), "Flash the Software and ECU is running "); 
  snprintf( chExpectedText, elCount(chExpectedText), "ECU should be in running state"); 
 
  A_DBGR_R();
  
  snprintf( chActionText, elCount(chActionText), "Flash the Software and ECU is running "); 
  snprintf( chExpectedText, elCount(chExpectedText), "ECU should be in running state"); 
 // TestStepAddActionExpected( chActionText, chExpectedText );
  A_DBGR_Go();
  A_DBGR_Go();
  /***************************************************************************************************************/    
                                              // Test Step 1  Call the function Test_SetHWIO_PowerDown by setting StartPowerDown to 1 then check transceiver is in the SLEEP mode and PMIC to STANDBY mode
  /***************************************************************************************************************/
  snprintf( chActionText, elCount(chActionText), "Configure StartPowerDown variable to invoke Test_SetHWIO_PowerDown interface"); 
  snprintf( chExpectedText, elCount(chExpectedText), "Verify StartPowerDown is configured as 1"); 
  //TestStepAddActionExpected( chActionText, chExpectedText );
  A_DBGR_VariableSet("StartPowerDown","1");
 // E_DBGR_VariableCheck("StartPowerDown",1,Equal);
  
  snprintf( chActionText, elCount(chActionText), "Check Trace32 is stopped"); 
  snprintf( chExpectedText, elCount(chExpectedText), "Verify Trace32 is stopped"); 
  //TestStepAddActionExpected( chActionText, chExpectedText );
  E_DBGR_CheckState(T32_State_Down);
  
 
  /***************************************************************************************************************/    
                                              // Test Step  Run the Software and capture UART log using python
  /***************************************************************************************************************/
  SysExec("powershell", "-ExecutionPolicy Bypass -File ./serial_logging.ps1", automation_root);
  /***************************************************************************************************************/    
                                              // Test Step 2 Disconnect the Battery and verify battery is disconnected
  /***************************************************************************************************************/
  Power_OFF_ON(powersupply_port,0);
  
  /***************************************************************************************************************/    
                                              // Test Step 5  Verify Transceiver wakeUp or not.
  /***************************************************************************************************************/
  snprintf( chActionText, elCount(chActionText), "Transmit CAN message. ID:0x40000101, PDU info:0x01"); 
  snprintf( chExpectedText, elCount(chExpectedText), "CAN message transmitted. ID:0x40000101, PDU info:0x01"); 
  TestStepAddActionExpected( chActionText, chExpectedText ); 
  E_CAN_WaitForMessageByID(0x00000101,10000,cc_eCAN_ABSENT,"CAN1");
  
  /***************************************************************************************************************/    
                                              // Test Step 3 Reconnect the battery power and set the supply voltage to 12V.
  /***************************************************************************************************************/
  
  Power_OFF_ON(powersupply_port,1);
  snprintf( chActionText, elCount(chActionText), "Transmit CAN message. ID:0x40000101, PDU info:0x01"); 
  snprintf( chExpectedText, elCount(chExpectedText), "CAN message transmitted. ID:0x40000101, PDU info:0x01"); 
  TestStepAddActionExpected( chActionText, chExpectedText ); 
  E_CAN_WaitForMessageByID(0x00000101,100000,cc_eCAN_PRESENT,"CAN1");
  
  /***************************************************************************************************************/    
    // Test Step 6 Check UART log in the Tera Term window is update: Last wakeup event is: 1 (wkupPwrOn).
  /***************************************************************************************************************/ 
  strncpy(searchString,"Last wakeup event is: 1",256);
  
  snprintf( chActionText, elCount(chActionText), "waiting for UART log"); 
  snprintf( chExpectedText, elCount(chExpectedText), "waiting for UART log"); 
  TestStepAddActionExpected( chActionText, chExpectedText );
  A_GENERIC_SetTimeout(25000,"waiting for battery disconnect");
  
  snprintf(chActionText, elCount(chActionText), "Run Python script to check battConnectionStatus in log file");
  snprintf(chExpectedText, elCount(chExpectedText), "Python script should execute successfully");
  result =iFcnt_READFILE_SearchKeywordInFile(teraterm,searchString,"string is present");
  
  if(result == 1)
  {
    testStepPass("0","string is present");
  }
  else
  {
    testStepFail("1","string is not present");
  }
}

testcase Verify_that_the_software_reports_wkupCanBusA_for_GetHWIO_e_WakeupSigSt_LLSI_CAN_A_bus_wakeup_scenario_1()
{
  /***************************************************************************************************************/    
                                                // Variable Definition
  /***************************************************************************************************************/ 
  

  
  /***************************************************************************************************************/    
                                               // Local Values
  /***************************************************************************************************************/ 
  

  
  /***************************************************************************************************************/    
                                              // Test Case Info
  /***************************************************************************************************************/
  setWriteDbgLevel(DebugOff);
  snprintf( chTestTitle, elCount(chTestTitle), "Verify_that_the_software_reports_wkupCanBusA_for_GetHWIO_e_WakeupSigSt_LLSI_CAN_A_bus_wakeup_scenario_1" );
  snprintf( chTestDescription, elCount(chTestDescription), "Purpose:To check the GetHWIO_e_WakeupSigSt interface ");
  TestCaseAddInfo( chTestTitle, "TC_L30SW_Q-36542355", chTestDescription );

  /***************************************************************************************************************/    
                                              // Start of Test Case
  /***************************************************************************************************************/
  
  /***************************************************************************************************************/    
                                              // Test Step 0 PRECONDITIONS
  /***************************************************************************************************************/
  snprintf( chActionText, elCount(chActionText), "Flash the Software and ECU is running "); 
  snprintf( chExpectedText, elCount(chExpectedText), "ECU should be in running state"); 
  TestStepAddActionExpected( chActionText, chExpectedText );
  
  A_DBGR_BreakpointDeleteAll();
  A_DBGR_R();

  snprintf( chActionText, elCount(chActionText), "Set Breakpoint TestCanTrcv_Init callback function ");
  snprintf( chExpectedText, elCount(chExpectedText), "Breakpoint is Set in TestCanTrcv_Init");
  A_DBGR_BreakpointSet("TestCanTrcv_Init");
  A_DBGR_Go_Safe();

  /***************************************************************************************************************/    
                                              // Test Step 1 Call the function MngCNDD_CanTrcvInitialize to initialize the CAN transceiver.
  /***************************************************************************************************************/
  snprintf( chActionText, elCount(chActionText), "Verify Breakpoint should hit in TestCanTrcv_Init ");
  snprintf( chExpectedText, elCount(chExpectedText), "Breakpoint hit in TestCanTrcv_Init function"); 
  //TestStepAddActionExpected( chActionText, chExpectedText );  
  E_DBGR_BreakpointCheckForHalt("TestCanTrcv_Init");
  
  /***************************************************************************************************************/    
                                              // Test Step 2 Configure the values for the structure TsCNDD_CanTrcvCnfgType for CAN2 Channel.
  /***************************************************************************************************************/
  snprintf( chActionText, elCount(chActionText), "Set Breakpoint in TestCan_Init "); 
  snprintf( chExpectedText, elCount(chExpectedText), "Verify Breakpoint is Set in TestCan_Init"); 
  TestStepAddActionExpected( chActionText, chExpectedText );  
  A_DBGR_BreakpointSet("TestCan_Init");  
  A_DBGR_Go();
  
  snprintf( chActionText, elCount(chActionText), "Verify Breakpoint should hit in TestCan_Init "); 
  snprintf( chExpectedText, elCount(chExpectedText), "Breakpoint hit in TestCan_Init function"); 
 // TestStepAddActionExpected( chActionText, chExpectedText );  
  E_DBGR_BreakpointCheckForHalt("TestCan_Init");
  
  snprintf( chActionText, elCount(chActionText), "Configure CanTrcvPnFrameDataMaskIndex variable"); 
  snprintf( chExpectedText, elCount(chExpectedText), "Verify CanTrcvPnFrameDataMaskIndex is configured as 0"); 
  TestStepAddActionExpected( chActionText, chExpectedText );
  A_DBGR_VariableSet("VsCANR_PnFrameData1[0].CanTrcvPnFrameDataMaskIndex","0");
  E_DBGR_VariableCheck("VsCANR_PnFrameData1[0].CanTrcvPnFrameDataMaskIndex",0,Equal);
  
  snprintf( chActionText, elCount(chActionText), "Configure CanTrcvPnFrameDataMask variable"); 
  snprintf( chExpectedText, elCount(chExpectedText), "Verify CanTrcvPnFrameDataMask is configured as 1"); 
  TestStepAddActionExpected( chActionText, chExpectedText );
  A_DBGR_VariableSet("VsCANR_PnFrameData1[0].CanTrcvPnFrameDataMask","1");
  E_DBGR_VariableCheck("VsCANR_PnFrameData1[0].CanTrcvPnFrameDataMask",1,Equal);
  
  snprintf( chActionText, elCount(chActionText), "Configure CanTrcvPnFrameDataMaskIndex variable"); 
  snprintf( chExpectedText, elCount(chExpectedText), "Verify CanTrcvPnFrameDataMaskIndex is configured as 7"); 
  TestStepAddActionExpected( chActionText, chExpectedText );
  A_DBGR_VariableSet("VsCANR_PnFrameData1[7].CanTrcvPnFrameDataMaskIndex","7");
  E_DBGR_VariableCheck("VsCANR_PnFrameData1[7].CanTrcvPnFrameDataMaskIndex",7,Equal);
  
  snprintf( chActionText, elCount(chActionText), "Configure CanTrcvPnFrameDataMask variable"); 
  snprintf( chExpectedText, elCount(chExpectedText), "Verify CanTrcvPnFrameDataMask is configured as 8"); 
  TestStepAddActionExpected( chActionText, chExpectedText );
  A_DBGR_VariableSet("VsCANR_PnFrameData1[7].CanTrcvPnFrameDataMask","8");
  E_DBGR_VariableCheck("VsCANR_PnFrameData1[7].CanTrcvPnFrameDataMask",8,Equal);
  
  snprintf( chActionText, elCount(chActionText), "Configure CanTrcvPnFrameCanId variable"); 
  snprintf( chExpectedText, elCount(chExpectedText), "Verify CanTrcvPnFrameCanId is configured as 0x123"); 
  TestStepAddActionExpected( chActionText, chExpectedText );
  A_DBGR_VariableSet("VsCANR_PnConfig[0].CanTrcvPnFrameCanId","0x123");
  E_DBGR_VariableCheck("VsCANR_PnConfig[0].CanTrcvPnFrameCanId",0x123,Equal);
  
  snprintf( chActionText, elCount(chActionText), "Configure CanTrcvPnFrameCanIdMask variable"); 
  snprintf( chExpectedText, elCount(chExpectedText), "Verify CanTrcvPnFrameCanIdMask is configured as 0"); 
  TestStepAddActionExpected( chActionText, chExpectedText );
  A_DBGR_VariableSet("VsCANR_PnConfig[0].CanTrcvPnFrameCanIdMask","0");
  E_DBGR_VariableCheck("VsCANR_PnConfig[0].CanTrcvPnFrameCanIdMask",0,Equal);
  
  snprintf( chActionText, elCount(chActionText), "Configure CanTrcvPnFrameIdType variable"); 
  snprintf( chExpectedText, elCount(chExpectedText), "Verify CanTrcvPnFrameIdType is configured as 0"); 
  TestStepAddActionExpected( chActionText, chExpectedText );
  A_DBGR_VariableSet("VsCANR_PnConfig[0].CanTrcvPnFrameIdType","0");
  E_DBGR_VariableCheck("VsCANR_PnConfig[0].CanTrcvPnFrameIdType",0,Equal);
  
  snprintf( chActionText, elCount(chActionText), "Configure CanTrcvPnFrameDlc variable"); 
  snprintf( chExpectedText, elCount(chExpectedText), "Verify CanTrcvPnFrameDlc is configured as 8"); 
  TestStepAddActionExpected( chActionText, chExpectedText );
  A_DBGR_VariableSet("VsCANR_PnConfig[0].CanTrcvPnFrameDlc","8");
  E_DBGR_VariableCheck("VsCANR_PnConfig[0].CanTrcvPnFrameDlc",8,Equal);
  
  snprintf( chActionText, elCount(chActionText), "Configure CanTrcvPnEnabled variable"); 
  snprintf( chExpectedText, elCount(chExpectedText), "Verify CanTrcvPnEnabled is configured as 1"); 
  TestStepAddActionExpected( chActionText, chExpectedText );
  A_DBGR_VariableSet("VsCANR_PnConfig[0].CanTrcvPnEnabled","1");
  E_DBGR_VariableCheck("VsCANR_PnConfig[0].CanTrcvPnEnabled",1,Equal);
  
  snprintf( chActionText, elCount(chActionText), "Configure CanTrcvChannelId variable"); 
  snprintf( chExpectedText, elCount(chExpectedText), "Verify CanTrcvChannelId is configured as 0"); 
  TestStepAddActionExpected( chActionText, chExpectedText );
  A_DBGR_VariableSet("VsCANR_TrcvChannels[0].CanTrcvChannelId","0");
  E_DBGR_VariableCheck("VsCANR_TrcvChannels[0].CanTrcvChannelId",0,Equal);
  
  snprintf( chActionText, elCount(chActionText), "Configure CanTrcvChannelUsed variable"); 
  snprintf( chExpectedText, elCount(chExpectedText), "Verify CanTrcvChannelUsed is configured as 1"); 
  TestStepAddActionExpected( chActionText, chExpectedText );
  A_DBGR_VariableSet("VsCANR_TrcvChannels[0].CanTrcvChannelUsed","1");
  E_DBGR_VariableCheck("VsCANR_TrcvChannels[0].CanTrcvChannelUsed",1,Equal);
  
  snprintf( chActionText, elCount(chActionText), "Configure CanTrcvPinWakeupEnabled variable"); 
  snprintf( chExpectedText, elCount(chExpectedText), "Verify CanTrcvPinWakeupEnabled is configured as 0"); 
  TestStepAddActionExpected( chActionText, chExpectedText );
  A_DBGR_VariableSet("VsCANR_TrcvChannels[0].CanTrcvPinWakeupEnabled","0");
  E_DBGR_VariableCheck("VsCANR_TrcvChannels[0].CanTrcvPinWakeupEnabled",0,Equal);
  
  snprintf( chActionText, elCount(chActionText), "Configure CanTrcvNumberOfChannels variable"); 
  snprintf( chExpectedText, elCount(chExpectedText), "Verify CanTrcvNumberOfChannels is configured as 2"); 
  TestStepAddActionExpected( chActionText, chExpectedText );
  A_DBGR_VariableSet("VsCANR_CanTrcvConfig.CanTrcvNumberOfChannels","2");
  E_DBGR_VariableCheck("VsCANR_CanTrcvConfig.CanTrcvNumberOfChannels",2,Equal);
  
  snprintf( chActionText, elCount(chActionText), "Flash the Software and ECU is running "); 
  snprintf( chExpectedText, elCount(chExpectedText), "ECU should be in running state"); 
  TestStepAddActionExpected( chActionText, chExpectedText );
  A_DBGR_Go();
  
  /***************************************************************************************************************/    
                                              // Test Step 3  Call the function Test_SetHWIO_PowerDown by setting StartPowerDown to 1 then check transceiver is in the SLEEP mode and PMIC to STANDBY mode
  /***************************************************************************************************************/
  snprintf( chActionText, elCount(chActionText), "Configure StartPowerDown variable to invoke Test_SetHWIO_PowerDown interface"); 
  snprintf( chExpectedText, elCount(chExpectedText), "Verify StartPowerDown is configured as 1"); 
  //TestStepAddActionExpected( chActionText, chExpectedText );
  A_DBGR_VariableSet("StartPowerDown","1");
 // E_DBGR_VariableCheck("StartPowerDown",1,Equal);
  
  snprintf( chActionText, elCount(chActionText), "Check Trace32 is stopped"); 
  snprintf( chExpectedText, elCount(chExpectedText), "Verify Trace32 is stopped"); 
  //TestStepAddActionExpected( chActionText, chExpectedText );
  E_DBGR_CheckState(T32_State_Down);
  
   /***************************************************************************************************************/    
                                              // Test Step 4 Run the Software and capture UART log using python
  /***************************************************************************************************************/
  
  SysExec("powershell", "-ExecutionPolicy Bypass -File ./serial_logging.ps1", automation_root);
  
  snprintf( chActionText, elCount(chActionText), "waiting for UART log"); 
  snprintf( chExpectedText, elCount(chExpectedText), "waiting for UART log"); 
  TestStepAddActionExpected( chActionText, chExpectedText );
  A_GENERIC_SetTimeout(3000,"waiting for UART log");
 
  
  /***************************************************************************************************************/    
                                              // Test Step 5  This step involves sending a CAN wakeup frame with ID 0x123 and 8 bytes of data from Canoe.
  /***************************************************************************************************************/
//  snprintf( chActionText, elCount(chActionText), "Transmit CAN message. ID:0x123"); 
//  snprintf( chExpectedText, elCount(chExpectedText), "CAN message transmitted. ID:0x123"); 
//  //TestStepAddActionExpected( chActionText, chExpectedText );
//  A_CAN_SendMessage(0x123, CANA_Wakeup_1, 8, 1);
//  A_CAN_SendMessage(0x123, CANA_Wakeup_1, 8, 1);
  setTimer(periodicTimer_CAN2, 1);
  
  /***************************************************************************************************************/    
                                              // Test Step 6  Verify Transceiver wakeUp or not.
  /***************************************************************************************************************/
  snprintf( chActionText, elCount(chActionText), "Transmit CAN message. ID:0x40000101, PDU info:0x01"); 
  snprintf( chExpectedText, elCount(chExpectedText), "CAN message transmitted. ID:0x40000101, PDU info:0x01"); 
  //TestStepAddActionExpected( chActionText, chExpectedText ); 
  
  E_CAN_WaitForMessageByID(0x00000101,15000,cc_eCAN_PRESENT,"CAN1");
  
  /***************************************************************************************************************/    
                          // Test Step 7 Check UART log in the Tera Term window is update: Last wakeup event is: 2 (wkupCanBusA).
  /***************************************************************************************************************/ 
  strncpy(searchString,"Last wakeup event is: 2",256);
  
  snprintf( chActionText, elCount(chActionText), "waiting for UART log"); 
  snprintf( chExpectedText, elCount(chExpectedText), "waiting for UART log"); 
  TestStepAddActionExpected( chActionText, chExpectedText );
  A_GENERIC_SetTimeout(25000,"waiting for UART log");
  
  snprintf(chActionText, elCount(chActionText), "Run Python script to check battConnectionStatus in log file");
  snprintf(chExpectedText, elCount(chExpectedText), "Python script should execute successfully");
  result =iFcnt_READFILE_SearchKeywordInFile(teraterm,searchString,"string is present");
  
  if(result == 1)
  {
    testStepPass("0","string is present");
  }
  else
  {
    testStepFail("1","string is not present");
  }
  
  cancelTimer(periodicTimer_CAN2);
  testWaitForTimeout(1000);
}

testcase Verify_that_the_software_reports_wkupCanBusA_for_GetHWIO_e_WakeupSigSt_LLSI_CAN_A_bus_wakeup_scenario_2()
{
   /***************************************************************************************************************/    
                                                // Variable Definition
  /***************************************************************************************************************/ 
  

  
  /***************************************************************************************************************/    
                                               // Local Values
  /***************************************************************************************************************/ 
  

  
  /***************************************************************************************************************/    
                                              // Test Case Info
  /***************************************************************************************************************/
  setWriteDbgLevel(DebugOff);
  snprintf( chTestTitle, elCount(chTestTitle), "Verify_that_the_software_reports_wkupCanBusA_for_GetHWIO_e_WakeupSigSt_LLSI_CAN_A_bus_wakeup_scenario_2" );
  snprintf( chTestDescription, elCount(chTestDescription), "Purpose:To check the GetHWIO_e_WakeupSigSt interface ");
  TestCaseAddInfo( chTestTitle, "TC_L30SW_Q-36542436", chTestDescription );

  /***************************************************************************************************************/    
                                              // Start of Test Case
  /***************************************************************************************************************/
  
  /***************************************************************************************************************/    
                                              // Test Step 0 PRECONDITIONS
  /***************************************************************************************************************/
  snprintf( chActionText, elCount(chActionText), "Flash the Software and ECU is running "); 
  snprintf( chExpectedText, elCount(chExpectedText), "ECU should be in running state"); 
  //TestStepAddActionExpected( chActionText, chExpectedText );
  
  A_DBGR_BreakpointDeleteAll();
  
  snprintf( chActionText, elCount(chActionText), "Flash the Software and ECU is running "); 
  snprintf( chExpectedText, elCount(chExpectedText), "ECU should be in running state"); 
 
  A_DBGR_R();
  A_DBGR_Go();
  /***************************************************************************************************************/    
                                              // Test Step 1 Call the function MngCNDD_CanTrcvInitialize to initialize the CAN transceiver.
  /***************************************************************************************************************/
  snprintf( chActionText, elCount(chActionText), "Set Breakpoint TestCanTrcv_Init callback function "); 
  snprintf( chExpectedText, elCount(chExpectedText), "Breakpoint is Set in TestCanTrcv_Init"); 
  //TestStepAddActionExpected( chActionText, chExpectedText );   
  A_DBGR_BreakpointSet("TestCanTrcv_Init");  
  A_DBGR_Go();
  
  snprintf( chActionText, elCount(chActionText), "Verify Breakpoint should hit in TestCanTrcv_Init "); 
  snprintf( chExpectedText, elCount(chExpectedText), "Breakpoint hit in TestCanTrcv_Init function"); 
  //TestStepAddActionExpected( chActionText, chExpectedText );  
  E_DBGR_BreakpointCheckForHalt("TestCanTrcv_Init");
  
  /***************************************************************************************************************/    
                                              // Test Step 2 Configure the values for the structure TsCNDD_CanTrcvCnfgType for CAN2 Channel.
  /***************************************************************************************************************/
  snprintf( chActionText, elCount(chActionText), "Set Breakpoint in TestCan_Init "); 
  snprintf( chExpectedText, elCount(chExpectedText), "Verify Breakpoint is Set in TestCan_Init"); 
  TestStepAddActionExpected( chActionText, chExpectedText );  
  A_DBGR_BreakpointSet("TestCan_Init");  
  A_DBGR_Go();
  
  snprintf( chActionText, elCount(chActionText), "Verify Breakpoint should hit in TestCan_Init "); 
  snprintf( chExpectedText, elCount(chExpectedText), "Breakpoint hit in TestCan_Init function"); 
 // TestStepAddActionExpected( chActionText, chExpectedText );  
  E_DBGR_BreakpointCheckForHalt("TestCan_Init");
  
  snprintf( chActionText, elCount(chActionText), "Configure CanTrcvPnFrameDataMaskIndex variable"); 
  snprintf( chExpectedText, elCount(chExpectedText), "Verify CanTrcvPnFrameDataMaskIndex is configured as 0"); 
  TestStepAddActionExpected( chActionText, chExpectedText );
  A_DBGR_VariableSet("VsCANR_PnFrameData1[0].CanTrcvPnFrameDataMaskIndex","0");
  E_DBGR_VariableCheck("VsCANR_PnFrameData1[0].CanTrcvPnFrameDataMaskIndex",0,Equal);
  
  snprintf( chActionText, elCount(chActionText), "Configure CanTrcvPnFrameDataMask variable"); 
  snprintf( chExpectedText, elCount(chExpectedText), "Verify CanTrcvPnFrameDataMask is configured as 1"); 
  TestStepAddActionExpected( chActionText, chExpectedText );
  A_DBGR_VariableSet("VsCANR_PnFrameData1[0].CanTrcvPnFrameDataMask","1");
  E_DBGR_VariableCheck("VsCANR_PnFrameData1[0].CanTrcvPnFrameDataMask",1,Equal);
  
  snprintf( chActionText, elCount(chActionText), "Configure CanTrcvPnFrameDataMaskIndex variable"); 
  snprintf( chExpectedText, elCount(chExpectedText), "Verify CanTrcvPnFrameDataMaskIndex is configured as 7"); 
  TestStepAddActionExpected( chActionText, chExpectedText );
  A_DBGR_VariableSet("VsCANR_PnFrameData1[7].CanTrcvPnFrameDataMaskIndex","7");
  E_DBGR_VariableCheck("VsCANR_PnFrameData1[7].CanTrcvPnFrameDataMaskIndex",7,Equal);
  
  snprintf( chActionText, elCount(chActionText), "Configure CanTrcvPnFrameDataMask variable"); 
  snprintf( chExpectedText, elCount(chExpectedText), "Verify CanTrcvPnFrameDataMask is configured as 8"); 
  TestStepAddActionExpected( chActionText, chExpectedText );
  A_DBGR_VariableSet("VsCANR_PnFrameData1[7].CanTrcvPnFrameDataMask","8");
  E_DBGR_VariableCheck("VsCANR_PnFrameData1[7].CanTrcvPnFrameDataMask",8,Equal);
  
  snprintf( chActionText, elCount(chActionText), "Configure CanTrcvPnFrameCanId variable"); 
  snprintf( chExpectedText, elCount(chExpectedText), "Verify CanTrcvPnFrameCanId is configured as 0x123"); 
  TestStepAddActionExpected( chActionText, chExpectedText );
  A_DBGR_VariableSet("VsCANR_PnConfig[0].CanTrcvPnFrameCanId","0x123");
  E_DBGR_VariableCheck("VsCANR_PnConfig[0].CanTrcvPnFrameCanId",0x123,Equal);
  
  snprintf( chActionText, elCount(chActionText), "Configure CanTrcvPnFrameCanIdMask variable"); 
  snprintf( chExpectedText, elCount(chExpectedText), "Verify CanTrcvPnFrameCanIdMask is configured as 0"); 
  TestStepAddActionExpected( chActionText, chExpectedText );
  A_DBGR_VariableSet("VsCANR_PnConfig[0].CanTrcvPnFrameCanIdMask","0");
  E_DBGR_VariableCheck("VsCANR_PnConfig[0].CanTrcvPnFrameCanIdMask",0,Equal);
  
  snprintf( chActionText, elCount(chActionText), "Configure CanTrcvPnFrameIdType variable"); 
  snprintf( chExpectedText, elCount(chExpectedText), "Verify CanTrcvPnFrameIdType is configured as 0"); 
  TestStepAddActionExpected( chActionText, chExpectedText );
  A_DBGR_VariableSet("VsCANR_PnConfig[0].CanTrcvPnFrameIdType","0");
  E_DBGR_VariableCheck("VsCANR_PnConfig[0].CanTrcvPnFrameIdType",0,Equal);
  
  snprintf( chActionText, elCount(chActionText), "Configure CanTrcvPnFrameDlc variable"); 
  snprintf( chExpectedText, elCount(chExpectedText), "Verify CanTrcvPnFrameDlc is configured as 8"); 
  TestStepAddActionExpected( chActionText, chExpectedText );
  A_DBGR_VariableSet("VsCANR_PnConfig[0].CanTrcvPnFrameDlc","8");
  E_DBGR_VariableCheck("VsCANR_PnConfig[0].CanTrcvPnFrameDlc",8,Equal);
  
  snprintf( chActionText, elCount(chActionText), "Configure CanTrcvPnEnabled variable"); 
  snprintf( chExpectedText, elCount(chExpectedText), "Verify CanTrcvPnEnabled is configured as 1"); 
  TestStepAddActionExpected( chActionText, chExpectedText );
  A_DBGR_VariableSet("VsCANR_PnConfig[0].CanTrcvPnEnabled","1");
  E_DBGR_VariableCheck("VsCANR_PnConfig[0].CanTrcvPnEnabled",1,Equal);
  
  snprintf( chActionText, elCount(chActionText), "Configure CanTrcvChannelId variable"); 
  snprintf( chExpectedText, elCount(chExpectedText), "Verify CanTrcvChannelId is configured as 0"); 
  TestStepAddActionExpected( chActionText, chExpectedText );
  A_DBGR_VariableSet("VsCANR_TrcvChannels[0].CanTrcvChannelId","0");
  E_DBGR_VariableCheck("VsCANR_TrcvChannels[0].CanTrcvChannelId",0,Equal);
  
  snprintf( chActionText, elCount(chActionText), "Configure CanTrcvChannelUsed variable"); 
  snprintf( chExpectedText, elCount(chExpectedText), "Verify CanTrcvChannelUsed is configured as 1"); 
  TestStepAddActionExpected( chActionText, chExpectedText );
  A_DBGR_VariableSet("VsCANR_TrcvChannels[0].CanTrcvChannelUsed","1");
  E_DBGR_VariableCheck("VsCANR_TrcvChannels[0].CanTrcvChannelUsed",1,Equal);
  
  snprintf( chActionText, elCount(chActionText), "Configure CanTrcvPinWakeupEnabled variable"); 
  snprintf( chExpectedText, elCount(chExpectedText), "Verify CanTrcvPinWakeupEnabled is configured as 0"); 
  TestStepAddActionExpected( chActionText, chExpectedText );
  A_DBGR_VariableSet("VsCANR_TrcvChannels[0].CanTrcvPinWakeupEnabled","0");
  E_DBGR_VariableCheck("VsCANR_TrcvChannels[0].CanTrcvPinWakeupEnabled",0,Equal);
  
  snprintf( chActionText, elCount(chActionText), "Configure CanTrcvNumberOfChannels variable"); 
  snprintf( chExpectedText, elCount(chExpectedText), "Verify CanTrcvNumberOfChannels is configured as 2"); 
  TestStepAddActionExpected( chActionText, chExpectedText );
  A_DBGR_VariableSet("VsCANR_CanTrcvConfig.CanTrcvNumberOfChannels","2");
  E_DBGR_VariableCheck("VsCANR_CanTrcvConfig.CanTrcvNumberOfChannels",2,Equal);
  
  snprintf( chActionText, elCount(chActionText), "Flash the Software and ECU is running "); 
  snprintf( chExpectedText, elCount(chExpectedText), "ECU should be in running state"); 
  TestStepAddActionExpected( chActionText, chExpectedText );
  A_DBGR_Go();
  
  /***************************************************************************************************************/    
                                              // Test Step 3  Call the function Test_SetHWIO_PowerDown by setting StartPowerDown to 1 then check transceiver is in the SLEEP mode and PMIC to STANDBY mode
  /***************************************************************************************************************/
  snprintf( chActionText, elCount(chActionText), "Configure StartPowerDown variable to invoke Test_SetHWIO_PowerDown interface"); 
  snprintf( chExpectedText, elCount(chExpectedText), "Verify StartPowerDown is configured as 1"); 
  //TestStepAddActionExpected( chActionText, chExpectedText );
  A_DBGR_VariableSet("StartPowerDown","1");
 // E_DBGR_VariableCheck("StartPowerDown",1,Equal);
  
  snprintf( chActionText, elCount(chActionText), "Check Trace32 is stopped"); 
  snprintf( chExpectedText, elCount(chExpectedText), "Verify Trace32 is stopped"); 
  //TestStepAddActionExpected( chActionText, chExpectedText );
  E_DBGR_CheckState(T32_State_Down);
  
   /***************************************************************************************************************/    
                                              // Test Step 4 Run the Software and capture UART log using python
  /***************************************************************************************************************/
  
  SysExec("powershell", "-ExecutionPolicy Bypass -File ./serial_logging.ps1", automation_root);
  
  snprintf( chActionText, elCount(chActionText), "waiting for UART log"); 
  snprintf( chExpectedText, elCount(chExpectedText), "waiting for UART log"); 
  TestStepAddActionExpected( chActionText, chExpectedText );
  A_GENERIC_SetTimeout(3000,"waiting for UART log");
 
  
  /***************************************************************************************************************/    
                                              // Test Step 5  This step involves sending a CAN wakeup frame with ID 0x123 and 8 bytes of data from Canoe.
  /***************************************************************************************************************/
//  snprintf( chActionText, elCount(chActionText), "Transmit CAN message. ID:0x123"); 
//  snprintf( chExpectedText, elCount(chExpectedText), "CAN message transmitted. ID:0x123"); 
//  //TestStepAddActionExpected( chActionText, chExpectedText );
//  A_CAN_SendMessage(0x123, CANA_Wakeup_2, 8, 1);
//  A_CAN_SendMessage(0x123, CANA_Wakeup_2, 8, 1);
  
  setTimer(periodicTimer_CAN2, 1);
  
  /***************************************************************************************************************/    
                                              // Test Step 6  Verify Transceiver wakeUp or not.
  /***************************************************************************************************************/
  snprintf( chActionText, elCount(chActionText), "Transmit CAN message. ID:0x40000101, PDU info:0x01"); 
  snprintf( chExpectedText, elCount(chExpectedText), "CAN message transmitted. ID:0x40000101, PDU info:0x01"); 
  //TestStepAddActionExpected( chActionText, chExpectedText ); 
  
  E_CAN_WaitForMessageByID(0x00000101,10000,cc_eCAN_PRESENT,"CAN1");
  
  /***************************************************************************************************************/    
                          // Test Step 7 Check UART log in the Tera Term window is update: Last wakeup event is: 2 (wkupCanBusA).
  /***************************************************************************************************************/ 
  strncpy(searchString,"Last wakeup event is: 2",256);
  
  snprintf( chActionText, elCount(chActionText), "waiting for UART log"); 
  snprintf( chExpectedText, elCount(chExpectedText), "waiting for UART log"); 
  TestStepAddActionExpected( chActionText, chExpectedText );
  A_GENERIC_SetTimeout(25000,"waiting for UART log");
  
  snprintf(chActionText, elCount(chActionText), "Run Python script to check battConnectionStatus in log file");
  snprintf(chExpectedText, elCount(chExpectedText), "Python script should execute successfully");
  result =iFcnt_READFILE_SearchKeywordInFile(teraterm,searchString,"string is present");
  
  if(result == 1)
  {
    testStepPass("0","string is present");
  }
  else
  {
    testStepFail("1","string is not present");
  }
  
  cancelTimer(periodicTimer_CAN2);
  testWaitForTimeout(1000);
}

testcase Verify_that_the_software_reports_wkupCanBusA_for_GetHWIO_e_WakeupSigSt_LLSI_CAN_A_bus_wakeup_scenario_3()
{
   /***************************************************************************************************************/    
                                                // Variable Definition
  /***************************************************************************************************************/ 
  

  
  /***************************************************************************************************************/    
                                               // Local Values
  /***************************************************************************************************************/ 
  

  
  /***************************************************************************************************************/    
                                              // Test Case Info
  /***************************************************************************************************************/
  setWriteDbgLevel(DebugOff);
  snprintf( chTestTitle, elCount(chTestTitle), "Verify_that_the_software_reports_wkupCanBusA_for_GetHWIO_e_WakeupSigSt_LLSI_CAN_A_bus_wakeup_scenario_3" );
  snprintf( chTestDescription, elCount(chTestDescription), "Purpose:To check the GetHWIO_e_WakeupSigSt interface ");
  TestCaseAddInfo( chTestTitle, "TC_L30SW_Q-36542437", chTestDescription );

  /***************************************************************************************************************/    
                                              // Start of Test Case
  /***************************************************************************************************************/
  
  /***************************************************************************************************************/    
                                              // Test Step 0 PRECONDITIONS
  /***************************************************************************************************************/
  snprintf( chActionText, elCount(chActionText), "Flash the Software and ECU is running "); 
  snprintf( chExpectedText, elCount(chExpectedText), "ECU should be in running state"); 
  //TestStepAddActionExpected( chActionText, chExpectedText );
  
  A_DBGR_BreakpointDeleteAll();
  
  snprintf( chActionText, elCount(chActionText), "Flash the Software and ECU is running "); 
  snprintf( chExpectedText, elCount(chExpectedText), "ECU should be in running state"); 
 
  A_DBGR_R();
  A_DBGR_Go();
  /***************************************************************************************************************/    
                                              // Test Step 1 Call the function MngCNDD_CanTrcvInitialize to initialize the CAN transceiver.
  /***************************************************************************************************************/
  snprintf( chActionText, elCount(chActionText), "Set Breakpoint TestCanTrcv_Init callback function "); 
  snprintf( chExpectedText, elCount(chExpectedText), "Breakpoint is Set in TestCanTrcv_Init"); 
  //TestStepAddActionExpected( chActionText, chExpectedText );   
  A_DBGR_BreakpointSet("TestCanTrcv_Init");  
  A_DBGR_Go();
  
  snprintf( chActionText, elCount(chActionText), "Verify Breakpoint should hit in TestCanTrcv_Init "); 
  snprintf( chExpectedText, elCount(chExpectedText), "Breakpoint hit in TestCanTrcv_Init function"); 
  //TestStepAddActionExpected( chActionText, chExpectedText );  
  E_DBGR_BreakpointCheckForHalt("TestCanTrcv_Init");
  
  /***************************************************************************************************************/    
                                              // Test Step 2 Configure the values for the structure TsCNDD_CanTrcvCnfgType for CAN2 Channel.
  /***************************************************************************************************************/
  snprintf( chActionText, elCount(chActionText), "Set Breakpoint in TestCan_Init "); 
  snprintf( chExpectedText, elCount(chExpectedText), "Verify Breakpoint is Set in TestCan_Init"); 
  TestStepAddActionExpected( chActionText, chExpectedText );  
  A_DBGR_BreakpointSet("TestCan_Init");  
  A_DBGR_Go();
  
  snprintf( chActionText, elCount(chActionText), "Verify Breakpoint should hit in TestCan_Init "); 
  snprintf( chExpectedText, elCount(chExpectedText), "Breakpoint hit in TestCan_Init function"); 
 // TestStepAddActionExpected( chActionText, chExpectedText );  
  E_DBGR_BreakpointCheckForHalt("TestCan_Init");
  
  snprintf( chActionText, elCount(chActionText), "Configure CanTrcvPnFrameDataMaskIndex variable"); 
  snprintf( chExpectedText, elCount(chExpectedText), "Verify CanTrcvPnFrameDataMaskIndex is configured as 0"); 
  TestStepAddActionExpected( chActionText, chExpectedText );
  A_DBGR_VariableSet("VsCANR_PnFrameData1[0].CanTrcvPnFrameDataMaskIndex","0");
  E_DBGR_VariableCheck("VsCANR_PnFrameData1[0].CanTrcvPnFrameDataMaskIndex",0,Equal);
  
  snprintf( chActionText, elCount(chActionText), "Configure CanTrcvPnFrameDataMask variable"); 
  snprintf( chExpectedText, elCount(chExpectedText), "Verify CanTrcvPnFrameDataMask is configured as 1"); 
  TestStepAddActionExpected( chActionText, chExpectedText );
  A_DBGR_VariableSet("VsCANR_PnFrameData1[0].CanTrcvPnFrameDataMask","1");
  E_DBGR_VariableCheck("VsCANR_PnFrameData1[0].CanTrcvPnFrameDataMask",1,Equal);
  
  snprintf( chActionText, elCount(chActionText), "Configure CanTrcvPnFrameDataMaskIndex variable"); 
  snprintf( chExpectedText, elCount(chExpectedText), "Verify CanTrcvPnFrameDataMaskIndex is configured as 7"); 
  TestStepAddActionExpected( chActionText, chExpectedText );
  A_DBGR_VariableSet("VsCANR_PnFrameData1[7].CanTrcvPnFrameDataMaskIndex","7");
  E_DBGR_VariableCheck("VsCANR_PnFrameData1[7].CanTrcvPnFrameDataMaskIndex",7,Equal);
  
  snprintf( chActionText, elCount(chActionText), "Configure CanTrcvPnFrameDataMask variable"); 
  snprintf( chExpectedText, elCount(chExpectedText), "Verify CanTrcvPnFrameDataMask is configured as 8"); 
  TestStepAddActionExpected( chActionText, chExpectedText );
  A_DBGR_VariableSet("VsCANR_PnFrameData1[7].CanTrcvPnFrameDataMask","8");
  E_DBGR_VariableCheck("VsCANR_PnFrameData1[7].CanTrcvPnFrameDataMask",8,Equal);
  
  snprintf( chActionText, elCount(chActionText), "Configure CanTrcvPnFrameCanId variable"); 
  snprintf( chExpectedText, elCount(chExpectedText), "Verify CanTrcvPnFrameCanId is configured as 0x123"); 
  TestStepAddActionExpected( chActionText, chExpectedText );
  A_DBGR_VariableSet("VsCANR_PnConfig[0].CanTrcvPnFrameCanId","0x123");
  E_DBGR_VariableCheck("VsCANR_PnConfig[0].CanTrcvPnFrameCanId",0x123,Equal);
  
  snprintf( chActionText, elCount(chActionText), "Configure CanTrcvPnFrameCanIdMask variable"); 
  snprintf( chExpectedText, elCount(chExpectedText), "Verify CanTrcvPnFrameCanIdMask is configured as 0"); 
  TestStepAddActionExpected( chActionText, chExpectedText );
  A_DBGR_VariableSet("VsCANR_PnConfig[0].CanTrcvPnFrameCanIdMask","0");
  E_DBGR_VariableCheck("VsCANR_PnConfig[0].CanTrcvPnFrameCanIdMask",0,Equal);
  
  snprintf( chActionText, elCount(chActionText), "Configure CanTrcvPnFrameIdType variable"); 
  snprintf( chExpectedText, elCount(chExpectedText), "Verify CanTrcvPnFrameIdType is configured as 0"); 
  TestStepAddActionExpected( chActionText, chExpectedText );
  A_DBGR_VariableSet("VsCANR_PnConfig[0].CanTrcvPnFrameIdType","0");
  E_DBGR_VariableCheck("VsCANR_PnConfig[0].CanTrcvPnFrameIdType",0,Equal);
  
  snprintf( chActionText, elCount(chActionText), "Configure CanTrcvPnFrameDlc variable"); 
  snprintf( chExpectedText, elCount(chExpectedText), "Verify CanTrcvPnFrameDlc is configured as 8"); 
  TestStepAddActionExpected( chActionText, chExpectedText );
  A_DBGR_VariableSet("VsCANR_PnConfig[0].CanTrcvPnFrameDlc","8");
  E_DBGR_VariableCheck("VsCANR_PnConfig[0].CanTrcvPnFrameDlc",8,Equal);
  
  snprintf( chActionText, elCount(chActionText), "Configure CanTrcvPnEnabled variable"); 
  snprintf( chExpectedText, elCount(chExpectedText), "Verify CanTrcvPnEnabled is configured as 1"); 
  TestStepAddActionExpected( chActionText, chExpectedText );
  A_DBGR_VariableSet("VsCANR_PnConfig[0].CanTrcvPnEnabled","1");
  E_DBGR_VariableCheck("VsCANR_PnConfig[0].CanTrcvPnEnabled",1,Equal);
  
  snprintf( chActionText, elCount(chActionText), "Configure CanTrcvChannelId variable"); 
  snprintf( chExpectedText, elCount(chExpectedText), "Verify CanTrcvChannelId is configured as 0"); 
  TestStepAddActionExpected( chActionText, chExpectedText );
  A_DBGR_VariableSet("VsCANR_TrcvChannels[0].CanTrcvChannelId","0");
  E_DBGR_VariableCheck("VsCANR_TrcvChannels[0].CanTrcvChannelId",0,Equal);
  
  snprintf( chActionText, elCount(chActionText), "Configure CanTrcvChannelUsed variable"); 
  snprintf( chExpectedText, elCount(chExpectedText), "Verify CanTrcvChannelUsed is configured as 1"); 
  TestStepAddActionExpected( chActionText, chExpectedText );
  A_DBGR_VariableSet("VsCANR_TrcvChannels[0].CanTrcvChannelUsed","1");
  E_DBGR_VariableCheck("VsCANR_TrcvChannels[0].CanTrcvChannelUsed",1,Equal);
  
  snprintf( chActionText, elCount(chActionText), "Configure CanTrcvPinWakeupEnabled variable"); 
  snprintf( chExpectedText, elCount(chExpectedText), "Verify CanTrcvPinWakeupEnabled is configured as 0"); 
  TestStepAddActionExpected( chActionText, chExpectedText );
  A_DBGR_VariableSet("VsCANR_TrcvChannels[0].CanTrcvPinWakeupEnabled","0");
  E_DBGR_VariableCheck("VsCANR_TrcvChannels[0].CanTrcvPinWakeupEnabled",0,Equal);
  
  snprintf( chActionText, elCount(chActionText), "Configure CanTrcvNumberOfChannels variable"); 
  snprintf( chExpectedText, elCount(chExpectedText), "Verify CanTrcvNumberOfChannels is configured as 2"); 
  TestStepAddActionExpected( chActionText, chExpectedText );
  A_DBGR_VariableSet("VsCANR_CanTrcvConfig.CanTrcvNumberOfChannels","2");
  E_DBGR_VariableCheck("VsCANR_CanTrcvConfig.CanTrcvNumberOfChannels",2,Equal);
  
  snprintf( chActionText, elCount(chActionText), "Flash the Software and ECU is running "); 
  snprintf( chExpectedText, elCount(chExpectedText), "ECU should be in running state"); 
  TestStepAddActionExpected( chActionText, chExpectedText );
  A_DBGR_Go();
  
  /***************************************************************************************************************/    
                                              // Test Step 3  Call the function Test_SetHWIO_PowerDown by setting StartPowerDown to 1 then check transceiver is in the SLEEP mode and PMIC to STANDBY mode
  /***************************************************************************************************************/
  snprintf( chActionText, elCount(chActionText), "Configure StartPowerDown variable to invoke Test_SetHWIO_PowerDown interface"); 
  snprintf( chExpectedText, elCount(chExpectedText), "Verify StartPowerDown is configured as 1"); 
  //TestStepAddActionExpected( chActionText, chExpectedText );
  A_DBGR_VariableSet("StartPowerDown","1");
 // E_DBGR_VariableCheck("StartPowerDown",1,Equal);
  
  snprintf( chActionText, elCount(chActionText), "Check Trace32 is stopped"); 
  snprintf( chExpectedText, elCount(chExpectedText), "Verify Trace32 is stopped"); 
  //TestStepAddActionExpected( chActionText, chExpectedText );
  E_DBGR_CheckState(T32_State_Down);
  
   /***************************************************************************************************************/    
                                              // Test Step 4 Run the Software and capture UART log using python
  /***************************************************************************************************************/
  
  SysExec("powershell", "-ExecutionPolicy Bypass -File ./serial_logging.ps1", automation_root);
  
  snprintf( chActionText, elCount(chActionText), "waiting for UART log"); 
  snprintf( chExpectedText, elCount(chExpectedText), "waiting for UART log"); 
  TestStepAddActionExpected( chActionText, chExpectedText );
  A_GENERIC_SetTimeout(3000,"waiting for UART log");
 
  
  /***************************************************************************************************************/    
                                              // Test Step 5  This step involves sending a CAN wakeup frame with ID 0x123 and 8 bytes of data from Canoe.
  /***************************************************************************************************************/
//  snprintf( chActionText, elCount(chActionText), "Transmit CAN message. ID:0x123"); 
//  snprintf( chExpectedText, elCount(chExpectedText), "CAN message transmitted. ID:0x123"); 
//  //TestStepAddActionExpected( chActionText, chExpectedText );
//  A_CAN_SendMessage(0x123, CANA_Wakeup, 8, 1);
//  A_CAN_SendMessage(0x123, CANA_Wakeup, 8, 1);
  
  setTimer(periodicTimer_CAN2, 1);
  
  
  /***************************************************************************************************************/    
                                              // Test Step 6  Verify Transceiver wakeUp or not.
  /***************************************************************************************************************/
  snprintf( chActionText, elCount(chActionText), "Transmit CAN message. ID:0x40000101, PDU info:0x01"); 
  snprintf( chExpectedText, elCount(chExpectedText), "CAN message transmitted. ID:0x40000101, PDU info:0x01"); 
  //TestStepAddActionExpected( chActionText, chExpectedText ); 
  
  E_CAN_WaitForMessageByID(0x00000101,10000,cc_eCAN_PRESENT,"CAN1");
  
  /***************************************************************************************************************/    
                          // Test Step 7 Check UART log in the Tera Term window is update: Last wakeup event is: 2 (wkupCanBusA).
  /***************************************************************************************************************/ 
  strncpy(searchString,"Last wakeup event is: 2",256);
  
  snprintf( chActionText, elCount(chActionText), "waiting for UART log"); 
  snprintf( chExpectedText, elCount(chExpectedText), "waiting for UART log"); 
  TestStepAddActionExpected( chActionText, chExpectedText );
  A_GENERIC_SetTimeout(25000,"waiting for UART log");
  
  snprintf(chActionText, elCount(chActionText), "Run Python script to check battConnectionStatus in log file");
  snprintf(chExpectedText, elCount(chExpectedText), "Python script should execute successfully");
  result =iFcnt_READFILE_SearchKeywordInFile(teraterm,searchString,"string is present");
  
  if(result == 1)
  {
    testStepPass("0","string is present");
  }
  else
  {
    testStepFail("1","string is not present");
  }

  cancelTimer(periodicTimer_CAN2);
  testWaitForTimeout(1000);
}


testcase Verify_that_the_software_reports_wkupCanBusB_for_GetHWIO_e_WakeupSigSt_LLSI_function_when_the_wakeup_event_detected_is_CAN_B()
{
   /***************************************************************************************************************/    
                                                // Variable Definition
  /***************************************************************************************************************/ 
  

  
  /***************************************************************************************************************/    
                                               // Local Values
  /***************************************************************************************************************/ 
  

  
  /***************************************************************************************************************/    
                                              // Test Case Info
  /***************************************************************************************************************/
  setWriteDbgLevel(DebugOff);
  snprintf( chTestTitle, elCount(chTestTitle), "Verify_that_the_software_reports_wkupCanBusB_for_GetHWIO_e_WakeupSigSt_LLSI_function_when_the_wakeup_event_detected_is_CAN_B" );
  snprintf( chTestDescription, elCount(chTestDescription), "Purpose:To check the GetHWIO_e_WakeupSigSt interface ");
  TestCaseAddInfo( chTestTitle, "TC_L30SW_Q-36542356", chTestDescription );

  /***************************************************************************************************************/    
                                              // Test Step 0 PRECONDITIONS
  /***************************************************************************************************************/
  snprintf( chActionText, elCount(chActionText), "Flash the Software and ECU is running "); 
  snprintf( chExpectedText, elCount(chExpectedText), "ECU should be in running state"); 
  //TestStepAddActionExpected( chActionText, chExpectedText );
  A_DBGR_BreakpointDeleteAll();
  
  snprintf( chActionText, elCount(chActionText), "Flash the Software and ECU is running "); 
  snprintf( chExpectedText, elCount(chExpectedText), "ECU should be in running state"); 
  //TestStepAddActionExpected( chActionText, chExpectedText );
  A_DBGR_R();
  A_DBGR_Go();
  /***************************************************************************************************************/    
                                              // Test Step 1 Call the function MngCNDD_CanTrcvInitialize to initialize the CAN transceiver.
  /***************************************************************************************************************/
  snprintf( chActionText, elCount(chActionText), "Set Breakpoint TestCanTrcv_Init callback function "); 
  snprintf( chExpectedText, elCount(chExpectedText), "Breakpoint is Set in TestCanTrcv_Init"); 
  //TestStepAddActionExpected( chActionText, chExpectedText );   
  A_DBGR_BreakpointSet("TestCanTrcv_Init");  
  A_DBGR_Go();
  
  snprintf( chActionText, elCount(chActionText), "Verify Breakpoint should hit in TestCanTrcv_Init "); 
  snprintf( chExpectedText, elCount(chExpectedText), "Breakpoint hit in TestCanTrcv_Init function"); 
  //TestStepAddActionExpected( chActionText, chExpectedText );  
  E_DBGR_BreakpointCheckForHalt("TestCanTrcv_Init");
  /***************************************************************************************************************/    
                                              // Test Step 2 Configure the values for the structure TsCNDD_CanTrcvCnfgType for CAN2 Channel.
  /***************************************************************************************************************/
  snprintf( chActionText, elCount(chActionText), "Set Breakpoint in TestCan_Init "); 
  snprintf( chExpectedText, elCount(chExpectedText), "Verify Breakpoint is Set in TestCan_Init"); 
  TestStepAddActionExpected( chActionText, chExpectedText );  
  A_DBGR_BreakpointSet("TestCan_Init");  
  A_DBGR_Go();
  
  snprintf( chActionText, elCount(chActionText), "Verify Breakpoint should hit in TestCan_Init "); 
  snprintf( chExpectedText, elCount(chExpectedText), "Breakpoint hit in TestCan_Init function"); 
 // TestStepAddActionExpected( chActionText, chExpectedText );  
  E_DBGR_BreakpointCheckForHalt("TestCan_Init");
  
  snprintf( chActionText, elCount(chActionText), "Configure CanTrcvPnFrameDataMaskIndex variable"); 
  snprintf( chExpectedText, elCount(chExpectedText), "verify Configure CanTrcvPnFrameDataMaskIndex as 1"); 
  TestStepAddActionExpected( chActionText, chExpectedText );
  A_DBGR_VariableSet("VsCANR_PnFrameData2[1].CanTrcvPnFrameDataMaskIndex","1");
  E_DBGR_VariableCheck("VsCANR_PnFrameData2[1].CanTrcvPnFrameDataMaskIndex",1,Equal);
  
  snprintf( chActionText, elCount(chActionText), "Configure CanTrcvPnFrameDataMask variable"); 
  snprintf( chExpectedText, elCount(chExpectedText), "verify Configure CanTrcvPnFrameDataMask as 1"); 
  TestStepAddActionExpected( chActionText, chExpectedText );
  A_DBGR_VariableSet("VsCANR_PnFrameData2[1].CanTrcvPnFrameDataMask","1");
  E_DBGR_VariableCheck("VsCANR_PnFrameData2[1].CanTrcvPnFrameDataMask",1,Equal);
  
  snprintf( chActionText, elCount(chActionText), "Configure CanTrcvPnFrameCanId variable"); 
  snprintf( chExpectedText, elCount(chExpectedText), "verify Configure CanTrcvPnFrameCanId as 0x456"); 
  TestStepAddActionExpected( chActionText, chExpectedText );
  A_DBGR_VariableSet("VsCANR_PnConfig[1].CanTrcvPnFrameCanId","0x456");
  E_DBGR_VariableCheck("VsCANR_PnConfig[1].CanTrcvPnFrameCanId",0x456,Equal);
  
  snprintf( chActionText, elCount(chActionText), "Configure CanTrcvPnFrameCanIdMask variable"); 
  snprintf( chExpectedText, elCount(chExpectedText), "verify Configure CanTrcvPnFrameCanIdMask as 0"); 
  TestStepAddActionExpected( chActionText, chExpectedText );
  A_DBGR_VariableSet("VsCANR_PnConfig[1].CanTrcvPnFrameCanIdMask","0");
  E_DBGR_VariableCheck("VsCANR_PnConfig[1].CanTrcvPnFrameCanIdMask",0,Equal);
  
  snprintf( chActionText, elCount(chActionText), "Configure CanTrcvPnFrameIdType variable"); 
  snprintf( chExpectedText, elCount(chExpectedText), "verify Configure CanTrcvPnFrameIdType as 0"); 
  TestStepAddActionExpected( chActionText, chExpectedText );
  A_DBGR_VariableSet("VsCANR_PnConfig[1].CanTrcvPnFrameIdType","0");
  E_DBGR_VariableCheck("VsCANR_PnConfig[1].CanTrcvPnFrameIdType",0,Equal);
  
  snprintf( chActionText, elCount(chActionText), "Configure CanTrcvPnFrameDlc variable"); 
  snprintf( chExpectedText, elCount(chExpectedText), "verify Configure CanTrcvPnFrameDlc as 4"); 
  TestStepAddActionExpected( chActionText, chExpectedText );
  A_DBGR_VariableSet("VsCANR_PnConfig[1].CanTrcvPnFrameDlc","4");
  E_DBGR_VariableCheck("VsCANR_PnConfig[1].CanTrcvPnFrameDlc",4,Equal);
  
  snprintf( chActionText, elCount(chActionText), "Configure CanTrcvPnEnabled variable"); 
  snprintf( chExpectedText, elCount(chExpectedText), "verify Configure CanTrcvPnEnabled as 1"); 
  TestStepAddActionExpected( chActionText, chExpectedText );
  A_DBGR_VariableSet("VsCANR_PnConfig[1].CanTrcvPnEnabled","1");
  E_DBGR_VariableCheck("VsCANR_PnConfig[1].CanTrcvPnEnabled",1,Equal);
  
  snprintf( chActionText, elCount(chActionText), "Configure CanTrcvChannelId variable"); 
  snprintf( chExpectedText, elCount(chExpectedText), "verify Configure CanTrcvChannelId as 0"); 
  TestStepAddActionExpected( chActionText, chExpectedText );
  A_DBGR_VariableSet("VsCANR_TrcvChannels[1].CanTrcvChannelId","1");
  E_DBGR_VariableCheck("VsCANR_TrcvChannels[1].CanTrcvChannelId",1,Equal);
  
  snprintf( chActionText, elCount(chActionText), "Configure CanTrcvChannelUsed variable"); 
  snprintf( chExpectedText, elCount(chExpectedText), "verify Configure CanTrcvChannelUsed as 1"); 
  TestStepAddActionExpected( chActionText, chExpectedText );
  A_DBGR_VariableSet("VsCANR_TrcvChannels[1].CanTrcvChannelUsed","1");
  E_DBGR_VariableCheck("VsCANR_TrcvChannels[1].CanTrcvChannelUsed",1,Equal);
  
  snprintf( chActionText, elCount(chActionText), "Configure CanTrcvPinWakeupEnabled variable"); 
  snprintf( chExpectedText, elCount(chExpectedText), "verify Configure CanTrcvPinWakeupEnabled as 0"); 
  TestStepAddActionExpected( chActionText, chExpectedText );
  A_DBGR_VariableSet("VsCANR_TrcvChannels[1].CanTrcvPinWakeupEnabled","0");
  E_DBGR_VariableCheck("VsCANR_TrcvChannels[1].CanTrcvPinWakeupEnabled",0,Equal);
  
  snprintf( chActionText, elCount(chActionText), "Configure CanTrcvNumberOfChannels variable"); 
  snprintf( chExpectedText, elCount(chExpectedText), "verify Configure CanTrcvNumberOfChannels as 2"); 
  TestStepAddActionExpected( chActionText, chExpectedText );
  A_DBGR_VariableSet("VsCANR_CanTrcvConfig.CanTrcvNumberOfChannels","2");
  E_DBGR_VariableCheck("VsCANR_CanTrcvConfig.CanTrcvNumberOfChannels",2,Equal);
  
  snprintf( chActionText, elCount(chActionText), "Flash the Software and ECU is running "); 
  snprintf( chExpectedText, elCount(chExpectedText), "ECU should be in running state"); 
  TestStepAddActionExpected( chActionText, chExpectedText );
  A_DBGR_Go();
  
  /***************************************************************************************************************/    
                                              // Test Step 3  Call the function Test_SetHWIO_PowerDown by setting StartPowerDown to 1 then check transceiver is in the SLEEP mode and PMIC to STANDBY mode
  /***************************************************************************************************************/
  snprintf( chActionText, elCount(chActionText), "Configure StartPowerDown variable to invoke Test_SetHWIO_PowerDown interface"); 
  snprintf( chExpectedText, elCount(chExpectedText), "Verify StartPowerDown is configured as 1"); 
  //TestStepAddActionExpected( chActionText, chExpectedText );
  A_DBGR_VariableSet("StartPowerDown","1");
 // E_DBGR_VariableCheck("StartPowerDown",1,Equal);
  
  snprintf( chActionText, elCount(chActionText), "Check Trace32 is stopped"); 
  snprintf( chExpectedText, elCount(chExpectedText), "Verify Trace32 is stopped"); 
  //TestStepAddActionExpected( chActionText, chExpectedText );
  E_DBGR_CheckState(T32_State_Down);
  
   /***************************************************************************************************************/    
                                              // Test Step 4 Run the Software and capture UART log using python
  /***************************************************************************************************************/
  
  SysExec("powershell", "-ExecutionPolicy Bypass -File ./serial_logging.ps1", automation_root);
  
  snprintf( chActionText, elCount(chActionText), "waiting for UART log"); 
  snprintf( chExpectedText, elCount(chExpectedText), "waiting for UART log"); 
  TestStepAddActionExpected( chActionText, chExpectedText );
  A_GENERIC_SetTimeout(3000,"waiting for UART log");
 
  
  /***************************************************************************************************************/    
                                              // Test Step 4  This step involves sending a CAN wakeup frame with ID 0x456 and 4 bytes of data from Canoe.
  /***************************************************************************************************************/
//  snprintf( chActionText, elCount(chActionText), "Transmit CAN message. ID:0x123"); 
//  snprintf( chExpectedText, elCount(chExpectedText), "CAN message transmitted. ID:0x123"); 
// // TestStepAddActionExpected( chActionText, chExpectedText );
//  A_CAN_SendMessage(0x456, CANB_Wakeup, 4, 2);
//  A_CAN_SendMessage(0x456, CANB_Wakeup, 4, 2);
  
  
  setTimer(periodicTimer_CAN8,1);
  /***************************************************************************************************************/    
                                              // Test Step 6  Verify Transceiver wakeUp or not.
  /***************************************************************************************************************/
  snprintf( chActionText, elCount(chActionText), "Transmit CAN message. ID:0x40000101, PDU info:0x01"); 
  snprintf( chExpectedText, elCount(chExpectedText), "CAN message transmitted. ID:0x40000101, PDU info:0x01"); 
  //TestStepAddActionExpected( chActionText, chExpectedText ); 
  
  E_CAN_WaitForMessageByID(0x00000101,10000,cc_eCAN_PRESENT,"CAN1");
  
  /***************************************************************************************************************/    
                          // Test Step 7 Check UART log in the Tera Term window is update: Last wakeup event is: 2 (wkupCanBusA).
  /***************************************************************************************************************/ 
  strncpy(searchString,"Last wakeup event is: 4",256);
  
  snprintf( chActionText, elCount(chActionText), "waiting for UART log"); 
  snprintf( chExpectedText, elCount(chExpectedText), "waiting for UART log"); 
  TestStepAddActionExpected( chActionText, chExpectedText );
  A_GENERIC_SetTimeout(25000,"waiting for UART log");
  
  snprintf(chActionText, elCount(chActionText), "Run Python script to check battConnectionStatus in log file");
  snprintf(chExpectedText, elCount(chExpectedText), "Python script should execute successfully");
  result =iFcnt_READFILE_SearchKeywordInFile(teraterm,searchString,"string is present");
  
  if(result == 1)
  {
    testStepPass("0","string is present");
  }
  else
  {
    testStepFail("1","string is not present");
  }
 
  cancelTimer(periodicTimer_CAN8);
  testWaitForTimeout(1000);
}

testcase Verify_that_the_software_reports_wkupPwrOn_for_GetHWIO_e_WakeupSigSt_wakeup_event_detected_is_Battery_during_Initialization()
{
  /***************************************************************************************************************/    
                                                // Variable Definition
  /***************************************************************************************************************/ 
  

  
  /***************************************************************************************************************/    
                                               // Local Values
  /***************************************************************************************************************/ 
  

  
  /***************************************************************************************************************/    
                                              // Test Case Info
  /***************************************************************************************************************/
  setWriteDbgLevel(DebugOff);
  snprintf( chTestTitle, elCount(chTestTitle), "Verify_that_the_software_reports_wkupPwrOn_for_GetHWIO_e_WakeupSigSt_wakeup_event_detected_is_Battery_during_Initialization" );
  snprintf( chTestDescription, elCount(chTestDescription), "Purpose:To check the GetHWIO_e_WakeupSigSt interface ");
  TestCaseAddInfo( chTestTitle, "TC_L30SW_Q-36707832", chTestDescription );

  /***************************************************************************************************************/    
                                              // Start of Test Case
  /***************************************************************************************************************/
  
  /***************************************************************************************************************/    
                                              // Test Step 0 PRECONDITIONS
  /***************************************************************************************************************/
  snprintf( chActionText, elCount(chActionText), "Flash the Software and ECU is running "); 
  snprintf( chExpectedText, elCount(chExpectedText), "ECU should be in running state"); 
  TestStepAddActionExpected( chActionText, chExpectedText );
  
  A_DBGR_BreakpointDeleteAll();
  
  snprintf( chActionText, elCount(chActionText), "Flash the Software and ECU is running "); 
  snprintf( chExpectedText, elCount(chExpectedText), "ECU should be in running state"); 
 
  A_DBGR_R();
  A_DBGR_Go();
  snprintf( chActionText, elCount(chActionText), "Flash the Software and ECU is running "); 
  snprintf( chExpectedText, elCount(chExpectedText), "ECU should be in running state"); 
 // TestStepAddActionExpected( chActionText, chExpectedText );
  A_DBGR_Go();
//  /***************************************************************************************************************/    
//                                              // Test Step   Call the function Test_GetHWIO_e_WakeupSigSt during initialization
//  /***************************************************************************************************************/
//  snprintf( chActionText, elCount(chActionText), "Configure init_wakeup variable to invoke GetHWIO_e_WakeupSigSt interface"); 
//  snprintf( chExpectedText, elCount(chExpectedText), "Verify init_wakeup is configured as 1"); 
//  //TestStepAddActionExpected( chActionText, chExpectedText );
//  A_DBGR_VariableSet("init_wakeup","1");
//  E_DBGR_VariableCheck("init_wakeup",1,Equal);
  
  
  
  /***************************************************************************************************************/    
                                              // Test Step 1  Call the function Test_SetHWIO_PowerDown by setting StartPowerDown to 1 then check transceiver is in the SLEEP mode and PMIC to STANDBY mode
  /***************************************************************************************************************/
  snprintf( chActionText, elCount(chActionText), "Configure StartPowerDown variable to invoke Test_SetHWIO_PowerDown interface"); 
  snprintf( chExpectedText, elCount(chExpectedText), "Verify StartPowerDown is configured as 1"); 
  //TestStepAddActionExpected( chActionText, chExpectedText );
  A_DBGR_VariableSet("StartPowerDown","1");
 // E_DBGR_VariableCheck("StartPowerDown",1,Equal);
  
  snprintf( chActionText, elCount(chActionText), "Check Trace32 is stopped"); 
  snprintf( chExpectedText, elCount(chExpectedText), "Verify Trace32 is stopped"); 
  //TestStepAddActionExpected( chActionText, chExpectedText );
  E_DBGR_CheckState(T32_State_Down);
  
 
  /***************************************************************************************************************/    
                                              // Test Step  Run the Software and capture UART log using python
  /***************************************************************************************************************/
  SysExec("powershell", "-ExecutionPolicy Bypass -File ./serial_logging.ps1", automation_root);
  /***************************************************************************************************************/    
                                              // Test Step 2 Disconnect the Battery and verify battery is disconnected
  /***************************************************************************************************************/
  Power_OFF_ON(powersupply_port,0);
  
  /***************************************************************************************************************/    
                                              // Test Step 5  Verify Transceiver wakeUp or not.
  /***************************************************************************************************************/
  snprintf( chActionText, elCount(chActionText), "Transmit CAN message. ID:0x40000101, PDU info:0x01"); 
  snprintf( chExpectedText, elCount(chExpectedText), "CAN message transmitted. ID:0x40000101, PDU info:0x01"); 
  TestStepAddActionExpected( chActionText, chExpectedText ); 
  E_CAN_WaitForMessageByID(0x00000101,10000,cc_eCAN_ABSENT,"CAN1");
  
  /***************************************************************************************************************/    
                                              // Test Step 3 Reconnect the battery power and set the supply voltage to 12V.
  /***************************************************************************************************************/
  
  Power_OFF_ON(powersupply_port,1);
  snprintf( chActionText, elCount(chActionText), "Transmit CAN message. ID:0x40000101, PDU info:0x01"); 
  snprintf( chExpectedText, elCount(chExpectedText), "CAN message transmitted. ID:0x40000101, PDU info:0x01"); 
  TestStepAddActionExpected( chActionText, chExpectedText ); 
  E_CAN_WaitForMessageByID(0x00000101,100000,cc_eCAN_PRESENT,"CAN1");
  
  /***************************************************************************************************************/    
    // Test Step 6 Check UART log in the Tera Term window is update: Last wakeup event is: 1 (wkupPwrOn).
  /***************************************************************************************************************/ 
  strncpy(searchString,"Last wakeup event is: 1",256);
  
  snprintf( chActionText, elCount(chActionText), "waiting for UART log"); 
  snprintf( chExpectedText, elCount(chExpectedText), "waiting for UART log"); 
  TestStepAddActionExpected( chActionText, chExpectedText );
  A_GENERIC_SetTimeout(20000,"waiting for battery disconnect");
  
  snprintf(chActionText, elCount(chActionText), "Run Python script to check battConnectionStatus in log file");
  snprintf(chExpectedText, elCount(chExpectedText), "Python script should execute successfully");
  result =iFcnt_READFILE_SearchKeywordInFile(teraterm,searchString,"string is present");
  
  if(result == 1)
  {
    testStepPass("0","string is present");
  }
  else
  {
    testStepFail("1","string is not present");
  }
  
  strncpy(searchString,"Inside initialization",256);
  
  snprintf(chActionText, elCount(chActionText), "Run Python script to check battConnectionStatus in log file");
  snprintf(chExpectedText, elCount(chExpectedText), "Python script should execute successfully");
  result =iFcnt_READFILE_SearchKeywordInFile(teraterm,searchString,"string is present");
  
  if(result == 1)
  {
    testStepPass("0","string is present");
  }
  else
  {
    testStepFail("1","string is not present");
  }
  
}

testcase Verify_that_the_software_reports_wkupCanBusA_for_GetHWIO_e_WakeupSigSt_wakeup_event_detected_CAN_A_Wakeup_during_Initialization()
{
   /***************************************************************************************************************/    
                                                // Variable Definition
  /***************************************************************************************************************/ 
  

  
  /***************************************************************************************************************/    
                                               // Local Values
  /***************************************************************************************************************/ 
  

  
  /***************************************************************************************************************/    
                                              // Test Case Info
  /***************************************************************************************************************/
  setWriteDbgLevel(DebugOff);
  snprintf( chTestTitle, elCount(chTestTitle), "Verify_that_the_software_reports_wkupCanBusA_for_GetHWIO_e_WakeupSigSt_wakeup_event_detected_CAN_A_Wakeup_during_Initialization" );
  snprintf( chTestDescription, elCount(chTestDescription), "Purpose:To check the GetHWIO_e_WakeupSigSt interface ");
  TestCaseAddInfo( chTestTitle, "TC_L30SW_Q-36739510", chTestDescription );

  /***************************************************************************************************************/    
                                              // Start of Test Case
  /***************************************************************************************************************/
  
  /***************************************************************************************************************/    
                                              // Test Step 0 PRECONDITIONS
  /***************************************************************************************************************/
  snprintf( chActionText, elCount(chActionText), "Flash the Software and ECU is running "); 
  snprintf( chExpectedText, elCount(chExpectedText), "ECU should be in running state"); 
  //TestStepAddActionExpected( chActionText, chExpectedText );
  
  A_DBGR_BreakpointDeleteAll();
  
  snprintf( chActionText, elCount(chActionText), "Flash the Software and ECU is running "); 
  snprintf( chExpectedText, elCount(chExpectedText), "ECU should be in running state"); 
 
  A_DBGR_R();
  A_DBGR_Go();
  /***************************************************************************************************************/    
                                              // Test Step 1 Call the function MngCNDD_CanTrcvInitialize to initialize the CAN transceiver.
  /***************************************************************************************************************/
  snprintf( chActionText, elCount(chActionText), "Set Breakpoint TestCanTrcv_Init callback function "); 
  snprintf( chExpectedText, elCount(chExpectedText), "Breakpoint is Set in TestCanTrcv_Init"); 
  //TestStepAddActionExpected( chActionText, chExpectedText );   
  A_DBGR_BreakpointSet("TestCanTrcv_Init");  
  A_DBGR_Go();
  
  snprintf( chActionText, elCount(chActionText), "Verify Breakpoint should hit in TestCanTrcv_Init "); 
  snprintf( chExpectedText, elCount(chExpectedText), "Breakpoint hit in TestCanTrcv_Init function"); 
  //TestStepAddActionExpected( chActionText, chExpectedText );  
  E_DBGR_BreakpointCheckForHalt("TestCanTrcv_Init");
  
  /***************************************************************************************************************/    
                                              // Test Step 2 Configure the values for the structure TsCNDD_CanTrcvCnfgType for CAN2 Channel.
  /***************************************************************************************************************/
  snprintf( chActionText, elCount(chActionText), "Set Breakpoint in TestCan_Init "); 
  snprintf( chExpectedText, elCount(chExpectedText), "Verify Breakpoint is Set in TestCan_Init"); 
  TestStepAddActionExpected( chActionText, chExpectedText );  
  A_DBGR_BreakpointSet("TestCan_Init");  
  A_DBGR_Go();
  
  snprintf( chActionText, elCount(chActionText), "Verify Breakpoint should hit in TestCan_Init "); 
  snprintf( chExpectedText, elCount(chExpectedText), "Breakpoint hit in TestCan_Init function"); 
 // TestStepAddActionExpected( chActionText, chExpectedText );  
  E_DBGR_BreakpointCheckForHalt("TestCan_Init");
  
  snprintf( chActionText, elCount(chActionText), "Configure CanTrcvPnFrameDataMaskIndex variable"); 
  snprintf( chExpectedText, elCount(chExpectedText), "Verify CanTrcvPnFrameDataMaskIndex is configured as 0"); 
  TestStepAddActionExpected( chActionText, chExpectedText );
  A_DBGR_VariableSet("VsCANR_PnFrameData1[0].CanTrcvPnFrameDataMaskIndex","0");
  E_DBGR_VariableCheck("VsCANR_PnFrameData1[0].CanTrcvPnFrameDataMaskIndex",0,Equal);
  
  snprintf( chActionText, elCount(chActionText), "Configure CanTrcvPnFrameDataMask variable"); 
  snprintf( chExpectedText, elCount(chExpectedText), "Verify CanTrcvPnFrameDataMask is configured as 1"); 
  TestStepAddActionExpected( chActionText, chExpectedText );
  A_DBGR_VariableSet("VsCANR_PnFrameData1[0].CanTrcvPnFrameDataMask","1");
  E_DBGR_VariableCheck("VsCANR_PnFrameData1[0].CanTrcvPnFrameDataMask",1,Equal);
  
  snprintf( chActionText, elCount(chActionText), "Configure CanTrcvPnFrameDataMaskIndex variable"); 
  snprintf( chExpectedText, elCount(chExpectedText), "Verify CanTrcvPnFrameDataMaskIndex is configured as 7"); 
  TestStepAddActionExpected( chActionText, chExpectedText );
  A_DBGR_VariableSet("VsCANR_PnFrameData1[7].CanTrcvPnFrameDataMaskIndex","7");
  E_DBGR_VariableCheck("VsCANR_PnFrameData1[7].CanTrcvPnFrameDataMaskIndex",7,Equal);
  
  snprintf( chActionText, elCount(chActionText), "Configure CanTrcvPnFrameDataMask variable"); 
  snprintf( chExpectedText, elCount(chExpectedText), "Verify CanTrcvPnFrameDataMask is configured as 8"); 
  TestStepAddActionExpected( chActionText, chExpectedText );
  A_DBGR_VariableSet("VsCANR_PnFrameData1[7].CanTrcvPnFrameDataMask","8");
  E_DBGR_VariableCheck("VsCANR_PnFrameData1[7].CanTrcvPnFrameDataMask",8,Equal);
  
  snprintf( chActionText, elCount(chActionText), "Configure CanTrcvPnFrameCanId variable"); 
  snprintf( chExpectedText, elCount(chExpectedText), "Verify CanTrcvPnFrameCanId is configured as 0x123"); 
  TestStepAddActionExpected( chActionText, chExpectedText );
  A_DBGR_VariableSet("VsCANR_PnConfig[0].CanTrcvPnFrameCanId","0x123");
  E_DBGR_VariableCheck("VsCANR_PnConfig[0].CanTrcvPnFrameCanId",0x123,Equal);
  
  snprintf( chActionText, elCount(chActionText), "Configure CanTrcvPnFrameCanIdMask variable"); 
  snprintf( chExpectedText, elCount(chExpectedText), "Verify CanTrcvPnFrameCanIdMask is configured as 0"); 
  TestStepAddActionExpected( chActionText, chExpectedText );
  A_DBGR_VariableSet("VsCANR_PnConfig[0].CanTrcvPnFrameCanIdMask","0");
  E_DBGR_VariableCheck("VsCANR_PnConfig[0].CanTrcvPnFrameCanIdMask",0,Equal);
  
  snprintf( chActionText, elCount(chActionText), "Configure CanTrcvPnFrameIdType variable"); 
  snprintf( chExpectedText, elCount(chExpectedText), "Verify CanTrcvPnFrameIdType is configured as 0"); 
  TestStepAddActionExpected( chActionText, chExpectedText );
  A_DBGR_VariableSet("VsCANR_PnConfig[0].CanTrcvPnFrameIdType","0");
  E_DBGR_VariableCheck("VsCANR_PnConfig[0].CanTrcvPnFrameIdType",0,Equal);
  
  snprintf( chActionText, elCount(chActionText), "Configure CanTrcvPnFrameDlc variable"); 
  snprintf( chExpectedText, elCount(chExpectedText), "Verify CanTrcvPnFrameDlc is configured as 8"); 
  TestStepAddActionExpected( chActionText, chExpectedText );
  A_DBGR_VariableSet("VsCANR_PnConfig[0].CanTrcvPnFrameDlc","8");
  E_DBGR_VariableCheck("VsCANR_PnConfig[0].CanTrcvPnFrameDlc",8,Equal);
  
  snprintf( chActionText, elCount(chActionText), "Configure CanTrcvPnEnabled variable"); 
  snprintf( chExpectedText, elCount(chExpectedText), "Verify CanTrcvPnEnabled is configured as 1"); 
  TestStepAddActionExpected( chActionText, chExpectedText );
  A_DBGR_VariableSet("VsCANR_PnConfig[0].CanTrcvPnEnabled","1");
  E_DBGR_VariableCheck("VsCANR_PnConfig[0].CanTrcvPnEnabled",1,Equal);
  
  snprintf( chActionText, elCount(chActionText), "Configure CanTrcvChannelId variable"); 
  snprintf( chExpectedText, elCount(chExpectedText), "Verify CanTrcvChannelId is configured as 0"); 
  TestStepAddActionExpected( chActionText, chExpectedText );
  A_DBGR_VariableSet("VsCANR_TrcvChannels[0].CanTrcvChannelId","0");
  E_DBGR_VariableCheck("VsCANR_TrcvChannels[0].CanTrcvChannelId",0,Equal);
  
  snprintf( chActionText, elCount(chActionText), "Configure CanTrcvChannelUsed variable"); 
  snprintf( chExpectedText, elCount(chExpectedText), "Verify CanTrcvChannelUsed is configured as 1"); 
  TestStepAddActionExpected( chActionText, chExpectedText );
  A_DBGR_VariableSet("VsCANR_TrcvChannels[0].CanTrcvChannelUsed","1");
  E_DBGR_VariableCheck("VsCANR_TrcvChannels[0].CanTrcvChannelUsed",1,Equal);
  
  snprintf( chActionText, elCount(chActionText), "Configure CanTrcvPinWakeupEnabled variable"); 
  snprintf( chExpectedText, elCount(chExpectedText), "Verify CanTrcvPinWakeupEnabled is configured as 0"); 
  TestStepAddActionExpected( chActionText, chExpectedText );
  A_DBGR_VariableSet("VsCANR_TrcvChannels[0].CanTrcvPinWakeupEnabled","0");
  E_DBGR_VariableCheck("VsCANR_TrcvChannels[0].CanTrcvPinWakeupEnabled",0,Equal);
  
  snprintf( chActionText, elCount(chActionText), "Configure CanTrcvNumberOfChannels variable"); 
  snprintf( chExpectedText, elCount(chExpectedText), "Verify CanTrcvNumberOfChannels is configured as 2"); 
  TestStepAddActionExpected( chActionText, chExpectedText );
  A_DBGR_VariableSet("VsCANR_CanTrcvConfig.CanTrcvNumberOfChannels","2");
  E_DBGR_VariableCheck("VsCANR_CanTrcvConfig.CanTrcvNumberOfChannels",2,Equal);
  
  snprintf( chActionText, elCount(chActionText), "Flash the Software and ECU is running "); 
  snprintf( chExpectedText, elCount(chExpectedText), "ECU should be in running state"); 
  TestStepAddActionExpected( chActionText, chExpectedText );
  A_DBGR_Go();
  
// /***************************************************************************************************************/    
//                                              // Test Step   Call the function Test_GetHWIO_e_WakeupSigSt during initialization
//  /***************************************************************************************************************/
//  snprintf( chActionText, elCount(chActionText), "Configure init_wakeup variable to invoke GetHWIO_e_WakeupSigSt interface"); 
//  snprintf( chExpectedText, elCount(chExpectedText), "Verify init_wakeup is configured as 1"); 
//  TestStepAddActionExpected( chActionText, chExpectedText );
//  A_DBGR_VariableSet("init_wakeup","1");
//  E_DBGR_VariableCheck("init_wakeup",1,Equal);
  
  /***************************************************************************************************************/    
                                              // Test Step 3  Call the function Test_SetHWIO_PowerDown by setting StartPowerDown to 1 then check transceiver is in the SLEEP mode and PMIC to STANDBY mode
  /***************************************************************************************************************/
  snprintf( chActionText, elCount(chActionText), "Configure StartPowerDown variable to invoke Test_SetHWIO_PowerDown interface"); 
  snprintf( chExpectedText, elCount(chExpectedText), "Verify StartPowerDown is configured as 1"); 
  //TestStepAddActionExpected( chActionText, chExpectedText );
  A_DBGR_VariableSet("StartPowerDown","1");
 // E_DBGR_VariableCheck("StartPowerDown",1,Equal);
  
  snprintf( chActionText, elCount(chActionText), "Check Trace32 is stopped"); 
  snprintf( chExpectedText, elCount(chExpectedText), "Verify Trace32 is stopped"); 
  //TestStepAddActionExpected( chActionText, chExpectedText );
  E_DBGR_CheckState(T32_State_Down);
  
   /***************************************************************************************************************/    
                                              // Test Step 4 Run the Software and capture UART log using python
  /***************************************************************************************************************/
  
  SysExec("powershell", "-ExecutionPolicy Bypass -File ./serial_logging.ps1", automation_root);
  
  snprintf( chActionText, elCount(chActionText), "waiting for UART log"); 
  snprintf( chExpectedText, elCount(chExpectedText), "waiting for UART log"); 
  TestStepAddActionExpected( chActionText, chExpectedText );
  A_GENERIC_SetTimeout(3000,"waiting for UART log");
 
  
  /***************************************************************************************************************/    
                                              // Test Step 5  This step involves sending a CAN wakeup frame with ID 0x123 and 8 bytes of data from Canoe.
  /***************************************************************************************************************/
//  snprintf( chActionText, elCount(chActionText), "Transmit CAN message. ID:0x123"); 
//  snprintf( chExpectedText, elCount(chExpectedText), "CAN message transmitted. ID:0x123"); 
//  //TestStepAddActionExpected( chActionText, chExpectedText );
//  A_CAN_SendMessage(0x123, CANA_Wakeup, 8, 1);
//  A_CAN_SendMessage(0x123, CANA_Wakeup, 8, 1);
  
  setTimer(periodicTimer_CAN2,1);
  /***************************************************************************************************************/    
                                              // Test Step 6  Verify Transceiver wakeUp or not.
  /***************************************************************************************************************/
  snprintf( chActionText, elCount(chActionText), "Transmit CAN message. ID:0x40000101, PDU info:0x01"); 
  snprintf( chExpectedText, elCount(chExpectedText), "CAN message transmitted. ID:0x40000101, PDU info:0x01"); 
  //TestStepAddActionExpected( chActionText, chExpectedText ); 
  
  E_CAN_WaitForMessageByID(0x00000101,10000,cc_eCAN_PRESENT,"CAN1");
  
  /***************************************************************************************************************/    
                          // Test Step 7 Check UART log in the Tera Term window is update: Last wakeup event is: 2 (wkupCanBusA).
  /***************************************************************************************************************/ 
  strncpy(searchString,"Last wakeup event is: 2",256);
  
  snprintf( chActionText, elCount(chActionText), "waiting for UART log"); 
  snprintf( chExpectedText, elCount(chExpectedText), "waiting for UART log"); 
  TestStepAddActionExpected( chActionText, chExpectedText );
  A_GENERIC_SetTimeout(20000,"waiting for UART log");
  
  snprintf(chActionText, elCount(chActionText), "Run Python script to check battConnectionStatus in log file");
  snprintf(chExpectedText, elCount(chExpectedText), "Python script should execute successfully");
  result =iFcnt_READFILE_SearchKeywordInFile(teraterm,searchString,"string is present");
  
  if(result == 1)
  {
    testStepPass("0","string is present");
  }
  else
  {
    testStepFail("1","string is not present");
  }
  
  strncpy(searchString,"Inside initialization",256);
  
  snprintf(chActionText, elCount(chActionText), "Run Python script to check battConnectionStatus in log file");
  snprintf(chExpectedText, elCount(chExpectedText), "Python script should execute successfully");
  result =iFcnt_READFILE_SearchKeywordInFile(teraterm,searchString,"string is present");
  
  if(result == 1)
  {
    testStepPass("0","string is present");
  }
  else
  {
    testStepFail("1","string is not present");
  }
  cancelTimer(periodicTimer_CAN2);
  testWaitForTimeout(1000);
}

testcase Verify_that_the_software_reports_wkupCanBusB_for_GetHWIO_e_WakeupSigSt_wakeup_event_detected_CAN_B_Wakeup_during_Initialization()
{
    /***************************************************************************************************************/    
                                                // Variable Definition
  /***************************************************************************************************************/ 
  

  
  /***************************************************************************************************************/    
                                               // Local Values
  /***************************************************************************************************************/ 
  

  
  /***************************************************************************************************************/    
                                              // Test Case Info
  /***************************************************************************************************************/
  setWriteDbgLevel(DebugOff);
  snprintf( chTestTitle, elCount(chTestTitle), "Verify_that_the_software_reports_wkupCanBusB_for_GetHWIO_e_WakeupSigSt_wakeup_event_detected_CAN_B_Wakeup_during_Initialization" );
  snprintf( chTestDescription, elCount(chTestDescription), "Purpose:To check the GetHWIO_e_WakeupSigSt interface ");
  TestCaseAddInfo( chTestTitle, "TC_L30SW_Q-36739511", chTestDescription );

  /***************************************************************************************************************/    
                                              // Test Step 0 PRECONDITIONS
  /***************************************************************************************************************/
  snprintf( chActionText, elCount(chActionText), "Flash the Software and ECU is running "); 
  snprintf( chExpectedText, elCount(chExpectedText), "ECU should be in running state"); 
  //TestStepAddActionExpected( chActionText, chExpectedText );
  A_DBGR_BreakpointDeleteAll();
  
  snprintf( chActionText, elCount(chActionText), "Flash the Software and ECU is running "); 
  snprintf( chExpectedText, elCount(chExpectedText), "ECU should be in running state"); 
  //TestStepAddActionExpected( chActionText, chExpectedText );
  A_DBGR_R();
  A_DBGR_Go();
  /***************************************************************************************************************/    
                                              // Test Step 1 Call the function MngCNDD_CanTrcvInitialize to initialize the CAN transceiver.
  /***************************************************************************************************************/
  snprintf( chActionText, elCount(chActionText), "Set Breakpoint TestCanTrcv_Init callback function "); 
  snprintf( chExpectedText, elCount(chExpectedText), "Breakpoint is Set in TestCanTrcv_Init"); 
  //TestStepAddActionExpected( chActionText, chExpectedText );   
  A_DBGR_BreakpointSet("TestCanTrcv_Init");  
  A_DBGR_Go();
  
  snprintf( chActionText, elCount(chActionText), "Verify Breakpoint should hit in TestCanTrcv_Init "); 
  snprintf( chExpectedText, elCount(chExpectedText), "Breakpoint hit in TestCanTrcv_Init function"); 
  //TestStepAddActionExpected( chActionText, chExpectedText );  
  E_DBGR_BreakpointCheckForHalt("TestCanTrcv_Init");
  /***************************************************************************************************************/    
                                              // Test Step 2 Configure the values for the structure TsCNDD_CanTrcvCnfgType for CAN2 Channel.
  /***************************************************************************************************************/
  snprintf( chActionText, elCount(chActionText), "Set Breakpoint in TestCan_Init "); 
  snprintf( chExpectedText, elCount(chExpectedText), "Verify Breakpoint is Set in TestCan_Init"); 
  TestStepAddActionExpected( chActionText, chExpectedText );  
  A_DBGR_BreakpointSet("TestCan_Init");  
  A_DBGR_Go();
  
  snprintf( chActionText, elCount(chActionText), "Verify Breakpoint should hit in TestCan_Init "); 
  snprintf( chExpectedText, elCount(chExpectedText), "Breakpoint hit in TestCan_Init function"); 
 // TestStepAddActionExpected( chActionText, chExpectedText );  
  E_DBGR_BreakpointCheckForHalt("TestCan_Init");
  
  snprintf( chActionText, elCount(chActionText), "Configure CanTrcvPnFrameDataMaskIndex variable"); 
  snprintf( chExpectedText, elCount(chExpectedText), "verify Configure CanTrcvPnFrameDataMaskIndex as 1"); 
  TestStepAddActionExpected( chActionText, chExpectedText );
  A_DBGR_VariableSet("VsCANR_PnFrameData2[1].CanTrcvPnFrameDataMaskIndex","1");
  E_DBGR_VariableCheck("VsCANR_PnFrameData2[1].CanTrcvPnFrameDataMaskIndex",1,Equal);
  
  snprintf( chActionText, elCount(chActionText), "Configure CanTrcvPnFrameDataMask variable"); 
  snprintf( chExpectedText, elCount(chExpectedText), "verify Configure CanTrcvPnFrameDataMask as 1"); 
  TestStepAddActionExpected( chActionText, chExpectedText );
  A_DBGR_VariableSet("VsCANR_PnFrameData2[1].CanTrcvPnFrameDataMask","1");
  E_DBGR_VariableCheck("VsCANR_PnFrameData2[1].CanTrcvPnFrameDataMask",1,Equal);
  
  snprintf( chActionText, elCount(chActionText), "Configure CanTrcvPnFrameCanId variable"); 
  snprintf( chExpectedText, elCount(chExpectedText), "verify Configure CanTrcvPnFrameCanId as 0x456"); 
  TestStepAddActionExpected( chActionText, chExpectedText );
  A_DBGR_VariableSet("VsCANR_PnConfig[1].CanTrcvPnFrameCanId","0x456");
  E_DBGR_VariableCheck("VsCANR_PnConfig[1].CanTrcvPnFrameCanId",0x456,Equal);
  
  snprintf( chActionText, elCount(chActionText), "Configure CanTrcvPnFrameCanIdMask variable"); 
  snprintf( chExpectedText, elCount(chExpectedText), "verify Configure CanTrcvPnFrameCanIdMask as 0"); 
  TestStepAddActionExpected( chActionText, chExpectedText );
  A_DBGR_VariableSet("VsCANR_PnConfig[1].CanTrcvPnFrameCanIdMask","0");
  E_DBGR_VariableCheck("VsCANR_PnConfig[1].CanTrcvPnFrameCanIdMask",0,Equal);
  
  snprintf( chActionText, elCount(chActionText), "Configure CanTrcvPnFrameIdType variable"); 
  snprintf( chExpectedText, elCount(chExpectedText), "verify Configure CanTrcvPnFrameIdType as 0"); 
  TestStepAddActionExpected( chActionText, chExpectedText );
  A_DBGR_VariableSet("VsCANR_PnConfig[1].CanTrcvPnFrameIdType","0");
  E_DBGR_VariableCheck("VsCANR_PnConfig[1].CanTrcvPnFrameIdType",0,Equal);
  
  snprintf( chActionText, elCount(chActionText), "Configure CanTrcvPnFrameDlc variable"); 
  snprintf( chExpectedText, elCount(chExpectedText), "verify Configure CanTrcvPnFrameDlc as 4"); 
  TestStepAddActionExpected( chActionText, chExpectedText );
  A_DBGR_VariableSet("VsCANR_PnConfig[1].CanTrcvPnFrameDlc","4");
  E_DBGR_VariableCheck("VsCANR_PnConfig[1].CanTrcvPnFrameDlc",4,Equal);
  
  snprintf( chActionText, elCount(chActionText), "Configure CanTrcvPnEnabled variable"); 
  snprintf( chExpectedText, elCount(chExpectedText), "verify Configure CanTrcvPnEnabled as 1"); 
  TestStepAddActionExpected( chActionText, chExpectedText );
  A_DBGR_VariableSet("VsCANR_PnConfig[1].CanTrcvPnEnabled","1");
  E_DBGR_VariableCheck("VsCANR_PnConfig[1].CanTrcvPnEnabled",1,Equal);
  
  snprintf( chActionText, elCount(chActionText), "Configure CanTrcvChannelId variable"); 
  snprintf( chExpectedText, elCount(chExpectedText), "verify Configure CanTrcvChannelId as 0"); 
  TestStepAddActionExpected( chActionText, chExpectedText );
  A_DBGR_VariableSet("VsCANR_TrcvChannels[1].CanTrcvChannelId","1");
  E_DBGR_VariableCheck("VsCANR_TrcvChannels[1].CanTrcvChannelId",1,Equal);
  
  snprintf( chActionText, elCount(chActionText), "Configure CanTrcvChannelUsed variable"); 
  snprintf( chExpectedText, elCount(chExpectedText), "verify Configure CanTrcvChannelUsed as 1"); 
  TestStepAddActionExpected( chActionText, chExpectedText );
  A_DBGR_VariableSet("VsCANR_TrcvChannels[1].CanTrcvChannelUsed","1");
  E_DBGR_VariableCheck("VsCANR_TrcvChannels[1].CanTrcvChannelUsed",1,Equal);
  
  snprintf( chActionText, elCount(chActionText), "Configure CanTrcvPinWakeupEnabled variable"); 
  snprintf( chExpectedText, elCount(chExpectedText), "verify Configure CanTrcvPinWakeupEnabled as 0"); 
  TestStepAddActionExpected( chActionText, chExpectedText );
  A_DBGR_VariableSet("VsCANR_TrcvChannels[1].CanTrcvPinWakeupEnabled","0");
  E_DBGR_VariableCheck("VsCANR_TrcvChannels[1].CanTrcvPinWakeupEnabled",0,Equal);
  
  snprintf( chActionText, elCount(chActionText), "Configure CanTrcvNumberOfChannels variable"); 
  snprintf( chExpectedText, elCount(chExpectedText), "verify Configure CanTrcvNumberOfChannels as 2"); 
  TestStepAddActionExpected( chActionText, chExpectedText );
  A_DBGR_VariableSet("VsCANR_CanTrcvConfig.CanTrcvNumberOfChannels","2");
  E_DBGR_VariableCheck("VsCANR_CanTrcvConfig.CanTrcvNumberOfChannels",2,Equal);
  
  snprintf( chActionText, elCount(chActionText), "Flash the Software and ECU is running "); 
  snprintf( chExpectedText, elCount(chExpectedText), "ECU should be in running state"); 
  TestStepAddActionExpected( chActionText, chExpectedText );
  A_DBGR_Go();
  
//  /***************************************************************************************************************/    
//                                              // Test Step   Call the function Test_GetHWIO_e_WakeupSigSt during initialization
//  /***************************************************************************************************************/
//  snprintf( chActionText, elCount(chActionText), "Configure init_wakeup variable to invoke GetHWIO_e_WakeupSigSt interface"); 
//  snprintf( chExpectedText, elCount(chExpectedText), "Verify init_wakeup is configured as 1"); 
//  TestStepAddActionExpected( chActionText, chExpectedText );
//  A_DBGR_VariableSet("init_wakeup","1");
//  E_DBGR_VariableCheck("init_wakeup",1,Equal);
  
  /***************************************************************************************************************/    
                                              // Test Step 3  Call the function Test_SetHWIO_PowerDown by setting StartPowerDown to 1 then check transceiver is in the SLEEP mode and PMIC to STANDBY mode
  /***************************************************************************************************************/
  snprintf( chActionText, elCount(chActionText), "Configure StartPowerDown variable to invoke Test_SetHWIO_PowerDown interface"); 
  snprintf( chExpectedText, elCount(chExpectedText), "Verify StartPowerDown is configured as 1"); 
  //TestStepAddActionExpected( chActionText, chExpectedText );
  A_DBGR_VariableSet("StartPowerDown","1");
 // E_DBGR_VariableCheck("StartPowerDown",1,Equal);
  
  snprintf( chActionText, elCount(chActionText), "Check Trace32 is stopped"); 
  snprintf( chExpectedText, elCount(chExpectedText), "Verify Trace32 is stopped"); 
  //TestStepAddActionExpected( chActionText, chExpectedText );
  E_DBGR_CheckState(T32_State_Down);
  
   /***************************************************************************************************************/    
                                              // Test Step 4 Run the Software and capture UART log using python
  /***************************************************************************************************************/
  
  SysExec("powershell", "-ExecutionPolicy Bypass -File ./serial_logging.ps1", automation_root);
  
  snprintf( chActionText, elCount(chActionText), "waiting for UART log"); 
  snprintf( chExpectedText, elCount(chExpectedText), "waiting for UART log"); 
  TestStepAddActionExpected( chActionText, chExpectedText );
  A_GENERIC_SetTimeout(3000,"waiting for UART log");
 
  
  /***************************************************************************************************************/    
                                              // Test Step 4  This step involves sending a CAN wakeup frame with ID 0x456 and 4 bytes of data from Canoe.
  /***************************************************************************************************************/
//  snprintf( chActionText, elCount(chActionText), "Transmit CAN message. ID:0x123"); 
//  snprintf( chExpectedText, elCount(chExpectedText), "CAN message transmitted. ID:0x123"); 
// // TestStepAddActionExpected( chActionText, chExpectedText );
//  A_CAN_SendMessage(0x456, CANB_Wakeup, 4, 2);
//  A_CAN_SendMessage(0x456, CANB_Wakeup, 4, 2);
  setTimer(periodicTimer_CAN8,1);
  /***************************************************************************************************************/    
                                              // Test Step 6  Verify Transceiver wakeUp or not.
  /***************************************************************************************************************/
  snprintf( chActionText, elCount(chActionText), "Transmit CAN message. ID:0x40000101, PDU info:0x01"); 
  snprintf( chExpectedText, elCount(chExpectedText), "CAN message transmitted. ID:0x40000101, PDU info:0x01"); 
  //TestStepAddActionExpected( chActionText, chExpectedText ); 
  
  E_CAN_WaitForMessageByID(0x00000101,10000,cc_eCAN_PRESENT,"CAN1");
  
  /***************************************************************************************************************/    
                          // Test Step 7 Check UART log in the Tera Term window is update: Last wakeup event is: 2 (wkupCanBusA).
  /***************************************************************************************************************/ 
  strncpy(searchString,"Last wakeup event is: 4",256);
  
  snprintf( chActionText, elCount(chActionText), "waiting for UART log"); 
  snprintf( chExpectedText, elCount(chExpectedText), "waiting for UART log"); 
  TestStepAddActionExpected( chActionText, chExpectedText );
  A_GENERIC_SetTimeout(20000,"waiting for UART log");
  
  snprintf(chActionText, elCount(chActionText), "Run Python script to check battConnectionStatus in log file");
  snprintf(chExpectedText, elCount(chExpectedText), "Python script should execute successfully");
  result =iFcnt_READFILE_SearchKeywordInFile(teraterm,searchString,"string is present");
  
  if(result == 1)
  {
    testStepPass("0","string is present");
  }
  else
  {
    testStepFail("1","string is not present");
  }
  
  strncpy(searchString,"Inside initialization",256);
  
  snprintf(chActionText, elCount(chActionText), "Run Python script to check battConnectionStatus in log file");
  snprintf(chExpectedText, elCount(chExpectedText), "Python script should execute successfully");
  result =iFcnt_READFILE_SearchKeywordInFile(teraterm,searchString,"string is present");
  
  if(result == 1)
  {
    testStepPass("0","string is present");
  }
  else
  {
    testStepFail("1","string is not present");
  }
  
  cancelTimer(periodicTimer_CAN8);
  testWaitForTimeout(1000);
 
}

testcase Verify_that_the_software_reports_wkupPwrOn_for_GetHWIO_e_WakeupSigSt_wakeup_event_detected_is_Battery_during_Shutdown()
{
  /***************************************************************************************************************/    
                                                // Variable Definition
  /***************************************************************************************************************/ 
  

  
  /***************************************************************************************************************/    
                                               // Local Values
  /***************************************************************************************************************/ 
  

  
  /***************************************************************************************************************/    
                                              // Test Case Info
  /***************************************************************************************************************/
  setWriteDbgLevel(DebugOff);
  snprintf( chTestTitle, elCount(chTestTitle), "Verify_that_the_software_reports_wkupPwrOn_for_GetHWIO_e_WakeupSigSt_wakeup_event_detected_is_Battery_during_Shutdown" );
  snprintf( chTestDescription, elCount(chTestDescription), "Purpose:To check the GetHWIO_e_WakeupSigSt interface ");
  TestCaseAddInfo( chTestTitle, "TC_L30SW_Q-36712276", chTestDescription );

  /***************************************************************************************************************/    
                                              // Start of Test Case
  /***************************************************************************************************************/
  
  /***************************************************************************************************************/    
                                              // Test Step 0 PRECONDITIONS
  /***************************************************************************************************************/
  snprintf( chActionText, elCount(chActionText), "Flash the Software and ECU is running "); 
  snprintf( chExpectedText, elCount(chExpectedText), "ECU should be in running state"); 
  TestStepAddActionExpected( chActionText, chExpectedText );
  
  A_DBGR_BreakpointDeleteAll();
  
  snprintf( chActionText, elCount(chActionText), "Flash the Software and ECU is running "); 
  snprintf( chExpectedText, elCount(chExpectedText), "ECU should be in running state"); 
 
  A_DBGR_R();
  A_DBGR_Go();
  snprintf( chActionText, elCount(chActionText), "Flash the Software and ECU is running "); 
  snprintf( chExpectedText, elCount(chExpectedText), "ECU should be in running state"); 
 // TestStepAddActionExpected( chActionText, chExpectedText );
  A_DBGR_Go();
  /***************************************************************************************************************/    
                                              // Test Step  Run the Software and capture UART log using python
  /***************************************************************************************************************/
  SysExec("powershell", "-ExecutionPolicy Bypass -File ./serial_logging.ps1", automation_root);
  
  /***************************************************************************************************************/    
                                              // Test Step   Call the function Test_GetHWIO_e_WakeupSigSt during initialization
  /***************************************************************************************************************/
  snprintf( chActionText, elCount(chActionText), "Configure delay_shutdown variable to invoke delay during shutdown interface"); 
  snprintf( chExpectedText, elCount(chExpectedText), "Verify delay_shutdown is configured as 1"); 
  //TestStepAddActionExpected( chActionText, chExpectedText );
  A_DBGR_VariableSet("Test_delay_shutdown","1");
  E_DBGR_VariableCheck("Test_delay_shutdown",1,Equal);
  
  
  /***************************************************************************************************************/    
                                              // Test Step 1  Call the function Test_SetHWIO_PowerDown by setting StartPowerDown to 1 then check transceiver is in the SLEEP mode and PMIC to STANDBY mode
  /***************************************************************************************************************/
  snprintf( chActionText, elCount(chActionText), "Configure StartPowerDown variable to invoke Test_SetHWIO_PowerDown interface"); 
  snprintf( chExpectedText, elCount(chExpectedText), "Verify StartPowerDown is configured as 1"); 
  TestStepAddActionExpected( chActionText, chExpectedText );
  A_DBGR_VariableSet("StartPowerDown","1");
  E_DBGR_VariableCheck("StartPowerDown",1,Equal);
  
  /***************************************************************************************************************/    
                                              // Test Step 2 Disconnect the Battery and verify battery is disconnected
  /***************************************************************************************************************/
  Power_OFF_ON(powersupply_port,0);
  
  /***************************************************************************************************************/    
                                              // Test Step 5  Verify Transceiver wakeUp or not.
  /***************************************************************************************************************/
  snprintf( chActionText, elCount(chActionText), "Transmit CAN message. ID:0x40000101, PDU info:0x01"); 
  snprintf( chExpectedText, elCount(chExpectedText), "CAN message transmitted. ID:0x40000101, PDU info:0x01"); 
  TestStepAddActionExpected( chActionText, chExpectedText ); 
  E_CAN_WaitForMessageByID(0x00000101,10000,cc_eCAN_ABSENT,"CAN1");
  
  /***************************************************************************************************************/    
                                              // Test Step 3 Reconnect the battery power and set the supply voltage to 12V.
  /***************************************************************************************************************/
  
  Power_OFF_ON(powersupply_port,1);
  snprintf( chActionText, elCount(chActionText), "Transmit CAN message. ID:0x40000101, PDU info:0x01"); 
  snprintf( chExpectedText, elCount(chExpectedText), "CAN message transmitted. ID:0x40000101, PDU info:0x01"); 
  TestStepAddActionExpected( chActionText, chExpectedText ); 
  E_CAN_WaitForMessageByID(0x00000101,100000,cc_eCAN_PRESENT,"CAN1");
  
  /***************************************************************************************************************/    
    // Test Step 6 Check UART log in the Tera Term window is update: Last wakeup event is: 1 (wkupPwrOn).
  /***************************************************************************************************************/ 
  strncpy(searchString,"Last wakeup event is: 1",256);
  
  snprintf( chActionText, elCount(chActionText), "waiting for UART log"); 
  snprintf( chExpectedText, elCount(chExpectedText), "waiting for UART log"); 
  TestStepAddActionExpected( chActionText, chExpectedText );
  A_GENERIC_SetTimeout(20000,"waiting for battery disconnect");
  
  snprintf(chActionText, elCount(chActionText), "Run Python script to check battConnectionStatus in log file");
  snprintf(chExpectedText, elCount(chExpectedText), "Python script should execute successfully");
  result =iFcnt_READFILE_SearchKeywordInFile(teraterm,searchString,"string is present");
  
  if(result == 1)
  {
    testStepPass("0","string is present");
  }
  else
  {
    testStepFail("1","string is not present");
  }
  
  strncpy(searchString,"CAN Transcevier 0 is moving to SLEEP mode",256);
  snprintf(chActionText, elCount(chActionText), "Run Python script to check battConnectionStatus in log file");
  snprintf(chExpectedText, elCount(chExpectedText), "Python script should execute successfully");
  result =iFcnt_READFILE_SearchKeywordInFile(teraterm,searchString,"string is present");
  
  if(result == 1)
  {
    testStepFail("0","string is present");
  }
  else
  {
    testStepPass("1","string is not present");
  }
}

testcase Verify_that_the_software_reports_Multiple_for_GetHWIO_e_WakeupSigSt_wakeup_event_detected_is_CAN_A_bus_and_CAN_B_bus()
{
  /***************************************************************************************************************/    
                                                // Variable Definition
  /***************************************************************************************************************/ 
  

  
  /***************************************************************************************************************/    
                                               // Local Values
  /***************************************************************************************************************/ 
  

  
  /***************************************************************************************************************/    
                                              // Test Case Info
  /***************************************************************************************************************/
  setWriteDbgLevel(DebugOff);
  snprintf( chTestTitle, elCount(chTestTitle), "Verify_that_the_software_reports_wkupCanBusA_for_GetHWIO_e_WakeupSigSt_wakeup_event_detected_CAN_A_Wakeup_during_Initialization" );
  snprintf( chTestDescription, elCount(chTestDescription), "Purpose:To check the GetHWIO_e_WakeupSigSt interface ");
  TestCaseAddInfo( chTestTitle, "TC_L30SW_Q-36739510", chTestDescription );

  /***************************************************************************************************************/    
                                              // Start of Test Case
  /***************************************************************************************************************/
  
  /***************************************************************************************************************/    
                                              // Test Step 0 PRECONDITIONS
  /***************************************************************************************************************/
  snprintf( chActionText, elCount(chActionText), "Flash the Software and ECU is running "); 
  snprintf( chExpectedText, elCount(chExpectedText), "ECU should be in running state"); 
  //TestStepAddActionExpected( chActionText, chExpectedText );
  
  A_DBGR_BreakpointDeleteAll();
  A_DBGR_R();

  A_DBGR_BreakpointSet("TestCanTrcv_Init");
  A_DBGR_Go_Safe();
  /***************************************************************************************************************/    
                                              // Test Step 1 Call the function MngCNDD_CanTrcvInitialize to initialize the CAN transceiver.
  /***************************************************************************************************************/

  snprintf( chActionText, elCount(chActionText), "Verify Breakpoint should hit in TestCanTrcv_Init "); 
  snprintf( chExpectedText, elCount(chExpectedText), "Breakpoint hit in TestCanTrcv_Init function"); 
  //TestStepAddActionExpected( chActionText, chExpectedText );  
  E_DBGR_BreakpointCheckForHalt("TestCanTrcv_Init");
  
  /***************************************************************************************************************/    
                                              // Test Step 2 Configure the values for the structure TsCNDD_CanTrcvCnfgType for CAN2 Channel.
  /***************************************************************************************************************/
  snprintf( chActionText, elCount(chActionText), "Set Breakpoint in TestCan_Init "); 
  snprintf( chExpectedText, elCount(chExpectedText), "Verify Breakpoint is Set in TestCan_Init"); 
  TestStepAddActionExpected( chActionText, chExpectedText );  
  A_DBGR_BreakpointSet("TestCan_Init");  
  A_DBGR_Go();
  
  snprintf( chActionText, elCount(chActionText), "Verify Breakpoint should hit in TestCan_Init "); 
  snprintf( chExpectedText, elCount(chExpectedText), "Breakpoint hit in TestCan_Init function"); 
 // TestStepAddActionExpected( chActionText, chExpectedText );  
  E_DBGR_BreakpointCheckForHalt("TestCan_Init");
  
  snprintf( chActionText, elCount(chActionText), "Configure CanTrcvPnFrameDataMaskIndex variable"); 
  snprintf( chExpectedText, elCount(chExpectedText), "Verify CanTrcvPnFrameDataMaskIndex is configured as 0"); 
  TestStepAddActionExpected( chActionText, chExpectedText );
  A_DBGR_VariableSet("VsCANR_PnFrameData1[0].CanTrcvPnFrameDataMaskIndex","0");
  E_DBGR_VariableCheck("VsCANR_PnFrameData1[0].CanTrcvPnFrameDataMaskIndex",0,Equal);
  
  snprintf( chActionText, elCount(chActionText), "Configure CanTrcvPnFrameDataMask variable"); 
  snprintf( chExpectedText, elCount(chExpectedText), "Verify CanTrcvPnFrameDataMask is configured as 1"); 
  TestStepAddActionExpected( chActionText, chExpectedText );
  A_DBGR_VariableSet("VsCANR_PnFrameData1[0].CanTrcvPnFrameDataMask","1");
  E_DBGR_VariableCheck("VsCANR_PnFrameData1[0].CanTrcvPnFrameDataMask",1,Equal);
  
  snprintf( chActionText, elCount(chActionText), "Configure CanTrcvPnFrameDataMaskIndex variable"); 
  snprintf( chExpectedText, elCount(chExpectedText), "Verify CanTrcvPnFrameDataMaskIndex is configured as 7"); 
  TestStepAddActionExpected( chActionText, chExpectedText );
  A_DBGR_VariableSet("VsCANR_PnFrameData1[7].CanTrcvPnFrameDataMaskIndex","7");
  E_DBGR_VariableCheck("VsCANR_PnFrameData1[7].CanTrcvPnFrameDataMaskIndex",7,Equal);
  
  snprintf( chActionText, elCount(chActionText), "Configure CanTrcvPnFrameDataMask variable"); 
  snprintf( chExpectedText, elCount(chExpectedText), "Verify CanTrcvPnFrameDataMask is configured as 8"); 
  TestStepAddActionExpected( chActionText, chExpectedText );
  A_DBGR_VariableSet("VsCANR_PnFrameData1[7].CanTrcvPnFrameDataMask","8");
  E_DBGR_VariableCheck("VsCANR_PnFrameData1[7].CanTrcvPnFrameDataMask",8,Equal);
  
  snprintf( chActionText, elCount(chActionText), "Configure CanTrcvPnFrameCanId variable"); 
  snprintf( chExpectedText, elCount(chExpectedText), "Verify CanTrcvPnFrameCanId is configured as 0x123"); 
  TestStepAddActionExpected( chActionText, chExpectedText );
  A_DBGR_VariableSet("VsCANR_PnConfig[0].CanTrcvPnFrameCanId","0x123");
  E_DBGR_VariableCheck("VsCANR_PnConfig[0].CanTrcvPnFrameCanId",0x123,Equal);
  
  snprintf( chActionText, elCount(chActionText), "Configure CanTrcvPnFrameCanIdMask variable"); 
  snprintf( chExpectedText, elCount(chExpectedText), "Verify CanTrcvPnFrameCanIdMask is configured as 0"); 
  TestStepAddActionExpected( chActionText, chExpectedText );
  A_DBGR_VariableSet("VsCANR_PnConfig[0].CanTrcvPnFrameCanIdMask","0");
  E_DBGR_VariableCheck("VsCANR_PnConfig[0].CanTrcvPnFrameCanIdMask",0,Equal);
  
  snprintf( chActionText, elCount(chActionText), "Configure CanTrcvPnFrameIdType variable"); 
  snprintf( chExpectedText, elCount(chExpectedText), "Verify CanTrcvPnFrameIdType is configured as 0"); 
  TestStepAddActionExpected( chActionText, chExpectedText );
  A_DBGR_VariableSet("VsCANR_PnConfig[0].CanTrcvPnFrameIdType","0");
  E_DBGR_VariableCheck("VsCANR_PnConfig[0].CanTrcvPnFrameIdType",0,Equal);
  
  snprintf( chActionText, elCount(chActionText), "Configure CanTrcvPnFrameDlc variable"); 
  snprintf( chExpectedText, elCount(chExpectedText), "Verify CanTrcvPnFrameDlc is configured as 8"); 
  TestStepAddActionExpected( chActionText, chExpectedText );
  A_DBGR_VariableSet("VsCANR_PnConfig[0].CanTrcvPnFrameDlc","8");
  E_DBGR_VariableCheck("VsCANR_PnConfig[0].CanTrcvPnFrameDlc",8,Equal);
  
  snprintf( chActionText, elCount(chActionText), "Configure CanTrcvPnEnabled variable"); 
  snprintf( chExpectedText, elCount(chExpectedText), "Verify CanTrcvPnEnabled is configured as 1"); 
  TestStepAddActionExpected( chActionText, chExpectedText );
  A_DBGR_VariableSet("VsCANR_PnConfig[0].CanTrcvPnEnabled","1");
  E_DBGR_VariableCheck("VsCANR_PnConfig[0].CanTrcvPnEnabled",1,Equal);
  
  snprintf( chActionText, elCount(chActionText), "Configure CanTrcvChannelId variable"); 
  snprintf( chExpectedText, elCount(chExpectedText), "Verify CanTrcvChannelId is configured as 0"); 
  TestStepAddActionExpected( chActionText, chExpectedText );
  A_DBGR_VariableSet("VsCANR_TrcvChannels[0].CanTrcvChannelId","0");
  E_DBGR_VariableCheck("VsCANR_TrcvChannels[0].CanTrcvChannelId",0,Equal);
  
  snprintf( chActionText, elCount(chActionText), "Configure CanTrcvChannelUsed variable"); 
  snprintf( chExpectedText, elCount(chExpectedText), "Verify CanTrcvChannelUsed is configured as 1"); 
  TestStepAddActionExpected( chActionText, chExpectedText );
  A_DBGR_VariableSet("VsCANR_TrcvChannels[0].CanTrcvChannelUsed","1");
  E_DBGR_VariableCheck("VsCANR_TrcvChannels[0].CanTrcvChannelUsed",1,Equal);
  
  snprintf( chActionText, elCount(chActionText), "Configure CanTrcvPinWakeupEnabled variable"); 
  snprintf( chExpectedText, elCount(chExpectedText), "Verify CanTrcvPinWakeupEnabled is configured as 0"); 
  TestStepAddActionExpected( chActionText, chExpectedText );
  A_DBGR_VariableSet("VsCANR_TrcvChannels[0].CanTrcvPinWakeupEnabled","0");
  E_DBGR_VariableCheck("VsCANR_TrcvChannels[0].CanTrcvPinWakeupEnabled",0,Equal);
  
  snprintf( chActionText, elCount(chActionText), "Configure CanTrcvNumberOfChannels variable"); 
  snprintf( chExpectedText, elCount(chExpectedText), "Verify CanTrcvNumberOfChannels is configured as 2"); 
  TestStepAddActionExpected( chActionText, chExpectedText );
  A_DBGR_VariableSet("VsCANR_CanTrcvConfig.CanTrcvNumberOfChannels","2");
  E_DBGR_VariableCheck("VsCANR_CanTrcvConfig.CanTrcvNumberOfChannels",2,Equal);
  
  snprintf( chActionText, elCount(chActionText), "Flash the Software and ECU is running "); 
  snprintf( chExpectedText, elCount(chExpectedText), "ECU should be in running state"); 
  TestStepAddActionExpected( chActionText, chExpectedText );
  A_DBGR_Go();
  
  /***************************************************************************************************************/    
                                              // Test Step 3  Call the function Test_SetHWIO_PowerDown by setting StartPowerDown to 1 then check transceiver is in the SLEEP mode and PMIC to STANDBY mode
  /***************************************************************************************************************/
  snprintf( chActionText, elCount(chActionText), "Configure StartPowerDown variable to invoke Test_SetHWIO_PowerDown interface"); 
  snprintf( chExpectedText, elCount(chExpectedText), "Verify StartPowerDown is configured as 1"); 
  //TestStepAddActionExpected( chActionText, chExpectedText );
  A_DBGR_VariableSet("StartPowerDown","1");
 // E_DBGR_VariableCheck("StartPowerDown",1,Equal);
  
  snprintf( chActionText, elCount(chActionText), "Check Trace32 is stopped"); 
  snprintf( chExpectedText, elCount(chExpectedText), "Verify Trace32 is stopped"); 
  //TestStepAddActionExpected( chActionText, chExpectedText );
  E_DBGR_CheckState(T32_State_Down);
  
   /***************************************************************************************************************/    
                                              // Test Step 4 Run the Software and capture UART log using python
  /***************************************************************************************************************/
  
  SysExec("powershell", "-ExecutionPolicy Bypass -File ./serial_logging.ps1", automation_root);
  
  snprintf( chActionText, elCount(chActionText), "waiting for UART log"); 
  snprintf( chExpectedText, elCount(chExpectedText), "waiting for UART log"); 
  TestStepAddActionExpected( chActionText, chExpectedText );
  A_GENERIC_SetTimeout(3000,"waiting for UART log");
 
  
  /***************************************************************************************************************/    
                                              // Test Step 5  This step involves sending a CAN wakeup frame with ID 0x123 and 8 bytes of data from Canoe.
  /***************************************************************************************************************/
//  snprintf( chActionText, elCount(chActionText), "Transmit CAN message. ID:0x123"); 
//  snprintf( chExpectedText, elCount(chExpectedText), "CAN message transmitted. ID:0x123"); 
//  //TestStepAddActionExpected( chActionText, chExpectedText );
//  A_CAN_SendMessage(0x123, CANA_Wakeup, 8, 1);
//  A_CAN_SendMessage(0x123, CANA_Wakeup, 8, 1);
//  A_CAN_SendMessage(0x456, CANB_Wakeup, 4, 2);
  
  setTimer(periodicTimer_Multiple,1);
  
  /***************************************************************************************************************/    
                                              // Test Step 6  Verify Transceiver wakeUp or not.
  /***************************************************************************************************************/
  snprintf( chActionText, elCount(chActionText), "Transmit CAN message. ID:0x40000101, PDU info:0x01"); 
  snprintf( chExpectedText, elCount(chExpectedText), "CAN message transmitted. ID:0x40000101, PDU info:0x01"); 
  //TestStepAddActionExpected( chActionText, chExpectedText ); 
  
  E_CAN_WaitForMessageByID(0x00000101,10000,cc_eCAN_PRESENT,"CAN1");
  
  /***************************************************************************************************************/    
                          // Test Step 7 Check UART log in the Tera Term window is update: Last wakeup event is: 2 (wkupCanBusA).
  /***************************************************************************************************************/ 
  strncpy(searchString,"Last wakeup event is: 6",256);
  
  snprintf( chActionText, elCount(chActionText), "waiting for UART log"); 
  snprintf( chExpectedText, elCount(chExpectedText), "waiting for UART log"); 
  TestStepAddActionExpected( chActionText, chExpectedText );
  A_GENERIC_SetTimeout(25000,"waiting for UART log");
  
  snprintf(chActionText, elCount(chActionText), "Run Python script to check battConnectionStatus in log file");
  snprintf(chExpectedText, elCount(chExpectedText), "Python script should execute successfully");
  result =iFcnt_READFILE_SearchKeywordInFile(teraterm,searchString,"string is present");
  
  if(result == 1)
  {
    testStepPass("0","string is present");
  }
  else
  {
    testStepFail("1","string is not present");
  }
 
  cancelTimer(periodicTimer_Multiple);
  testWaitForTimeout(1000);
}

testcase Verify_that_the_software_reports_wkupCanBusA_for_GetHWIO_e_WakeupSigSt_wakeup_event_detected_is_CAN_A_bus_during_Shutdown()
{
  /***************************************************************************************************************/    
                                                // Variable Definition
  /***************************************************************************************************************/ 
  

  
  /***************************************************************************************************************/    
                                               // Local Values
  /***************************************************************************************************************/ 
  

  
  /***************************************************************************************************************/    
                                              // Test Case Info
  /***************************************************************************************************************/
  setWriteDbgLevel(DebugOff);
  snprintf( chTestTitle, elCount(chTestTitle), "Verify_that_the_software_reports_wkupCanBusA_for_GetHWIO_e_WakeupSigSt_wakeup_event_detected_is_CAN_A_bus_during_Shutdown" );
  snprintf( chTestDescription, elCount(chTestDescription), "Purpose:To check the GetHWIO_e_WakeupSigSt interface ");
  TestCaseAddInfo( chTestTitle, "TC_L30SW_Q-36712277", chTestDescription );

 /***************************************************************************************************************/    
                                              // Start of Test Case
  /***************************************************************************************************************/
  
  /***************************************************************************************************************/    
                                              // Test Step 0 PRECONDITIONS
  /***************************************************************************************************************/
  snprintf( chActionText, elCount(chActionText), "Flash the Software and ECU is running "); 
  snprintf( chExpectedText, elCount(chExpectedText), "ECU should be in running state"); 
  //TestStepAddActionExpected( chActionText, chExpectedText );
  
  A_DBGR_BreakpointDeleteAll();
  
  snprintf( chActionText, elCount(chActionText), "Flash the Software and ECU is running "); 
  snprintf( chExpectedText, elCount(chExpectedText), "ECU should be in running state"); 
 
  A_DBGR_R();
  A_DBGR_Go();
  /***************************************************************************************************************/    
                                              // Test Step 1 Call the function MngCNDD_CanTrcvInitialize to initialize the CAN transceiver.
  /***************************************************************************************************************/
  snprintf( chActionText, elCount(chActionText), "Set Breakpoint TestCanTrcv_Init callback function "); 
  snprintf( chExpectedText, elCount(chExpectedText), "Breakpoint is Set in TestCanTrcv_Init"); 
  //TestStepAddActionExpected( chActionText, chExpectedText );   
  A_DBGR_BreakpointSet("TestCanTrcv_Init");  
  A_DBGR_Go();
  
  snprintf( chActionText, elCount(chActionText), "Verify Breakpoint should hit in TestCanTrcv_Init "); 
  snprintf( chExpectedText, elCount(chExpectedText), "Breakpoint hit in TestCanTrcv_Init function"); 
  //TestStepAddActionExpected( chActionText, chExpectedText );  
  E_DBGR_BreakpointCheckForHalt("TestCanTrcv_Init");
  
  /***************************************************************************************************************/    
                                              // Test Step 2 Configure the values for the structure TsCNDD_CanTrcvCnfgType for CAN2 Channel.
  /***************************************************************************************************************/
  snprintf( chActionText, elCount(chActionText), "Set Breakpoint in TestCan_Init "); 
  snprintf( chExpectedText, elCount(chExpectedText), "Verify Breakpoint is Set in TestCan_Init"); 
  TestStepAddActionExpected( chActionText, chExpectedText );  
  A_DBGR_BreakpointSet("TestCan_Init");  
  A_DBGR_Go();
  
  snprintf( chActionText, elCount(chActionText), "Verify Breakpoint should hit in TestCan_Init "); 
  snprintf( chExpectedText, elCount(chExpectedText), "Breakpoint hit in TestCan_Init function"); 
 // TestStepAddActionExpected( chActionText, chExpectedText );  
  E_DBGR_BreakpointCheckForHalt("TestCan_Init");
  
  snprintf( chActionText, elCount(chActionText), "Configure CanTrcvPnFrameDataMaskIndex variable"); 
  snprintf( chExpectedText, elCount(chExpectedText), "verify Configure CanTrcvPnFrameDataMaskIndex as 1"); 
  TestStepAddActionExpected( chActionText, chExpectedText );
  A_DBGR_VariableSet("VsCANR_PnFrameData2[1].CanTrcvPnFrameDataMaskIndex","1");
  E_DBGR_VariableCheck("VsCANR_PnFrameData2[1].CanTrcvPnFrameDataMaskIndex",1,Equal);
  
  snprintf( chActionText, elCount(chActionText), "Configure CanTrcvPnFrameDataMask variable"); 
  snprintf( chExpectedText, elCount(chExpectedText), "verify Configure CanTrcvPnFrameDataMask as 1"); 
  TestStepAddActionExpected( chActionText, chExpectedText );
  A_DBGR_VariableSet("VsCANR_PnFrameData2[1].CanTrcvPnFrameDataMask","1");
  E_DBGR_VariableCheck("VsCANR_PnFrameData2[1].CanTrcvPnFrameDataMask",1,Equal);
  
  snprintf( chActionText, elCount(chActionText), "Configure CanTrcvPnFrameCanId variable"); 
  snprintf( chExpectedText, elCount(chExpectedText), "verify Configure CanTrcvPnFrameCanId as 0x456"); 
  TestStepAddActionExpected( chActionText, chExpectedText );
  A_DBGR_VariableSet("VsCANR_PnConfig[1].CanTrcvPnFrameCanId","0x456");
  E_DBGR_VariableCheck("VsCANR_PnConfig[1].CanTrcvPnFrameCanId",0x456,Equal);
  
  snprintf( chActionText, elCount(chActionText), "Configure CanTrcvPnFrameCanIdMask variable"); 
  snprintf( chExpectedText, elCount(chExpectedText), "verify Configure CanTrcvPnFrameCanIdMask as 0"); 
  TestStepAddActionExpected( chActionText, chExpectedText );
  A_DBGR_VariableSet("VsCANR_PnConfig[1].CanTrcvPnFrameCanIdMask","0");
  E_DBGR_VariableCheck("VsCANR_PnConfig[1].CanTrcvPnFrameCanIdMask",0,Equal);
  
  snprintf( chActionText, elCount(chActionText), "Configure CanTrcvPnFrameIdType variable"); 
  snprintf( chExpectedText, elCount(chExpectedText), "verify Configure CanTrcvPnFrameIdType as 0"); 
  TestStepAddActionExpected( chActionText, chExpectedText );
  A_DBGR_VariableSet("VsCANR_PnConfig[1].CanTrcvPnFrameIdType","0");
  E_DBGR_VariableCheck("VsCANR_PnConfig[1].CanTrcvPnFrameIdType",0,Equal);
  
  snprintf( chActionText, elCount(chActionText), "Configure CanTrcvPnFrameDlc variable"); 
  snprintf( chExpectedText, elCount(chExpectedText), "verify Configure CanTrcvPnFrameDlc as 4"); 
  TestStepAddActionExpected( chActionText, chExpectedText );
  A_DBGR_VariableSet("VsCANR_PnConfig[1].CanTrcvPnFrameDlc","4");
  E_DBGR_VariableCheck("VsCANR_PnConfig[1].CanTrcvPnFrameDlc",4,Equal);
  
  snprintf( chActionText, elCount(chActionText), "Configure CanTrcvPnEnabled variable"); 
  snprintf( chExpectedText, elCount(chExpectedText), "verify Configure CanTrcvPnEnabled as 1"); 
  TestStepAddActionExpected( chActionText, chExpectedText );
  A_DBGR_VariableSet("VsCANR_PnConfig[1].CanTrcvPnEnabled","1");
  E_DBGR_VariableCheck("VsCANR_PnConfig[1].CanTrcvPnEnabled",1,Equal);
  
  snprintf( chActionText, elCount(chActionText), "Configure CanTrcvChannelId variable"); 
  snprintf( chExpectedText, elCount(chExpectedText), "verify Configure CanTrcvChannelId as 0"); 
  TestStepAddActionExpected( chActionText, chExpectedText );
  A_DBGR_VariableSet("VsCANR_TrcvChannels[1].CanTrcvChannelId","1");
  E_DBGR_VariableCheck("VsCANR_TrcvChannels[1].CanTrcvChannelId",1,Equal);
  
  snprintf( chActionText, elCount(chActionText), "Configure CanTrcvChannelUsed variable"); 
  snprintf( chExpectedText, elCount(chExpectedText), "verify Configure CanTrcvChannelUsed as 1"); 
  TestStepAddActionExpected( chActionText, chExpectedText );
  A_DBGR_VariableSet("VsCANR_TrcvChannels[1].CanTrcvChannelUsed","1");
  E_DBGR_VariableCheck("VsCANR_TrcvChannels[1].CanTrcvChannelUsed",1,Equal);
  
  snprintf( chActionText, elCount(chActionText), "Configure CanTrcvPinWakeupEnabled variable"); 
  snprintf( chExpectedText, elCount(chExpectedText), "verify Configure CanTrcvPinWakeupEnabled as 0"); 
  TestStepAddActionExpected( chActionText, chExpectedText );
  A_DBGR_VariableSet("VsCANR_TrcvChannels[1].CanTrcvPinWakeupEnabled","0");
  E_DBGR_VariableCheck("VsCANR_TrcvChannels[1].CanTrcvPinWakeupEnabled",0,Equal);
  
  snprintf( chActionText, elCount(chActionText), "Configure CanTrcvNumberOfChannels variable"); 
  snprintf( chExpectedText, elCount(chExpectedText), "verify Configure CanTrcvNumberOfChannels as 2"); 
  TestStepAddActionExpected( chActionText, chExpectedText );
  A_DBGR_VariableSet("VsCANR_CanTrcvConfig.CanTrcvNumberOfChannels","2");
  E_DBGR_VariableCheck("VsCANR_CanTrcvConfig.CanTrcvNumberOfChannels",2,Equal);
  
  snprintf( chActionText, elCount(chActionText), "Flash the Software and ECU is running "); 
  snprintf( chExpectedText, elCount(chExpectedText), "ECU should be in running state"); 
  TestStepAddActionExpected( chActionText, chExpectedText );
  A_DBGR_Go();
  
    /***************************************************************************************************************/    
                                              // Test Step   Call the function Test_GetHWIO_e_WakeupSigSt during initialization
  /***************************************************************************************************************/
//  snprintf( chActionText, elCount(chActionText), "Configure delay_shutdown variable to invoke delay during shutdown interface"); 
//  snprintf( chExpectedText, elCount(chExpectedText), "Verify delay_shutdown is configured as 1"); 
//  //TestStepAddActionExpected( chActionText, chExpectedText );
//  A_DBGR_VariableSet("delay_shutdown","1");
//  E_DBGR_VariableCheck("delay_shutdown",1,Equal);
  snprintf( chActionText, elCount(chActionText), "Flash the Software and ECU is running "); 
  snprintf( chExpectedText, elCount(chExpectedText), "ECU should be in running state"); 
  //TestStepAddActionExpected( chActionText, chExpectedText );
  
  A_DBGR_BreakpointDeleteAll();
  
  /***************************************************************************************************************/    
                                              // Test Step Send wakeup message periodically
  /***************************************************************************************************************/
  SysExec("powershell", "-ExecutionPolicy Bypass -File ./serial_logging.ps1", automation_root);
  setTimer(periodicTimer_CAN2, 1);
//  snprintf( chActionText, elCount(chActionText), "Configure delay_shutdown variable to invoke delay during shutdown interface"); 
//  snprintf( chExpectedText, elCount(chExpectedText), "Verify delay_shutdown is configured as 1"); 
  
//  A_CAN_SendBurstMessage( 0x456,  CANB_Wakeup, 10000,  4, 2, cc_eCAN_NORMAL);
  
  /***************************************************************************************************************/    
                                              // Test Step 3  Call the function Test_SetHWIO_PowerDown by setting StartPowerDown to 1 then check transceiver is in the SLEEP mode and PMIC to STANDBY mode
  /***************************************************************************************************************/
  snprintf( chActionText, elCount(chActionText), "Configure StartPowerDown variable to invoke Test_SetHWIO_PowerDown interface"); 
  snprintf( chExpectedText, elCount(chExpectedText), "Verify StartPowerDown is configured as 1"); 
  //TestStepAddActionExpected( chActionText, chExpectedText );
  A_DBGR_VariableSet("StartPowerDown","1");
  

  
  snprintf( chActionText, elCount(chActionText), "Flash the Software and ECU is running "); 
  snprintf( chExpectedText, elCount(chExpectedText), "ECU should be in running state"); 
  //TestStepAddActionExpected( chActionText, chExpectedText );
  A_DBGR_Go();
  /***************************************************************************************************************/    
                          // Test Step 7 Check UART log in the Tera Term window is update: Last wakeup event is: 2 (wkupCanBusA).
  /***************************************************************************************************************/ 
  strncpy(searchString,"Last wakeup event is: 2",256);

  snprintf( chActionText, elCount(chActionText), "waiting for UART log"); 
  snprintf( chExpectedText, elCount(chExpectedText), "waiting for UART log"); 
 // TestStepAddActionExpected( chActionText, chExpectedText );
  A_GENERIC_SetTimeout(25000,"waiting for UART log");
  
  snprintf(chActionText, elCount(chActionText), "Run Python script to check battConnectionStatus in log file");
  snprintf(chExpectedText, elCount(chExpectedText), "Python script should execute successfully");
  result =iFcnt_READFILE_SearchKeywordInFile(teraterm,searchString,"string is present");
  
  if(result == 1)
  {
    testStepPass("0","string is present");
  }
  else
  {
    testStepFail("1","string is not present");
  }
  cancelTimer(periodicTimer_CAN2);
  testWaitForTimeout(1000); 
}

testcase Verify_the_software_reports_wkupCanBusA_for_GetHWIO_e_WakeupSigSt_Func_due_to_CAN_error_frame_counter_overflow_for_CAN2_Channel()
{
   /***************************************************************************************************************/    
                                                // Variable Definition
  /***************************************************************************************************************/ 
  

  
  /***************************************************************************************************************/    
                                               // Local Values
  /***************************************************************************************************************/ 
  

  
  /***************************************************************************************************************/    
                                              // Test Case Info
  /***************************************************************************************************************/
  setWriteDbgLevel(DebugOff);
  snprintf( chTestTitle, elCount(chTestTitle), "Verify_the_software_reports_wkupCanBusA_for_GetHWIO_e_WakeupSigSt_Func_due_to_CAN_error_frame_counter_overflow_for_CAN2_Channel" );
  snprintf( chTestDescription, elCount(chTestDescription), "Purpose:To check the GetHWIO_e_WakeupSigSt interface ");
  TestCaseAddInfo( chTestTitle, "TC_L30SW_Q-36542357", chTestDescription );

  /***************************************************************************************************************/    
                                              // Start of Test Case
  /***************************************************************************************************************/
  
  /***************************************************************************************************************/    
                                              // Test Step 0 PRECONDITIONS
  /***************************************************************************************************************/
  snprintf( chActionText, elCount(chActionText), "Flash the Software and ECU is running "); 
  snprintf( chExpectedText, elCount(chExpectedText), "ECU should be in running state"); 
  //TestStepAddActionExpected( chActionText, chExpectedText );
  
  A_DBGR_BreakpointDeleteAll();
  A_DBGR_R();

  A_DBGR_BreakpointSet("TestCanTrcv_Init");
  A_DBGR_Go_Safe();

  /***************************************************************************************************************/
                                              // Test Step 1 Call the function MngCNDD_CanTrcvInitialize to initialize the CAN transceiver.
  /***************************************************************************************************************/
  snprintf( chActionText, elCount(chActionText), "Verify Breakpoint should hit in TestCanTrcv_Init "); 
  snprintf( chExpectedText, elCount(chExpectedText), "Breakpoint hit in TestCanTrcv_Init function"); 
  //TestStepAddActionExpected( chActionText, chExpectedText );  
  E_DBGR_BreakpointCheckForHalt("TestCanTrcv_Init");
  
  /***************************************************************************************************************/    
                                              // Test Step 2 Configure the values for the structure TsCNDD_CanTrcvCnfgType for CAN2 Channel.
  /***************************************************************************************************************/
  snprintf( chActionText, elCount(chActionText), "Set Breakpoint in TestCan_Init "); 
  snprintf( chExpectedText, elCount(chExpectedText), "Verify Breakpoint is Set in TestCan_Init"); 
  TestStepAddActionExpected( chActionText, chExpectedText );  
  A_DBGR_Go();
  
  
  /***************************************************************************************************************/    
                                              // Test Step 3  Call the function Test_SetHWIO_PowerDown by setting StartPowerDown to 1 then check transceiver is in the SLEEP mode and PMIC to STANDBY mode
  /***************************************************************************************************************/
  snprintf( chActionText, elCount(chActionText), "Configure StartPowerDown variable to invoke Test_SetHWIO_PowerDown interface"); 
  snprintf( chExpectedText, elCount(chExpectedText), "Verify StartPowerDown is configured as 1"); 
  //TestStepAddActionExpected( chActionText, chExpectedText );
  A_DBGR_VariableSet("StartPowerDown","1");
 // E_DBGR_VariableCheck("StartPowerDown",1,Equal);
  
  snprintf( chActionText, elCount(chActionText), "Check Trace32 is stopped"); 
  snprintf( chExpectedText, elCount(chExpectedText), "Verify Trace32 is stopped"); 
  //TestStepAddActionExpected( chActionText, chExpectedText );
  E_DBGR_CheckState(T32_State_Down);
  
   /***************************************************************************************************************/    
                                              // Test Step 4 Run the Software and capture UART log using python
  /***************************************************************************************************************/
  
  SysExec("powershell", "-ExecutionPolicy Bypass -File ./serial_logging.ps1", automation_root);
  
  snprintf( chActionText, elCount(chActionText), "waiting for UART log"); 
  snprintf( chExpectedText, elCount(chExpectedText), "waiting for UART log"); 
  TestStepAddActionExpected( chActionText, chExpectedText );
  A_GENERIC_SetTimeout(3000,"waiting for UART log");
 
  
  /***************************************************************************************************************/    
                                              // Test Step 5  This step involves sending a CAN wakeup frame with ID 0x123 and 8 bytes of data from Canoe.
  /***************************************************************************************************************/
  snprintf( chActionText, elCount(chActionText), "Transmit CAN error frame counter overflow"); 
  snprintf( chExpectedText, elCount(chExpectedText), "CAN error frame counter overflow transmitted."); 
  //TestStepAddActionExpected( chActionText, chExpectedText );
  while(1)
  {
    canOutputErrorFrame(CAN1.errorFrame, 12, 0);
    if (i == 100)
    {
      break;
    }
    i++;
  }
  /***************************************************************************************************************/    
                                              // Test Step 6  Verify Transceiver wakeUp or not.
  /***************************************************************************************************************/
  snprintf( chActionText, elCount(chActionText), "Transmit CAN message. ID:0x40000101, PDU info:0x01"); 
  snprintf( chExpectedText, elCount(chExpectedText), "CAN message transmitted. ID:0x40000101, PDU info:0x01"); 
  //TestStepAddActionExpected( chActionText, chExpectedText ); 
  
  E_CAN_WaitForMessageByID(0x00000101,10000,cc_eCAN_PRESENT,"CAN1");
  
  /***************************************************************************************************************/    
                          // Test Step 7 Check UART log in the Tera Term window is update: Last wakeup event is: 2 (wkupCanBusA).
  /***************************************************************************************************************/ 
  strncpy(searchString,"Last wakeup event is: 2",256);
  
  snprintf( chActionText, elCount(chActionText), "waiting for UART log"); 
  snprintf( chExpectedText, elCount(chExpectedText), "waiting for UART log"); 
  TestStepAddActionExpected( chActionText, chExpectedText );
  A_GENERIC_SetTimeout(25000,"waiting for UART log");
  
  snprintf(chActionText, elCount(chActionText), "Run Python script to check battConnectionStatus in log file");
  snprintf(chExpectedText, elCount(chExpectedText), "Python script should execute successfully");
  result =iFcnt_READFILE_SearchKeywordInFile(teraterm,searchString,"string is present");
  
  if(result == 1)
  {
    testStepPass("0","string is present");
  }
  else
  {
    testStepFail("1","string is not present");
  }
  strncpy(searchString,"PN frame detection error wakeup event found in transceiver",256);
  
  snprintf(chActionText, elCount(chActionText), "Run Python script to check battConnectionStatus in log file");
  snprintf(chExpectedText, elCount(chExpectedText), "Python script should execute successfully");
  result =iFcnt_READFILE_SearchKeywordInFile(teraterm,searchString,"string is present");
  
  if(result == 1)
  {
    testStepPass("0","string is present");
  }
  else
  {
    testStepFail("1","string is not present");
  }
  
}

testcase Verify_the_software_reports_wkupCanBusB_for_GetHWIO_e_WakeupSigSt_Func_due_to_CAN_error_frame_counter_overflow_for_CAN8_Channel()
{
    /***************************************************************************************************************/    
                                                // Variable Definition
  /***************************************************************************************************************/ 
  

  
  /***************************************************************************************************************/    
                                               // Local Values
  /***************************************************************************************************************/ 
  

  
  /***************************************************************************************************************/    
                                              // Test Case Info
  /***************************************************************************************************************/
  setWriteDbgLevel(DebugOff);
  snprintf( chTestTitle, elCount(chTestTitle), "Verify_the_software_reports_wkupCanBusB_for_GetHWIO_e_WakeupSigSt_Func_due_to_CAN_error_frame_counter_overflow_for_CAN8_Channel" );
  snprintf( chTestDescription, elCount(chTestDescription), "Purpose:To check the GetHWIO_e_WakeupSigSt interface ");
  TestCaseAddInfo( chTestTitle, "TC_L30SW_Q-36542358", chTestDescription );

   /***************************************************************************************************************/    
                                              // Start of Test Case
  /***************************************************************************************************************/
  
  /***************************************************************************************************************/    
                                              // Test Step 0 PRECONDITIONS
  /***************************************************************************************************************/
  snprintf( chActionText, elCount(chActionText), "Flash the Software and ECU is running "); 
  snprintf( chExpectedText, elCount(chExpectedText), "ECU should be in running state"); 
  //TestStepAddActionExpected( chActionText, chExpectedText );
  
  A_DBGR_BreakpointDeleteAll();
  
  snprintf( chActionText, elCount(chActionText), "Flash the Software and ECU is running "); 
  snprintf( chExpectedText, elCount(chExpectedText), "ECU should be in running state"); 
 
  A_DBGR_R();
  A_DBGR_Go_Safe();
  /***************************************************************************************************************/    
                                              // Test Step 1 Call the function MngCNDD_CanTrcvInitialize to initialize the CAN transceiver.
  /***************************************************************************************************************/
  snprintf( chActionText, elCount(chActionText), "Set Breakpoint TestCanTrcv_Init callback function "); 
  snprintf( chExpectedText, elCount(chExpectedText), "Breakpoint is Set in TestCanTrcv_Init"); 
  //TestStepAddActionExpected( chActionText, chExpectedText );   
  A_DBGR_BreakpointSet("TestCanTrcv_Init");

  snprintf( chActionText, elCount(chActionText), "Verify Breakpoint should hit in TestCanTrcv_Init "); 
  snprintf( chExpectedText, elCount(chExpectedText), "Breakpoint hit in TestCanTrcv_Init function"); 
  //TestStepAddActionExpected( chActionText, chExpectedText );  
  E_DBGR_BreakpointCheckForHalt("TestCanTrcv_Init");
  
  /***************************************************************************************************************/    
                                              // Test Step 2 Configure the values for the structure TsCNDD_CanTrcvCnfgType for CAN2 Channel.
  /***************************************************************************************************************/
  snprintf( chActionText, elCount(chActionText), "Set Breakpoint in TestCan_Init "); 
  snprintf( chExpectedText, elCount(chExpectedText), "Verify Breakpoint is Set in TestCan_Init"); 
  TestStepAddActionExpected( chActionText, chExpectedText );  
  A_DBGR_Go();
  
  
  /***************************************************************************************************************/    
                                              // Test Step 3  Call the function Test_SetHWIO_PowerDown by setting StartPowerDown to 1 then check transceiver is in the SLEEP mode and PMIC to STANDBY mode
  /***************************************************************************************************************/
  snprintf( chActionText, elCount(chActionText), "Configure StartPowerDown variable to invoke Test_SetHWIO_PowerDown interface"); 
  snprintf( chExpectedText, elCount(chExpectedText), "Verify StartPowerDown is configured as 1"); 
  //TestStepAddActionExpected( chActionText, chExpectedText );
  A_DBGR_VariableSet("StartPowerDown","1");
 // E_DBGR_VariableCheck("StartPowerDown",1,Equal);
  
  snprintf( chActionText, elCount(chActionText), "Check Trace32 is stopped"); 
  snprintf( chExpectedText, elCount(chExpectedText), "Verify Trace32 is stopped"); 
  //TestStepAddActionExpected( chActionText, chExpectedText );
  E_DBGR_CheckState(T32_State_Down);
  
   /***************************************************************************************************************/    
                                              // Test Step 4 Run the Software and capture UART log using python
  /***************************************************************************************************************/
  
  SysExec("powershell", "-ExecutionPolicy Bypass -File ./serial_logging.ps1", automation_root);
  
  snprintf( chActionText, elCount(chActionText), "waiting for UART log"); 
  snprintf( chExpectedText, elCount(chExpectedText), "waiting for UART log"); 
  TestStepAddActionExpected( chActionText, chExpectedText );
  A_GENERIC_SetTimeout(3000,"waiting for UART log");
 
  
  /***************************************************************************************************************/    
                                              // Test Step 5  This step involves sending a CAN wakeup frame with ID 0x123 and 8 bytes of data from Canoe.
  /***************************************************************************************************************/
  snprintf( chActionText, elCount(chActionText), "Transmit CAN error frame counter overflow"); 
  snprintf( chExpectedText, elCount(chExpectedText), "CAN error frame counter overflow transmitted."); 
  //TestStepAddActionExpected( chActionText, chExpectedText );
  while(1)
  {
    canOutputErrorFrame(CAN2.errorFrame, 12, 0);
    if (i == 200)
    {
      break;
    }
    i++;
  }
  /***************************************************************************************************************/    
                                              // Test Step 6  Verify Transceiver wakeUp or not.
  /***************************************************************************************************************/
  snprintf( chActionText, elCount(chActionText), "Transmit CAN message. ID:0x40000101, PDU info:0x01"); 
  snprintf( chExpectedText, elCount(chExpectedText), "CAN message transmitted. ID:0x40000101, PDU info:0x01"); 
  //TestStepAddActionExpected( chActionText, chExpectedText ); 
  
  E_CAN_WaitForMessageByID(0x00000101,10000,cc_eCAN_PRESENT,"CAN1");
  
  /***************************************************************************************************************/    
                          // Test Step 7 Check UART log in the Tera Term window is update: Last wakeup event is: 2 (wkupCanBusA).
  /***************************************************************************************************************/ 
  strncpy(searchString,"Last wakeup event is: 4",256);
  
  snprintf( chActionText, elCount(chActionText), "waiting for UART log"); 
  snprintf( chExpectedText, elCount(chExpectedText), "waiting for UART log"); 
  TestStepAddActionExpected( chActionText, chExpectedText );
  A_GENERIC_SetTimeout(25000,"waiting for UART log");
  
  snprintf(chActionText, elCount(chActionText), "Run Python script to check battConnectionStatus in log file");
  snprintf(chExpectedText, elCount(chExpectedText), "Python script should execute successfully");
  result =iFcnt_READFILE_SearchKeywordInFile(teraterm,searchString,"string is present");
  
  if(result == 1)
  {
    testStepPass("0","string is present");
  }
  else
  {
    testStepFail("1","string is not present");
  }
  strncpy(searchString,"PN frame detection error wakeup event found in transceiver 1",256);
  
  snprintf(chActionText, elCount(chActionText), "Run Python script to check battConnectionStatus in log file");
  snprintf(chExpectedText, elCount(chExpectedText), "Python script should execute successfully");
  result =iFcnt_READFILE_SearchKeywordInFile(teraterm,searchString,"string is present");
  
  if(result == 1)
  {
    testStepPass("0","string is present");
  }
  else
  {
    testStepFail("1","string is not present");
  }
  
}

testcase Verify_the_software_reports_GetHWIO_e_WakeupSigSt_Func_due_to_CAN_error_frame_counter_overflow_for_CAN2_during_initilization()
{
   /***************************************************************************************************************/    
                                                // Variable Definition
  /***************************************************************************************************************/ 
  

  
  /***************************************************************************************************************/    
                                               // Local Values
  /***************************************************************************************************************/ 
  

  
  /***************************************************************************************************************/    
                                              // Test Case Info
  /***************************************************************************************************************/
  setWriteDbgLevel(DebugOff);
  snprintf( chTestTitle, elCount(chTestTitle), "Verify_the_software_reports_GetHWIO_e_WakeupSigSt_Func_due_to_CAN_error_frame_counter_overflow_for_CAN2_during_initilization" );
  snprintf( chTestDescription, elCount(chTestDescription), "Purpose:To check the GetHWIO_e_WakeupSigSt interface ");
  TestCaseAddInfo( chTestTitle, "TC_L30SW_Q-36739512", chTestDescription );

  /***************************************************************************************************************/    
                                              // Start of Test Case
  /***************************************************************************************************************/
  
  /***************************************************************************************************************/    
                                              // Test Step 0 PRECONDITIONS
  /***************************************************************************************************************/
  snprintf( chActionText, elCount(chActionText), "Flash the Software and ECU is running "); 
  snprintf( chExpectedText, elCount(chExpectedText), "ECU should be in running state"); 
  //TestStepAddActionExpected( chActionText, chExpectedText );
  
  A_DBGR_BreakpointDeleteAll();
  
  snprintf( chActionText, elCount(chActionText), "Flash the Software and ECU is running "); 
  snprintf( chExpectedText, elCount(chExpectedText), "ECU should be in running state"); 
 
  A_DBGR_R();
  A_DBGR_Go();
  /***************************************************************************************************************/    
                                              // Test Step 1 Call the function MngCNDD_CanTrcvInitialize to initialize the CAN transceiver.
  /***************************************************************************************************************/
  snprintf( chActionText, elCount(chActionText), "Set Breakpoint TestCanTrcv_Init callback function "); 
  snprintf( chExpectedText, elCount(chExpectedText), "Breakpoint is Set in TestCanTrcv_Init"); 
  //TestStepAddActionExpected( chActionText, chExpectedText );   
  A_DBGR_BreakpointSet("TestCanTrcv_Init");  
  A_DBGR_Go();
  
  snprintf( chActionText, elCount(chActionText), "Verify Breakpoint should hit in TestCanTrcv_Init "); 
  snprintf( chExpectedText, elCount(chExpectedText), "Breakpoint hit in TestCanTrcv_Init function"); 
  //TestStepAddActionExpected( chActionText, chExpectedText );  
  E_DBGR_BreakpointCheckForHalt("TestCanTrcv_Init");
  
  /***************************************************************************************************************/    
                                              // Test Step 2 Configure the values for the structure TsCNDD_CanTrcvCnfgType for CAN2 Channel.
  /***************************************************************************************************************/
  snprintf( chActionText, elCount(chActionText), "Set Breakpoint in TestCan_Init "); 
  snprintf( chExpectedText, elCount(chExpectedText), "Verify Breakpoint is Set in TestCan_Init"); 
  TestStepAddActionExpected( chActionText, chExpectedText );  
  A_DBGR_Go();
  
  
//  /***************************************************************************************************************/    
//                                              // Test Step   Call the function Test_GetHWIO_e_WakeupSigSt during initialization
//  /***************************************************************************************************************/
//  snprintf( chActionText, elCount(chActionText), "Configure init_wakeup variable to invoke GetHWIO_e_WakeupSigSt interface"); 
//  snprintf( chExpectedText, elCount(chExpectedText), "Verify init_wakeup is configured as 1"); 
//  TestStepAddActionExpected( chActionText, chExpectedText );
//  A_DBGR_VariableSet("init_wakeup","1");
//  E_DBGR_VariableCheck("init_wakeup",1,Equal);
  
  
  /***************************************************************************************************************/    
                                              // Test Step 3  Call the function Test_SetHWIO_PowerDown by setting StartPowerDown to 1 then check transceiver is in the SLEEP mode and PMIC to STANDBY mode
  /***************************************************************************************************************/
  snprintf( chActionText, elCount(chActionText), "Configure StartPowerDown variable to invoke Test_SetHWIO_PowerDown interface"); 
  snprintf( chExpectedText, elCount(chExpectedText), "Verify StartPowerDown is configured as 1"); 
  //TestStepAddActionExpected( chActionText, chExpectedText );
  A_DBGR_VariableSet("StartPowerDown","1");
 // E_DBGR_VariableCheck("StartPowerDown",1,Equal);
  
  snprintf( chActionText, elCount(chActionText), "Check Trace32 is stopped"); 
  snprintf( chExpectedText, elCount(chExpectedText), "Verify Trace32 is stopped"); 
  //TestStepAddActionExpected( chActionText, chExpectedText );
  E_DBGR_CheckState(T32_State_Down);
  
   /***************************************************************************************************************/    
                                              // Test Step 4 Run the Software and capture UART log using python
  /***************************************************************************************************************/
  
  SysExec("powershell", "-ExecutionPolicy Bypass -File ./serial_logging.ps1", automation_root);
  
  snprintf( chActionText, elCount(chActionText), "waiting for UART log"); 
  snprintf( chExpectedText, elCount(chExpectedText), "waiting for UART log"); 
  TestStepAddActionExpected( chActionText, chExpectedText );
  A_GENERIC_SetTimeout(3000,"waiting for UART log");
 
  
  /***************************************************************************************************************/    
                                              // Test Step 5  This step involves sending a CAN wakeup frame with ID 0x123 and 8 bytes of data from Canoe.
  /***************************************************************************************************************/
  snprintf( chActionText, elCount(chActionText), "Transmit CAN error frame counter overflow"); 
  snprintf( chExpectedText, elCount(chExpectedText), "CAN error frame counter overflow transmitted."); 
  //TestStepAddActionExpected( chActionText, chExpectedText );
  while(1)
  {
    canOutputErrorFrame(CAN1.errorFrame, 12, 0);
    if (i == 100)
    {
      break;
    }
    i++;
  }
  /***************************************************************************************************************/    
                                              // Test Step 6  Verify Transceiver wakeUp or not.
  /***************************************************************************************************************/
  snprintf( chActionText, elCount(chActionText), "Transmit CAN message. ID:0x40000101, PDU info:0x01"); 
  snprintf( chExpectedText, elCount(chExpectedText), "CAN message transmitted. ID:0x40000101, PDU info:0x01"); 
  //TestStepAddActionExpected( chActionText, chExpectedText ); 
  
  E_CAN_WaitForMessageByID(0x00000101,10000,cc_eCAN_PRESENT,"CAN1");
  
  /***************************************************************************************************************/    
                          // Test Step 7 Check UART log in the Tera Term window is update: Last wakeup event is: 2 (wkupCanBusA).
  /***************************************************************************************************************/ 
  strncpy(searchString,"Last wakeup event is: 2",256);
  
  snprintf( chActionText, elCount(chActionText), "waiting for UART log"); 
  snprintf( chExpectedText, elCount(chExpectedText), "waiting for UART log"); 
  TestStepAddActionExpected( chActionText, chExpectedText );
  A_GENERIC_SetTimeout(20000,"waiting for UART log");
  
  snprintf(chActionText, elCount(chActionText), "Run Python script to check battConnectionStatus in log file");
  snprintf(chExpectedText, elCount(chExpectedText), "Python script should execute successfully");
  result =iFcnt_READFILE_SearchKeywordInFile(teraterm,searchString,"string is present");
  
  if(result == 1)
  {
    testStepPass("0","string is present");
  }
  else
  {
    testStepFail("1","string is not present");
  }
  strncpy(searchString,"PN frame detection error wakeup event found in transceiver",256);
  
  snprintf(chActionText, elCount(chActionText), "Run Python script to check battConnectionStatus in log file");
  snprintf(chExpectedText, elCount(chExpectedText), "Python script should execute successfully");
  result =iFcnt_READFILE_SearchKeywordInFile(teraterm,searchString,"string is present");
  
  if(result == 1)
  {
    testStepPass("0","string is present");
  }
  else
  {
    testStepFail("1","string is not present");
  }
  strncpy(searchString,"Inside initialization",256);
  
  snprintf(chActionText, elCount(chActionText), "Run Python script to check battConnectionStatus in log file");
  snprintf(chExpectedText, elCount(chExpectedText), "Python script should execute successfully");
  result =iFcnt_READFILE_SearchKeywordInFile(teraterm,searchString,"string is present");
  
  if(result == 1)
  {
    testStepPass("0","string is present");
  }
  else
  {
    testStepFail("1","string is not present");
  }
  
}

testcase Verify_the_software_reports_GetHWIO_e_WakeupSigSt_Func_due_to_CAN_error_frame_counter_overflow_for_CAN8_during_initilization()
{
     /***************************************************************************************************************/    
                                                // Variable Definition
  /***************************************************************************************************************/ 
  

  
  /***************************************************************************************************************/    
                                               // Local Values
  /***************************************************************************************************************/ 
  

  
  /***************************************************************************************************************/    
                                              // Test Case Info
  /***************************************************************************************************************/
  setWriteDbgLevel(DebugOff);
  snprintf( chTestTitle, elCount(chTestTitle), "Verify_the_software_reports_GetHWIO_e_WakeupSigSt_Func_due_to_CAN_error_frame_counter_overflow_for_CAN8_during_initilization" );
  snprintf( chTestDescription, elCount(chTestDescription), "Purpose:To check the GetHWIO_e_WakeupSigSt interface ");
  TestCaseAddInfo( chTestTitle, "TC_L30SW_Q-36739513", chTestDescription );

  /***************************************************************************************************************/    
                                              // Start of Test Case
  /***************************************************************************************************************/
  
  /***************************************************************************************************************/    
                                              // Test Step 0 PRECONDITIONS
  /***************************************************************************************************************/
  snprintf( chActionText, elCount(chActionText), "Flash the Software and ECU is running "); 
  snprintf( chExpectedText, elCount(chExpectedText), "ECU should be in running state"); 
  //TestStepAddActionExpected( chActionText, chExpectedText );
  
  A_DBGR_BreakpointDeleteAll();
  
  snprintf( chActionText, elCount(chActionText), "Flash the Software and ECU is running "); 
  snprintf( chExpectedText, elCount(chExpectedText), "ECU should be in running state"); 
 
  A_DBGR_R();
  A_DBGR_Go();
  /***************************************************************************************************************/    
                                              // Test Step 1 Call the function MngCNDD_CanTrcvInitialize to initialize the CAN transceiver.
  /***************************************************************************************************************/
  snprintf( chActionText, elCount(chActionText), "Set Breakpoint TestCanTrcv_Init callback function "); 
  snprintf( chExpectedText, elCount(chExpectedText), "Breakpoint is Set in TestCanTrcv_Init"); 
  //TestStepAddActionExpected( chActionText, chExpectedText );   
  A_DBGR_BreakpointSet("TestCanTrcv_Init");  
  A_DBGR_Go();
  
  snprintf( chActionText, elCount(chActionText), "Verify Breakpoint should hit in TestCanTrcv_Init "); 
  snprintf( chExpectedText, elCount(chExpectedText), "Breakpoint hit in TestCanTrcv_Init function"); 
  //TestStepAddActionExpected( chActionText, chExpectedText );  
  E_DBGR_BreakpointCheckForHalt("TestCanTrcv_Init");
  
  /***************************************************************************************************************/    
                                              // Test Step 2 Configure the values for the structure TsCNDD_CanTrcvCnfgType for CAN2 Channel.
  /***************************************************************************************************************/
  snprintf( chActionText, elCount(chActionText), "Set Breakpoint in TestCan_Init "); 
  snprintf( chExpectedText, elCount(chExpectedText), "Verify Breakpoint is Set in TestCan_Init"); 
  TestStepAddActionExpected( chActionText, chExpectedText );  
  A_DBGR_Go();
  
  
//  /***************************************************************************************************************/    
//                                              // Test Step   Call the function Test_GetHWIO_e_WakeupSigSt during initialization
//  /***************************************************************************************************************/
//  snprintf( chActionText, elCount(chActionText), "Configure init_wakeup variable to invoke GetHWIO_e_WakeupSigSt interface"); 
//  snprintf( chExpectedText, elCount(chExpectedText), "Verify init_wakeup is configured as 1"); 
//  TestStepAddActionExpected( chActionText, chExpectedText );
//  A_DBGR_VariableSet("init_wakeup","1");
//  E_DBGR_VariableCheck("init_wakeup",1,Equal);
  
  
  /***************************************************************************************************************/    
                                              // Test Step 3  Call the function Test_SetHWIO_PowerDown by setting StartPowerDown to 1 then check transceiver is in the SLEEP mode and PMIC to STANDBY mode
  /***************************************************************************************************************/
  snprintf( chActionText, elCount(chActionText), "Configure StartPowerDown variable to invoke Test_SetHWIO_PowerDown interface"); 
  snprintf( chExpectedText, elCount(chExpectedText), "Verify StartPowerDown is configured as 1"); 
  //TestStepAddActionExpected( chActionText, chExpectedText );
  A_DBGR_VariableSet("StartPowerDown","1");
 // E_DBGR_VariableCheck("StartPowerDown",1,Equal);
  
  snprintf( chActionText, elCount(chActionText), "Check Trace32 is stopped"); 
  snprintf( chExpectedText, elCount(chExpectedText), "Verify Trace32 is stopped"); 
  //TestStepAddActionExpected( chActionText, chExpectedText );
  E_DBGR_CheckState(T32_State_Down);
  
   /***************************************************************************************************************/    
                                              // Test Step 4 Run the Software and capture UART log using python
  /***************************************************************************************************************/
  
  SysExec("powershell", "-ExecutionPolicy Bypass -File ./serial_logging.ps1", automation_root);
  
  snprintf( chActionText, elCount(chActionText), "waiting for UART log"); 
  snprintf( chExpectedText, elCount(chExpectedText), "waiting for UART log"); 
  TestStepAddActionExpected( chActionText, chExpectedText );
  A_GENERIC_SetTimeout(3000,"waiting for UART log");
 
  
  /***************************************************************************************************************/    
                                              // Test Step 5  This step involves sending a CAN wakeup frame with ID 0x123 and 8 bytes of data from Canoe.
  /***************************************************************************************************************/
  snprintf( chActionText, elCount(chActionText), "Transmit CAN error frame counter overflow"); 
  snprintf( chExpectedText, elCount(chExpectedText), "CAN error frame counter overflow transmitted."); 
  //TestStepAddActionExpected( chActionText, chExpectedText );
  while(1)
  {
    canOutputErrorFrame(CAN2.errorFrame, 12, 0);
    if (i == 200)
    {
      break;
    }
    i++;
  }
  /***************************************************************************************************************/    
                                              // Test Step 6  Verify Transceiver wakeUp or not.
  /***************************************************************************************************************/
  snprintf( chActionText, elCount(chActionText), "Transmit CAN message. ID:0x40000101, PDU info:0x01"); 
  snprintf( chExpectedText, elCount(chExpectedText), "CAN message transmitted. ID:0x40000101, PDU info:0x01"); 
  //TestStepAddActionExpected( chActionText, chExpectedText ); 
  
  E_CAN_WaitForMessageByID(0x00000101,10000,cc_eCAN_PRESENT,"CAN1");
  
  /***************************************************************************************************************/    
                          // Test Step 7 Check UART log in the Tera Term window is update: Last wakeup event is: 2 (wkupCanBusA).
  /***************************************************************************************************************/ 
  strncpy(searchString,"Last wakeup event is: 4",256);
  
  snprintf( chActionText, elCount(chActionText), "waiting for UART log"); 
  snprintf( chExpectedText, elCount(chExpectedText), "waiting for UART log"); 
  TestStepAddActionExpected( chActionText, chExpectedText );
  A_GENERIC_SetTimeout(25000,"waiting for UART log");
  
  snprintf(chActionText, elCount(chActionText), "Run Python script to check battConnectionStatus in log file");
  snprintf(chExpectedText, elCount(chExpectedText), "Python script should execute successfully");
  result =iFcnt_READFILE_SearchKeywordInFile(teraterm,searchString,"string is present");
  
  if(result == 1)
  {
    testStepPass("0","string is present");
  }
  else
  {
    testStepFail("1","string is not present");
  }
  strncpy(searchString,"PN frame detection error wakeup event found in transceiver 1",256);
  
  snprintf(chActionText, elCount(chActionText), "Run Python script to check battConnectionStatus in log file");
  snprintf(chExpectedText, elCount(chExpectedText), "Python script should execute successfully");
  result =iFcnt_READFILE_SearchKeywordInFile(teraterm,searchString,"string is present");
  
  if(result == 1)
  {
    testStepPass("0","string is present");
  }
  else
  {
    testStepFail("1","string is not present");
  }
  strncpy(searchString,"Inside initialization",256);
  
  snprintf(chActionText, elCount(chActionText), "Run Python script to check battConnectionStatus in log file");
  snprintf(chExpectedText, elCount(chExpectedText), "Python script should execute successfully");
  result =iFcnt_READFILE_SearchKeywordInFile(teraterm,searchString,"string is present");
  
  if(result == 1)
  {
    testStepPass("0","string is present");
  }
  else
  {
    testStepFail("1","string is not present");
  }
  
}

testcase Verify_that_the_software_reports_wkupCanBusB_for_GetHWIO_e_WakeupSigSt_wakeup_event_detected_is_CAN_B_bus_during_Shutdown()
{
  /***************************************************************************************************************/    
                                                // Variable Definition
  /***************************************************************************************************************/ 
  

  
  /***************************************************************************************************************/    
                                               // Local Values
  /***************************************************************************************************************/ 
  

  
  /***************************************************************************************************************/    
                                              // Test Case Info
  /***************************************************************************************************************/
  setWriteDbgLevel(DebugOff);
  snprintf( chTestTitle, elCount(chTestTitle), "Verify_that_the_software_reports_wkupCanBusB_for_GetHWIO_e_WakeupSigSt_wakeup_event_detected_is_CAN_B_bus_during_Shutdown" );
  snprintf( chTestDescription, elCount(chTestDescription), "Purpose:To check the GetHWIO_e_WakeupSigSt interface ");
  TestCaseAddInfo( chTestTitle, "TC_L30SW_Q-36712281", chTestDescription );

  /***************************************************************************************************************/    
                                              // Start of Test Case
  /***************************************************************************************************************/
  
  /***************************************************************************************************************/    
                                              // Test Step 0 PRECONDITIONS
  /***************************************************************************************************************/
  snprintf( chActionText, elCount(chActionText), "Flash the Software and ECU is running "); 
  snprintf( chExpectedText, elCount(chExpectedText), "ECU should be in running state"); 
  //TestStepAddActionExpected( chActionText, chExpectedText );
  
  A_DBGR_BreakpointDeleteAll();
  
  snprintf( chActionText, elCount(chActionText), "Flash the Software and ECU is running "); 
  snprintf( chExpectedText, elCount(chExpectedText), "ECU should be in running state"); 
 
  A_DBGR_R();
  A_DBGR_Go();
  /***************************************************************************************************************/    
                                              // Test Step 1 Call the function MngCNDD_CanTrcvInitialize to initialize the CAN transceiver.
  /***************************************************************************************************************/
  snprintf( chActionText, elCount(chActionText), "Set Breakpoint TestCanTrcv_Init callback function "); 
  snprintf( chExpectedText, elCount(chExpectedText), "Breakpoint is Set in TestCanTrcv_Init"); 
  //TestStepAddActionExpected( chActionText, chExpectedText );   
  A_DBGR_BreakpointSet("TestCanTrcv_Init");  
  A_DBGR_Go();
  
  snprintf( chActionText, elCount(chActionText), "Verify Breakpoint should hit in TestCanTrcv_Init "); 
  snprintf( chExpectedText, elCount(chExpectedText), "Breakpoint hit in TestCanTrcv_Init function"); 
  //TestStepAddActionExpected( chActionText, chExpectedText );  
  E_DBGR_BreakpointCheckForHalt("TestCanTrcv_Init");
  
  /***************************************************************************************************************/    
                                              // Test Step 2 Configure the values for the structure TsCNDD_CanTrcvCnfgType for CAN2 Channel.
  /***************************************************************************************************************/
  snprintf( chActionText, elCount(chActionText), "Set Breakpoint in TestCan_Init "); 
  snprintf( chExpectedText, elCount(chExpectedText), "Verify Breakpoint is Set in TestCan_Init"); 
  TestStepAddActionExpected( chActionText, chExpectedText );  
  A_DBGR_BreakpointSet("TestCan_Init");  
  A_DBGR_Go();
  
  snprintf( chActionText, elCount(chActionText), "Verify Breakpoint should hit in TestCan_Init "); 
  snprintf( chExpectedText, elCount(chExpectedText), "Breakpoint hit in TestCan_Init function"); 
 // TestStepAddActionExpected( chActionText, chExpectedText );  
  E_DBGR_BreakpointCheckForHalt("TestCan_Init");
  
  snprintf( chActionText, elCount(chActionText), "Configure CanTrcvPnFrameDataMaskIndex variable"); 
  snprintf( chExpectedText, elCount(chExpectedText), "verify Configure CanTrcvPnFrameDataMaskIndex as 1"); 
  TestStepAddActionExpected( chActionText, chExpectedText );
  A_DBGR_VariableSet("VsCANR_PnFrameData2[1].CanTrcvPnFrameDataMaskIndex","1");
  E_DBGR_VariableCheck("VsCANR_PnFrameData2[1].CanTrcvPnFrameDataMaskIndex",1,Equal);
  
  snprintf( chActionText, elCount(chActionText), "Configure CanTrcvPnFrameDataMask variable"); 
  snprintf( chExpectedText, elCount(chExpectedText), "verify Configure CanTrcvPnFrameDataMask as 1"); 
  TestStepAddActionExpected( chActionText, chExpectedText );
  A_DBGR_VariableSet("VsCANR_PnFrameData2[1].CanTrcvPnFrameDataMask","1");
  E_DBGR_VariableCheck("VsCANR_PnFrameData2[1].CanTrcvPnFrameDataMask",1,Equal);
  
  snprintf( chActionText, elCount(chActionText), "Configure CanTrcvPnFrameCanId variable"); 
  snprintf( chExpectedText, elCount(chExpectedText), "verify Configure CanTrcvPnFrameCanId as 0x456"); 
  TestStepAddActionExpected( chActionText, chExpectedText );
  A_DBGR_VariableSet("VsCANR_PnConfig[1].CanTrcvPnFrameCanId","0x456");
  E_DBGR_VariableCheck("VsCANR_PnConfig[1].CanTrcvPnFrameCanId",0x456,Equal);
  
  snprintf( chActionText, elCount(chActionText), "Configure CanTrcvPnFrameCanIdMask variable"); 
  snprintf( chExpectedText, elCount(chExpectedText), "verify Configure CanTrcvPnFrameCanIdMask as 0"); 
  TestStepAddActionExpected( chActionText, chExpectedText );
  A_DBGR_VariableSet("VsCANR_PnConfig[1].CanTrcvPnFrameCanIdMask","0");
  E_DBGR_VariableCheck("VsCANR_PnConfig[1].CanTrcvPnFrameCanIdMask",0,Equal);
  
  snprintf( chActionText, elCount(chActionText), "Configure CanTrcvPnFrameIdType variable"); 
  snprintf( chExpectedText, elCount(chExpectedText), "verify Configure CanTrcvPnFrameIdType as 0"); 
  TestStepAddActionExpected( chActionText, chExpectedText );
  A_DBGR_VariableSet("VsCANR_PnConfig[1].CanTrcvPnFrameIdType","0");
  E_DBGR_VariableCheck("VsCANR_PnConfig[1].CanTrcvPnFrameIdType",0,Equal);
  
  snprintf( chActionText, elCount(chActionText), "Configure CanTrcvPnFrameDlc variable"); 
  snprintf( chExpectedText, elCount(chExpectedText), "verify Configure CanTrcvPnFrameDlc as 4"); 
  TestStepAddActionExpected( chActionText, chExpectedText );
  A_DBGR_VariableSet("VsCANR_PnConfig[1].CanTrcvPnFrameDlc","4");
  E_DBGR_VariableCheck("VsCANR_PnConfig[1].CanTrcvPnFrameDlc",4,Equal);
  
  snprintf( chActionText, elCount(chActionText), "Configure CanTrcvPnEnabled variable"); 
  snprintf( chExpectedText, elCount(chExpectedText), "verify Configure CanTrcvPnEnabled as 1"); 
  TestStepAddActionExpected( chActionText, chExpectedText );
  A_DBGR_VariableSet("VsCANR_PnConfig[1].CanTrcvPnEnabled","1");
  E_DBGR_VariableCheck("VsCANR_PnConfig[1].CanTrcvPnEnabled",1,Equal);
  
  snprintf( chActionText, elCount(chActionText), "Configure CanTrcvChannelId variable"); 
  snprintf( chExpectedText, elCount(chExpectedText), "verify Configure CanTrcvChannelId as 0"); 
  TestStepAddActionExpected( chActionText, chExpectedText );
  A_DBGR_VariableSet("VsCANR_TrcvChannels[1].CanTrcvChannelId","1");
  E_DBGR_VariableCheck("VsCANR_TrcvChannels[1].CanTrcvChannelId",1,Equal);
  
  snprintf( chActionText, elCount(chActionText), "Configure CanTrcvChannelUsed variable"); 
  snprintf( chExpectedText, elCount(chExpectedText), "verify Configure CanTrcvChannelUsed as 1"); 
  TestStepAddActionExpected( chActionText, chExpectedText );
  A_DBGR_VariableSet("VsCANR_TrcvChannels[1].CanTrcvChannelUsed","1");
  E_DBGR_VariableCheck("VsCANR_TrcvChannels[1].CanTrcvChannelUsed",1,Equal);
  
  snprintf( chActionText, elCount(chActionText), "Configure CanTrcvPinWakeupEnabled variable"); 
  snprintf( chExpectedText, elCount(chExpectedText), "verify Configure CanTrcvPinWakeupEnabled as 0"); 
  TestStepAddActionExpected( chActionText, chExpectedText );
  A_DBGR_VariableSet("VsCANR_TrcvChannels[1].CanTrcvPinWakeupEnabled","0");
  E_DBGR_VariableCheck("VsCANR_TrcvChannels[1].CanTrcvPinWakeupEnabled",0,Equal);
  
  snprintf( chActionText, elCount(chActionText), "Configure CanTrcvNumberOfChannels variable"); 
  snprintf( chExpectedText, elCount(chExpectedText), "verify Configure CanTrcvNumberOfChannels as 2"); 
  TestStepAddActionExpected( chActionText, chExpectedText );
  A_DBGR_VariableSet("VsCANR_CanTrcvConfig.CanTrcvNumberOfChannels","2");
  E_DBGR_VariableCheck("VsCANR_CanTrcvConfig.CanTrcvNumberOfChannels",2,Equal);
  
  snprintf( chActionText, elCount(chActionText), "Flash the Software and ECU is running "); 
  snprintf( chExpectedText, elCount(chExpectedText), "ECU should be in running state"); 
  TestStepAddActionExpected( chActionText, chExpectedText );
  A_DBGR_Go();
  
    /***************************************************************************************************************/    
                                              // Test Step   Call the function Test_GetHWIO_e_WakeupSigSt during initialization
  /***************************************************************************************************************/
//  snprintf( chActionText, elCount(chActionText), "Configure delay_shutdown variable to invoke delay during shutdown interface"); 
//  snprintf( chExpectedText, elCount(chExpectedText), "Verify delay_shutdown is configured as 1"); 
//  //TestStepAddActionExpected( chActionText, chExpectedText );
//  A_DBGR_VariableSet("delay_shutdown","1");
//  E_DBGR_VariableCheck("delay_shutdown",1,Equal);
  
  snprintf( chActionText, elCount(chActionText), "Flash the Software and ECU is running "); 
  snprintf( chExpectedText, elCount(chExpectedText), "ECU should be in running state"); 
  //TestStepAddActionExpected( chActionText, chExpectedText );
  
  A_DBGR_BreakpointDeleteAll();
  
  /***************************************************************************************************************/    
                                              // Test Step Send wakeup message periodically
  /***************************************************************************************************************/
  SysExec("powershell", "-ExecutionPolicy Bypass -File ./serial_logging.ps1", automation_root);
  setTimer(periodicTimer_CAN8, 1);
//  snprintf( chActionText, elCount(chActionText), "Configure delay_shutdown variable to invoke delay during shutdown interface"); 
//  snprintf( chExpectedText, elCount(chExpectedText), "Verify delay_shutdown is configured as 1"); 
  
//  A_CAN_SendBurstMessage( 0x456,  CANB_Wakeup, 10000,  4, 2, cc_eCAN_NORMAL);
  A_GENERIC_SetTimeout(2000,"sending periodic msg");
  /***************************************************************************************************************/    
                                              // Test Step 3  Call the function Test_SetHWIO_PowerDown by setting StartPowerDown to 1 then check transceiver is in the SLEEP mode and PMIC to STANDBY mode
  /***************************************************************************************************************/
  snprintf( chActionText, elCount(chActionText), "Configure StartPowerDown variable to invoke Test_SetHWIO_PowerDown interface"); 
  snprintf( chExpectedText, elCount(chExpectedText), "Verify StartPowerDown is configured as 1"); 
  //TestStepAddActionExpected( chActionText, chExpectedText );
  A_DBGR_VariableSet("StartPowerDown","1");
  

  snprintf( chActionText, elCount(chActionText), "Flash the Software and ECU is running "); 
  snprintf( chExpectedText, elCount(chExpectedText), "ECU should be in running state"); 
  //TestStepAddActionExpected( chActionText, chExpectedText );
  A_DBGR_Go();
  
  
  /***************************************************************************************************************/    
                          // Test Step 7 Check UART log in the Tera Term window is update: Last wakeup event is: 2 (wkupCanBusA).
  /***************************************************************************************************************/ 
  strncpy(searchString,"Last wakeup event is: 4",256);

  snprintf( chActionText, elCount(chActionText), "waiting for UART log"); 
  snprintf( chExpectedText, elCount(chExpectedText), "waiting for UART log"); 
 // TestStepAddActionExpected( chActionText, chExpectedText );
  A_GENERIC_SetTimeout(25000,"waiting for UART log");
  
  snprintf(chActionText, elCount(chActionText), "Run Python script to check battConnectionStatus in log file");
  snprintf(chExpectedText, elCount(chExpectedText), "Python script should execute successfully");
  result =iFcnt_READFILE_SearchKeywordInFile(teraterm,searchString,"string is present");
  
  if(result == 1)
  {
    testStepPass("0","string is present");
  }
  else
  {
    testStepFail("1","string is not present");
  }
  cancelTimer(periodicTimer_CAN8);
  testWaitForTimeout(1000);
}

testcase Verify_the_software_reports_GetHWIO_e_WakeupSigSt_Func_due_to_CAN_error_frame_counter_overflow_for_CAN2_during_shutdown()
{
     /***************************************************************************************************************/    
                                                // Variable Definition
  /***************************************************************************************************************/ 
  

  
  /***************************************************************************************************************/    
                                               // Local Values
  /***************************************************************************************************************/ 
  

  
  /***************************************************************************************************************/    
                                              // Test Case Info
  /***************************************************************************************************************/
  setWriteDbgLevel(DebugOff);
  snprintf( chTestTitle, elCount(chTestTitle), "Verify_the_software_reports_GetHWIO_e_WakeupSigSt_Func_due_to_CAN_error_frame_counter_overflow_for_CAN2_during_shutdown" );
  snprintf( chTestDescription, elCount(chTestDescription), "Purpose:To check the GetHWIO_e_WakeupSigSt interface ");
  TestCaseAddInfo( chTestTitle, "TC_L30SW_Q-36712282", chTestDescription );

  /***************************************************************************************************************/    
                                              // Start of Test Case
  /***************************************************************************************************************/
  
  /***************************************************************************************************************/    
                                              // Test Step 0 PRECONDITIONS
  /***************************************************************************************************************/
  snprintf( chActionText, elCount(chActionText), "Flash the Software and ECU is running "); 
  snprintf( chExpectedText, elCount(chExpectedText), "ECU should be in running state"); 
  //TestStepAddActionExpected( chActionText, chExpectedText );
  
  A_DBGR_BreakpointDeleteAll();
  
  snprintf( chActionText, elCount(chActionText), "Flash the Software and ECU is running "); 
  snprintf( chExpectedText, elCount(chExpectedText), "ECU should be in running state"); 
 
  A_DBGR_R();
  A_DBGR_Go();
  /***************************************************************************************************************/    
                                              // Test Step 1 Call the function MngCNDD_CanTrcvInitialize to initialize the CAN transceiver.
  /***************************************************************************************************************/
  snprintf( chActionText, elCount(chActionText), "Set Breakpoint TestCanTrcv_Init callback function "); 
  snprintf( chExpectedText, elCount(chExpectedText), "Breakpoint is Set in TestCanTrcv_Init"); 
  //TestStepAddActionExpected( chActionText, chExpectedText );   
  A_DBGR_BreakpointSet("TestCanTrcv_Init");  
  A_DBGR_Go();
  
  snprintf( chActionText, elCount(chActionText), "Verify Breakpoint should hit in TestCanTrcv_Init "); 
  snprintf( chExpectedText, elCount(chExpectedText), "Breakpoint hit in TestCanTrcv_Init function"); 
  //TestStepAddActionExpected( chActionText, chExpectedText );  
  E_DBGR_BreakpointCheckForHalt("TestCanTrcv_Init");
  
  /***************************************************************************************************************/    
                                              // Test Step 2 Configure the values for the structure TsCNDD_CanTrcvCnfgType for CAN2 Channel.
  /***************************************************************************************************************/
  snprintf( chActionText, elCount(chActionText), "Set Breakpoint in TestCan_Init "); 
  snprintf( chExpectedText, elCount(chExpectedText), "Verify Breakpoint is Set in TestCan_Init"); 
  TestStepAddActionExpected( chActionText, chExpectedText );  
  A_DBGR_Go();
  
   /***************************************************************************************************************/    
                                              // Test Step 4   This step involves sending a CAN error frames from Canoe.
  /***************************************************************************************************************/
  setTimer(periodic_error_2,1);
  
  
  /***************************************************************************************************************/    
                                              // Test Step 3 Run the Software and capture UART log using python
  /***************************************************************************************************************/
  
  SysExec("powershell", "-ExecutionPolicy Bypass -File ./serial_logging.ps1", automation_root);
  
  snprintf( chActionText, elCount(chActionText), "waiting for UART log"); 
  snprintf( chExpectedText, elCount(chExpectedText), "waiting for UART log"); 
  //TestStepAddActionExpected( chActionText, chExpectedText );
  A_GENERIC_SetTimeout(3000,"waiting for UART log");
 
//  snprintf( chActionText, elCount(chActionText), "Configure delay_shutdown variable to invoke delay during shutdown interface"); 
//  snprintf( chExpectedText, elCount(chExpectedText), "Verify delay_shutdown is configured as 1"); 
//  //TestStepAddActionExpected( chActionText, chExpectedText );
//  A_DBGR_VariableSet("delay_shutdown","1");
//  E_DBGR_VariableCheck("delay_shutdown",1,Equal);
  snprintf( chActionText, elCount(chActionText), "Flash the Software and ECU is running "); 
  snprintf( chExpectedText, elCount(chExpectedText), "ECU should be in running state"); 
  //TestStepAddActionExpected( chActionText, chExpectedText );
  
  A_DBGR_BreakpointDeleteAll();

  /***************************************************************************************************************/    
                                              // Test Step 5  Call the function Test_SetHWIO_PowerDown by setting StartPowerDown to 1 then check transceiver is in the SLEEP mode and PMIC to STANDBY mode
  /***************************************************************************************************************/
  snprintf( chActionText, elCount(chActionText), "Configure StartPowerDown variable to invoke Test_SetHWIO_PowerDown interface"); 
  snprintf( chExpectedText, elCount(chExpectedText), "Verify StartPowerDown is configured as 1"); 
  //TestStepAddActionExpected( chActionText, chExpectedText );
  A_DBGR_VariableSet("StartPowerDown","1");
 // E_DBGR_VariableCheck("StartPowerDown",1,Equal);   
  
  snprintf( chActionText, elCount(chActionText), "Flash the Software and ECU is running "); 
  snprintf( chExpectedText, elCount(chExpectedText), "ECU should be in running state"); 
  //TestStepAddActionExpected( chActionText, chExpectedText );
  A_DBGR_Go();
  
  
  
  /***************************************************************************************************************/    
                                              // Test Step 6  Verify Transceiver wakeUp or not.
  /***************************************************************************************************************/
  snprintf( chActionText, elCount(chActionText), "Transmit CAN message. ID:0x40000101, PDU info:0x01"); 
  snprintf( chExpectedText, elCount(chExpectedText), "CAN message transmitted. ID:0x40000101, PDU info:0x01"); 
  //TestStepAddActionExpected( chActionText, chExpectedText ); 
  
  E_CAN_WaitForMessageByID(0x00000101,10000,cc_eCAN_ABSENT,"CAN2");
  
  /***************************************************************************************************************/    
                          // Test Step 7 Check UART log in the Tera Term window is update: Last wakeup event is: 2 (wkupCanBusA).
  /***************************************************************************************************************/ 
  strncpy(searchString,"Last wakeup event is: 2",256);
  
  snprintf( chActionText, elCount(chActionText), "waiting for UART log"); 
  snprintf( chExpectedText, elCount(chExpectedText), "waiting for UART log"); 
  TestStepAddActionExpected( chActionText, chExpectedText );
  A_GENERIC_SetTimeout(20000,"waiting for UART log");
  
  snprintf(chActionText, elCount(chActionText), "Run Python script to check battConnectionStatus in log file");
  snprintf(chExpectedText, elCount(chExpectedText), "Python script should execute successfully");
  result =iFcnt_READFILE_SearchKeywordInFile(teraterm,searchString,"string is present");
  
  if(result == 1)
  {
    testStepPass("0","string is present");
  }
  else
  {
    testStepFail("1","string is not present");
  }
  strncpy(searchString,"Frame error counter overflow fault detected in transceiver 0",256);
  
  snprintf(chActionText, elCount(chActionText), "Run Python script to check battConnectionStatus in log file");
  snprintf(chExpectedText, elCount(chExpectedText), "Python script should execute successfully");
  result =iFcnt_READFILE_SearchKeywordInFile(teraterm,searchString,"string is present");
  
  if(result == 1)
  {
    testStepPass("0","string is present");
  }
  else
  {
    testStepFail("1","string is not present");
  }
  cancelTimer(periodic_error_2);
  testWaitForTimeout(1000);

}

testcase Verify_the_software_reports_GetHWIO_e_WakeupSigSt_Func_due_to_CAN_error_frame_counter_overflow_for_CAN8_during_shutdown()
{
    /***************************************************************************************************************/    
                                                // Variable Definition
  /***************************************************************************************************************/ 
  

  
  /***************************************************************************************************************/    
                                               // Local Values
  /***************************************************************************************************************/ 
  

  
  /***************************************************************************************************************/    
                                              // Test Case Info
  /***************************************************************************************************************/
  setWriteDbgLevel(DebugOff);
  snprintf( chTestTitle, elCount(chTestTitle), "Verify_the_software_reports_GetHWIO_e_WakeupSigSt_Func_due_to_CAN_error_frame_counter_overflow_for_CAN8_during_shutdown" );
  snprintf( chTestDescription, elCount(chTestDescription), "Purpose:To check the GetHWIO_e_WakeupSigSt interface ");
  TestCaseAddInfo( chTestTitle, "TC_L30SW_Q-36712283", chTestDescription );

  /***************************************************************************************************************/    
                                              // Start of Test Case
  /***************************************************************************************************************/
  
  /***************************************************************************************************************/    
                                              // Test Step 0 PRECONDITIONS
  /***************************************************************************************************************/
  snprintf( chActionText, elCount(chActionText), "Flash the Software and ECU is running "); 
  snprintf( chExpectedText, elCount(chExpectedText), "ECU should be in running state"); 
  //TestStepAddActionExpected( chActionText, chExpectedText );
  
  A_DBGR_BreakpointDeleteAll();
  
  snprintf( chActionText, elCount(chActionText), "Flash the Software and ECU is running "); 
  snprintf( chExpectedText, elCount(chExpectedText), "ECU should be in running state"); 
 
  A_DBGR_R();
  A_DBGR_Go();
  /***************************************************************************************************************/    
                                              // Test Step 1 Call the function MngCNDD_CanTrcvInitialize to initialize the CAN transceiver.
  /***************************************************************************************************************/
  snprintf( chActionText, elCount(chActionText), "Set Breakpoint TestCanTrcv_Init callback function "); 
  snprintf( chExpectedText, elCount(chExpectedText), "Breakpoint is Set in TestCanTrcv_Init"); 
  //TestStepAddActionExpected( chActionText, chExpectedText );   
  A_DBGR_BreakpointSet("TestCanTrcv_Init");  
  A_DBGR_Go();
  
  snprintf( chActionText, elCount(chActionText), "Verify Breakpoint should hit in TestCanTrcv_Init "); 
  snprintf( chExpectedText, elCount(chExpectedText), "Breakpoint hit in TestCanTrcv_Init function"); 
  //TestStepAddActionExpected( chActionText, chExpectedText );  
  E_DBGR_BreakpointCheckForHalt("TestCanTrcv_Init");
  
  /***************************************************************************************************************/    
                                              // Test Step 2 Configure the values for the structure TsCNDD_CanTrcvCnfgType for CAN2 Channel.
  /***************************************************************************************************************/
  snprintf( chActionText, elCount(chActionText), "Set Breakpoint in TestCan_Init "); 
  snprintf( chExpectedText, elCount(chExpectedText), "Verify Breakpoint is Set in TestCan_Init"); 
  TestStepAddActionExpected( chActionText, chExpectedText );  
  A_DBGR_Go();
  
   /***************************************************************************************************************/    
                                              // Test Step 4   This step involves sending a CAN error frames from Canoe.
  /***************************************************************************************************************/
  setTimer(periodic_error_8,1);
  
  
  /***************************************************************************************************************/    
                                              // Test Step 3 Run the Software and capture UART log using python
  /***************************************************************************************************************/
  
  SysExec("powershell", "-ExecutionPolicy Bypass -File ./serial_logging.ps1", automation_root);
  
  snprintf( chActionText, elCount(chActionText), "waiting for UART log"); 
  snprintf( chExpectedText, elCount(chExpectedText), "waiting for UART log"); 
  //TestStepAddActionExpected( chActionText, chExpectedText );
  A_GENERIC_SetTimeout(3000,"waiting for UART log");
 
//  snprintf( chActionText, elCount(chActionText), "Configure delay_shutdown variable to invoke delay during shutdown interface"); 
//  snprintf( chExpectedText, elCount(chExpectedText), "Verify delay_shutdown is configured as 1"); 
//  //TestStepAddActionExpected( chActionText, chExpectedText );
//  A_DBGR_VariableSet("delay_shutdown","1");
//  E_DBGR_VariableCheck("delay_shutdown",1,Equal);
  snprintf( chActionText, elCount(chActionText), "Flash the Software and ECU is running "); 
  snprintf( chExpectedText, elCount(chExpectedText), "ECU should be in running state"); 
  //TestStepAddActionExpected( chActionText, chExpectedText );
  
  A_DBGR_BreakpointDeleteAll();

  /***************************************************************************************************************/    
                                              // Test Step 5  Call the function Test_SetHWIO_PowerDown by setting StartPowerDown to 1 then check transceiver is in the SLEEP mode and PMIC to STANDBY mode
  /***************************************************************************************************************/
  snprintf( chActionText, elCount(chActionText), "Configure StartPowerDown variable to invoke Test_SetHWIO_PowerDown interface"); 
  snprintf( chExpectedText, elCount(chExpectedText), "Verify StartPowerDown is configured as 1"); 
  //TestStepAddActionExpected( chActionText, chExpectedText );
  A_DBGR_VariableSet("StartPowerDown","1");
 // E_DBGR_VariableCheck("StartPowerDown",1,Equal);   
  
  snprintf( chActionText, elCount(chActionText), "Flash the Software and ECU is running "); 
  snprintf( chExpectedText, elCount(chExpectedText), "ECU should be in running state"); 
  //TestStepAddActionExpected( chActionText, chExpectedText );
  A_DBGR_Go();
  
  /***************************************************************************************************************/    
                                              // Test Step 6  Verify Transceiver wakeUp or not.
  /***************************************************************************************************************/
  snprintf( chActionText, elCount(chActionText), "Transmit CAN message. ID:0x40000101, PDU info:0x01"); 
  snprintf( chExpectedText, elCount(chExpectedText), "CAN message transmitted. ID:0x40000101, PDU info:0x01"); 
  //TestStepAddActionExpected( chActionText, chExpectedText ); 
  
  E_CAN_WaitForMessageByID(0x00000101,10000,cc_eCAN_ABSENT,"CAN1");
  
  /***************************************************************************************************************/    
                          // Test Step 7 Check UART log in the Tera Term window is update: Last wakeup event is: 2 (wkupCanBusA).
  /***************************************************************************************************************/ 
  strncpy(searchString,"Last wakeup event is: 4",256);
  
  snprintf( chActionText, elCount(chActionText), "waiting for UART log"); 
  snprintf( chExpectedText, elCount(chExpectedText), "waiting for UART log"); 
  TestStepAddActionExpected( chActionText, chExpectedText );
  A_GENERIC_SetTimeout(20000,"waiting for UART log");
  
  snprintf(chActionText, elCount(chActionText), "Run Python script to check battConnectionStatus in log file");
  snprintf(chExpectedText, elCount(chExpectedText), "Python script should execute successfully");
  result =iFcnt_READFILE_SearchKeywordInFile(teraterm,searchString,"string is present");
  
  if(result == 1)
  {
    testStepPass("0","string is present");
  }
  else
  {
    testStepFail("1","string is not present");
  }
  strncpy(searchString,"Frame error counter overflow fault detected in transceiver 1",256);
  
  snprintf(chActionText, elCount(chActionText), "Run Python script to check battConnectionStatus in log file");
  snprintf(chExpectedText, elCount(chExpectedText), "Python script should execute successfully");
  result =iFcnt_READFILE_SearchKeywordInFile(teraterm,searchString,"string is present");
  
  if(result == 1)
  {
    testStepPass("0","string is present");
  }
  else
  {
    testStepFail("1","string is not present");
  }
  cancelTimer(periodic_error_8);
  testWaitForTimeout(1000);

}

testcase Verify_that_the_software_does_not_report_a_CAN_A_BUS_WAKEUP_when_an_invalid_PN_frame_is_sent()
{
  /***************************************************************************************************************/    
                                                // Variable Definition
  /***************************************************************************************************************/ 
  

  
  /***************************************************************************************************************/    
                                               // Local Values
  /***************************************************************************************************************/ 
  

  
  /***************************************************************************************************************/    
                                              // Test Case Info
  /***************************************************************************************************************/
  setWriteDbgLevel(DebugOff);
  snprintf( chTestTitle, elCount(chTestTitle), "Verify_that_the_software_does_not_report_a_CAN_A_BUS_WAKEUP_when_an_invalid_PN_frame_is_sent" );
  snprintf( chTestDescription, elCount(chTestDescription), "Purpose:To check the GetHWIO_e_WakeupSigSt interface ");
  TestCaseAddInfo( chTestTitle, "TC_L30SW_Q-37200829", chTestDescription );

  /***************************************************************************************************************/    
                                              // Start of Test Case
  /***************************************************************************************************************/
  
  /***************************************************************************************************************/    
                                              // Test Step 0 PRECONDITIONS
  /***************************************************************************************************************/
  snprintf( chActionText, elCount(chActionText), "Flash the Software and ECU is running "); 
  snprintf( chExpectedText, elCount(chExpectedText), "ECU should be in running state"); 
  //TestStepAddActionExpected( chActionText, chExpectedText );
  
  A_DBGR_BreakpointDeleteAll();
  
  snprintf( chActionText, elCount(chActionText), "Flash the Software and ECU is running "); 
  snprintf( chExpectedText, elCount(chExpectedText), "ECU should be in running state"); 
 
  A_DBGR_R();
  A_DBGR_Go();
  /***************************************************************************************************************/    
                                              // Test Step 1 Call the function MngCNDD_CanTrcvInitialize to initialize the CAN transceiver.
  /***************************************************************************************************************/
  snprintf( chActionText, elCount(chActionText), "Set Breakpoint TestCanTrcv_Init callback function "); 
  snprintf( chExpectedText, elCount(chExpectedText), "Breakpoint is Set in TestCanTrcv_Init"); 
  //TestStepAddActionExpected( chActionText, chExpectedText );   
  A_DBGR_BreakpointSet("TestCanTrcv_Init");  
  A_DBGR_Go();
  
  snprintf( chActionText, elCount(chActionText), "Verify Breakpoint should hit in TestCanTrcv_Init "); 
  snprintf( chExpectedText, elCount(chExpectedText), "Breakpoint hit in TestCanTrcv_Init function"); 
  //TestStepAddActionExpected( chActionText, chExpectedText );  
  E_DBGR_BreakpointCheckForHalt("TestCanTrcv_Init");
  
  /***************************************************************************************************************/    
                                              // Test Step 2 Configure the values for the structure TsCNDD_CanTrcvCnfgType for CAN2 Channel.
  /***************************************************************************************************************/
  snprintf( chActionText, elCount(chActionText), "Set Breakpoint in TestCan_Init "); 
  snprintf( chExpectedText, elCount(chExpectedText), "Verify Breakpoint is Set in TestCan_Init"); 
  TestStepAddActionExpected( chActionText, chExpectedText );  
  A_DBGR_BreakpointSet("TestCan_Init");  
  A_DBGR_Go();
  
  snprintf( chActionText, elCount(chActionText), "Verify Breakpoint should hit in TestCan_Init "); 
  snprintf( chExpectedText, elCount(chExpectedText), "Breakpoint hit in TestCan_Init function"); 
 // TestStepAddActionExpected( chActionText, chExpectedText );  
  E_DBGR_BreakpointCheckForHalt("TestCan_Init");
  
  snprintf( chActionText, elCount(chActionText), "Configure CanTrcvPnFrameDataMaskIndex variable"); 
  snprintf( chExpectedText, elCount(chExpectedText), "Verify CanTrcvPnFrameDataMaskIndex is configured as 0"); 
  TestStepAddActionExpected( chActionText, chExpectedText );
  A_DBGR_VariableSet("VsCANR_PnFrameData1[0].CanTrcvPnFrameDataMaskIndex","0");
  E_DBGR_VariableCheck("VsCANR_PnFrameData1[0].CanTrcvPnFrameDataMaskIndex",0,Equal);
  
  snprintf( chActionText, elCount(chActionText), "Configure CanTrcvPnFrameDataMask variable"); 
  snprintf( chExpectedText, elCount(chExpectedText), "Verify CanTrcvPnFrameDataMask is configured as 1"); 
  TestStepAddActionExpected( chActionText, chExpectedText );
  A_DBGR_VariableSet("VsCANR_PnFrameData1[0].CanTrcvPnFrameDataMask","1");
  E_DBGR_VariableCheck("VsCANR_PnFrameData1[0].CanTrcvPnFrameDataMask",1,Equal);
  
  snprintf( chActionText, elCount(chActionText), "Configure CanTrcvPnFrameDataMaskIndex variable"); 
  snprintf( chExpectedText, elCount(chExpectedText), "Verify CanTrcvPnFrameDataMaskIndex is configured as 7"); 
  TestStepAddActionExpected( chActionText, chExpectedText );
  A_DBGR_VariableSet("VsCANR_PnFrameData1[7].CanTrcvPnFrameDataMaskIndex","7");
  E_DBGR_VariableCheck("VsCANR_PnFrameData1[7].CanTrcvPnFrameDataMaskIndex",7,Equal);
  
  snprintf( chActionText, elCount(chActionText), "Configure CanTrcvPnFrameDataMask variable"); 
  snprintf( chExpectedText, elCount(chExpectedText), "Verify CanTrcvPnFrameDataMask is configured as 8"); 
  TestStepAddActionExpected( chActionText, chExpectedText );
  A_DBGR_VariableSet("VsCANR_PnFrameData1[7].CanTrcvPnFrameDataMask","8");
  E_DBGR_VariableCheck("VsCANR_PnFrameData1[7].CanTrcvPnFrameDataMask",8,Equal);
  
  snprintf( chActionText, elCount(chActionText), "Configure CanTrcvPnFrameCanId variable"); 
  snprintf( chExpectedText, elCount(chExpectedText), "Verify CanTrcvPnFrameCanId is configured as 0x123"); 
  TestStepAddActionExpected( chActionText, chExpectedText );
  A_DBGR_VariableSet("VsCANR_PnConfig[0].CanTrcvPnFrameCanId","0x123");
  E_DBGR_VariableCheck("VsCANR_PnConfig[0].CanTrcvPnFrameCanId",0x123,Equal);
  
  snprintf( chActionText, elCount(chActionText), "Configure CanTrcvPnFrameCanIdMask variable"); 
  snprintf( chExpectedText, elCount(chExpectedText), "Verify CanTrcvPnFrameCanIdMask is configured as 0"); 
  TestStepAddActionExpected( chActionText, chExpectedText );
  A_DBGR_VariableSet("VsCANR_PnConfig[0].CanTrcvPnFrameCanIdMask","0");
  E_DBGR_VariableCheck("VsCANR_PnConfig[0].CanTrcvPnFrameCanIdMask",0,Equal);
  
  snprintf( chActionText, elCount(chActionText), "Configure CanTrcvPnFrameIdType variable"); 
  snprintf( chExpectedText, elCount(chExpectedText), "Verify CanTrcvPnFrameIdType is configured as 0"); 
  TestStepAddActionExpected( chActionText, chExpectedText );
  A_DBGR_VariableSet("VsCANR_PnConfig[0].CanTrcvPnFrameIdType","0");
  E_DBGR_VariableCheck("VsCANR_PnConfig[0].CanTrcvPnFrameIdType",0,Equal);
  
  snprintf( chActionText, elCount(chActionText), "Configure CanTrcvPnFrameDlc variable"); 
  snprintf( chExpectedText, elCount(chExpectedText), "Verify CanTrcvPnFrameDlc is configured as 8"); 
  TestStepAddActionExpected( chActionText, chExpectedText );
  A_DBGR_VariableSet("VsCANR_PnConfig[0].CanTrcvPnFrameDlc","8");
  E_DBGR_VariableCheck("VsCANR_PnConfig[0].CanTrcvPnFrameDlc",8,Equal);
  
  snprintf( chActionText, elCount(chActionText), "Configure CanTrcvPnEnabled variable"); 
  snprintf( chExpectedText, elCount(chExpectedText), "Verify CanTrcvPnEnabled is configured as 1"); 
  TestStepAddActionExpected( chActionText, chExpectedText );
  A_DBGR_VariableSet("VsCANR_PnConfig[0].CanTrcvPnEnabled","1");
  E_DBGR_VariableCheck("VsCANR_PnConfig[0].CanTrcvPnEnabled",1,Equal);
  
  snprintf( chActionText, elCount(chActionText), "Configure CanTrcvChannelId variable"); 
  snprintf( chExpectedText, elCount(chExpectedText), "Verify CanTrcvChannelId is configured as 0"); 
  TestStepAddActionExpected( chActionText, chExpectedText );
  A_DBGR_VariableSet("VsCANR_TrcvChannels[0].CanTrcvChannelId","0");
  E_DBGR_VariableCheck("VsCANR_TrcvChannels[0].CanTrcvChannelId",0,Equal);
  
  snprintf( chActionText, elCount(chActionText), "Configure CanTrcvChannelUsed variable"); 
  snprintf( chExpectedText, elCount(chExpectedText), "Verify CanTrcvChannelUsed is configured as 1"); 
  TestStepAddActionExpected( chActionText, chExpectedText );
  A_DBGR_VariableSet("VsCANR_TrcvChannels[0].CanTrcvChannelUsed","1");
  E_DBGR_VariableCheck("VsCANR_TrcvChannels[0].CanTrcvChannelUsed",1,Equal);
  
  snprintf( chActionText, elCount(chActionText), "Configure CanTrcvPinWakeupEnabled variable"); 
  snprintf( chExpectedText, elCount(chExpectedText), "Verify CanTrcvPinWakeupEnabled is configured as 0"); 
  TestStepAddActionExpected( chActionText, chExpectedText );
  A_DBGR_VariableSet("VsCANR_TrcvChannels[0].CanTrcvPinWakeupEnabled","0");
  E_DBGR_VariableCheck("VsCANR_TrcvChannels[0].CanTrcvPinWakeupEnabled",0,Equal);
  
  snprintf( chActionText, elCount(chActionText), "Configure CanTrcvNumberOfChannels variable"); 
  snprintf( chExpectedText, elCount(chExpectedText), "Verify CanTrcvNumberOfChannels is configured as 2"); 
  TestStepAddActionExpected( chActionText, chExpectedText );
  A_DBGR_VariableSet("VsCANR_CanTrcvConfig.CanTrcvNumberOfChannels","2");
  E_DBGR_VariableCheck("VsCANR_CanTrcvConfig.CanTrcvNumberOfChannels",2,Equal);
  
  snprintf( chActionText, elCount(chActionText), "Flash the Software and ECU is running "); 
  snprintf( chExpectedText, elCount(chExpectedText), "ECU should be in running state"); 
  TestStepAddActionExpected( chActionText, chExpectedText );
  A_DBGR_Go();
  
  /***************************************************************************************************************/    
                                              // Test Step 3  Call the function Test_SetHWIO_PowerDown by setting StartPowerDown to 1 then check transceiver is in the SLEEP mode and PMIC to STANDBY mode
  /***************************************************************************************************************/
  snprintf( chActionText, elCount(chActionText), "Configure StartPowerDown variable to invoke Test_SetHWIO_PowerDown interface"); 
  snprintf( chExpectedText, elCount(chExpectedText), "Verify StartPowerDown is configured as 1"); 
  //TestStepAddActionExpected( chActionText, chExpectedText );
  A_DBGR_VariableSet("StartPowerDown","1");
 // E_DBGR_VariableCheck("StartPowerDown",1,Equal);
  
  snprintf( chActionText, elCount(chActionText), "Check Trace32 is stopped"); 
  snprintf( chExpectedText, elCount(chExpectedText), "Verify Trace32 is stopped"); 
  //TestStepAddActionExpected( chActionText, chExpectedText );
  E_DBGR_CheckState(T32_State_Down);
  
   /***************************************************************************************************************/    
                                              // Test Step 4 Run the Software and capture UART log using python
  /***************************************************************************************************************/
  
  SysExec("powershell", "-ExecutionPolicy Bypass -File ./serial_logging.ps1", automation_root);
  
  snprintf( chActionText, elCount(chActionText), "waiting for UART log"); 
  snprintf( chExpectedText, elCount(chExpectedText), "waiting for UART log"); 
  TestStepAddActionExpected( chActionText, chExpectedText );
  A_GENERIC_SetTimeout(3000,"waiting for UART log");
 
  
  /***************************************************************************************************************/    
                                              // Test Step 5  This step involves sending a CAN wakeup frame with ID 0x123 and 8 bytes of data from Canoe.
  /***************************************************************************************************************/
  snprintf( chActionText, elCount(chActionText), "Transmit CAN message. ID:0x123"); 
  snprintf( chExpectedText, elCount(chExpectedText), "CAN message transmitted. ID:0x123"); 
  //TestStepAddActionExpected( chActionText, chExpectedText );
  A_CAN_SendMessage(0x144, CANA_Wakeup_1, 8, 1);
  A_CAN_SendMessage(0x144, CANA_Wakeup_1, 8, 1);
  //setTimer(periodicTimer_CAN2, 1);
  
  /***************************************************************************************************************/    
                                              // Test Step 6  Verify Transceiver wakeUp or not.
  /***************************************************************************************************************/
  snprintf( chActionText, elCount(chActionText), "Transmit CAN message. ID:0x40000101, PDU info:0x01"); 
  snprintf( chExpectedText, elCount(chExpectedText), "CAN message transmitted. ID:0x40000101, PDU info:0x01"); 
  //TestStepAddActionExpected( chActionText, chExpectedText ); 
  
  E_CAN_WaitForMessageByID(0x00000101,10000,cc_eCAN_ABSENT,"CAN1");
  
  /***************************************************************************************************************/    
                          // Test Step 7 Check UART log in the Tera Term window is update: Last wakeup event is: 2 (wkupCanBusA).
  /***************************************************************************************************************/ 
  strncpy(searchString,"Last wakeup event is: 2",256);
  
  snprintf( chActionText, elCount(chActionText), "waiting for UART log"); 
  snprintf( chExpectedText, elCount(chExpectedText), "waiting for UART log"); 
  TestStepAddActionExpected( chActionText, chExpectedText );
  A_GENERIC_SetTimeout(25000,"waiting for UART log");
  
  snprintf(chActionText, elCount(chActionText), "Run Python script to check battConnectionStatus in log file");
  snprintf(chExpectedText, elCount(chExpectedText), "Python script should execute successfully");
  result =iFcnt_READFILE_SearchKeywordInFile(teraterm,searchString,"string is present");
  
  if(result == 1)
  {
    testStepFail("0","string is present");
  }
  else
  {
    testSteppass("1","string is not present");
  }
  setTimer(periodicTimer_CAN2, 1);
  testWaitForTimeout(1000);
  
  cancelTimer(periodicTimer_CAN2);
  testWaitForTimeout(1000);
}

testcase Verify_that_the_software_does_not_report_a_CAN_B_BUS_WAKEUP_when_an_invalid_PN_frame_is_sent()
{
   /***************************************************************************************************************/    
                                                // Variable Definition
  /***************************************************************************************************************/ 
  

  
  /***************************************************************************************************************/    
                                               // Local Values
  /***************************************************************************************************************/ 
  

  
  /***************************************************************************************************************/    
                                              // Test Case Info
  /***************************************************************************************************************/
  setWriteDbgLevel(DebugOff);
  snprintf( chTestTitle, elCount(chTestTitle), "Verify_that_the_software_does_not_report_a_CAN_B_BUS_WAKEUP_when_an_invalid_PN_frame_is_sent" );
  snprintf( chTestDescription, elCount(chTestDescription), "Purpose:To check the GetHWIO_e_WakeupSigSt interface ");
  TestCaseAddInfo( chTestTitle, "TC_L30SW_Q-37200884", chTestDescription );

  /***************************************************************************************************************/    
                                              // Test Step 0 PRECONDITIONS
  /***************************************************************************************************************/
  snprintf( chActionText, elCount(chActionText), "Flash the Software and ECU is running "); 
  snprintf( chExpectedText, elCount(chExpectedText), "ECU should be in running state"); 
  //TestStepAddActionExpected( chActionText, chExpectedText );
  A_DBGR_BreakpointDeleteAll();
  
  snprintf( chActionText, elCount(chActionText), "Flash the Software and ECU is running "); 
  snprintf( chExpectedText, elCount(chExpectedText), "ECU should be in running state"); 
  //TestStepAddActionExpected( chActionText, chExpectedText );
  A_DBGR_R();
  A_DBGR_Go();
  /***************************************************************************************************************/    
                                              // Test Step 1 Call the function MngCNDD_CanTrcvInitialize to initialize the CAN transceiver.
  /***************************************************************************************************************/
  snprintf( chActionText, elCount(chActionText), "Set Breakpoint TestCanTrcv_Init callback function "); 
  snprintf( chExpectedText, elCount(chExpectedText), "Breakpoint is Set in TestCanTrcv_Init"); 
  //TestStepAddActionExpected( chActionText, chExpectedText );   
  A_DBGR_BreakpointSet("TestCanTrcv_Init");  
  A_DBGR_Go();
  
  snprintf( chActionText, elCount(chActionText), "Verify Breakpoint should hit in TestCanTrcv_Init "); 
  snprintf( chExpectedText, elCount(chExpectedText), "Breakpoint hit in TestCanTrcv_Init function"); 
  //TestStepAddActionExpected( chActionText, chExpectedText );  
  E_DBGR_BreakpointCheckForHalt("TestCanTrcv_Init");
  /***************************************************************************************************************/    
                                              // Test Step 2 Configure the values for the structure TsCNDD_CanTrcvCnfgType for CAN2 Channel.
  /***************************************************************************************************************/
  snprintf( chActionText, elCount(chActionText), "Set Breakpoint in TestCan_Init "); 
  snprintf( chExpectedText, elCount(chExpectedText), "Verify Breakpoint is Set in TestCan_Init"); 
  TestStepAddActionExpected( chActionText, chExpectedText );  
  A_DBGR_BreakpointSet("TestCan_Init");  
  A_DBGR_Go();
  
  snprintf( chActionText, elCount(chActionText), "Verify Breakpoint should hit in TestCan_Init "); 
  snprintf( chExpectedText, elCount(chExpectedText), "Breakpoint hit in TestCan_Init function"); 
 // TestStepAddActionExpected( chActionText, chExpectedText );  
  E_DBGR_BreakpointCheckForHalt("TestCan_Init");
  
  snprintf( chActionText, elCount(chActionText), "Configure CanTrcvPnFrameDataMaskIndex variable"); 
  snprintf( chExpectedText, elCount(chExpectedText), "verify Configure CanTrcvPnFrameDataMaskIndex as 1"); 
  TestStepAddActionExpected( chActionText, chExpectedText );
  A_DBGR_VariableSet("VsCANR_PnFrameData2[1].CanTrcvPnFrameDataMaskIndex","1");
  E_DBGR_VariableCheck("VsCANR_PnFrameData2[1].CanTrcvPnFrameDataMaskIndex",1,Equal);
  
  snprintf( chActionText, elCount(chActionText), "Configure CanTrcvPnFrameDataMask variable"); 
  snprintf( chExpectedText, elCount(chExpectedText), "verify Configure CanTrcvPnFrameDataMask as 1"); 
  TestStepAddActionExpected( chActionText, chExpectedText );
  A_DBGR_VariableSet("VsCANR_PnFrameData2[1].CanTrcvPnFrameDataMask","1");
  E_DBGR_VariableCheck("VsCANR_PnFrameData2[1].CanTrcvPnFrameDataMask",1,Equal);
  
  snprintf( chActionText, elCount(chActionText), "Configure CanTrcvPnFrameCanId variable"); 
  snprintf( chExpectedText, elCount(chExpectedText), "verify Configure CanTrcvPnFrameCanId as 0x456"); 
  TestStepAddActionExpected( chActionText, chExpectedText );
  A_DBGR_VariableSet("VsCANR_PnConfig[1].CanTrcvPnFrameCanId","0x456");
  E_DBGR_VariableCheck("VsCANR_PnConfig[1].CanTrcvPnFrameCanId",0x456,Equal);
  
  snprintf( chActionText, elCount(chActionText), "Configure CanTrcvPnFrameCanIdMask variable"); 
  snprintf( chExpectedText, elCount(chExpectedText), "verify Configure CanTrcvPnFrameCanIdMask as 0"); 
  TestStepAddActionExpected( chActionText, chExpectedText );
  A_DBGR_VariableSet("VsCANR_PnConfig[1].CanTrcvPnFrameCanIdMask","0");
  E_DBGR_VariableCheck("VsCANR_PnConfig[1].CanTrcvPnFrameCanIdMask",0,Equal);
  
  snprintf( chActionText, elCount(chActionText), "Configure CanTrcvPnFrameIdType variable"); 
  snprintf( chExpectedText, elCount(chExpectedText), "verify Configure CanTrcvPnFrameIdType as 0"); 
  TestStepAddActionExpected( chActionText, chExpectedText );
  A_DBGR_VariableSet("VsCANR_PnConfig[1].CanTrcvPnFrameIdType","0");
  E_DBGR_VariableCheck("VsCANR_PnConfig[1].CanTrcvPnFrameIdType",0,Equal);
  
  snprintf( chActionText, elCount(chActionText), "Configure CanTrcvPnFrameDlc variable"); 
  snprintf( chExpectedText, elCount(chExpectedText), "verify Configure CanTrcvPnFrameDlc as 4"); 
  TestStepAddActionExpected( chActionText, chExpectedText );
  A_DBGR_VariableSet("VsCANR_PnConfig[1].CanTrcvPnFrameDlc","4");
  E_DBGR_VariableCheck("VsCANR_PnConfig[1].CanTrcvPnFrameDlc",4,Equal);
  
  snprintf( chActionText, elCount(chActionText), "Configure CanTrcvPnEnabled variable"); 
  snprintf( chExpectedText, elCount(chExpectedText), "verify Configure CanTrcvPnEnabled as 1"); 
  TestStepAddActionExpected( chActionText, chExpectedText );
  A_DBGR_VariableSet("VsCANR_PnConfig[1].CanTrcvPnEnabled","1");
  E_DBGR_VariableCheck("VsCANR_PnConfig[1].CanTrcvPnEnabled",1,Equal);
  
  snprintf( chActionText, elCount(chActionText), "Configure CanTrcvChannelId variable"); 
  snprintf( chExpectedText, elCount(chExpectedText), "verify Configure CanTrcvChannelId as 0"); 
  TestStepAddActionExpected( chActionText, chExpectedText );
  A_DBGR_VariableSet("VsCANR_TrcvChannels[1].CanTrcvChannelId","1");
  E_DBGR_VariableCheck("VsCANR_TrcvChannels[1].CanTrcvChannelId",1,Equal);
  
  snprintf( chActionText, elCount(chActionText), "Configure CanTrcvChannelUsed variable"); 
  snprintf( chExpectedText, elCount(chExpectedText), "verify Configure CanTrcvChannelUsed as 1"); 
  TestStepAddActionExpected( chActionText, chExpectedText );
  A_DBGR_VariableSet("VsCANR_TrcvChannels[1].CanTrcvChannelUsed","1");
  E_DBGR_VariableCheck("VsCANR_TrcvChannels[1].CanTrcvChannelUsed",1,Equal);
  
  snprintf( chActionText, elCount(chActionText), "Configure CanTrcvPinWakeupEnabled variable"); 
  snprintf( chExpectedText, elCount(chExpectedText), "verify Configure CanTrcvPinWakeupEnabled as 0"); 
  TestStepAddActionExpected( chActionText, chExpectedText );
  A_DBGR_VariableSet("VsCANR_TrcvChannels[1].CanTrcvPinWakeupEnabled","0");
  E_DBGR_VariableCheck("VsCANR_TrcvChannels[1].CanTrcvPinWakeupEnabled",0,Equal);
  
  snprintf( chActionText, elCount(chActionText), "Configure CanTrcvNumberOfChannels variable"); 
  snprintf( chExpectedText, elCount(chExpectedText), "verify Configure CanTrcvNumberOfChannels as 2"); 
  TestStepAddActionExpected( chActionText, chExpectedText );
  A_DBGR_VariableSet("VsCANR_CanTrcvConfig.CanTrcvNumberOfChannels","2");
  E_DBGR_VariableCheck("VsCANR_CanTrcvConfig.CanTrcvNumberOfChannels",2,Equal);
  
  snprintf( chActionText, elCount(chActionText), "Flash the Software and ECU is running "); 
  snprintf( chExpectedText, elCount(chExpectedText), "ECU should be in running state"); 
  TestStepAddActionExpected( chActionText, chExpectedText );
  A_DBGR_Go();
  
  /***************************************************************************************************************/    
                                              // Test Step 3  Call the function Test_SetHWIO_PowerDown by setting StartPowerDown to 1 then check transceiver is in the SLEEP mode and PMIC to STANDBY mode
  /***************************************************************************************************************/
  snprintf( chActionText, elCount(chActionText), "Configure StartPowerDown variable to invoke Test_SetHWIO_PowerDown interface"); 
  snprintf( chExpectedText, elCount(chExpectedText), "Verify StartPowerDown is configured as 1"); 
  //TestStepAddActionExpected( chActionText, chExpectedText );
  A_DBGR_VariableSet("StartPowerDown","1");
 // E_DBGR_VariableCheck("StartPowerDown",1,Equal);
  
  snprintf( chActionText, elCount(chActionText), "Check Trace32 is stopped"); 
  snprintf( chExpectedText, elCount(chExpectedText), "Verify Trace32 is stopped"); 
  //TestStepAddActionExpected( chActionText, chExpectedText );
  E_DBGR_CheckState(T32_State_Down);
  
   /***************************************************************************************************************/    
                                              // Test Step 4 Run the Software and capture UART log using python
  /***************************************************************************************************************/
  
  SysExec("powershell", "-ExecutionPolicy Bypass -File ./serial_logging.ps1", automation_root);
  
  snprintf( chActionText, elCount(chActionText), "waiting for UART log"); 
  snprintf( chExpectedText, elCount(chExpectedText), "waiting for UART log"); 
  TestStepAddActionExpected( chActionText, chExpectedText );
  A_GENERIC_SetTimeout(3000,"waiting for UART log");
 
  
  /***************************************************************************************************************/    
                                              // Test Step 4  This step involves sending a CAN wakeup frame with ID 0x456 and 4 bytes of data from Canoe.
  /***************************************************************************************************************/
  snprintf( chActionText, elCount(chActionText), "Transmit CAN message. ID:0x123"); 
  snprintf( chExpectedText, elCount(chExpectedText), "CAN message transmitted. ID:0x123"); 
 // TestStepAddActionExpected( chActionText, chExpectedText );
  A_CAN_SendMessage(0x446, CANB_Wakeup, 4, 2);
  A_CAN_SendMessage(0x446, CANB_Wakeup, 4, 2);
  
  
//  setTimer(periodicTimer_CAN8,1);
  /***************************************************************************************************************/    
                                              // Test Step 6  Verify Transceiver wakeUp or not.
  /***************************************************************************************************************/
  snprintf( chActionText, elCount(chActionText), "Transmit CAN message. ID:0x40000101, PDU info:0x01"); 
  snprintf( chExpectedText, elCount(chExpectedText), "CAN message transmitted. ID:0x40000101, PDU info:0x01"); 
  //TestStepAddActionExpected( chActionText, chExpectedText ); 
  
  E_CAN_WaitForMessageByID(0x00000101,10000,cc_eCAN_ABSENT,"CAN1");
  
  /***************************************************************************************************************/    
                          // Test Step 7 Check UART log in the Tera Term window is update: Last wakeup event is: 2 (wkupCanBusA).
  /***************************************************************************************************************/ 
  strncpy(searchString,"Last wakeup event is: 4",256);
  
  snprintf( chActionText, elCount(chActionText), "waiting for UART log"); 
  snprintf( chExpectedText, elCount(chExpectedText), "waiting for UART log"); 
  TestStepAddActionExpected( chActionText, chExpectedText );
  A_GENERIC_SetTimeout(25000,"waiting for UART log");
  
  snprintf(chActionText, elCount(chActionText), "Run Python script to check battConnectionStatus in log file");
  snprintf(chExpectedText, elCount(chExpectedText), "Python script should execute successfully");
  result =iFcnt_READFILE_SearchKeywordInFile(teraterm,searchString,"string is present");
  
  if(result == 1)
  {
    testStepFail("0","string is present");
  }
  else
  {
    testSteppass("1","string is not present");
  }
 
  setTimer(periodicTimer_CAN8,1);
  testWaitForTimeout(1000);
  
  cancelTimer(periodicTimer_CAN8);
  testWaitForTimeout(1000);
}

testcase Stress_for_WakeUp_Sleep()
{
    /***************************************************************************************************************/    
                                                // Variable Definition
  /***************************************************************************************************************/ 


  
  /***************************************************************************************************************/    
                                               // Local Values
  /***************************************************************************************************************/ 


  
  /***************************************************************************************************************/    
                                              // Test Case Info
  /***************************************************************************************************************/
  setWriteDbgLevel(DebugOff);
  snprintf( chTestTitle, elCount(chTestTitle), "Verify_MngCNDD_CanTrcvInitialize_interface_for_CAN_Transceiver_Initialization_for_CANA_CAN2" );
  snprintf( chTestDescription, elCount(chTestDescription), "Purpose:To check the MngCNDD_CanTrcvInitialize interface for CAN2 channel");
  TestCaseAddInfo( chTestTitle, "TC_L30SW_Q-36403647", chTestDescription );

  /***************************************************************************************************************/    
                                              // Start of Test Case
  /***************************************************************************************************************/
  /***************************************************************************************************************/    
                                              // Test Step 0 PRECONDITIONS
  /***************************************************************************************************************/
  snprintf( chActionText, elCount(chActionText), "Flash the Software and ECU is running "); 
  snprintf( chExpectedText, elCount(chExpectedText), "ECU should be in running state"); 
  TestStepAddActionExpected( chActionText, chExpectedText );

  A_DBGR_BreakpointDeleteAll();
  A_DBGR_R();
  A_DBGR_Go();
  /***************************************************************************************************************/    
                                              // Test Step 1 debugger Running
  /***************************************************************************************************************/
  snprintf( chActionText, elCount(chActionText), "Flash the Software and ECU is running "); 
  snprintf( chExpectedText, elCount(chExpectedText), "ECU should be in running state"); 
  //TestStepAddActionExpected( chActionText, chExpectedText );
  A_DBGR_Go();
  while(1)
  {
  /***************************************************************************************************************/    
                                              // Test Step 3  Call the function Test_SetHWIO_PowerDown by setting StartPowerDown to 1 then check transceiver is in the SLEEP mode and PMIC to STANDBY mode
  /***************************************************************************************************************/
  if(Stress != 0)
  {
    TestStepAddActionExpected( chActionText, chExpectedText );
  }
  A_GENERIC_SetTimeout(1000,"waiting to move ECU to SLEEP");
  snprintf( chActionText, elCount(chActionText), "ECU is moving to Sleep mode");
  snprintf( chExpectedText, elCount(chExpectedText), "ECU is in sleep mode");
  //TestStepAddActionExpected( chActionText, chExpectedText );
  E_CAN_WaitForMessageByID(0x00000101,10000,cc_eCAN_ABSENT,"CAN1");

  snprintf( chActionText, elCount(chActionText), "ECU is in sleep mode");
  snprintf( chExpectedText, elCount(chExpectedText), "ECU is in sleep mode");
  TestStepAddActionExpected( chActionText, chExpectedText );
  E_DBGR_CheckState(T32_State_Down);
  /***************************************************************************************************************/    
                                              // Test Step Verify Transceiver is in sleep or not.
  /***************************************************************************************************************/

  /***************************************************************************************************************/    
                                              // Test Step 4  This step involves sending a CAN wakeup frame with ID 0x123 and 8 bytes of data from Canoe.
  /***************************************************************************************************************/
  if(Stress % 2 == 1)
  {
  snprintf( chActionText, elCount(chActionText), "Transmit CAN message. ID:0x123"); 
  snprintf( chExpectedText, elCount(chExpectedText), "CAN message transmitted. ID:0x123"); 
  TestStepAddActionExpected( chActionText, chExpectedText );
// setTimer(periodicTimer_CAN2, 1);
  A_CAN_SendMessage(0x123, CANA_Wakeup, 8, 1);
  A_CAN_SendMessage(0x123, CANA_Wakeup, 8, 1);
  }
  else
  {
  snprintf( chActionText, elCount(chActionText), "Transmit CAN message. ID:0x456"); 
  snprintf( chExpectedText, elCount(chExpectedText), "CAN message transmitted. ID:0x456"); 
  TestStepAddActionExpected( chActionText, chExpectedText );
  A_CAN_SendMessage(0x456, CANB_Wakeup, 4, 2);
  A_CAN_SendMessage(0x456, CANB_Wakeup, 4, 2);
  //testWaitForTimeout(1500);

  }
  /***************************************************************************************************************/    
                                              // Test Step 5  Verify Transceiver wakeUp or not.
  /***************************************************************************************************************/
  snprintf(chActionText, elCount(chActionText), "ECU wakeup Stress Test count %d",Stress);
	snprintf(chExpectedText, elCount(chExpectedText), "ECU is running Stress Test count %d",Stress);
  //TestStepAddActionExpected( chActionText, chExpectedText );
  E_CAN_WaitForMessageByID(0x105,10000,cc_eCAN_PRESENT,"CAN1");
  Stress = Stress+1;

  /***************************************************************************************************************/    
                                              // Test Step 1 debugger Running
  /***************************************************************************************************************/

  if(Stress == 50)
  {
    Stress =0;
    break;
  }
  }
}

testcase Stres_Test_Power_Reset()
{
   /***************************************************************************************************************/    
                                                // Variable Definition
  /***************************************************************************************************************/ 
  

  
  /***************************************************************************************************************/    
                                               // Local Values
  /***************************************************************************************************************/ 
  

  
  /***************************************************************************************************************/    
                                              // Test Case Info
  /***************************************************************************************************************/
  setWriteDbgLevel(DebugOff);
  snprintf( chTestTitle, elCount(chTestTitle), "Stres_Test_Power_Reset" );
  snprintf( chTestDescription, elCount(chTestDescription), "Purpose:To check the Stres_Test_Power_Reset");
  TestCaseAddInfo( chTestTitle, "TC_L30SW_Q-36542354", chTestDescription );

  /***************************************************************************************************************/    
                                              // Start of Test Case
  /***************************************************************************************************************/
  
  /***************************************************************************************************************/    
                                              // Test Step 0 PRECONDITIONS
  /***************************************************************************************************************/
  snprintf( chActionText, elCount(chActionText), "Flash the Software and ECU is running "); 
  snprintf( chExpectedText, elCount(chExpectedText), "ECU should be in running state"); 
  TestStepAddActionExpected( chActionText, chExpectedText );
  
  A_DBGR_BreakpointDeleteAll();
  
  while(1)
  {
  snprintf( chActionText, elCount(chActionText), "Flash the Software and ECU is running "); 
  snprintf( chExpectedText, elCount(chExpectedText), "ECU should be in running state"); 
 
  A_DBGR_R();
  A_DBGR_Go();
  snprintf( chActionText, elCount(chActionText), "Flash the Software and ECU is running "); 
  snprintf( chExpectedText, elCount(chExpectedText), "ECU should be in running state"); 
 // TestStepAddActionExpected( chActionText, chExpectedText );
  A_DBGR_Go();
  
  /***************************************************************************************************************/    
                                              // Test Step 2 Disconnect the Battery and verify battery is disconnected
  /***************************************************************************************************************/
  Power_OFF_ON(powersupply_port,0);
  
  /***************************************************************************************************************/    
                                              // Test Step 5  Verify Transceiver wakeUp or not.
  /***************************************************************************************************************/
  snprintf( chActionText, elCount(chActionText), "Transmit CAN message. ID:0x40000101, PDU info:0x01"); 
  snprintf( chExpectedText, elCount(chExpectedText), "CAN message transmitted. ID:0x40000101, PDU info:0x01"); 
  //TestStepAddActionExpected( chActionText, chExpectedText ); 
  E_CAN_WaitForMessageByID(0x00000101,10000,cc_eCAN_ABSENT,"CAN1");
  
  /***************************************************************************************************************/    
                                              // Test Step 3 Reconnect the battery power and set the supply voltage to 12V.
  /***************************************************************************************************************/
  testWaitForTimeout(10);
  Power_OFF_ON(powersupply_port,1);
  snprintf( chActionText, elCount(chActionText), "Transmit CAN message. ID:0x40000101, PDU info:0x01"); 
  snprintf( chExpectedText, elCount(chExpectedText), "CAN message transmitted. ID:0x40000101, PDU info:0x01"); 
  TestStepAddActionExpected( chActionText, chExpectedText ); 
  E_CAN_WaitForMessageByID(0x00000101,1000,cc_eCAN_PRESENT,"CAN1");
  
  Stress = Stress+1;
  snprintf(chActionText, elCount(chActionText), "Stress Test count %d",Stress);
	snprintf(chExpectedText, elCount(chExpectedText), "Stress Test count %d",Stress);
  TestStepAddActionExpected( chActionText, chExpectedText );
	A_CAN_SendMessage(CANID[i], dat_64byte, 8, 2);
    
  if(Stress == 50)
  {
    Stress =0;
    break;
  }
  }
}

