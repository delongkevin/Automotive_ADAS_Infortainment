/*@!Encoding:1252*/

includes
{
  
  #include "..\..\AutomationDependent\ProjectSpecific\GenLib_Includes.cin"
  #include "..\..\AutomationDependent\PowerSupply_libraries\Power_ctrl.can"
}

variables
{
  char chTestDescription[500];
  char chActionText[500];
  char chExpectedText[500];
  char chTestTitle[100];
  char canIdValue[256];
  int result;
  char searchString[256];
  char command[256];
  byte CANA_Wakeup[8] =  {0x08,0x00,0x00,0x00,0x00,0x00,0x00,0x01};
}

testcase Verify_default_value_of_INTERNAL_BUS_STATUS_parameter()
{
   /***************************************************************************************************************/    
                                                // Variable Definition
  /***************************************************************************************************************/ 
  

  
  /***************************************************************************************************************/    
                                               // Local Values
  /***************************************************************************************************************/ 
  

  
  /***************************************************************************************************************/    
                                              // Test Case Info
  /***************************************************************************************************************/
  setWriteDbgLevel(DebugOff);
  snprintf( chTestTitle, elCount(chTestTitle), "Verify_default_value_of_INTERNAL_BUS_STATUS_parameter" );
  snprintf( chTestDescription, elCount(chTestDescription), "Purpose:To check the GetHWIO_e_BusStatus interface ");
  TestCaseAddInfo( chTestTitle, "TC_L30SW_Q-36629478", chTestDescription );

  /***************************************************************************************************************/    
                                              // Start of Test Case
  /***************************************************************************************************************/
  
  /***************************************************************************************************************/    
                                              // Test Step 0 PRECONDITIONS
  /***************************************************************************************************************/
  snprintf( chActionText, elCount(chActionText), "Flash the Software and ECU is running "); 
  snprintf( chExpectedText, elCount(chExpectedText), "ECU should be in running state"); 
  TestStepAddActionExpected( chActionText, chExpectedText );
  A_DBGR_BreakpointDeleteAll();
  
  snprintf( chActionText, elCount(chActionText), "Flash the Software and ECU is running "); 
  snprintf( chExpectedText, elCount(chExpectedText), "ECU should be in running state"); 
 
  A_DBGR_R();
  A_DBGR_Go();
  /***************************************************************************************************************/    
                                              // Test Step 1 	Set a breakpoint at line INTERNAL_BUS_STATUS = GetHWIO_e_BusStatus(void); inside function void Test_GetHWIO_e_BusStatus(void).
  /***************************************************************************************************************/
  snprintf( chActionText, elCount(chActionText), "Set Breakpoint Test_GetHWIO_e_BusStatus callback function "); 
  snprintf( chExpectedText, elCount(chExpectedText), "Breakpoint is Set in Test_GetHWIO_e_BusStatus"); 
  //TestStepAddActionExpected( chActionText, chExpectedText );   
  A_DBGR_BreakpointSet("Test_GetHWIO_e_BusStatus\\5");  
  
   /***************************************************************************************************************/    
                                              // Test Step 2 Run the debugger
  /***************************************************************************************************************/
  snprintf( chActionText, elCount(chActionText), "Run the software "); 
  snprintf( chExpectedText, elCount(chExpectedText), "ECU should be in running state"); 
  A_DBGR_Go();
  
   /***************************************************************************************************************/    
                                              // Test Step 3 Wait for the breakpoint to hit
  /***************************************************************************************************************/
 
  
  snprintf( chActionText, elCount(chActionText), "Verify Breakpoint should hit in Test_GetHWIO_e_BusStatus "); 
  snprintf( chExpectedText, elCount(chExpectedText), "Breakpoint hit in Test_GetHWIO_e_BusStatus function"); 
  //TestStepAddActionExpected( chActionText, chExpectedText );  
  E_DBGR_BreakpointCheckForHalt("Test_GetHWIO_e_BusStatus\\5");
  
  /***************************************************************************************************************/    
                                              // Test Step 3 verify INTERNAL_BUS_STATUS is having 2.
  /***************************************************************************************************************/
  snprintf( chActionText, elCount(chActionText), "Configure CanTrcvPnFrameDataMaskIndex variable"); 
  snprintf( chExpectedText, elCount(chExpectedText), "Verify CanTrcvPnFrameDataMaskIndex is configured as 0"); 
  TestStepAddActionExpected( chActionText, chExpectedText );
  E_DBGR_VariableCheck("INTERNAL_BUS_STATUS",2,Equal);
}

testcase Verify_GetHWIO_e_BusStatus_function_returns_correct_values()
{
   /***************************************************************************************************************/    
                                                // Variable Definition
  /***************************************************************************************************************/ 
  

  
  /***************************************************************************************************************/    
                                               // Local Values
  /***************************************************************************************************************/ 
  

  
  /***************************************************************************************************************/    
                                              // Test Case Info
  /***************************************************************************************************************/
  setWriteDbgLevel(DebugOff);
  snprintf( chTestTitle, elCount(chTestTitle), "Verify_GetHWIO_e_BusStatus_function_returns_correct_values" );
  snprintf( chTestDescription, elCount(chTestDescription), "Purpose:To check the GetHWIO_e_BusStatus interface ");
  TestCaseAddInfo( chTestTitle, "TC_L30SW_Q-36629479", chTestDescription );

  /***************************************************************************************************************/    
                                              // Start of Test Case
  /***************************************************************************************************************/
  
  /***************************************************************************************************************/    
                                              // Test Step 0 PRECONDITIONS
  /***************************************************************************************************************/
  snprintf( chActionText, elCount(chActionText), "Flash the Software and ECU is running "); 
  snprintf( chExpectedText, elCount(chExpectedText), "ECU should be in running state"); 
  TestStepAddActionExpected( chActionText, chExpectedText );
  A_DBGR_BreakpointDeleteAll();
  
  snprintf( chActionText, elCount(chActionText), "Flash the Software and ECU is running "); 
  snprintf( chExpectedText, elCount(chExpectedText), "ECU should be in running state"); 
 
  A_DBGR_R();
  A_DBGR_Go();
  /***************************************************************************************************************/    
                                              // Test Step 1 	Set a breakpoint at line INTERNAL_BUS_STATUS = GetHWIO_e_BusStatus(void); inside function void Test_GetHWIO_e_BusStatus(void).
  /***************************************************************************************************************/
  snprintf( chActionText, elCount(chActionText), "Set Breakpoint Test_GetHWIO_e_BusStatus callback function "); 
  snprintf( chExpectedText, elCount(chExpectedText), "Breakpoint is Set in Test_GetHWIO_e_BusStatus"); 
  //TestStepAddActionExpected( chActionText, chExpectedText );   
  A_DBGR_BreakpointSet("Test_GetHWIO_e_BusStatus\\8");  
  
   /***************************************************************************************************************/    
                                              // Test Step 2 Run the debugger
  /***************************************************************************************************************/
  snprintf( chActionText, elCount(chActionText), "Run the software "); 
  snprintf( chExpectedText, elCount(chExpectedText), "ECU should be in running state"); 
  A_DBGR_Go();
  
   /***************************************************************************************************************/    
                                              // Test Step 3 Wait for the breakpoint to hit
  /***************************************************************************************************************/
 
  
  snprintf( chActionText, elCount(chActionText), "Verify Breakpoint should hit in Test_GetHWIO_e_BusStatus "); 
  snprintf( chExpectedText, elCount(chExpectedText), "Breakpoint hit in Test_GetHWIO_e_BusStatus function"); 
  //TestStepAddActionExpected( chActionText, chExpectedText );  
  E_DBGR_BreakpointCheckForHalt("Test_GetHWIO_e_BusStatus\\8");
  
  /***************************************************************************************************************/    
                                              // Test Step 3 verify INTERNAL_BUS_STATUS is having 2.
  /***************************************************************************************************************/
  snprintf( chActionText, elCount(chActionText), "Verify INTERNAL_BUS_STATUS have 0 to 2 values"); 
  snprintf( chExpectedText, elCount(chExpectedText), "INTERNAL_BUS_STATUS have 0 to 2 values"); 
  TestStepAddActionExpected( chActionText, chExpectedText );
  E_DBGR_VariableCheck("INTERNAL_BUS_STATUS",3,Smaller);
  
  
  snprintf( chActionText, elCount(chActionText), "Flash the Software and ECU is running "); 
  snprintf( chExpectedText, elCount(chExpectedText), "ECU should be in running state"); 
  TestStepAddActionExpected( chActionText, chExpectedText );
  A_DBGR_BreakpointDeleteAll();
  
  snprintf( chActionText, elCount(chActionText), "Run the software "); 
  snprintf( chExpectedText, elCount(chExpectedText), "ECU should be in running state"); 
  A_DBGR_Go();
  /***************************************************************************************************************/    
                                              // Test Step 4 	Set a breakpoint at line INTERNAL_BUS_STATUS = GetHWIO_e_BusStatus(void); inside function void Test_GetHWIO_e_BusStatus(void).
  /***************************************************************************************************************/
  snprintf( chActionText, elCount(chActionText), "Set Breakpoint Test_GetHWIO_e_BusStatus callback function "); 
  snprintf( chExpectedText, elCount(chExpectedText), "Breakpoint is Set in Test_GetHWIO_e_BusStatus"); 
  //TestStepAddActionExpected( chActionText, chExpectedText );   
  A_DBGR_BreakpointSet("Test_GetHWIO_e_BusStatus\\11");  
  
//   /***************************************************************************************************************/    
//                                              // Test Step 5 Run the debugger
//  /***************************************************************************************************************/
 
//  A_DBGR_Go();
  
   /***************************************************************************************************************/    
                                              // Test Step 3 Wait for the breakpoint to hit
  /***************************************************************************************************************/
 
  
  snprintf( chActionText, elCount(chActionText), "Verify Breakpoint should hit in Test_GetHWIO_e_BusStatus "); 
  snprintf( chExpectedText, elCount(chExpectedText), "Breakpoint hit in Test_GetHWIO_e_BusStatus function"); 
  //TestStepAddActionExpected( chActionText, chExpectedText );  
  E_DBGR_BreakpointCheckForHalt("Test_GetHWIO_e_BusStatus\\11");
  
  snprintf( chActionText, elCount(chActionText), "Configure CanTrcvPnFrameDataMaskIndex variable"); 
  snprintf( chExpectedText, elCount(chExpectedText), "Verify CanTrcvPnFrameDataMaskIndex is configured as 0"); 
  TestStepAddActionExpected( chActionText, chExpectedText );
  E_DBGR_VariableCheck("INTERNAL_BUS_STATUS",3,Smaller);
  
}

testcase Verify_INTERNAL_BUS_STATUS_is_set_to_indeterminate_during_Reset_Initialization()
{
  /***************************************************************************************************************/    
                                                // Variable Definition
  /***************************************************************************************************************/ 
  

  
  /***************************************************************************************************************/    
                                               // Local Values
  /***************************************************************************************************************/ 
  

  
  /***************************************************************************************************************/    
                                              // Test Case Info
  /***************************************************************************************************************/
  setWriteDbgLevel(DebugOff);
  snprintf( chTestTitle, elCount(chTestTitle), "Verify_INTERNAL_BUS_STATUS_is_set_to_indeterminate_during_Reset_Initialization" );
  snprintf( chTestDescription, elCount(chTestDescription), "Purpose:To check the GetHWIO_e_BusStatus interface ");
  TestCaseAddInfo( chTestTitle, "TC_L30SW_Q-36629480", chTestDescription );

  /***************************************************************************************************************/    
                                              // Start of Test Case
  /***************************************************************************************************************/
  
  /***************************************************************************************************************/    
                                              // Test Step 0 PRECONDITIONS
  /***************************************************************************************************************/
  snprintf( chActionText, elCount(chActionText), "Flash the Software and ECU is running "); 
  snprintf( chExpectedText, elCount(chExpectedText), "ECU should be in running state"); 
  TestStepAddActionExpected( chActionText, chExpectedText );
  A_DBGR_BreakpointDeleteAll();
  
  snprintf( chActionText, elCount(chActionText), "Flash the Software and ECU is running "); 
  snprintf( chExpectedText, elCount(chExpectedText), "ECU should be in running state"); 
 
  A_DBGR_R();
  A_DBGR_Go();
  /***************************************************************************************************************/    
                                              // Test Step 1 	Set a breakpoint at line INTERNAL_BUS_STATUS = GetHWIO_e_BusStatus(void); inside function void Test_GetHWIO_e_BusStatus(void).
  /***************************************************************************************************************/
  snprintf( chActionText, elCount(chActionText), "Set Breakpoint Test_GetHWIO_e_BusStatus callback function "); 
  snprintf( chExpectedText, elCount(chExpectedText), "Breakpoint is Set in Test_GetHWIO_e_BusStatus"); 
  //TestStepAddActionExpected( chActionText, chExpectedText );   
  A_DBGR_BreakpointSet("Test_GetHWIO_e_BusStatus\\5");  
  
   /***************************************************************************************************************/    
                                              // Test Step 2 Run the debugger
  /***************************************************************************************************************/
  snprintf( chActionText, elCount(chActionText), "Run the software "); 
  snprintf( chExpectedText, elCount(chExpectedText), "ECU should be in running state"); 
  A_DBGR_Go();
  
   /***************************************************************************************************************/    
                                              // Test Step 3 Wait for the breakpoint to hit
  /***************************************************************************************************************/
 
  
  snprintf( chActionText, elCount(chActionText), "Verify Breakpoint should hit in Test_GetHWIO_e_BusStatus "); 
  snprintf( chExpectedText, elCount(chExpectedText), "Breakpoint hit in Test_GetHWIO_e_BusStatus function"); 
  //TestStepAddActionExpected( chActionText, chExpectedText );  
  E_DBGR_BreakpointCheckForHalt("Test_GetHWIO_e_BusStatus\\5");
  
  /***************************************************************************************************************/    
                                              // Test Step 3 verify INTERNAL_BUS_STATUS is having 2.
  /***************************************************************************************************************/
  snprintf( chActionText, elCount(chActionText), "Configure CanTrcvPnFrameDataMaskIndex variable"); 
  snprintf( chExpectedText, elCount(chExpectedText), "Verify CanTrcvPnFrameDataMaskIndex is configured as 0"); 
  TestStepAddActionExpected( chActionText, chExpectedText );
  E_DBGR_VariableCheck("INTERNAL_BUS_STATUS",2,Equal);
  
  /***************************************************************************************************************/    
                                              // Test Step 4 	Perform a reset initialization.
  /***************************************************************************************************************/
  
  snprintf( chActionText, elCount(chActionText), "Flash the Software and ECU is running "); 
  snprintf( chExpectedText, elCount(chExpectedText), "ECU should be in running state"); 
  TestStepAddActionExpected( chActionText, chExpectedText );
  A_DBGR_R();
  
  snprintf( chActionText, elCount(chActionText), "Run the software "); 
  snprintf( chExpectedText, elCount(chExpectedText), "ECU should be in running state"); 
  A_DBGR_Go();
  A_DBGR_Go();
  
  /***************************************************************************************************************/    
                                              // Test Step 3 verify INTERNAL_BUS_STATUS is having 2.
  /***************************************************************************************************************/
  snprintf( chActionText, elCount(chActionText), "Configure CanTrcvPnFrameDataMaskIndex variable"); 
  snprintf( chExpectedText, elCount(chExpectedText), "Verify CanTrcvPnFrameDataMaskIndex is configured as 0"); 
  //TestStepAddActionExpected( chActionText, chExpectedText );
  E_DBGR_VariableCheck("INTERNAL_BUS_STATUS",2,Equal);
  
}

testcase Verify_default_value_of_BUS_ID_parameter()
{
  /***************************************************************************************************************/    
                                                // Variable Definition
  /***************************************************************************************************************/ 
  

  
  /***************************************************************************************************************/    
                                               // Local Values
  /***************************************************************************************************************/ 
  

  
  /***************************************************************************************************************/    
                                              // Test Case Info
  /***************************************************************************************************************/
  setWriteDbgLevel(DebugOff);
  snprintf( chTestTitle, elCount(chTestTitle), "Verify_default_value_of_BUS_ID_parameter" );
  snprintf( chTestDescription, elCount(chTestDescription), "Purpose:To check the GetHWIO_e_BusID interface ");
  TestCaseAddInfo( chTestTitle, "TC_L30SW_Q-36629481", chTestDescription );

  /***************************************************************************************************************/    
                                              // Start of Test Case
  /***************************************************************************************************************/
  
  /***************************************************************************************************************/    
                                              // Test Step 0 PRECONDITIONS
  /***************************************************************************************************************/
  snprintf( chActionText, elCount(chActionText), "Flash the Software and ECU is running "); 
  snprintf( chExpectedText, elCount(chExpectedText), "ECU should be in running state"); 
  TestStepAddActionExpected( chActionText, chExpectedText );
  A_DBGR_BreakpointDeleteAll();
  
  snprintf( chActionText, elCount(chActionText), "Flash the Software and ECU is running "); 
  snprintf( chExpectedText, elCount(chExpectedText), "ECU should be in running state"); 
 
  A_DBGR_R();
  A_DBGR_Go();
  /***************************************************************************************************************/    
                                              // Test Step 1 	Set a breakpoint at line BUS_ID = GetHWIO_e_BusID(void); inside function void Test_GetHWIO_e_BusID( void )
  /***************************************************************************************************************/
  snprintf( chActionText, elCount(chActionText), "Set Breakpoint Test_GetHWIO_e_BusID callback function "); 
  snprintf( chExpectedText, elCount(chExpectedText), "Breakpoint is Set in Test_GetHWIO_e_BusID"); 
  //TestStepAddActionExpected( chActionText, chExpectedText );   
  A_DBGR_BreakpointSet("Test_GetHWIO_e_BusID\\13");  
  
   /***************************************************************************************************************/    
                                              // Test Step 2 Run the debugger
  /***************************************************************************************************************/
  snprintf( chActionText, elCount(chActionText), "Run the software "); 
  snprintf( chExpectedText, elCount(chExpectedText), "ECU should be in running state"); 
  A_DBGR_Go();
  
   /***************************************************************************************************************/    
                                              // Test Step 3 Wait for the breakpoint to hit
  /***************************************************************************************************************/
 
  
  snprintf( chActionText, elCount(chActionText), "Verify Breakpoint should hit in Test_GetHWIO_e_BusID "); 
  snprintf( chExpectedText, elCount(chExpectedText), "Breakpoint hit in Test_GetHWIO_e_BusID function"); 
  //TestStepAddActionExpected( chActionText, chExpectedText );  
  E_DBGR_BreakpointCheckForHalt("Test_GetHWIO_e_BusID\\13");
  
  /***************************************************************************************************************/    
                                              // Test Step 3 verify INTERNAL_BUS_STATUS is having 2.
  /***************************************************************************************************************/
  snprintf( chActionText, elCount(chActionText), "Configure BUS_ID variable"); 
  snprintf( chExpectedText, elCount(chExpectedText), "Verify BUS_ID is configured as 0"); 
  TestStepAddActionExpected( chActionText, chExpectedText );
  E_DBGR_VariableCheck("BUS_ID",0,Equal);
  
  
}

testcase Verify_GetHWIO_e_BusStatus_function_returns_0_if_No_Fault_is_present_in_Bus_Network()
{
    /***************************************************************************************************************/    
                                                // Variable Definition
  /***************************************************************************************************************/ 
  

  
  /***************************************************************************************************************/    
                                               // Local Values
  /***************************************************************************************************************/ 
  

  
  /***************************************************************************************************************/    
                                              // Test Case Info
  /***************************************************************************************************************/
  setWriteDbgLevel(DebugOff);
  snprintf( chTestTitle, elCount(chTestTitle), "Verify_GetHWIO_e_BusStatus_function_returns_0_if_No_Fault_is_present_in_Bus_Network" );
  snprintf( chTestDescription, elCount(chTestDescription), "Purpose:To check the GetHWIO_e_BusStatus interface ");
  TestCaseAddInfo( chTestTitle, "TC_L30SW_Q-37084731", chTestDescription );

  /***************************************************************************************************************/    
                                              // Start of Test Case
  /***************************************************************************************************************/
  
  /***************************************************************************************************************/    
                                              // Test Step 0 PRECONDITIONS
  /***************************************************************************************************************/
  snprintf( chActionText, elCount(chActionText), "Flash the Software and ECU is running "); 
  snprintf( chExpectedText, elCount(chExpectedText), "ECU should be in running state"); 
  TestStepAddActionExpected( chActionText, chExpectedText );
  A_DBGR_BreakpointDeleteAll();
  
  snprintf( chActionText, elCount(chActionText), "Flash the Software and ECU is running "); 
  snprintf( chExpectedText, elCount(chExpectedText), "ECU should be in running state"); 
 
  A_DBGR_R();
  A_DBGR_Go();
  snprintf( chActionText, elCount(chActionText), "Run the software "); 
  snprintf( chExpectedText, elCount(chExpectedText), "ECU should be in running state"); 
  A_DBGR_Go();
  /***************************************************************************************************************/    
                                              // Test Step 1 	Set a breakpoint at line INTERNAL_BUS_STATUS = GetHWIO_e_BusStatus(void); inside function void Test_GetHWIO_e_BusStatus(void).
  /***************************************************************************************************************/
  snprintf( chActionText, elCount(chActionText), "Set Breakpoint Test_GetHWIO_e_BusStatus callback function "); 
  snprintf( chExpectedText, elCount(chExpectedText), "Breakpoint is Set in Test_GetHWIO_e_BusStatus"); 
  //TestStepAddActionExpected( chActionText, chExpectedText );   
  A_DBGR_BreakpointSet("Test_GetHWIO_e_BusStatus\\6");  
  
   /***************************************************************************************************************/    
                                              // Test Step 2 Run the debugger
  /***************************************************************************************************************/
  snprintf( chActionText, elCount(chActionText), "Run the software "); 
  snprintf( chExpectedText, elCount(chExpectedText), "ECU should be in running state"); 
  A_DBGR_Go();
  
   /***************************************************************************************************************/    
                                              // Test Step 3 Wait for the breakpoint to hit
  /***************************************************************************************************************/
 
  
  snprintf( chActionText, elCount(chActionText), "Verify Breakpoint should hit in Test_GetHWIO_e_BusStatus "); 
  snprintf( chExpectedText, elCount(chExpectedText), "Breakpoint hit in Test_GetHWIO_e_BusStatus function"); 
  E_DBGR_CheckState(T32_State_Running);
}

testcase Verify_GetHWIO_e_BusStatus_function_returns_1_if_Fault_is_present_in_Bus_Network()
{
  /***************************************************************************************************************/    
                                                // Variable Definition
  /***************************************************************************************************************/ 
  

  
  /***************************************************************************************************************/    
                                               // Local Values
  /***************************************************************************************************************/ 
  

  
  /***************************************************************************************************************/    
                                              // Test Case Info
  /***************************************************************************************************************/
  setWriteDbgLevel(DebugOff);
  snprintf( chTestTitle, elCount(chTestTitle), "Verify_GetHWIO_e_BusStatus_function_returns_1_if_Fault_is_present_in_Bus_Network" );
  snprintf( chTestDescription, elCount(chTestDescription), "Purpose:To check the GetHWIO_e_BusStatus interface ");
  TestCaseAddInfo( chTestTitle, "TC_L30SW_Q-37084759", chTestDescription );

  /***************************************************************************************************************/    
                                              // Start of Test Case
  /***************************************************************************************************************/
  
  /***************************************************************************************************************/    
                                              // Test Step 0 PRECONDITIONS
  /***************************************************************************************************************/
  snprintf( chActionText, elCount(chActionText), "Flash the Software and ECU is running "); 
  snprintf( chExpectedText, elCount(chExpectedText), "ECU should be in running state"); 
  TestStepAddActionExpected( chActionText, chExpectedText );
  A_DBGR_BreakpointDeleteAll();
  
  snprintf( chActionText, elCount(chActionText), "Flash the Software and ECU is running "); 
  snprintf( chExpectedText, elCount(chExpectedText), "ECU should be in running state"); 
 
  A_DBGR_R();
  
  A_DBGR_Go();
  /***************************************************************************************************************/    
                                              // Test Step 2 Set a breakpoint at line TestCanTrcv_Getmode(void); in OS_Tasks.c file
  /***************************************************************************************************************/
  snprintf( chActionText, elCount(chActionText), "Set Breakpoint Os_Entry_Task_Core0_5ms\\13 callback function "); 
  snprintf( chExpectedText, elCount(chExpectedText), "Breakpoint is Set in Os_Entry_Task_Core0_5ms\\13"); 
  //TestStepAddActionExpected( chActionText, chExpectedText );   
  A_DBGR_BreakpointSet("Os_Entry_Task_Core0_5ms\\13");  
  
  
   /***************************************************************************************************************/    
                                              // Test Step 3 Run the debugger
  /***************************************************************************************************************/
  snprintf( chActionText, elCount(chActionText), "Run the software "); 
  snprintf( chExpectedText, elCount(chExpectedText), "ECU should be in running state"); 
  A_DBGR_Go();
  
   /***************************************************************************************************************/    
                                              // Test Step 4 Wait for the breakpoint to hit
  /***************************************************************************************************************/
  snprintf( chActionText, elCount(chActionText), "Verify Breakpoint should hit in Os_Entry_Task_Core0_5ms\\13 "); 
  snprintf( chExpectedText, elCount(chExpectedText), "Breakpoint hit in Os_Entry_Task_Core0_5ms\\13 function"); 
  //TestStepAddActionExpected( chActionText, chExpectedText );  
  E_DBGR_BreakpointCheckForHalt("Os_Entry_Task_Core0_5ms\\13");
  
   snprintf( chActionText, elCount(chActionText), "Flash the Software and ECU is running "); 
  snprintf( chExpectedText, elCount(chExpectedText), "ECU should be in running state"); 
  TestStepAddActionExpected( chActionText, chExpectedText );
  A_DBGR_BreakpointDeleteAll();
  /***************************************************************************************************************/    
                                              // Test Step 5 MCALUTIL_SFRWRITE(SPI_HW_MODULE[KernelId].MC.U, ((uint32)TransferCount<<IFX_QSPI_MC_MCOUNT_OFF));
  /***************************************************************************************************************/
  snprintf( chActionText, elCount(chActionText), "Set Breakpoint Spi_lQspiHWSetJobConfig\\18 callback function "); 
  snprintf( chExpectedText, elCount(chExpectedText), "Breakpoint is Set in Spi_lQspiHWSetJobConfig\\18"); 
  //TestStepAddActionExpected( chActionText, chExpectedText );   
  A_DBGR_BreakpointSet("Spi_lQspiHWSetJobConfig\\18");  
  
   /***************************************************************************************************************/    
                                              // Test Step 6 Run the debugger
  /***************************************************************************************************************/
  snprintf( chActionText, elCount(chActionText), "Run the software "); 
  snprintf( chExpectedText, elCount(chExpectedText), "ECU should be in running state"); 
  A_DBGR_Go();
  
   /***************************************************************************************************************/    
                                              // Test Step 7 Wait for the breakpoint to hit
  /***************************************************************************************************************/
  snprintf( chActionText, elCount(chActionText), "Verify Breakpoint should hit in Os_Entry_Task_Core0_5ms\\13 "); 
  snprintf( chExpectedText, elCount(chExpectedText), "Breakpoint hit in Os_Entry_Task_Core0_5ms\\13 function"); 
  //TestStepAddActionExpected( chActionText, chExpectedText );  
  E_DBGR_BreakpointCheckForHalt("Spi_lQspiHWSetJobConfig\\18");
  
  /***************************************************************************************************************/    
                                              // Test Step 8 set TransferCount variable to 5 to inject TxFIFO overflow fault.
  /***************************************************************************************************************/
  snprintf( chActionText, elCount(chActionText), "Configure TransferCount variable"); 
  snprintf( chExpectedText, elCount(chExpectedText), "Verify TransferCount is configured as 0"); 
  TestStepAddActionExpected( chActionText, chExpectedText );
  A_DBGR_VariableSet("TransferCount","5");
  E_DBGR_VariableCheck("TransferCount",5,Equal);
  
  
  /***************************************************************************************************************/    
                                              // Test Step 9 Delete all Breakpoints
  /***************************************************************************************************************/
  snprintf( chActionText, elCount(chActionText), "Flash the Software and ECU is running "); 
  snprintf( chExpectedText, elCount(chExpectedText), "ECU should be in running state"); 
  TestStepAddActionExpected( chActionText, chExpectedText );
  A_DBGR_BreakpointDeleteAll();
  
   /***************************************************************************************************************/    
                                              // Test Step  Set a breakpoint at line INTERNAL_BUS_STATUS = GetHWIO_e_BusStatus(void); 
  /***************************************************************************************************************/
  snprintf( chActionText, elCount(chActionText), "Set Breakpoint Test_GetHWIO_e_BusStatus callback function "); 
  snprintf( chExpectedText, elCount(chExpectedText), "Breakpoint is Set in Test_GetHWIO_e_BusStatus"); 
  //TestStepAddActionExpected( chActionText, chExpectedText );   
  A_DBGR_BreakpointSet("Test_GetHWIO_e_BusStatus\\8");
  
  
  /***************************************************************************************************************/    
                                              // Test Step 10 Run the debugger
  /***************************************************************************************************************/
  snprintf( chActionText, elCount(chActionText), "Run the software "); 
  snprintf( chExpectedText, elCount(chExpectedText), "ECU should be in running state"); 
  A_DBGR_Go();

  /***************************************************************************************************************/    
                                              // Test Step 11 Wait for the breakpoint to hit
  /***************************************************************************************************************/
  snprintf( chActionText, elCount(chActionText), "Verify Breakpoint should hit in Test_GetHWIO_e_BusStatus\\8 "); 
  snprintf( chExpectedText, elCount(chExpectedText), "Breakpoint hit in Test_GetHWIO_e_BusStatus\\8 function"); 
  //TestStepAddActionExpected( chActionText, chExpectedText );  
  E_DBGR_BreakpointCheckForHalt("Test_GetHWIO_e_BusStatus\\8");
  
  /***************************************************************************************************************/    
                                              // Test Step 12 	Verify INTERNAL_BUS_STATUS value as 1.
  /***************************************************************************************************************/
  snprintf( chActionText, elCount(chActionText), "Configure INTERNAL_BUS_STATUS variable"); 
  snprintf( chExpectedText, elCount(chExpectedText), "Verify INTERNAL_BUS_STATUS is configured as 1"); 
  TestStepAddActionExpected( chActionText, chExpectedText );
  E_DBGR_VariableCheck("INTERNAL_BUS_STATUS",1,Equal);
  
  
  
}

testcase Verify_GetHWIO_e_BusID_function_returns_correct_values()
{
  /***************************************************************************************************************/    
                                                // Variable Definition
  /***************************************************************************************************************/ 
  

  
  /***************************************************************************************************************/    
                                               // Local Values
  /***************************************************************************************************************/ 
  

  
  /***************************************************************************************************************/    
                                              // Test Case Info
  /***************************************************************************************************************/
  setWriteDbgLevel(DebugOff);
  snprintf( chTestTitle, elCount(chTestTitle), "Verify_GetHWIO_e_BusID_function_returns_correct_values" );
  snprintf( chTestDescription, elCount(chTestDescription), "Purpose:To check the GetHWIO_e_BusID interface ");
  TestCaseAddInfo( chTestTitle, "TC_L30SW_Q-36629482", chTestDescription );

  /***************************************************************************************************************/    
                                              // Start of Test Case
  /***************************************************************************************************************/
  
  /***************************************************************************************************************/    
                                              // Test Step 0 PRECONDITIONS
  /***************************************************************************************************************/
  snprintf( chActionText, elCount(chActionText), "Flash the Software and ECU is running "); 
  snprintf( chExpectedText, elCount(chExpectedText), "ECU should be in running state"); 
  TestStepAddActionExpected( chActionText, chExpectedText );
  A_DBGR_BreakpointDeleteAll();
  
  snprintf( chActionText, elCount(chActionText), "Flash the Software and ECU is running "); 
  snprintf( chExpectedText, elCount(chExpectedText), "ECU should be in running state"); 
 
  A_DBGR_R();
  A_DBGR_Go();
  
  /***************************************************************************************************************/    
                                              // Test Step 1 Set a breakpoint at line TestCanTrcv_Getmode(void); in OS_Tasks.c file
  /***************************************************************************************************************/
  snprintf( chActionText, elCount(chActionText), "Set Breakpoint Os_Entry_Task_Core0_5ms\\13 callback function "); 
  snprintf( chExpectedText, elCount(chExpectedText), "Breakpoint is Set in Os_Entry_Task_Core0_5ms\\13"); 
  //TestStepAddActionExpected( chActionText, chExpectedText );   
  A_DBGR_BreakpointSet("Os_Entry_Task_Core0_5ms\\13");  
  
  
   /***************************************************************************************************************/    
                                              // Test Step 2 Run the debugger
  /***************************************************************************************************************/
  snprintf( chActionText, elCount(chActionText), "Run the software "); 
  snprintf( chExpectedText, elCount(chExpectedText), "ECU should be in running state"); 
  A_DBGR_Go();
  
   /***************************************************************************************************************/    
                                              // Test Step 3 Wait for the breakpoint to hit
  /***************************************************************************************************************/
  snprintf( chActionText, elCount(chActionText), "Verify Breakpoint should hit in Os_Entry_Task_Core0_5ms\\13 "); 
  snprintf( chExpectedText, elCount(chExpectedText), "Breakpoint hit in Os_Entry_Task_Core0_5ms\\13 function"); 
  //TestStepAddActionExpected( chActionText, chExpectedText );  
  E_DBGR_BreakpointCheckForHalt("Os_Entry_Task_Core0_5ms\\13");
  
  snprintf( chActionText, elCount(chActionText), "Flash the Software and ECU is running "); 
  snprintf( chExpectedText, elCount(chExpectedText), "ECU should be in running state"); 
  TestStepAddActionExpected( chActionText, chExpectedText );
  A_DBGR_BreakpointDeleteAll();
  /***************************************************************************************************************/    
                                              // Test Step 4 MCALUTIL_SFRWRITE(SPI_HW_MODULE[KernelId].MC.U, ((uint32)TransferCount<<IFX_QSPI_MC_MCOUNT_OFF));
  /***************************************************************************************************************/
  snprintf( chActionText, elCount(chActionText), "Set Breakpoint Spi_lQspiHWSetJobConfig\\18 callback function "); 
  snprintf( chExpectedText, elCount(chExpectedText), "Breakpoint is Set in Spi_lQspiHWSetJobConfig\\18"); 
  //TestStepAddActionExpected( chActionText, chExpectedText );   
  A_DBGR_BreakpointSet("Spi_lQspiHWSetJobConfig\\18");  
  
   /***************************************************************************************************************/    
                                              // Test Step 5 Run the debugger
  /***************************************************************************************************************/
  snprintf( chActionText, elCount(chActionText), "Run the software "); 
  snprintf( chExpectedText, elCount(chExpectedText), "ECU should be in running state"); 
  A_DBGR_Go();
  
   /***************************************************************************************************************/    
                                              // Test Step 6 Wait for the breakpoint to hit
  /***************************************************************************************************************/
  snprintf( chActionText, elCount(chActionText), "Verify Breakpoint should hit in Os_Entry_Task_Core0_5ms\\13 "); 
  snprintf( chExpectedText, elCount(chExpectedText), "Breakpoint hit in Os_Entry_Task_Core0_5ms\\13 function"); 
  //TestStepAddActionExpected( chActionText, chExpectedText );  
  E_DBGR_BreakpointCheckForHalt("Spi_lQspiHWSetJobConfig\\18");
  
  /***************************************************************************************************************/    
                                              // Test Step 7 set TransferCount variable to 5 to inject TxFIFO overflow fault.
  /***************************************************************************************************************/
  snprintf( chActionText, elCount(chActionText), "Configure TransferCount variable"); 
  snprintf( chExpectedText, elCount(chExpectedText), "Verify TransferCount is configured as 0"); 
  TestStepAddActionExpected( chActionText, chExpectedText );
  A_DBGR_VariableSet("TransferCount","5");
  E_DBGR_VariableCheck("TransferCount",5,Equal);
  
  /***************************************************************************************************************/    
                                              // Test Step 8 Delete all Breakpoints
  /***************************************************************************************************************/
  snprintf( chActionText, elCount(chActionText), "Flash the Software and ECU is running "); 
  snprintf( chExpectedText, elCount(chExpectedText), "ECU should be in running state"); 
  TestStepAddActionExpected( chActionText, chExpectedText );
  A_DBGR_BreakpointDeleteAll();
  
   /***************************************************************************************************************/    
                                              // Test Step 9 Set a breakpoint at line BUS_ID = GetHWIO_e_BusID(void); inside function void Test_GetHWIO_e_BusID( void ) 
  /***************************************************************************************************************/
  snprintf( chActionText, elCount(chActionText), "Set Breakpoint Test_GetHWIO_e_BusID\\8 callback function "); 
  snprintf( chExpectedText, elCount(chExpectedText), "Breakpoint is Set in Test_GetHWIO_e_BusID\\8"); 
  //TestStepAddActionExpected( chActionText, chExpectedText );   
  A_DBGR_BreakpointSet("Test_GetHWIO_e_BusID\\8"); 
  
  /***************************************************************************************************************/    
                                              // Test Step 10 Run the debugger
  /***************************************************************************************************************/
  snprintf( chActionText, elCount(chActionText), "Run the software "); 
  snprintf( chExpectedText, elCount(chExpectedText), "ECU should be in running state"); 
  A_DBGR_Go();

  /***************************************************************************************************************/    
                                              // Test Step 11 Wait for the breakpoint to hit
  /***************************************************************************************************************/
  snprintf( chActionText, elCount(chActionText), "Verify Breakpoint should hit in Test_GetHWIO_e_BusID\\8 "); 
  snprintf( chExpectedText, elCount(chExpectedText), "Breakpoint hit in Test_GetHWIO_e_BusID\\8 function"); 
  //TestStepAddActionExpected( chActionText, chExpectedText );  
  E_DBGR_BreakpointCheckForHalt("Test_GetHWIO_e_BusID\\8");
  
  snprintf( chActionText, elCount(chActionText), "Flash the Software and ECU is running "); 
  snprintf( chExpectedText, elCount(chExpectedText), "ECU should be in running state"); 
  TestStepAddActionExpected( chActionText, chExpectedText );
  A_DBGR_BreakpointDeleteAll();
  
  /***************************************************************************************************************/    
                                              // Test Step 12 	Verify BUS_ID value as 0 to 7.
  /***************************************************************************************************************/
  snprintf( chActionText, elCount(chActionText), "Configure BUSID variable"); 
  snprintf( chExpectedText, elCount(chExpectedText), "Verify BUSID is configured as 1"); 
  //TestStepAddActionExpected( chActionText, chExpectedText );
  E_DBGR_VariableCheck("BUS_ID",0,Greater);

  
  /***************************************************************************************************************/    
                                              // Test Step 13 	Set a breakpoint at line BUS_ID = GetHWIO_e_BusID(void); inside function void Test_GetHWIO_e_BusID( void )
  /***************************************************************************************************************/
  snprintf( chActionText, elCount(chActionText), "Set Breakpoint Test_GetHWIO_e_BusID callback function "); 
  snprintf( chExpectedText, elCount(chExpectedText), "Breakpoint is Set in Test_GetHWIO_e_BusID"); 
  TestStepAddActionExpected( chActionText, chExpectedText );   
  A_DBGR_BreakpointSet("Test_GetHWIO_e_BusID\\13");  
  
  /***************************************************************************************************************/    
                                              // Test Step 14 Run the debugger
  /***************************************************************************************************************/
  snprintf( chActionText, elCount(chActionText), "Run the software "); 
  snprintf( chExpectedText, elCount(chExpectedText), "ECU should be in running state"); 
  A_DBGR_Go();
  
  
   /***************************************************************************************************************/    
                                              // Test Step 15 Wait for the breakpoint to hit
  /***************************************************************************************************************/
 
  
  snprintf( chActionText, elCount(chActionText), "Verify Breakpoint should hit in Test_GetHWIO_e_BusID "); 
  snprintf( chExpectedText, elCount(chExpectedText), "Breakpoint hit in Test_GetHWIO_e_BusID function"); 
  //TestStepAddActionExpected( chActionText, chExpectedText );  
  E_DBGR_BreakpointCheckForHalt("Test_GetHWIO_e_BusID\\13");
  
  /***************************************************************************************************************/    
                                              // Test Step 16 verify INTERNAL_BUS_STATUS is having 2.
  /***************************************************************************************************************/
  snprintf( chActionText, elCount(chActionText), "Configure BUS_ID variable"); 
  snprintf( chExpectedText, elCount(chExpectedText), "Verify BUS_ID is configured as 0"); 
  TestStepAddActionExpected( chActionText, chExpectedText );
  E_DBGR_VariableCheck("BUS_ID",0,Equal);
}

testcase Verify_BUS_ID_is_set_to_No_Bus_Network_Error_during_Reset_Initialization()
{
  /***************************************************************************************************************/    
                                                // Variable Definition
  /***************************************************************************************************************/ 
  

  
  /***************************************************************************************************************/    
                                               // Local Values
  /***************************************************************************************************************/ 
  

  
  /***************************************************************************************************************/    
                                              // Test Case Info
  /***************************************************************************************************************/
  setWriteDbgLevel(DebugOff);
  snprintf( chTestTitle, elCount(chTestTitle), "Verify_BUS_ID_is_set_to_No_Bus_Network_Error_during_Reset_Initialization" );
  snprintf( chTestDescription, elCount(chTestDescription), "Purpose:To check the GetHWIO_e_BusID interface ");
  TestCaseAddInfo( chTestTitle, "TC_L30SW_Q-36629481", chTestDescription );

  /***************************************************************************************************************/    
                                              // Start of Test Case
  /***************************************************************************************************************/
  
  /***************************************************************************************************************/    
                                              // Test Step 0 PRECONDITIONS
  /***************************************************************************************************************/
  snprintf( chActionText, elCount(chActionText), "Flash the Software and ECU is running "); 
  snprintf( chExpectedText, elCount(chExpectedText), "ECU should be in running state"); 
  TestStepAddActionExpected( chActionText, chExpectedText );
  A_DBGR_BreakpointDeleteAll();
  
  snprintf( chActionText, elCount(chActionText), "Flash the Software and ECU is running "); 
  snprintf( chExpectedText, elCount(chExpectedText), "ECU should be in running state"); 
 
  A_DBGR_R();
  A_DBGR_Go();
  /***************************************************************************************************************/    
                                              // Test Step 1 	Set a breakpoint at line BUS_ID = GetHWIO_e_BusID(void); inside function void Test_GetHWIO_e_BusID( void )
  /***************************************************************************************************************/
  snprintf( chActionText, elCount(chActionText), "Set Breakpoint Test_GetHWIO_e_BusID callback function "); 
  snprintf( chExpectedText, elCount(chExpectedText), "Breakpoint is Set in Test_GetHWIO_e_BusID"); 
  //TestStepAddActionExpected( chActionText, chExpectedText );   
  A_DBGR_BreakpointSet("Test_GetHWIO_e_BusID\\13");  
  
   /***************************************************************************************************************/    
                                              // Test Step 2 Run the debugger
  /***************************************************************************************************************/
  snprintf( chActionText, elCount(chActionText), "Run the software "); 
  snprintf( chExpectedText, elCount(chExpectedText), "ECU should be in running state"); 
  A_DBGR_Go();
  
   /***************************************************************************************************************/    
                                              // Test Step 3 Wait for the breakpoint to hit
  /***************************************************************************************************************/
 
  
  snprintf( chActionText, elCount(chActionText), "Verify Breakpoint should hit in Test_GetHWIO_e_BusID "); 
  snprintf( chExpectedText, elCount(chExpectedText), "Breakpoint hit in Test_GetHWIO_e_BusID function"); 
  //TestStepAddActionExpected( chActionText, chExpectedText );  
  E_DBGR_BreakpointCheckForHalt("Test_GetHWIO_e_BusID\\13");
  
  /***************************************************************************************************************/    
                                              // Test Step 3 verify INTERNAL_BUS_STATUS is having 2.
  /***************************************************************************************************************/
  snprintf( chActionText, elCount(chActionText), "Configure BUS_ID variable"); 
  snprintf( chExpectedText, elCount(chExpectedText), "Verify BUS_ID is configured as 0"); 
  TestStepAddActionExpected( chActionText, chExpectedText );
  E_DBGR_VariableCheck("BUS_ID",0,Equal);
  
  
}

testcase Verify_bitwise_OR_operation_for_multiple_bus_faults_i_e_SPI_MCU_CAN2TCVR_and_SPI_MCU_CAN8TCVR_scenario_1()
{
  /***************************************************************************************************************/    
                                                // Variable Definition
  /***************************************************************************************************************/ 
  

  
  /***************************************************************************************************************/    
                                               // Local Values
  /***************************************************************************************************************/ 
  

  
  /***************************************************************************************************************/    
                                              // Test Case Info
  /***************************************************************************************************************/
  setWriteDbgLevel(DebugOff);
  snprintf( chTestTitle, elCount(chTestTitle), "Verify_bitwise_OR_operation_for_multiple_bus_faults_i_e_SPI_MCU_CAN2TCVR_and_SPI_MCU_CAN8TCVR_scenario_1" );
  snprintf( chTestDescription, elCount(chTestDescription), "Purpose:To check the GetHWIO_e_BusID interface ");
  TestCaseAddInfo( chTestTitle, "TC_L30SW_Q-37207955", chTestDescription );

  /***************************************************************************************************************/    
                                              // Test Step 0 PRECONDITIONS
  /***************************************************************************************************************/
  snprintf( chActionText, elCount(chActionText), "Flash the Software and ECU is running "); 
  snprintf( chExpectedText, elCount(chExpectedText), "ECU should be in running state"); 
  TestStepAddActionExpected( chActionText, chExpectedText );
  A_DBGR_BreakpointDeleteAll();
  
  snprintf( chActionText, elCount(chActionText), "Flash the Software and ECU is running "); 
  snprintf( chExpectedText, elCount(chExpectedText), "ECU should be in running state"); 
 
  A_DBGR_R();
  
  A_DBGR_Go();
  /***************************************************************************************************************/    
                                              // Test Step 1 Set a breakpoint at line TestCanTrcv_Getmode(void); in OS_Tasks.c file
  /***************************************************************************************************************/
  snprintf( chActionText, elCount(chActionText), "Set Breakpoint Os_Entry_Task_Core0_5ms\\13 callback function "); 
  snprintf( chExpectedText, elCount(chExpectedText), "Breakpoint is Set in Os_Entry_Task_Core0_5ms\\13"); 
  //TestStepAddActionExpected( chActionText, chExpectedText );   
  A_DBGR_BreakpointSet("Os_Entry_Task_Core0_5ms\\13");  
  
  
   /***************************************************************************************************************/    
                                              // Test Step 2 Run the debugger
  /***************************************************************************************************************/
  snprintf( chActionText, elCount(chActionText), "Run the software "); 
  snprintf( chExpectedText, elCount(chExpectedText), "ECU should be in running state"); 
  A_DBGR_Go();
  
   /***************************************************************************************************************/    
                                              // Test Step 3 Wait for the breakpoint to hit
  /***************************************************************************************************************/
  snprintf( chActionText, elCount(chActionText), "Verify Breakpoint should hit in Os_Entry_Task_Core0_5ms\\13 "); 
  snprintf( chExpectedText, elCount(chExpectedText), "Breakpoint hit in Os_Entry_Task_Core0_5ms\\13 function"); 
  //TestStepAddActionExpected( chActionText, chExpectedText );  
  E_DBGR_BreakpointCheckForHalt("Os_Entry_Task_Core0_5ms\\13");
  
  snprintf( chActionText, elCount(chActionText), "Flash the Software and ECU is running "); 
  snprintf( chExpectedText, elCount(chExpectedText), "ECU should be in running state"); 
  TestStepAddActionExpected( chActionText, chExpectedText );
  A_DBGR_BreakpointDeleteAll();
  /***************************************************************************************************************/    
                                              // Test Step 4 CAN_COMMAND_STATUS = GetCNDD_e_CanTrcvOpMode(0U, &Getcantravmode);
  /***************************************************************************************************************/
  snprintf( chActionText, elCount(chActionText), "Set Breakpoint TestCanTrcv_Getmode\\5 callback function "); 
  snprintf( chExpectedText, elCount(chExpectedText), "Breakpoint is Set in TestCanTrcv_Getmode\\5"); 
 // TestStepAddActionExpected( chActionText, chExpectedText );   
  A_DBGR_BreakpointSet("TestCanTrcv_Getmode\\5");  
  
  snprintf( chActionText, elCount(chActionText), "Run the software "); 
  snprintf( chExpectedText, elCount(chExpectedText), "ECU should be in running state"); 
  A_DBGR_Go();
  
  snprintf( chActionText, elCount(chActionText), "Verify Breakpoint should hit in Os_Entry_Task_Core0_5ms\\13 "); 
  snprintf( chExpectedText, elCount(chExpectedText), "Breakpoint hit in Os_Entry_Task_Core0_5ms\\13 function"); 
  //TestStepAddActionExpected( chActionText, chExpectedText );  
  E_DBGR_BreakpointCheckForHalt("TestCanTrcv_Getmode\\5");
  
  snprintf( chActionText, elCount(chActionText), "Flash the Software and ECU is running "); 
  snprintf( chExpectedText, elCount(chExpectedText), "ECU should be in running state"); 
  TestStepAddActionExpected( chActionText, chExpectedText );
  A_DBGR_BreakpointDeleteAll();
  /***************************************************************************************************************/    
                                              // Test Step 5 Set ChannelID_B to 1 to call GetCNDD_e_CanTrcvOpMode(1U, &Getcantravmode);
  /***************************************************************************************************************/

  snprintf( chActionText, elCount(chActionText), "Configure Channel_ID_B variable to invoke GetCNDD_e_CanTrcvOpMode interface"); 
  snprintf( chExpectedText, elCount(chExpectedText), "Verify Channel_ID_B is configured as 1"); 
  //TestStepAddActionExpected( chActionText, chExpectedText );
  A_DBGR_VariableSet("Channel_ID_B","1");
  E_DBGR_VariableCheck("Channel_ID_B",1,Equal);
  
  /***************************************************************************************************************/    
                                              // Test Step 6 MCALUTIL_SFRWRITE(SPI_HW_MODULE[KernelId].MC.U, ((uint32)TransferCount<<IFX_QSPI_MC_MCOUNT_OFF));
  /***************************************************************************************************************/
  snprintf( chActionText, elCount(chActionText), "Set Breakpoint Spi_lQspiHWSetJobConfig\\18 callback function "); 
  snprintf( chExpectedText, elCount(chExpectedText), "Breakpoint is Set in Spi_lQspiHWSetJobConfig\\18"); 
  TestStepAddActionExpected( chActionText, chExpectedText );   
  A_DBGR_BreakpointSet("Spi_lQspiHWSetJobConfig\\18");  
  
  /***************************************************************************************************************/    
                                              // Test Step 7 Run the debugger
  /***************************************************************************************************************/
  snprintf( chActionText, elCount(chActionText), "Run the software "); 
  snprintf( chExpectedText, elCount(chExpectedText), "ECU should be in running state"); 
  A_DBGR_Go();
  
   /***************************************************************************************************************/    
                                              // Test Step 8 Wait for the breakpoint to hit
  /***************************************************************************************************************/
  snprintf( chActionText, elCount(chActionText), "Verify Breakpoint should hit in Os_Entry_Task_Core0_5ms\\13 "); 
  snprintf( chExpectedText, elCount(chExpectedText), "Breakpoint hit in Os_Entry_Task_Core0_5ms\\13 function"); 
  //TestStepAddActionExpected( chActionText, chExpectedText );  
  E_DBGR_BreakpointCheckForHalt("Spi_lQspiHWSetJobConfig\\18");
  
  snprintf( chActionText, elCount(chActionText), "Flash the Software and ECU is running "); 
  snprintf( chExpectedText, elCount(chExpectedText), "ECU should be in running state"); 
  TestStepAddActionExpected( chActionText, chExpectedText );
  A_DBGR_BreakpointDeleteAll();
  
  /***************************************************************************************************************/    
                                              // Test Step 9 set TransferCount variable to 5 to inject TxFIFO overflow fault.
  /***************************************************************************************************************/
  snprintf( chActionText, elCount(chActionText), "Configure TransferCount variable"); 
  snprintf( chExpectedText, elCount(chExpectedText), "Verify TransferCount is configured as 0"); 
  //TestStepAddActionExpected( chActionText, chExpectedText );
  A_DBGR_VariableSet("TransferCount","5");
  E_DBGR_VariableCheck("TransferCount",5,Equal);
  
  /***************************************************************************************************************/    
                                              // Test Step 10 CAN_COMMAND_STATUS = GetCNDD_e_CanTrcvOpMode(1U, &Getcantravmode);
  /***************************************************************************************************************/
  snprintf( chActionText, elCount(chActionText), "Set Breakpoint TestCanTrcv_Getmode\\10 callback function "); 
  snprintf( chExpectedText, elCount(chExpectedText), "Breakpoint is Set in TestCanTrcv_Getmode\\10"); 
  TestStepAddActionExpected( chActionText, chExpectedText );   
  A_DBGR_BreakpointSet("TestCanTrcv_Getmode\\10");  
  
  /***************************************************************************************************************/    
                                              // Test Step 11  Run the debugger
  /***************************************************************************************************************/
  snprintf( chActionText, elCount(chActionText), "Run the software "); 
  snprintf( chExpectedText, elCount(chExpectedText), "ECU should be in running state"); 
  A_DBGR_Go();
  
  snprintf( chActionText, elCount(chActionText), "Verify Breakpoint should hit in Os_Entry_Task_Core0_5ms\\13 "); 
  snprintf( chExpectedText, elCount(chExpectedText), "Breakpoint hit in Os_Entry_Task_Core0_5ms\\13 function"); 
  //TestStepAddActionExpected( chActionText, chExpectedText );  
  E_DBGR_BreakpointCheckForHalt("TestCanTrcv_Getmode\\10");
  
   snprintf( chActionText, elCount(chActionText), "Flash the Software and ECU is running "); 
  snprintf( chExpectedText, elCount(chExpectedText), "ECU should be in running state"); 
  TestStepAddActionExpected( chActionText, chExpectedText );
  A_DBGR_BreakpointDeleteAll();
  
  /***************************************************************************************************************/    
                                              // Test Step 12 MCALUTIL_SFRWRITE(SPI_HW_MODULE[KernelId].MC.U, ((uint32)TransferCount<<IFX_QSPI_MC_MCOUNT_OFF));
  /***************************************************************************************************************/
  snprintf( chActionText, elCount(chActionText), "Set Breakpoint Spi_lQspiHWSetJobConfig\\18 callback function "); 
  snprintf( chExpectedText, elCount(chExpectedText), "Breakpoint is Set in Spi_lQspiHWSetJobConfig\\18"); 
  //TestStepAddActionExpected( chActionText, chExpectedText );   
  A_DBGR_BreakpointSet("Spi_lQspiHWSetJobConfig\\18");  
  
  /***************************************************************************************************************/    
                                              // Test Step 13 Run the debugger
  /***************************************************************************************************************/
  snprintf( chActionText, elCount(chActionText), "Run the software "); 
  snprintf( chExpectedText, elCount(chExpectedText), "ECU should be in running state"); 
  A_DBGR_Go();
  
   /***************************************************************************************************************/    
                                              // Test Step 14 Wait for the breakpoint to hit
  /***************************************************************************************************************/
  snprintf( chActionText, elCount(chActionText), "Verify Breakpoint should hit in Os_Entry_Task_Core0_5ms\\13 "); 
  snprintf( chExpectedText, elCount(chExpectedText), "Breakpoint hit in Os_Entry_Task_Core0_5ms\\13 function"); 
  //TestStepAddActionExpected( chActionText, chExpectedText );  
  E_DBGR_BreakpointCheckForHalt("Spi_lQspiHWSetJobConfig\\18");
  
  snprintf( chActionText, elCount(chActionText), "Flash the Software and ECU is running "); 
  snprintf( chExpectedText, elCount(chExpectedText), "ECU should be in running state"); 
  TestStepAddActionExpected( chActionText, chExpectedText );
  A_DBGR_BreakpointDeleteAll();
  /***************************************************************************************************************/    
                                              // Test Step 15 set TransferCount variable to 5 to inject TxFIFO overflow fault.
  /***************************************************************************************************************/
  snprintf( chActionText, elCount(chActionText), "Configure TransferCount variable"); 
  snprintf( chExpectedText, elCount(chExpectedText), "Verify TransferCount is configured as 0"); 
  //TestStepAddActionExpected( chActionText, chExpectedText );
  A_DBGR_VariableSet("TransferCount","5");
  E_DBGR_VariableCheck("TransferCount",5,Equal);
  
   
   /***************************************************************************************************************/    
                                              // Test Step 16 Set a breakpoint at line BUS_ID = GetHWIO_e_BusID(void); inside function void Test_GetHWIO_e_BusID( void ) 
  /***************************************************************************************************************/
  snprintf( chActionText, elCount(chActionText), "Set Breakpoint Test_GetHWIO_e_BusID\\8 callback function "); 
  snprintf( chExpectedText, elCount(chExpectedText), "Breakpoint is Set in Test_GetHWIO_e_BusID\\8"); 
  TestStepAddActionExpected( chActionText, chExpectedText );   
  A_DBGR_BreakpointSet("Test_GetHWIO_e_BusID\\8"); 
  
  /***************************************************************************************************************/    
                                              // Test Step 17 Run the debugger
  /***************************************************************************************************************/
  snprintf( chActionText, elCount(chActionText), "Run the software "); 
  snprintf( chExpectedText, elCount(chExpectedText), "ECU should be in running state"); 
  A_DBGR_Go();

  /***************************************************************************************************************/    
                                              // Test Step 18 Wait for the breakpoint to hit
  /***************************************************************************************************************/
  snprintf( chActionText, elCount(chActionText), "Verify Breakpoint should hit in Test_GetHWIO_e_BusID\\8 "); 
  snprintf( chExpectedText, elCount(chExpectedText), "Breakpoint hit in Test_GetHWIO_e_BusID\\8 function"); 
  //TestStepAddActionExpected( chActionText, chExpectedText );  
  E_DBGR_BreakpointCheckForHalt("Test_GetHWIO_e_BusID\\8");
  
  /***************************************************************************************************************/    
                                              // Test Step 19 	Verify BUS_ID value as 3.
  /***************************************************************************************************************/
  snprintf( chActionText, elCount(chActionText), "Configure BUSID variable"); 
  snprintf( chExpectedText, elCount(chExpectedText), "Verify BUSID is configured as 1"); 
  TestStepAddActionExpected( chActionText, chExpectedText );
  E_DBGR_VariableCheck("BUS_ID",3,Equal);

  
  
}

testcase Verify_bitwise_OR_operation_for_multiple_bus_faults_i_e_SPI_MCU_CAN2TCVR_and_SPI_MCU_PMIC_TLF4D_scenario_2()
{
  /***************************************************************************************************************/    
                                                // Variable Definition
  /***************************************************************************************************************/ 
  

  
  /***************************************************************************************************************/    
                                               // Local Values
  /***************************************************************************************************************/ 
  

  
  /***************************************************************************************************************/    
                                              // Test Case Info
  /***************************************************************************************************************/
  setWriteDbgLevel(DebugOff);
  snprintf( chTestTitle, elCount(chTestTitle), "Verify_bitwise_OR_operation_for_multiple_bus_faults_i_e_SPI_MCU_CAN2TCVR_and_SPI_MCU_PMIC_TLF4D_scenario_2" );
  snprintf( chTestDescription, elCount(chTestDescription), "Purpose:To check the GetHWIO_e_BusID interface ");
  TestCaseAddInfo( chTestTitle, "TC_L30SW_Q-37207951", chTestDescription );

  /***************************************************************************************************************/    
                                              // Test Step 0 PRECONDITIONS
  /***************************************************************************************************************/
  snprintf( chActionText, elCount(chActionText), "Flash the Software and ECU is running "); 
  snprintf( chExpectedText, elCount(chExpectedText), "ECU should be in running state"); 
  TestStepAddActionExpected( chActionText, chExpectedText );
  A_DBGR_BreakpointDeleteAll();
  
  snprintf( chActionText, elCount(chActionText), "Flash the Software and ECU is running "); 
  snprintf( chExpectedText, elCount(chExpectedText), "ECU should be in running state"); 
 
  A_DBGR_R();
  
  A_DBGR_Go();
  /***************************************************************************************************************/    
                                              // Test Step 1 Set a breakpoint at line TestCanTrcv_Getmode(void); in OS_Tasks.c file
  /***************************************************************************************************************/
  snprintf( chActionText, elCount(chActionText), "Set Breakpoint Os_Entry_Task_Core0_5ms\\13 callback function "); 
  snprintf( chExpectedText, elCount(chExpectedText), "Breakpoint is Set in Os_Entry_Task_Core0_5ms\\13"); 
  //TestStepAddActionExpected( chActionText, chExpectedText );   
  A_DBGR_BreakpointSet("Os_Entry_Task_Core0_5ms\\13");  
  
  
   /***************************************************************************************************************/    
                                              // Test Step 2 Run the debugger
  /***************************************************************************************************************/
  snprintf( chActionText, elCount(chActionText), "Run the software "); 
  snprintf( chExpectedText, elCount(chExpectedText), "ECU should be in running state"); 
  A_DBGR_Go();
  
   /***************************************************************************************************************/    
                                              // Test Step 3 Wait for the breakpoint to hit
  /***************************************************************************************************************/
  snprintf( chActionText, elCount(chActionText), "Verify Breakpoint should hit in Os_Entry_Task_Core0_5ms\\13 "); 
  snprintf( chExpectedText, elCount(chExpectedText), "Breakpoint hit in Os_Entry_Task_Core0_5ms\\13 function"); 
  //TestStepAddActionExpected( chActionText, chExpectedText );  
  E_DBGR_BreakpointCheckForHalt("Os_Entry_Task_Core0_5ms\\13");
  
  snprintf( chActionText, elCount(chActionText), "Flash the Software and ECU is running "); 
  snprintf( chExpectedText, elCount(chExpectedText), "ECU should be in running state"); 
  TestStepAddActionExpected( chActionText, chExpectedText );
  A_DBGR_BreakpointDeleteAll();
  /***************************************************************************************************************/    
                                              // Test Step 4 MCALUTIL_SFRWRITE(SPI_HW_MODULE[KernelId].MC.U, ((uint32)TransferCount<<IFX_QSPI_MC_MCOUNT_OFF));
  /***************************************************************************************************************/
  snprintf( chActionText, elCount(chActionText), "Set Breakpoint Spi_lQspiHWSetJobConfig\\18 callback function "); 
  snprintf( chExpectedText, elCount(chExpectedText), "Breakpoint is Set in Spi_lQspiHWSetJobConfig\\18"); 
  //TestStepAddActionExpected( chActionText, chExpectedText );   
  A_DBGR_BreakpointSet("Spi_lQspiHWSetJobConfig\\18");  
  
  /***************************************************************************************************************/    
                                              // Test Step 5 Run the debugger
  /***************************************************************************************************************/
  snprintf( chActionText, elCount(chActionText), "Run the software "); 
  snprintf( chExpectedText, elCount(chExpectedText), "ECU should be in running state"); 
  A_DBGR_Go();
  
   /***************************************************************************************************************/    
                                              // Test Step 6 Wait for the breakpoint to hit
  /***************************************************************************************************************/
  snprintf( chActionText, elCount(chActionText), "Verify Breakpoint should hit in Os_Entry_Task_Core0_5ms\\13 "); 
  snprintf( chExpectedText, elCount(chExpectedText), "Breakpoint hit in Os_Entry_Task_Core0_5ms\\13 function"); 
  //TestStepAddActionExpected( chActionText, chExpectedText );  
  E_DBGR_BreakpointCheckForHalt("Spi_lQspiHWSetJobConfig\\18");
  
  /***************************************************************************************************************/    
                                              // Test Step 7 set TransferCount variable to 5 to inject TxFIFO overflow fault.
  /***************************************************************************************************************/
  snprintf( chActionText, elCount(chActionText), "Configure TransferCount variable"); 
  snprintf( chExpectedText, elCount(chExpectedText), "Verify TransferCount is configured as 0"); 
  TestStepAddActionExpected( chActionText, chExpectedText );
  A_DBGR_VariableSet("TransferCount","5");
  E_DBGR_VariableCheck("TransferCount",5,Equal);
  
  snprintf( chActionText, elCount(chActionText), "Flash the Software and ECU is running "); 
  snprintf( chExpectedText, elCount(chExpectedText), "ECU should be in running state"); 
  TestStepAddActionExpected( chActionText, chExpectedText );
  A_DBGR_BreakpointDeleteAll();
  /***************************************************************************************************************/    
                                              // Test Step 8 Set a breakpoint at line TestCanTrcv_Getmode(void); in OS_Tasks.c file
  /***************************************************************************************************************/
  snprintf( chActionText, elCount(chActionText), "Set Breakpoint Os_Entry_Task_Core0_5ms\\14 callback function "); 
  snprintf( chExpectedText, elCount(chExpectedText), "Breakpoint is Set in Os_Entry_Task_Core0_5ms\\14"); 
  //TestStepAddActionExpected( chActionText, chExpectedText );   
  A_DBGR_BreakpointSet("Os_Entry_Task_Core0_5ms\\14");  
  
  
   /***************************************************************************************************************/    
                                              // Test Step 9 Run the debugger
  /***************************************************************************************************************/
  snprintf( chActionText, elCount(chActionText), "Run the software "); 
  snprintf( chExpectedText, elCount(chExpectedText), "ECU should be in running state"); 
  A_DBGR_Go();
  
   /***************************************************************************************************************/    
                                              // Test Step 10 Wait for the breakpoint to hit
  /***************************************************************************************************************/
  snprintf( chActionText, elCount(chActionText), "Verify Breakpoint should hit in Os_Entry_Task_Core0_5ms\\14 "); 
  snprintf( chExpectedText, elCount(chExpectedText), "Breakpoint hit in Os_Entry_Task_Core0_5ms\\14 function"); 
  //TestStepAddActionExpected( chActionText, chExpectedText );  
  E_DBGR_BreakpointCheckForHalt("Os_Entry_Task_Core0_5ms\\14");
  
  /***************************************************************************************************************/    
                                              // Test Step  Delete all Breakpoints
  /***************************************************************************************************************/
  snprintf( chActionText, elCount(chActionText), "Flash the Software and ECU is running "); 
  snprintf( chExpectedText, elCount(chExpectedText), "ECU should be in running state"); 
  TestStepAddActionExpected( chActionText, chExpectedText );
  A_DBGR_BreakpointDeleteAll();
  
  
  /***************************************************************************************************************/    
                                              // Test Step 11 Set Breakpoint Spi_lQspiSyncTransmitData32Bit\\24 callback function
  /***************************************************************************************************************/
  snprintf( chActionText, elCount(chActionText), "Set Breakpoint Spi_lQspiSyncTransmitData32Bit\\24 callback function "); 
  snprintf( chExpectedText, elCount(chExpectedText), "Breakpoint is Set in Spi_lQspiSyncTransmitData32Bit\\24"); 
  //TestStepAddActionExpected( chActionText, chExpectedText );   
  A_DBGR_BreakpointSet("Spi_lQspiSyncTransmitData32Bit\\24");  
  
  /***************************************************************************************************************/    
                                              // Test Step 12 Run the debugger
  /***************************************************************************************************************/
  snprintf( chActionText, elCount(chActionText), "Run the software "); 
  snprintf( chExpectedText, elCount(chExpectedText), "ECU should be in running state"); 
  A_DBGR_Go();
  
   /***************************************************************************************************************/    
                                              // Test Step 13 Wait for the breakpoint to hit
  /***************************************************************************************************************/
  snprintf( chActionText, elCount(chActionText), "Verify Breakpoint should hit in Spi_lQspiSyncTransmitData32Bit\\24 "); 
  snprintf( chExpectedText, elCount(chExpectedText), "Breakpoint hit in Spi_lQspiSyncTransmitData32Bit\\24 function"); 
  //TestStepAddActionExpected( chActionText, chExpectedText );  
  E_DBGR_BreakpointCheckForHalt("Spi_lQspiSyncTransmitData32Bit\\24");
  
  /***************************************************************************************************************/    
                                              // Test Step 14 set Timeout variable to 5 to inject TxFIFO overflow fault.
  /***************************************************************************************************************/
  snprintf( chActionText, elCount(chActionText), "Configure Timeout variable"); 
  snprintf( chExpectedText, elCount(chExpectedText), "Verify Timeout is configured as 0"); 
  TestStepAddActionExpected( chActionText, chExpectedText );
  A_DBGR_VariableSet("Timeout","0");
  E_DBGR_VariableCheck("Timeout",0,Equal);
  
  /***************************************************************************************************************/    
                                              // Test Step 15 Delete all Breakpoints
  /***************************************************************************************************************/
  snprintf( chActionText, elCount(chActionText), "Flash the Software and ECU is running "); 
  snprintf( chExpectedText, elCount(chExpectedText), "ECU should be in running state"); 
  TestStepAddActionExpected( chActionText, chExpectedText );
  A_DBGR_BreakpointDeleteAll();
  
   /***************************************************************************************************************/    
                                              // Test Step 16 Set a breakpoint at line BUS_ID = GetHWIO_e_BusID(void); inside function void Test_GetHWIO_e_BusID( void ) 
  /***************************************************************************************************************/
  snprintf( chActionText, elCount(chActionText), "Set Breakpoint Test_GetHWIO_e_BusID\\8 callback function "); 
  snprintf( chExpectedText, elCount(chExpectedText), "Breakpoint is Set in Test_GetHWIO_e_BusID\\8"); 
  //TestStepAddActionExpected( chActionText, chExpectedText );   
  A_DBGR_BreakpointSet("Test_GetHWIO_e_BusID\\8"); 
  
  /***************************************************************************************************************/    
                                              // Test Step 17 Run the debugger
  /***************************************************************************************************************/
  snprintf( chActionText, elCount(chActionText), "Run the software "); 
  snprintf( chExpectedText, elCount(chExpectedText), "ECU should be in running state"); 
  A_DBGR_Go();

  /***************************************************************************************************************/    
                                              // Test Step 18 Wait for the breakpoint to hit
  /***************************************************************************************************************/
  snprintf( chActionText, elCount(chActionText), "Verify Breakpoint should hit in Test_GetHWIO_e_BusID\\8 "); 
  snprintf( chExpectedText, elCount(chExpectedText), "Breakpoint hit in Test_GetHWIO_e_BusID\\8 function"); 
  //TestStepAddActionExpected( chActionText, chExpectedText );  
  E_DBGR_BreakpointCheckForHalt("Test_GetHWIO_e_BusID\\8");
  
  /***************************************************************************************************************/    
                                              // Test Step 19 	Verify BUS_ID value as 5.
  /***************************************************************************************************************/
  snprintf( chActionText, elCount(chActionText), "Configure BUSID variable"); 
  snprintf( chExpectedText, elCount(chExpectedText), "Verify BUSID is configured as 5"); 
  TestStepAddActionExpected( chActionText, chExpectedText );
  E_DBGR_VariableCheck("BUS_ID",5,Equal);


}

testcase Verify_bitwise_OR_operation_for_multiple_bus_faults_i_e_SPI_MCU_CAN8TCVR_and_SPI_MCU_PMIC_TLF4D_scenario_3()
{
  /***************************************************************************************************************/    
                                                // Variable Definition
  /***************************************************************************************************************/ 
  

  
  /***************************************************************************************************************/    
                                               // Local Values
  /***************************************************************************************************************/ 
  

  
  /***************************************************************************************************************/    
                                              // Test Case Info
  /***************************************************************************************************************/
  setWriteDbgLevel(DebugOff);
  snprintf( chTestTitle, elCount(chTestTitle), "Verify_bitwise_OR_operation_for_multiple_bus_faults_i_e_SPI_MCU_CAN8TCVR_and_SPI_MCU_PMIC_TLF4D_scenario_3" );
  snprintf( chTestDescription, elCount(chTestDescription), "Purpose:To check the GetHWIO_e_BusID interface ");
  TestCaseAddInfo( chTestTitle, "TC_L30SW_Q-36629484", chTestDescription );

  /***************************************************************************************************************/    
                                              // Test Step 0 PRECONDITIONS
  /***************************************************************************************************************/
  snprintf( chActionText, elCount(chActionText), "Flash the Software and ECU is running "); 
  snprintf( chExpectedText, elCount(chExpectedText), "ECU should be in running state"); 
  TestStepAddActionExpected( chActionText, chExpectedText );
  A_DBGR_BreakpointDeleteAll();
  
  snprintf( chActionText, elCount(chActionText), "Flash the Software and ECU is running "); 
  snprintf( chExpectedText, elCount(chExpectedText), "ECU should be in running state"); 
 
  A_DBGR_R();
  A_DBGR_Go();
  
  /***************************************************************************************************************/    
                                              // Test Step 1 Set a breakpoint at line TestCanTrcv_Getmode(void); in OS_Tasks.c file
  /***************************************************************************************************************/
  snprintf( chActionText, elCount(chActionText), "Set Breakpoint Os_Entry_Task_Core0_5ms\\13 callback function "); 
  snprintf( chExpectedText, elCount(chExpectedText), "Breakpoint is Set in Os_Entry_Task_Core0_5ms\\13"); 
  //TestStepAddActionExpected( chActionText, chExpectedText );   
  A_DBGR_BreakpointSet("Os_Entry_Task_Core0_5ms\\13");  
  
  
   /***************************************************************************************************************/    
                                              // Test Step 2 Run the debugger
  /***************************************************************************************************************/
  snprintf( chActionText, elCount(chActionText), "Run the software "); 
  snprintf( chExpectedText, elCount(chExpectedText), "ECU should be in running state"); 
  A_DBGR_Go();
  
  /***************************************************************************************************************/    
                                              // Test Step  Set a Channel_ID 1 and Channel_ID_B to 1 to call GetCNDD_e_CanTrcvOpMode(1U, &Getcantravmode);
  /***************************************************************************************************************/
  snprintf( chActionText, elCount(chActionText), "Configure Channel_ID variable"); 
  snprintf( chExpectedText, elCount(chExpectedText), "Verify TransferCount is configured as 1"); 
  //TestStepAddActionExpected( chActionText, chExpectedText );
  A_DBGR_VariableSet("Channel_ID","1");
  E_DBGR_VariableCheck("Channel_ID",1,Equal);
  
  snprintf( chActionText, elCount(chActionText), "Configure Channel_ID_B variable"); 
  snprintf( chExpectedText, elCount(chExpectedText), "Verify TransferCount is configured as 1"); 
  TestStepAddActionExpected( chActionText, chExpectedText );
  A_DBGR_VariableSet("Channel_ID_B","1");
  E_DBGR_VariableCheck("Channel_ID_B",1,Equal);
  
  
   /***************************************************************************************************************/    
                                              // Test Step 3 Wait for the breakpoint to hit
  /***************************************************************************************************************/
  snprintf( chActionText, elCount(chActionText), "Verify Breakpoint should hit in Os_Entry_Task_Core0_5ms\\13 "); 
  snprintf( chExpectedText, elCount(chExpectedText), "Breakpoint hit in Os_Entry_Task_Core0_5ms\\13 function"); 
  TestStepAddActionExpected( chActionText, chExpectedText );  
  E_DBGR_BreakpointCheckForHalt("Os_Entry_Task_Core0_5ms\\13");
  
  snprintf( chActionText, elCount(chActionText), "Flash the Software and ECU is running "); 
  snprintf( chExpectedText, elCount(chExpectedText), "ECU should be in running state"); 
  TestStepAddActionExpected( chActionText, chExpectedText );
  A_DBGR_BreakpointDeleteAll();
  
  /***************************************************************************************************************/    
                                              // Test Step 4 MCALUTIL_SFRWRITE(SPI_HW_MODULE[KernelId].MC.U, ((uint32)TransferCount<<IFX_QSPI_MC_MCOUNT_OFF));
  /***************************************************************************************************************/
  snprintf( chActionText, elCount(chActionText), "Set Breakpoint Spi_lQspiHWSetJobConfig\\18 callback function "); 
  snprintf( chExpectedText, elCount(chExpectedText), "Breakpoint is Set in Spi_lQspiHWSetJobConfig\\18"); 
  //TestStepAddActionExpected( chActionText, chExpectedText );   
  A_DBGR_BreakpointSet("Spi_lQspiHWSetJobConfig\\18");  
  
  /***************************************************************************************************************/    
                                              // Test Step 5 Run the debugger
  /***************************************************************************************************************/
  snprintf( chActionText, elCount(chActionText), "Run the software "); 
  snprintf( chExpectedText, elCount(chExpectedText), "ECU should be in running state"); 
  A_DBGR_Go();
  
   /***************************************************************************************************************/    
                                              // Test Step 6 Wait for the breakpoint to hit
  /***************************************************************************************************************/
  snprintf( chActionText, elCount(chActionText), "Verify Breakpoint should hit in Os_Entry_Task_Core0_5ms\\13 "); 
  snprintf( chExpectedText, elCount(chExpectedText), "Breakpoint hit in Os_Entry_Task_Core0_5ms\\13 function"); 
  //TestStepAddActionExpected( chActionText, chExpectedText );  
  E_DBGR_BreakpointCheckForHalt("Spi_lQspiHWSetJobConfig\\18");
  
  /***************************************************************************************************************/    
                                              // Test Step 7 set TransferCount variable to 5 to inject TxFIFO overflow fault.
  /***************************************************************************************************************/
  snprintf( chActionText, elCount(chActionText), "Configure TransferCount variable"); 
  snprintf( chExpectedText, elCount(chExpectedText), "Verify TransferCount is configured as 0"); 
  TestStepAddActionExpected( chActionText, chExpectedText );
  A_DBGR_VariableSet("TransferCount","5");
  E_DBGR_VariableCheck("TransferCount",5,Equal);
  
  snprintf( chActionText, elCount(chActionText), "Flash the Software and ECU is running "); 
  snprintf( chExpectedText, elCount(chExpectedText), "ECU should be in running state"); 
  TestStepAddActionExpected( chActionText, chExpectedText );
  A_DBGR_BreakpointDeleteAll();
  /***************************************************************************************************************/    
                                              // Test Step 8 Set a breakpoint at line TestCanTrcv_Getmode(void); in OS_Tasks.c file
  /***************************************************************************************************************/
  snprintf( chActionText, elCount(chActionText), "Set Breakpoint Os_Entry_Task_Core0_5ms\\14 callback function "); 
  snprintf( chExpectedText, elCount(chExpectedText), "Breakpoint is Set in Os_Entry_Task_Core0_5ms\\14"); 
  //TestStepAddActionExpected( chActionText, chExpectedText );   
  A_DBGR_BreakpointSet("Os_Entry_Task_Core0_5ms\\14");  
  
  
   /***************************************************************************************************************/    
                                              // Test Step 9 Run the debugger
  /***************************************************************************************************************/
  snprintf( chActionText, elCount(chActionText), "Run the software "); 
  snprintf( chExpectedText, elCount(chExpectedText), "ECU should be in running state"); 
  A_DBGR_Go();
  
   /***************************************************************************************************************/    
                                              // Test Step 10 Wait for the breakpoint to hit
  /***************************************************************************************************************/
  snprintf( chActionText, elCount(chActionText), "Verify Breakpoint should hit in Os_Entry_Task_Core0_5ms\\14 "); 
  snprintf( chExpectedText, elCount(chExpectedText), "Breakpoint hit in Os_Entry_Task_Core0_5ms\\14 function"); 
  //TestStepAddActionExpected( chActionText, chExpectedText );  
  E_DBGR_BreakpointCheckForHalt("Os_Entry_Task_Core0_5ms\\14");
  
  /***************************************************************************************************************/    
                                              // Test Step  Delete all Breakpoints
  /***************************************************************************************************************/
  snprintf( chActionText, elCount(chActionText), "Flash the Software and ECU is running "); 
  snprintf( chExpectedText, elCount(chExpectedText), "ECU should be in running state"); 
  TestStepAddActionExpected( chActionText, chExpectedText );
  A_DBGR_BreakpointDeleteAll();
  
  
  /***************************************************************************************************************/    
                                              // Test Step 11 Set Breakpoint Spi_lQspiSyncTransmitData32Bit\\24 callback function
  /***************************************************************************************************************/
  snprintf( chActionText, elCount(chActionText), "Set Breakpoint Spi_lQspiSyncTransmitData32Bit\\24 callback function "); 
  snprintf( chExpectedText, elCount(chExpectedText), "Breakpoint is Set in Spi_lQspiSyncTransmitData32Bit\\24"); 
  //TestStepAddActionExpected( chActionText, chExpectedText );   
  A_DBGR_BreakpointSet("Spi_lQspiSyncTransmitData32Bit\\24");  
  
  /***************************************************************************************************************/    
                                              // Test Step 12 Run the debugger
  /***************************************************************************************************************/
  snprintf( chActionText, elCount(chActionText), "Run the software "); 
  snprintf( chExpectedText, elCount(chExpectedText), "ECU should be in running state"); 
  A_DBGR_Go();
  
   /***************************************************************************************************************/    
                                              // Test Step 13 Wait for the breakpoint to hit
  /***************************************************************************************************************/
  snprintf( chActionText, elCount(chActionText), "Verify Breakpoint should hit in Spi_lQspiSyncTransmitData32Bit\\24 "); 
  snprintf( chExpectedText, elCount(chExpectedText), "Breakpoint hit in Spi_lQspiSyncTransmitData32Bit\\24 function"); 
  //TestStepAddActionExpected( chActionText, chExpectedText );  
  E_DBGR_BreakpointCheckForHalt("Spi_lQspiSyncTransmitData32Bit\\24");
  
  /***************************************************************************************************************/    
                                              // Test Step 14 set Timeout variable to 5 to inject TxFIFO overflow fault.
  /***************************************************************************************************************/
  snprintf( chActionText, elCount(chActionText), "Configure Timeout variable"); 
  snprintf( chExpectedText, elCount(chExpectedText), "Verify Timeout is configured as 0"); 
  TestStepAddActionExpected( chActionText, chExpectedText );
  A_DBGR_VariableSet("Timeout","0");
  E_DBGR_VariableCheck("Timeout",0,Equal);
  
  /***************************************************************************************************************/    
                                              // Test Step 15 Delete all Breakpoints
  /***************************************************************************************************************/
  snprintf( chActionText, elCount(chActionText), "Flash the Software and ECU is running "); 
  snprintf( chExpectedText, elCount(chExpectedText), "ECU should be in running state"); 
  TestStepAddActionExpected( chActionText, chExpectedText );
  A_DBGR_BreakpointDeleteAll();
  
   /***************************************************************************************************************/    
                                              // Test Step 16 Set a breakpoint at line BUS_ID = GetHWIO_e_BusID(void); inside function void Test_GetHWIO_e_BusID( void ) 
  /***************************************************************************************************************/
  snprintf( chActionText, elCount(chActionText), "Set Breakpoint Test_GetHWIO_e_BusID\\8 callback function "); 
  snprintf( chExpectedText, elCount(chExpectedText), "Breakpoint is Set in Test_GetHWIO_e_BusID\\8"); 
  //TestStepAddActionExpected( chActionText, chExpectedText );   
  A_DBGR_BreakpointSet("Test_GetHWIO_e_BusID\\8"); 
  
  /***************************************************************************************************************/    
                                              // Test Step 17 Run the debugger
  /***************************************************************************************************************/
  snprintf( chActionText, elCount(chActionText), "Run the software "); 
  snprintf( chExpectedText, elCount(chExpectedText), "ECU should be in running state"); 
  A_DBGR_Go();

  /***************************************************************************************************************/    
                                              // Test Step 18 Wait for the breakpoint to hit
  /***************************************************************************************************************/
  snprintf( chActionText, elCount(chActionText), "Verify Breakpoint should hit in Test_GetHWIO_e_BusID\\8 "); 
  snprintf( chExpectedText, elCount(chExpectedText), "Breakpoint hit in Test_GetHWIO_e_BusID\\8 function"); 
  //TestStepAddActionExpected( chActionText, chExpectedText );  
  E_DBGR_BreakpointCheckForHalt("Test_GetHWIO_e_BusID\\8");
  
  /***************************************************************************************************************/    
                                              // Test Step 19 	Verify BUS_ID value as 6.
  /***************************************************************************************************************/
  snprintf( chActionText, elCount(chActionText), "Configure BUSID variable"); 
  snprintf( chExpectedText, elCount(chExpectedText), "Verify BUSID is configured as 6"); 
  TestStepAddActionExpected( chActionText, chExpectedText );
  E_DBGR_VariableCheck("BUS_ID",6,Equal);


  
}

testcase Verify_bitwise_OR_operation_for_multiple_bus_faults_scenario_i_e_SPI_MCU_CAN2TCVR_CAN8TCVR_and_SPI_MCU_PMIC_TLF4D_scenario_4()
{
  /***************************************************************************************************************/    
                                                // Variable Definition
  /***************************************************************************************************************/ 
  

  
  /***************************************************************************************************************/    
                                               // Local Values
  /***************************************************************************************************************/ 
  

  
  /***************************************************************************************************************/    
                                              // Test Case Info
  /***************************************************************************************************************/
  setWriteDbgLevel(DebugOff);
  snprintf( chTestTitle, elCount(chTestTitle), "Verify_bitwise_OR_operation_for_multiple_bus_faults_scenario_i_e_SPI_MCU_CAN2TCVR_CAN8TCVR_and_SPI_MCU_PMIC_TLF4D_scenario_4" );
  snprintf( chTestDescription, elCount(chTestDescription), "Purpose:To check the GetHWIO_e_BusID interface ");
  TestCaseAddInfo( chTestTitle, "TC_L30SW_Q-37208092", chTestDescription );

  /***************************************************************************************************************/    
                                              // Test Step 0 PRECONDITIONS
  /***************************************************************************************************************/
  snprintf( chActionText, elCount(chActionText), "Flash the Software and ECU is running "); 
  snprintf( chExpectedText, elCount(chExpectedText), "ECU should be in running state"); 
  TestStepAddActionExpected( chActionText, chExpectedText );
  A_DBGR_BreakpointDeleteAll();
  
  snprintf( chActionText, elCount(chActionText), "Flash the Software and ECU is running "); 
  snprintf( chExpectedText, elCount(chExpectedText), "ECU should be in running state"); 
 
  A_DBGR_R();
  
  A_DBGR_Go();
  /***************************************************************************************************************/    
                                              // Test Step 1 Set a breakpoint at line TestCanTrcv_Getmode(void); in OS_Tasks.c file
  /***************************************************************************************************************/
  snprintf( chActionText, elCount(chActionText), "Set Breakpoint Os_Entry_Task_Core0_5ms\\13 callback function "); 
  snprintf( chExpectedText, elCount(chExpectedText), "Breakpoint is Set in Os_Entry_Task_Core0_5ms\\13"); 
  //TestStepAddActionExpected( chActionText, chExpectedText );   
  A_DBGR_BreakpointSet("Os_Entry_Task_Core0_5ms\\13");  
  
  
   /***************************************************************************************************************/    
                                              // Test Step 2 Run the debugger
  /***************************************************************************************************************/
  snprintf( chActionText, elCount(chActionText), "Run the software "); 
  snprintf( chExpectedText, elCount(chExpectedText), "ECU should be in running state"); 
  A_DBGR_Go();
  
   /***************************************************************************************************************/    
                                              // Test Step 3 Wait for the breakpoint to hit
  /***************************************************************************************************************/
  snprintf( chActionText, elCount(chActionText), "Verify Breakpoint should hit in Os_Entry_Task_Core0_5ms\\13 "); 
  snprintf( chExpectedText, elCount(chExpectedText), "Breakpoint hit in Os_Entry_Task_Core0_5ms\\13 function"); 
  //TestStepAddActionExpected( chActionText, chExpectedText );  
  E_DBGR_BreakpointCheckForHalt("Os_Entry_Task_Core0_5ms\\13");
  
  snprintf( chActionText, elCount(chActionText), "Flash the Software and ECU is running "); 
  snprintf( chExpectedText, elCount(chExpectedText), "ECU should be in running state"); 
  TestStepAddActionExpected( chActionText, chExpectedText );
  A_DBGR_BreakpointDeleteAll();
  /***************************************************************************************************************/    
                                              // Test Step 4 CAN_COMMAND_STATUS = GetCNDD_e_CanTrcvOpMode(0U, &Getcantravmode);
  /***************************************************************************************************************/
  snprintf( chActionText, elCount(chActionText), "Set Breakpoint TestCanTrcv_Getmode\\5 callback function "); 
  snprintf( chExpectedText, elCount(chExpectedText), "Breakpoint is Set in TestCanTrcv_Getmode\\5"); 
 // TestStepAddActionExpected( chActionText, chExpectedText );   
  A_DBGR_BreakpointSet("TestCanTrcv_Getmode\\5");  
  
  snprintf( chActionText, elCount(chActionText), "Run the software "); 
  snprintf( chExpectedText, elCount(chExpectedText), "ECU should be in running state"); 
  A_DBGR_Go();
  
  snprintf( chActionText, elCount(chActionText), "Verify Breakpoint should hit in Os_Entry_Task_Core0_5ms\\13 "); 
  snprintf( chExpectedText, elCount(chExpectedText), "Breakpoint hit in Os_Entry_Task_Core0_5ms\\13 function"); 
  //TestStepAddActionExpected( chActionText, chExpectedText );  
  E_DBGR_BreakpointCheckForHalt("TestCanTrcv_Getmode\\5");
  
  snprintf( chActionText, elCount(chActionText), "Flash the Software and ECU is running "); 
  snprintf( chExpectedText, elCount(chExpectedText), "ECU should be in running state"); 
  TestStepAddActionExpected( chActionText, chExpectedText );
  A_DBGR_BreakpointDeleteAll();
  /***************************************************************************************************************/    
                                              // Test Step 5 Set ChannelID_B to 1 to call GetCNDD_e_CanTrcvOpMode(1U, &Getcantravmode);
  /***************************************************************************************************************/

  snprintf( chActionText, elCount(chActionText), "Configure Channel_ID_B variable to invoke GetCNDD_e_CanTrcvOpMode interface"); 
  snprintf( chExpectedText, elCount(chExpectedText), "Verify Channel_ID_B is configured as 1"); 
  //TestStepAddActionExpected( chActionText, chExpectedText );
  A_DBGR_VariableSet("Channel_ID_B","1");
  E_DBGR_VariableCheck("Channel_ID_B",1,Equal);
  
  /***************************************************************************************************************/    
                                              // Test Step 6 MCALUTIL_SFRWRITE(SPI_HW_MODULE[KernelId].MC.U, ((uint32)TransferCount<<IFX_QSPI_MC_MCOUNT_OFF));
  /***************************************************************************************************************/
  snprintf( chActionText, elCount(chActionText), "Set Breakpoint Spi_lQspiHWSetJobConfig\\18 callback function "); 
  snprintf( chExpectedText, elCount(chExpectedText), "Breakpoint is Set in Spi_lQspiHWSetJobConfig\\18"); 
  TestStepAddActionExpected( chActionText, chExpectedText );   
  A_DBGR_BreakpointSet("Spi_lQspiHWSetJobConfig\\18");  
  
  /***************************************************************************************************************/    
                                              // Test Step 7 Run the debugger
  /***************************************************************************************************************/
  snprintf( chActionText, elCount(chActionText), "Run the software "); 
  snprintf( chExpectedText, elCount(chExpectedText), "ECU should be in running state"); 
  A_DBGR_Go();
  
   /***************************************************************************************************************/    
                                              // Test Step 8 Wait for the breakpoint to hit
  /***************************************************************************************************************/
  snprintf( chActionText, elCount(chActionText), "Verify Breakpoint should hit in Os_Entry_Task_Core0_5ms\\13 "); 
  snprintf( chExpectedText, elCount(chExpectedText), "Breakpoint hit in Os_Entry_Task_Core0_5ms\\13 function"); 
  //TestStepAddActionExpected( chActionText, chExpectedText );  
  E_DBGR_BreakpointCheckForHalt("Spi_lQspiHWSetJobConfig\\18");
  
  snprintf( chActionText, elCount(chActionText), "Flash the Software and ECU is running "); 
  snprintf( chExpectedText, elCount(chExpectedText), "ECU should be in running state"); 
  TestStepAddActionExpected( chActionText, chExpectedText );
  A_DBGR_BreakpointDeleteAll();
  
  /***************************************************************************************************************/    
                                              // Test Step 9 set TransferCount variable to 5 to inject TxFIFO overflow fault.
  /***************************************************************************************************************/
  snprintf( chActionText, elCount(chActionText), "Configure TransferCount variable"); 
  snprintf( chExpectedText, elCount(chExpectedText), "Verify TransferCount is configured as 0"); 
  //TestStepAddActionExpected( chActionText, chExpectedText );
  A_DBGR_VariableSet("TransferCount","5");
  E_DBGR_VariableCheck("TransferCount",5,Equal);
  
  /***************************************************************************************************************/    
                                              // Test Step 10 CAN_COMMAND_STATUS = GetCNDD_e_CanTrcvOpMode(1U, &Getcantravmode);
  /***************************************************************************************************************/
  snprintf( chActionText, elCount(chActionText), "Set Breakpoint TestCanTrcv_Getmode\\10 callback function "); 
  snprintf( chExpectedText, elCount(chExpectedText), "Breakpoint is Set in TestCanTrcv_Getmode\\10"); 
  TestStepAddActionExpected( chActionText, chExpectedText );   
  A_DBGR_BreakpointSet("TestCanTrcv_Getmode\\10");  
  
  /***************************************************************************************************************/    
                                              // Test Step 11  Run the debugger
  /***************************************************************************************************************/
  snprintf( chActionText, elCount(chActionText), "Run the software "); 
  snprintf( chExpectedText, elCount(chExpectedText), "ECU should be in running state"); 
  A_DBGR_Go();
  
  snprintf( chActionText, elCount(chActionText), "Verify Breakpoint should hit in Os_Entry_Task_Core0_5ms\\13 "); 
  snprintf( chExpectedText, elCount(chExpectedText), "Breakpoint hit in Os_Entry_Task_Core0_5ms\\13 function"); 
  //TestStepAddActionExpected( chActionText, chExpectedText );  
  E_DBGR_BreakpointCheckForHalt("TestCanTrcv_Getmode\\10");
  
   snprintf( chActionText, elCount(chActionText), "Flash the Software and ECU is running "); 
  snprintf( chExpectedText, elCount(chExpectedText), "ECU should be in running state"); 
  TestStepAddActionExpected( chActionText, chExpectedText );
  A_DBGR_BreakpointDeleteAll();
  
  /***************************************************************************************************************/    
                                              // Test Step 12 MCALUTIL_SFRWRITE(SPI_HW_MODULE[KernelId].MC.U, ((uint32)TransferCount<<IFX_QSPI_MC_MCOUNT_OFF));
  /***************************************************************************************************************/
  snprintf( chActionText, elCount(chActionText), "Set Breakpoint Spi_lQspiHWSetJobConfig\\18 callback function "); 
  snprintf( chExpectedText, elCount(chExpectedText), "Breakpoint is Set in Spi_lQspiHWSetJobConfig\\18"); 
  //TestStepAddActionExpected( chActionText, chExpectedText );   
  A_DBGR_BreakpointSet("Spi_lQspiHWSetJobConfig\\18");  
  
  /***************************************************************************************************************/    
                                              // Test Step 13 Run the debugger
  /***************************************************************************************************************/
  snprintf( chActionText, elCount(chActionText), "Run the software "); 
  snprintf( chExpectedText, elCount(chExpectedText), "ECU should be in running state"); 
  A_DBGR_Go();
  
   /***************************************************************************************************************/    
                                              // Test Step 14 Wait for the breakpoint to hit
  /***************************************************************************************************************/
  snprintf( chActionText, elCount(chActionText), "Verify Breakpoint should hit in Os_Entry_Task_Core0_5ms\\13 "); 
  snprintf( chExpectedText, elCount(chExpectedText), "Breakpoint hit in Os_Entry_Task_Core0_5ms\\13 function"); 
  //TestStepAddActionExpected( chActionText, chExpectedText );  
  E_DBGR_BreakpointCheckForHalt("Spi_lQspiHWSetJobConfig\\18");
  
  snprintf( chActionText, elCount(chActionText), "Flash the Software and ECU is running "); 
  snprintf( chExpectedText, elCount(chExpectedText), "ECU should be in running state"); 
  TestStepAddActionExpected( chActionText, chExpectedText );
  A_DBGR_BreakpointDeleteAll();
  /***************************************************************************************************************/    
                                              // Test Step 15 set TransferCount variable to 5 to inject TxFIFO overflow fault.
  /***************************************************************************************************************/
  snprintf( chActionText, elCount(chActionText), "Configure TransferCount variable"); 
  snprintf( chExpectedText, elCount(chExpectedText), "Verify TransferCount is configured as 0"); 
  //TestStepAddActionExpected( chActionText, chExpectedText );
  A_DBGR_VariableSet("TransferCount","5");
  E_DBGR_VariableCheck("TransferCount",5,Equal);
   
  snprintf( chActionText, elCount(chActionText), "Flash the Software and ECU is running "); 
  snprintf( chExpectedText, elCount(chExpectedText), "ECU should be in running state"); 
  TestStepAddActionExpected( chActionText, chExpectedText );
  A_DBGR_BreakpointDeleteAll();
  /***************************************************************************************************************/    
                                              // Test Step 8 Set a breakpoint at line TestCanTrcv_Getmode(void); in OS_Tasks.c file
  /***************************************************************************************************************/
  snprintf( chActionText, elCount(chActionText), "Set Breakpoint Os_Entry_Task_Core0_5ms\\14 callback function "); 
  snprintf( chExpectedText, elCount(chExpectedText), "Breakpoint is Set in Os_Entry_Task_Core0_5ms\\14"); 
  //TestStepAddActionExpected( chActionText, chExpectedText );   
  A_DBGR_BreakpointSet("Os_Entry_Task_Core0_5ms\\14");  
  
  
   /***************************************************************************************************************/    
                                              // Test Step 9 Run the debugger
  /***************************************************************************************************************/
  snprintf( chActionText, elCount(chActionText), "Run the software "); 
  snprintf( chExpectedText, elCount(chExpectedText), "ECU should be in running state"); 
  A_DBGR_Go();
  
   /***************************************************************************************************************/    
                                              // Test Step 10 Wait for the breakpoint to hit
  /***************************************************************************************************************/
  snprintf( chActionText, elCount(chActionText), "Verify Breakpoint should hit in Os_Entry_Task_Core0_5ms\\14 "); 
  snprintf( chExpectedText, elCount(chExpectedText), "Breakpoint hit in Os_Entry_Task_Core0_5ms\\14 function"); 
  //TestStepAddActionExpected( chActionText, chExpectedText );  
  E_DBGR_BreakpointCheckForHalt("Os_Entry_Task_Core0_5ms\\14");
  
  /***************************************************************************************************************/    
                                              // Test Step  Delete all Breakpoints
  /***************************************************************************************************************/
  snprintf( chActionText, elCount(chActionText), "Flash the Software and ECU is running "); 
  snprintf( chExpectedText, elCount(chExpectedText), "ECU should be in running state"); 
  TestStepAddActionExpected( chActionText, chExpectedText );
  A_DBGR_BreakpointDeleteAll();
  
  
  /***************************************************************************************************************/    
                                              // Test Step 11 Set Breakpoint Spi_lQspiSyncTransmitData32Bit\\24 callback function
  /***************************************************************************************************************/
  snprintf( chActionText, elCount(chActionText), "Set Breakpoint Spi_lQspiSyncTransmitData32Bit\\24 callback function "); 
  snprintf( chExpectedText, elCount(chExpectedText), "Breakpoint is Set in Spi_lQspiSyncTransmitData32Bit\\24"); 
  //TestStepAddActionExpected( chActionText, chExpectedText );   
  A_DBGR_BreakpointSet("Spi_lQspiSyncTransmitData32Bit\\24");  
  
  /***************************************************************************************************************/    
                                              // Test Step 12 Run the debugger
  /***************************************************************************************************************/
  snprintf( chActionText, elCount(chActionText), "Run the software "); 
  snprintf( chExpectedText, elCount(chExpectedText), "ECU should be in running state"); 
  A_DBGR_Go();
  
   /***************************************************************************************************************/    
                                              // Test Step 13 Wait for the breakpoint to hit
  /***************************************************************************************************************/
  snprintf( chActionText, elCount(chActionText), "Verify Breakpoint should hit in Spi_lQspiSyncTransmitData32Bit\\24 "); 
  snprintf( chExpectedText, elCount(chExpectedText), "Breakpoint hit in Spi_lQspiSyncTransmitData32Bit\\24 function"); 
  //TestStepAddActionExpected( chActionText, chExpectedText );  
  E_DBGR_BreakpointCheckForHalt("Spi_lQspiSyncTransmitData32Bit\\24");
  
  /***************************************************************************************************************/    
                                              // Test Step 14 set Timeout variable to 5 to inject TxFIFO overflow fault.
  /***************************************************************************************************************/
  snprintf( chActionText, elCount(chActionText), "Configure Timeout variable"); 
  snprintf( chExpectedText, elCount(chExpectedText), "Verify Timeout is configured as 0"); 
  TestStepAddActionExpected( chActionText, chExpectedText );
  A_DBGR_VariableSet("Timeout","0");
  E_DBGR_VariableCheck("Timeout",0,Equal);
  
  
  /***************************************************************************************************************/    
                                              // Test Step 14 Delete all Breakpoints
  /***************************************************************************************************************/
  snprintf( chActionText, elCount(chActionText), "Flash the Software and ECU is running "); 
  snprintf( chExpectedText, elCount(chExpectedText), "ECU should be in running state"); 
  TestStepAddActionExpected( chActionText, chExpectedText );
  A_DBGR_BreakpointDeleteAll();
  
   /***************************************************************************************************************/    
                                              // Test Step 15 Set a breakpoint at line BUS_ID = GetHWIO_e_BusID(void); inside function void Test_GetHWIO_e_BusID( void ) 
  /***************************************************************************************************************/
  snprintf( chActionText, elCount(chActionText), "Set Breakpoint Test_GetHWIO_e_BusID\\8 callback function "); 
  snprintf( chExpectedText, elCount(chExpectedText), "Breakpoint is Set in Test_GetHWIO_e_BusID\\8"); 
  //TestStepAddActionExpected( chActionText, chExpectedText );   
  A_DBGR_BreakpointSet("Test_GetHWIO_e_BusID\\8"); 
  
  /***************************************************************************************************************/    
                                              // Test Step 16 Run the debugger
  /***************************************************************************************************************/
  snprintf( chActionText, elCount(chActionText), "Run the software "); 
  snprintf( chExpectedText, elCount(chExpectedText), "ECU should be in running state"); 
  A_DBGR_Go();

  /***************************************************************************************************************/    
                                              // Test Step 17 Wait for the breakpoint to hit
  /***************************************************************************************************************/
  snprintf( chActionText, elCount(chActionText), "Verify Breakpoint should hit in Test_GetHWIO_e_BusID\\8 "); 
  snprintf( chExpectedText, elCount(chExpectedText), "Breakpoint hit in Test_GetHWIO_e_BusID\\8 function"); 
  //TestStepAddActionExpected( chActionText, chExpectedText );  
  E_DBGR_BreakpointCheckForHalt("Test_GetHWIO_e_BusID\\8");
  
  /***************************************************************************************************************/    
                                              // Test Step 18 	Verify BUS_ID value as 7.
  /***************************************************************************************************************/
  snprintf( chActionText, elCount(chActionText), "Configure BUSID variable"); 
  snprintf( chExpectedText, elCount(chExpectedText), "Verify BUSID is configured as 7"); 
  TestStepAddActionExpected( chActionText, chExpectedText );
  E_DBGR_VariableCheck("BUS_ID",7,Equal);

  
  
}

testcase Verify_default_value_of_BUS_DEVICE_ID_parameter()
{
  /***************************************************************************************************************/    
                                                // Variable Definition
  /***************************************************************************************************************/ 
  

  
  /***************************************************************************************************************/    
                                               // Local Values
  /***************************************************************************************************************/ 
  

  
  /***************************************************************************************************************/    
                                              // Test Case Info
  /***************************************************************************************************************/
  setWriteDbgLevel(DebugOff);
  snprintf( chTestTitle, elCount(chTestTitle), "Verify_default_value_of_BUS_DEVICE_ID_parameter" );
  snprintf( chTestDescription, elCount(chTestDescription), "Purpose:To check the GetHWIO_e_BusDeviceID interface ");
  TestCaseAddInfo( chTestTitle, "TC_L30SW_Q-36629485", chTestDescription );

  /***************************************************************************************************************/    
                                              // Start of Test Case
  /***************************************************************************************************************/
  
  /***************************************************************************************************************/    
                                              // Test Step 0 PRECONDITIONS
  /***************************************************************************************************************/
  snprintf( chActionText, elCount(chActionText), "Flash the Software and ECU is running "); 
  snprintf( chExpectedText, elCount(chExpectedText), "ECU should be in running state"); 
  TestStepAddActionExpected( chActionText, chExpectedText );
  A_DBGR_BreakpointDeleteAll();
  
  snprintf( chActionText, elCount(chActionText), "Flash the Software and ECU is running "); 
  snprintf( chExpectedText, elCount(chExpectedText), "ECU should be in running state"); 
 
  A_DBGR_R();
  A_DBGR_Go();
  /***************************************************************************************************************/    
                                              // Test Step 1 	Set a breakpoint at line BUS_DEVICE_ID = GetHWIO_e_BusDeviceID(void); inside function void Test_GetHWIO_e_BusDeviceID( void )
  /***************************************************************************************************************/
  snprintf( chActionText, elCount(chActionText), "Set Breakpoint Test_GetHWIO_e_BusID callback function "); 
  snprintf( chExpectedText, elCount(chExpectedText), "Breakpoint is Set in Test_GetHWIO_e_BusID"); 
  //TestStepAddActionExpected( chActionText, chExpectedText );   
  A_DBGR_BreakpointSet("Test_GetHWIO_e_BusDeviceID\\11");  
  
   /***************************************************************************************************************/    
                                              // Test Step 2 Run the debugger
  /***************************************************************************************************************/
  snprintf( chActionText, elCount(chActionText), "Run the software "); 
  snprintf( chExpectedText, elCount(chExpectedText), "ECU should be in running state"); 
  A_DBGR_Go();
  
   /***************************************************************************************************************/    
                                              // Test Step 3 Wait for the breakpoint to hit
  /***************************************************************************************************************/
 
  
  snprintf( chActionText, elCount(chActionText), "Verify Breakpoint should hit in Test_GetHWIO_e_BusDeviceID "); 
  snprintf( chExpectedText, elCount(chExpectedText), "Breakpoint hit in Test_GetHWIO_e_BusDeviceID function"); 
  //TestStepAddActionExpected( chActionText, chExpectedText );  
  E_DBGR_BreakpointCheckForHalt("Test_GetHWIO_e_BusDeviceID\\11");
  
  /***************************************************************************************************************/    
                                              // Test Step 3 verify BUS_DEVICE_ID is having 0.
  /***************************************************************************************************************/
  snprintf( chActionText, elCount(chActionText), "Configure BUS_DEVICE_ID variable"); 
  snprintf( chExpectedText, elCount(chExpectedText), "Verify BUS_DEVICE_ID is configured as 0"); 
  TestStepAddActionExpected( chActionText, chExpectedText );
  E_DBGR_VariableCheck("BUS_DEVICE_ID",0,Equal);
  
  
}

testcase Verify_GetHWIO_e_BusDeviceID_function_returns_correct_values()
{
    /***************************************************************************************************************/    
                                                // Variable Definition
  /***************************************************************************************************************/ 
  

  
  /***************************************************************************************************************/    
                                               // Local Values
  /***************************************************************************************************************/ 
  

  
  /***************************************************************************************************************/    
                                              // Test Case Info
  /***************************************************************************************************************/
  setWriteDbgLevel(DebugOff);
  snprintf( chTestTitle, elCount(chTestTitle), "Verify_GetHWIO_e_BusDeviceID_function_returns_correct_values" );
  snprintf( chTestDescription, elCount(chTestDescription), "Purpose:To check the GetHWIO_e_BusDeviceID interface ");
  TestCaseAddInfo( chTestTitle, "TC_L30SW_Q-36629486", chTestDescription );

  /***************************************************************************************************************/    
                                              // Start of Test Case
  /***************************************************************************************************************/
  
  /***************************************************************************************************************/    
                                              // Test Step 0 PRECONDITIONS
  /***************************************************************************************************************/
  snprintf( chActionText, elCount(chActionText), "Flash the Software and ECU is running "); 
  snprintf( chExpectedText, elCount(chExpectedText), "ECU should be in running state"); 
  TestStepAddActionExpected( chActionText, chExpectedText );
  A_DBGR_BreakpointDeleteAll();
  
  snprintf( chActionText, elCount(chActionText), "Flash the Software and ECU is running "); 
  snprintf( chExpectedText, elCount(chExpectedText), "ECU should be in running state"); 
 
  A_DBGR_R();
  
  A_DBGR_Go();
  /***************************************************************************************************************/    
                                              // Test Step 1 Set a breakpoint at line TestCanTrcv_Getmode(void); in OS_Tasks.c file
  /***************************************************************************************************************/
  snprintf( chActionText, elCount(chActionText), "Set Breakpoint Os_Entry_Task_Core0_5ms\\13 callback function "); 
  snprintf( chExpectedText, elCount(chExpectedText), "Breakpoint is Set in Os_Entry_Task_Core0_5ms\\13"); 
  //TestStepAddActionExpected( chActionText, chExpectedText );   
  A_DBGR_BreakpointSet("Os_Entry_Task_Core0_5ms\\13");  
  
  
   /***************************************************************************************************************/    
                                              // Test Step 2 Run the debugger
  /***************************************************************************************************************/
  snprintf( chActionText, elCount(chActionText), "Run the software "); 
  snprintf( chExpectedText, elCount(chExpectedText), "ECU should be in running state"); 
  A_DBGR_Go();
  
   /***************************************************************************************************************/    
                                              // Test Step 3 Wait for the breakpoint to hit
  /***************************************************************************************************************/
  snprintf( chActionText, elCount(chActionText), "Verify Breakpoint should hit in Os_Entry_Task_Core0_5ms\\13 "); 
  snprintf( chExpectedText, elCount(chExpectedText), "Breakpoint hit in Os_Entry_Task_Core0_5ms\\13 function"); 
  //TestStepAddActionExpected( chActionText, chExpectedText );  
  E_DBGR_BreakpointCheckForHalt("Os_Entry_Task_Core0_5ms\\13");
  
  snprintf( chActionText, elCount(chActionText), "Flash the Software and ECU is running "); 
  snprintf( chExpectedText, elCount(chExpectedText), "ECU should be in running state"); 
  TestStepAddActionExpected( chActionText, chExpectedText );
  A_DBGR_BreakpointDeleteAll();
  /***************************************************************************************************************/    
                                              // Test Step 4 MCALUTIL_SFRWRITE(SPI_HW_MODULE[KernelId].MC.U, ((uint32)TransferCount<<IFX_QSPI_MC_MCOUNT_OFF));
  /***************************************************************************************************************/
  snprintf( chActionText, elCount(chActionText), "Set Breakpoint Spi_lQspiHWSetJobConfig\\18 callback function "); 
  snprintf( chExpectedText, elCount(chExpectedText), "Breakpoint is Set in Spi_lQspiHWSetJobConfig\\18"); 
  //TestStepAddActionExpected( chActionText, chExpectedText );   
  A_DBGR_BreakpointSet("Spi_lQspiHWSetJobConfig\\18");  
  
   /***************************************************************************************************************/    
                                              // Test Step 5 Run the debugger
  /***************************************************************************************************************/
  snprintf( chActionText, elCount(chActionText), "Run the software "); 
  snprintf( chExpectedText, elCount(chExpectedText), "ECU should be in running state"); 
  A_DBGR_Go();
  
   /***************************************************************************************************************/    
                                              // Test Step 6 Wait for the breakpoint to hit
  /***************************************************************************************************************/
  snprintf( chActionText, elCount(chActionText), "Verify Breakpoint should hit in Os_Entry_Task_Core0_5ms\\13 "); 
  snprintf( chExpectedText, elCount(chExpectedText), "Breakpoint hit in Os_Entry_Task_Core0_5ms\\13 function"); 
  //TestStepAddActionExpected( chActionText, chExpectedText );  
  E_DBGR_BreakpointCheckForHalt("Spi_lQspiHWSetJobConfig\\18");
  
  /***************************************************************************************************************/    
                                              // Test Step 7 set TransferCount variable to 5 to inject TxFIFO overflow fault.
  /***************************************************************************************************************/
  snprintf( chActionText, elCount(chActionText), "Configure TransferCount variable"); 
  snprintf( chExpectedText, elCount(chExpectedText), "Verify TransferCount is configured as 0"); 
  TestStepAddActionExpected( chActionText, chExpectedText );
  A_DBGR_VariableSet("TransferCount","5");
  E_DBGR_VariableCheck("TransferCount",5,Equal);
  
  /***************************************************************************************************************/    
                                              // Test Step 8 Delete all Breakpoints
  /***************************************************************************************************************/
  snprintf( chActionText, elCount(chActionText), "Flash the Software and ECU is running "); 
  snprintf( chExpectedText, elCount(chExpectedText), "ECU should be in running state"); 
  TestStepAddActionExpected( chActionText, chExpectedText );
  A_DBGR_BreakpointDeleteAll();
  
   /***************************************************************************************************************/    
                                              // Test Step 9 Set a breakpoint at line BUS_DEVICE_ID = GetHWIO_e_BusDeviceID(void); inside function void Test_GetHWIO_e_BusDeviceID( void ) 
  /***************************************************************************************************************/
  snprintf( chActionText, elCount(chActionText), "Set Breakpoint Test_GetHWIO_e_BusDeviceID\\8 callback function "); 
  snprintf( chExpectedText, elCount(chExpectedText), "Breakpoint is Set in Test_GetHWIO_e_BusDeviceID\\8"); 
  //TestStepAddActionExpected( chActionText, chExpectedText );   
  A_DBGR_BreakpointSet("Test_GetHWIO_e_BusDeviceID\\8"); 
  
  /***************************************************************************************************************/    
                                              // Test Step 10 Run the debugger
  /***************************************************************************************************************/
  snprintf( chActionText, elCount(chActionText), "Run the software "); 
  snprintf( chExpectedText, elCount(chExpectedText), "ECU should be in running state"); 
  A_DBGR_Go();

  /***************************************************************************************************************/    
                                              // Test Step 11 Wait for the breakpoint to hit
  /***************************************************************************************************************/
  snprintf( chActionText, elCount(chActionText), "Verify Breakpoint should hit in Test_GetHWIO_e_BusDeviceID\\8 "); 
  snprintf( chExpectedText, elCount(chExpectedText), "Breakpoint hit in Test_GetHWIO_e_BusDeviceID\\8 function"); 
  //TestStepAddActionExpected( chActionText, chExpectedText );  
  E_DBGR_BreakpointCheckForHalt("Test_GetHWIO_e_BusDeviceID\\8");
  
  /***************************************************************************************************************/    
                                              // Test Step 12 	Verify BUS_DEVICE_ID value as 0 to 7.
  /***************************************************************************************************************/
  snprintf( chActionText, elCount(chActionText), "Configure BUSID variable"); 
  snprintf( chExpectedText, elCount(chExpectedText), "Verify BUSID is configured as 1"); 
  TestStepAddActionExpected( chActionText, chExpectedText );
  E_DBGR_VariableCheck("BUS_DEVICE_ID",0,Greater);

  snprintf( chActionText, elCount(chActionText), "Flash the Software and ECU is running "); 
  snprintf( chExpectedText, elCount(chExpectedText), "ECU should be in running state"); 
  TestStepAddActionExpected( chActionText, chExpectedText );
  A_DBGR_BreakpointDeleteAll();
  /***************************************************************************************************************/    
                                              // Test Step 13 	Set a breakpoint at line BUS_DEVICE_ID = GetHWIO_e_BusDeviceID(void); inside function void Test_GetHWIO_e_BusDeviceID( void )
  /***************************************************************************************************************/
  snprintf( chActionText, elCount(chActionText), "Set Breakpoint Test_GetHWIO_e_BusDeviceID callback function "); 
  snprintf( chExpectedText, elCount(chExpectedText), "Breakpoint is Set in Test_GetHWIO_e_BusDeviceID"); 
  //TestStepAddActionExpected( chActionText, chExpectedText );   
  A_DBGR_BreakpointSet("Test_GetHWIO_e_BusDeviceID\\11");  
  
    /***************************************************************************************************************/    
                                              // Test Step 14 Run the debugger
  /***************************************************************************************************************/
  snprintf( chActionText, elCount(chActionText), "Run the software "); 
  snprintf( chExpectedText, elCount(chExpectedText), "ECU should be in running state"); 
  A_DBGR_Go();
  
  
   /***************************************************************************************************************/    
                                              // Test Step 15 Wait for the breakpoint to hit
  /***************************************************************************************************************/
 
  
  snprintf( chActionText, elCount(chActionText), "Verify Breakpoint should hit in Test_GetHWIO_e_BusDeviceID "); 
  snprintf( chExpectedText, elCount(chExpectedText), "Breakpoint hit in Test_GetHWIO_e_BusDeviceID function"); 
  //TestStepAddActionExpected( chActionText, chExpectedText );  
  E_DBGR_BreakpointCheckForHalt("Test_GetHWIO_e_BusDeviceID\\11");
  
  /***************************************************************************************************************/    
                                              // Test Step 16 verify BUS_DEVICE_ID is having 0.
  /***************************************************************************************************************/
  snprintf( chActionText, elCount(chActionText), "Configure BUS_DEVICE_ID variable"); 
  snprintf( chExpectedText, elCount(chExpectedText), "Verify BUS_DEVICE_ID is configured as 0"); 
  TestStepAddActionExpected( chActionText, chExpectedText );
  E_DBGR_VariableCheck("BUS_DEVICE_ID",0,Equal);
}

testcase Verify_BUS_DEVICE_ID_is_set_to_No_Device_Error_during_Reset_Initialization()
{
    /***************************************************************************************************************/    
                                                // Variable Definition
  /***************************************************************************************************************/ 
  

  
  /***************************************************************************************************************/    
                                               // Local Values
  /***************************************************************************************************************/ 
  

  
  /***************************************************************************************************************/    
                                              // Test Case Info
  /***************************************************************************************************************/
  setWriteDbgLevel(DebugOff);
  snprintf( chTestTitle, elCount(chTestTitle), "Verify_BUS_DEVICE_ID_is_set_to_No_Device_Error_during_Reset_Initialization" );
  snprintf( chTestDescription, elCount(chTestDescription), "Purpose:To check the GetHWIO_e_BusDeviceID interface ");
  TestCaseAddInfo( chTestTitle, "TC_L30SW_Q-36629487", chTestDescription );

  /***************************************************************************************************************/    
                                              // Start of Test Case
  /***************************************************************************************************************/
  
  /***************************************************************************************************************/    
                                              // Test Step 0 PRECONDITIONS
  /***************************************************************************************************************/
  snprintf( chActionText, elCount(chActionText), "Flash the Software and ECU is running "); 
  snprintf( chExpectedText, elCount(chExpectedText), "ECU should be in running state"); 
  TestStepAddActionExpected( chActionText, chExpectedText );
  A_DBGR_BreakpointDeleteAll();
  
  snprintf( chActionText, elCount(chActionText), "Flash the Software and ECU is running "); 
  snprintf( chExpectedText, elCount(chExpectedText), "ECU should be in running state"); 
 
  A_DBGR_R();
  A_DBGR_Go();
  /***************************************************************************************************************/    
                                              // Test Step 1 	Set a breakpoint at line BUS_DEVICE_ID =GetHWIO_e_BusDeviceID(void); inside function void Test_GetHWIO_e_BusDeviceID( void )
  /***************************************************************************************************************/
  snprintf( chActionText, elCount(chActionText), "Set Breakpoint Test_GetHWIO_e_BusDeviceID callback function "); 
  snprintf( chExpectedText, elCount(chExpectedText), "Breakpoint is Set in Test_GetHWIO_e_BusDeviceID"); 
  //TestStepAddActionExpected( chActionText, chExpectedText );   
  A_DBGR_BreakpointSet("Test_GetHWIO_e_BusDeviceID\\11");  
  
   /***************************************************************************************************************/    
                                              // Test Step 2 Run the debugger
  /***************************************************************************************************************/
  snprintf( chActionText, elCount(chActionText), "Run the software "); 
  snprintf( chExpectedText, elCount(chExpectedText), "ECU should be in running state"); 
  A_DBGR_Go();
  
   /***************************************************************************************************************/    
                                              // Test Step 3 Wait for the breakpoint to hit
  /***************************************************************************************************************/
 
  
  snprintf( chActionText, elCount(chActionText), "Verify Breakpoint should hit in Test_GetHWIO_e_BusDeviceID "); 
  snprintf( chExpectedText, elCount(chExpectedText), "Breakpoint hit in Test_GetHWIO_e_BusDeviceID function"); 
  //TestStepAddActionExpected( chActionText, chExpectedText );  
  E_DBGR_BreakpointCheckForHalt("Test_GetHWIO_e_BusDeviceID\\11");
  
  /***************************************************************************************************************/    
                                              // Test Step 3 verify BUS_DEVICE_ID is having 0.
  /***************************************************************************************************************/
  snprintf( chActionText, elCount(chActionText), "Configure BUS_DEVICE_ID variable"); 
  snprintf( chExpectedText, elCount(chExpectedText), "Verify BUS_DEVICE_ID is configured as 0"); 
  TestStepAddActionExpected( chActionText, chExpectedText );
  E_DBGR_VariableCheck("BUS_DEVICE_ID",0,Equal);
  

}

testcase Verify_bitwise_OR_operation_for_multiple_device_faults_ie_CAN2TCVR_and_CAN8TCVR_scenario_1()
{
   /***************************************************************************************************************/    
                                                // Variable Definition
  /***************************************************************************************************************/ 
  

  
  /***************************************************************************************************************/    
                                               // Local Values
  /***************************************************************************************************************/ 
  

  
  /***************************************************************************************************************/    
                                              // Test Case Info
  /***************************************************************************************************************/
  setWriteDbgLevel(DebugOff);
  snprintf( chTestTitle, elCount(chTestTitle), "Verify_bitwise_OR_operation_for_multiple_device_faults_ie_CAN2TCVR_and_CAN8TCVR_scenario_1" );
  snprintf( chTestDescription, elCount(chTestDescription), "Purpose:To check the GetHWIO_e_BusDeviceID interface ");
  TestCaseAddInfo( chTestTitle, "TC_L30SW_Q-37207962", chTestDescription );

  /***************************************************************************************************************/    
                                              // Test Step 0 PRECONDITIONS
  /***************************************************************************************************************/
  snprintf( chActionText, elCount(chActionText), "Flash the Software and ECU is running "); 
  snprintf( chExpectedText, elCount(chExpectedText), "ECU should be in running state"); 
  TestStepAddActionExpected( chActionText, chExpectedText );
  A_DBGR_BreakpointDeleteAll();
  
  snprintf( chActionText, elCount(chActionText), "Flash the Software and ECU is running "); 
  snprintf( chExpectedText, elCount(chExpectedText), "ECU should be in running state"); 
 
  A_DBGR_R();
  
  A_DBGR_Go();
/***************************************************************************************************************/    
                                              // Test Step 1 Set a breakpoint at line TestCanTrcv_Getmode(void); in OS_Tasks.c file
  /***************************************************************************************************************/
  snprintf( chActionText, elCount(chActionText), "Set Breakpoint Os_Entry_Task_Core0_5ms\\13 callback function "); 
  snprintf( chExpectedText, elCount(chExpectedText), "Breakpoint is Set in Os_Entry_Task_Core0_5ms\\13"); 
  //TestStepAddActionExpected( chActionText, chExpectedText );   
  A_DBGR_BreakpointSet("Os_Entry_Task_Core0_5ms\\13");  
  
  
   /***************************************************************************************************************/    
                                              // Test Step 2 Run the debugger
  /***************************************************************************************************************/
  snprintf( chActionText, elCount(chActionText), "Run the software "); 
  snprintf( chExpectedText, elCount(chExpectedText), "ECU should be in running state"); 
  A_DBGR_Go();
  
   /***************************************************************************************************************/    
                                              // Test Step 3 Wait for the breakpoint to hit
  /***************************************************************************************************************/
  snprintf( chActionText, elCount(chActionText), "Verify Breakpoint should hit in Os_Entry_Task_Core0_5ms\\13 "); 
  snprintf( chExpectedText, elCount(chExpectedText), "Breakpoint hit in Os_Entry_Task_Core0_5ms\\13 function"); 
  //TestStepAddActionExpected( chActionText, chExpectedText );  
  E_DBGR_BreakpointCheckForHalt("Os_Entry_Task_Core0_5ms\\13");
  
  snprintf( chActionText, elCount(chActionText), "Flash the Software and ECU is running "); 
  snprintf( chExpectedText, elCount(chExpectedText), "ECU should be in running state"); 
  TestStepAddActionExpected( chActionText, chExpectedText );
  A_DBGR_BreakpointDeleteAll();
  /***************************************************************************************************************/    
                                              // Test Step 4 CAN_COMMAND_STATUS = GetCNDD_e_CanTrcvOpMode(0U, &Getcantravmode);
  /***************************************************************************************************************/
  snprintf( chActionText, elCount(chActionText), "Set Breakpoint TestCanTrcv_Getmode\\5 callback function "); 
  snprintf( chExpectedText, elCount(chExpectedText), "Breakpoint is Set in TestCanTrcv_Getmode\\5"); 
 // TestStepAddActionExpected( chActionText, chExpectedText );   
  A_DBGR_BreakpointSet("TestCanTrcv_Getmode\\5");  
  
  snprintf( chActionText, elCount(chActionText), "Run the software "); 
  snprintf( chExpectedText, elCount(chExpectedText), "ECU should be in running state"); 
  A_DBGR_Go();
  
  snprintf( chActionText, elCount(chActionText), "Verify Breakpoint should hit in Os_Entry_Task_Core0_5ms\\13 "); 
  snprintf( chExpectedText, elCount(chExpectedText), "Breakpoint hit in Os_Entry_Task_Core0_5ms\\13 function"); 
  //TestStepAddActionExpected( chActionText, chExpectedText );  
  E_DBGR_BreakpointCheckForHalt("TestCanTrcv_Getmode\\5");
  
  snprintf( chActionText, elCount(chActionText), "Flash the Software and ECU is running "); 
  snprintf( chExpectedText, elCount(chExpectedText), "ECU should be in running state"); 
  TestStepAddActionExpected( chActionText, chExpectedText );
  A_DBGR_BreakpointDeleteAll();
  /***************************************************************************************************************/    
                                              // Test Step 5 Set ChannelID_B to 1 to call GetCNDD_e_CanTrcvOpMode(1U, &Getcantravmode);
  /***************************************************************************************************************/

  snprintf( chActionText, elCount(chActionText), "Configure Channel_ID_B variable to invoke GetCNDD_e_CanTrcvOpMode interface"); 
  snprintf( chExpectedText, elCount(chExpectedText), "Verify Channel_ID_B is configured as 1"); 
  //TestStepAddActionExpected( chActionText, chExpectedText );
  A_DBGR_VariableSet("Channel_ID_B","1");
  E_DBGR_VariableCheck("Channel_ID_B",1,Equal);
  
  /***************************************************************************************************************/    
                                              // Test Step 6 MCALUTIL_SFRWRITE(SPI_HW_MODULE[KernelId].MC.U, ((uint32)TransferCount<<IFX_QSPI_MC_MCOUNT_OFF));
  /***************************************************************************************************************/
  snprintf( chActionText, elCount(chActionText), "Set Breakpoint Spi_lQspiHWSetJobConfig\\18 callback function "); 
  snprintf( chExpectedText, elCount(chExpectedText), "Breakpoint is Set in Spi_lQspiHWSetJobConfig\\18"); 
  TestStepAddActionExpected( chActionText, chExpectedText );   
  A_DBGR_BreakpointSet("Spi_lQspiHWSetJobConfig\\18");  
  
  /***************************************************************************************************************/    
                                              // Test Step 7 Run the debugger
  /***************************************************************************************************************/
  snprintf( chActionText, elCount(chActionText), "Run the software "); 
  snprintf( chExpectedText, elCount(chExpectedText), "ECU should be in running state"); 
  A_DBGR_Go();
  
   /***************************************************************************************************************/    
                                              // Test Step 8 Wait for the breakpoint to hit
  /***************************************************************************************************************/
  snprintf( chActionText, elCount(chActionText), "Verify Breakpoint should hit in Os_Entry_Task_Core0_5ms\\13 "); 
  snprintf( chExpectedText, elCount(chExpectedText), "Breakpoint hit in Os_Entry_Task_Core0_5ms\\13 function"); 
  //TestStepAddActionExpected( chActionText, chExpectedText );  
  E_DBGR_BreakpointCheckForHalt("Spi_lQspiHWSetJobConfig\\18");
  
  snprintf( chActionText, elCount(chActionText), "Flash the Software and ECU is running "); 
  snprintf( chExpectedText, elCount(chExpectedText), "ECU should be in running state"); 
  TestStepAddActionExpected( chActionText, chExpectedText );
  A_DBGR_BreakpointDeleteAll();
  
  /***************************************************************************************************************/    
                                              // Test Step 9 set TransferCount variable to 5 to inject TxFIFO overflow fault.
  /***************************************************************************************************************/
  snprintf( chActionText, elCount(chActionText), "Configure TransferCount variable"); 
  snprintf( chExpectedText, elCount(chExpectedText), "Verify TransferCount is configured as 0"); 
  //TestStepAddActionExpected( chActionText, chExpectedText );
  A_DBGR_VariableSet("TransferCount","5");
  E_DBGR_VariableCheck("TransferCount",5,Equal);
  
  /***************************************************************************************************************/    
                                              // Test Step 10 CAN_COMMAND_STATUS = GetCNDD_e_CanTrcvOpMode(1U, &Getcantravmode);
  /***************************************************************************************************************/
  snprintf( chActionText, elCount(chActionText), "Set Breakpoint TestCanTrcv_Getmode\\10 callback function "); 
  snprintf( chExpectedText, elCount(chExpectedText), "Breakpoint is Set in TestCanTrcv_Getmode\\10"); 
  TestStepAddActionExpected( chActionText, chExpectedText );   
  A_DBGR_BreakpointSet("TestCanTrcv_Getmode\\10");  
  
  /***************************************************************************************************************/    
                                              // Test Step 11  Run the debugger
  /***************************************************************************************************************/
  snprintf( chActionText, elCount(chActionText), "Run the software "); 
  snprintf( chExpectedText, elCount(chExpectedText), "ECU should be in running state"); 
  A_DBGR_Go();
  
  snprintf( chActionText, elCount(chActionText), "Verify Breakpoint should hit in Os_Entry_Task_Core0_5ms\\13 "); 
  snprintf( chExpectedText, elCount(chExpectedText), "Breakpoint hit in Os_Entry_Task_Core0_5ms\\13 function"); 
  //TestStepAddActionExpected( chActionText, chExpectedText );  
  E_DBGR_BreakpointCheckForHalt("TestCanTrcv_Getmode\\10");
  
   snprintf( chActionText, elCount(chActionText), "Flash the Software and ECU is running "); 
  snprintf( chExpectedText, elCount(chExpectedText), "ECU should be in running state"); 
  TestStepAddActionExpected( chActionText, chExpectedText );
  A_DBGR_BreakpointDeleteAll();
  
  /***************************************************************************************************************/    
                                              // Test Step 12 MCALUTIL_SFRWRITE(SPI_HW_MODULE[KernelId].MC.U, ((uint32)TransferCount<<IFX_QSPI_MC_MCOUNT_OFF));
  /***************************************************************************************************************/
  snprintf( chActionText, elCount(chActionText), "Set Breakpoint Spi_lQspiHWSetJobConfig\\18 callback function "); 
  snprintf( chExpectedText, elCount(chExpectedText), "Breakpoint is Set in Spi_lQspiHWSetJobConfig\\18"); 
  //TestStepAddActionExpected( chActionText, chExpectedText );   
  A_DBGR_BreakpointSet("Spi_lQspiHWSetJobConfig\\18");  
  
  /***************************************************************************************************************/    
                                              // Test Step 13 Run the debugger
  /***************************************************************************************************************/
  snprintf( chActionText, elCount(chActionText), "Run the software "); 
  snprintf( chExpectedText, elCount(chExpectedText), "ECU should be in running state"); 
  A_DBGR_Go();
  
   /***************************************************************************************************************/    
                                              // Test Step 14 Wait for the breakpoint to hit
  /***************************************************************************************************************/
  snprintf( chActionText, elCount(chActionText), "Verify Breakpoint should hit in Os_Entry_Task_Core0_5ms\\13 "); 
  snprintf( chExpectedText, elCount(chExpectedText), "Breakpoint hit in Os_Entry_Task_Core0_5ms\\13 function"); 
  //TestStepAddActionExpected( chActionText, chExpectedText );  
  E_DBGR_BreakpointCheckForHalt("Spi_lQspiHWSetJobConfig\\18");
  
  
  /***************************************************************************************************************/    
                                              // Test Step 15 set TransferCount variable to 5 to inject TxFIFO overflow fault.
  /***************************************************************************************************************/
  snprintf( chActionText, elCount(chActionText), "Configure TransferCount variable"); 
  snprintf( chExpectedText, elCount(chExpectedText), "Verify TransferCount is configured as 0"); 
  TestStepAddActionExpected( chActionText, chExpectedText );
  A_DBGR_VariableSet("TransferCount","5");
  E_DBGR_VariableCheck("TransferCount",5,Equal);
    
  snprintf( chActionText, elCount(chActionText), "Flash the Software and ECU is running "); 
  snprintf( chExpectedText, elCount(chExpectedText), "ECU should be in running state"); 
  TestStepAddActionExpected( chActionText, chExpectedText );
  A_DBGR_BreakpointDeleteAll();
   /***************************************************************************************************************/    
                                              // Test Step 15 Set a breakpoint at line BUS_DEVICE_ID = GetHWIO_e_BusDeviceID(void); inside function void Test_GetHWIO_e_BusDeviceID( void ) 
  /***************************************************************************************************************/
  snprintf( chActionText, elCount(chActionText), "Set Breakpoint Test_GetHWIO_e_BusDeviceID\\8 callback function "); 
  snprintf( chExpectedText, elCount(chExpectedText), "Breakpoint is Set in Test_GetHWIO_e_BusDeviceID\\8"); 
  //TestStepAddActionExpected( chActionText, chExpectedText );   
  A_DBGR_BreakpointSet("Test_GetHWIO_e_BusDeviceID\\8"); 
  
  /***************************************************************************************************************/    
                                              // Test Step 16 Run the debugger
  /***************************************************************************************************************/
  snprintf( chActionText, elCount(chActionText), "Run the software "); 
  snprintf( chExpectedText, elCount(chExpectedText), "ECU should be in running state"); 
  A_DBGR_Go();

  /***************************************************************************************************************/    
                                              // Test Step 17 Wait for the breakpoint to hit
  /***************************************************************************************************************/
  snprintf( chActionText, elCount(chActionText), "Verify Breakpoint should hit in Test_GetHWIO_e_BusDeviceID\\8 "); 
  snprintf( chExpectedText, elCount(chExpectedText), "Breakpoint hit in Test_GetHWIO_e_BusDeviceID\\8 function"); 
  //TestStepAddActionExpected( chActionText, chExpectedText );  
  E_DBGR_BreakpointCheckForHalt("Test_GetHWIO_e_BusDeviceID\\8");
  
  /***************************************************************************************************************/    
                                              // Test Step 18 	Verify BUS_DEVICE_ID value as 3.
  /***************************************************************************************************************/
  snprintf( chActionText, elCount(chActionText), "Configure BUSID variable"); 
  snprintf( chExpectedText, elCount(chExpectedText), "Verify BUSID is configured as 1"); 
  TestStepAddActionExpected( chActionText, chExpectedText );
  E_DBGR_VariableCheck("BUS_DEVICE_ID",3,Equal);

}

testcase Verify_bitwise_OR_operation_for_multiple_device_faults_ie_CAN2TCVR_and_PMIC_TLF4D_scenario_2()
{
  /***************************************************************************************************************/    
                                                // Variable Definition
  /***************************************************************************************************************/ 
  

  
  /***************************************************************************************************************/    
                                               // Local Values
  /***************************************************************************************************************/ 
  

  
  /***************************************************************************************************************/    
                                              // Test Case Info
  /***************************************************************************************************************/
  setWriteDbgLevel(DebugOff);
  snprintf( chTestTitle, elCount(chTestTitle), "Verify_bitwise_OR_operation_for_multiple_device_faults_ie_CAN2TCVR_and_PMIC_TLF4D_scenario_2" );
  snprintf( chTestDescription, elCount(chTestDescription), "Purpose:To check the GetHWIO_e_BusDeviceID interface ");
  TestCaseAddInfo( chTestTitle, "TC_L30SW_Q-37207973", chTestDescription );

  /***************************************************************************************************************/    
                                              // Test Step 0 PRECONDITIONS
  /***************************************************************************************************************/
  snprintf( chActionText, elCount(chActionText), "Flash the Software and ECU is running "); 
  snprintf( chExpectedText, elCount(chExpectedText), "ECU should be in running state"); 
  TestStepAddActionExpected( chActionText, chExpectedText );
  A_DBGR_BreakpointDeleteAll();
  
  snprintf( chActionText, elCount(chActionText), "Flash the Software and ECU is running "); 
  snprintf( chExpectedText, elCount(chExpectedText), "ECU should be in running state"); 
 
  A_DBGR_R();
  
  A_DBGR_Go();
  /***************************************************************************************************************/    
                                              // Test Step 1 Set a breakpoint at line TestCanTrcv_Getmode(void); in OS_Tasks.c file
  /***************************************************************************************************************/
  snprintf( chActionText, elCount(chActionText), "Set Breakpoint Os_Entry_Task_Core0_5ms\\13 callback function "); 
  snprintf( chExpectedText, elCount(chExpectedText), "Breakpoint is Set in Os_Entry_Task_Core0_5ms\\13"); 
  //TestStepAddActionExpected( chActionText, chExpectedText );   
  A_DBGR_BreakpointSet("Os_Entry_Task_Core0_5ms\\13");  
  
  
   /***************************************************************************************************************/    
                                              // Test Step 2 Run the debugger
  /***************************************************************************************************************/
  snprintf( chActionText, elCount(chActionText), "Run the software "); 
  snprintf( chExpectedText, elCount(chExpectedText), "ECU should be in running state"); 
  A_DBGR_Go();
  
   /***************************************************************************************************************/    
                                              // Test Step 3 Wait for the breakpoint to hit
  /***************************************************************************************************************/
  snprintf( chActionText, elCount(chActionText), "Verify Breakpoint should hit in Os_Entry_Task_Core0_5ms\\13 "); 
  snprintf( chExpectedText, elCount(chExpectedText), "Breakpoint hit in Os_Entry_Task_Core0_5ms\\13 function"); 
  //TestStepAddActionExpected( chActionText, chExpectedText );  
  E_DBGR_BreakpointCheckForHalt("Os_Entry_Task_Core0_5ms\\13");
  
  snprintf( chActionText, elCount(chActionText), "Flash the Software and ECU is running "); 
  snprintf( chExpectedText, elCount(chExpectedText), "ECU should be in running state"); 
  TestStepAddActionExpected( chActionText, chExpectedText );
  A_DBGR_BreakpointDeleteAll();
  /***************************************************************************************************************/    
                                              // Test Step 4 MCALUTIL_SFRWRITE(SPI_HW_MODULE[KernelId].MC.U, ((uint32)TransferCount<<IFX_QSPI_MC_MCOUNT_OFF));
  /***************************************************************************************************************/
  snprintf( chActionText, elCount(chActionText), "Set Breakpoint Spi_lQspiHWSetJobConfig\\18 callback function "); 
  snprintf( chExpectedText, elCount(chExpectedText), "Breakpoint is Set in Spi_lQspiHWSetJobConfig\\18"); 
  //TestStepAddActionExpected( chActionText, chExpectedText );   
  A_DBGR_BreakpointSet("Spi_lQspiHWSetJobConfig\\18");  
  
  /***************************************************************************************************************/    
                                              // Test Step 5 Run the debugger
  /***************************************************************************************************************/
  snprintf( chActionText, elCount(chActionText), "Run the software "); 
  snprintf( chExpectedText, elCount(chExpectedText), "ECU should be in running state"); 
  A_DBGR_Go();
  testWaitForTimeout(500);
   /***************************************************************************************************************/    
                                              // Test Step 6 Wait for the breakpoint to hit
  /***************************************************************************************************************/
  snprintf( chActionText, elCount(chActionText), "Verify Breakpoint should hit in Os_Entry_Task_Core0_5ms\\13 "); 
  snprintf( chExpectedText, elCount(chExpectedText), "Breakpoint hit in Os_Entry_Task_Core0_5ms\\13 function"); 
  //TestStepAddActionExpected( chActionText, chExpectedText );  
  E_DBGR_BreakpointCheckForHalt("Spi_lQspiHWSetJobConfig\\18");
  
  /***************************************************************************************************************/    
                                              // Test Step 7 set TransferCount variable to 5 to inject TxFIFO overflow fault.
  /***************************************************************************************************************/
  snprintf( chActionText, elCount(chActionText), "Configure TransferCount variable"); 
  snprintf( chExpectedText, elCount(chExpectedText), "Verify TransferCount is configured as 0"); 
  TestStepAddActionExpected( chActionText, chExpectedText );
  A_DBGR_VariableSet("TransferCount","5");
  E_DBGR_VariableCheck("TransferCount",5,Equal);
  
  snprintf( chActionText, elCount(chActionText), "Flash the Software and ECU is running "); 
  snprintf( chExpectedText, elCount(chExpectedText), "ECU should be in running state"); 
  TestStepAddActionExpected( chActionText, chExpectedText );
  A_DBGR_BreakpointDeleteAll();
  /***************************************************************************************************************/    
                                              // Test Step 8 Set a breakpoint at line TestCanTrcv_Getmode(void); in OS_Tasks.c file
  /***************************************************************************************************************/
  snprintf( chActionText, elCount(chActionText), "Set Breakpoint Os_Entry_Task_Core0_5ms\\14 callback function "); 
  snprintf( chExpectedText, elCount(chExpectedText), "Breakpoint is Set in Os_Entry_Task_Core0_5ms\\14"); 
  //TestStepAddActionExpected( chActionText, chExpectedText );   
  A_DBGR_BreakpointSet("Os_Entry_Task_Core0_5ms\\14");  
  
  
   /***************************************************************************************************************/    
                                              // Test Step 9 Run the debugger
  /***************************************************************************************************************/
  snprintf( chActionText, elCount(chActionText), "Run the software "); 
  snprintf( chExpectedText, elCount(chExpectedText), "ECU should be in running state"); 
  A_DBGR_Go();
  
   /***************************************************************************************************************/    
                                              // Test Step 10 Wait for the breakpoint to hit
  /***************************************************************************************************************/
  snprintf( chActionText, elCount(chActionText), "Verify Breakpoint should hit in Os_Entry_Task_Core0_5ms\\14 "); 
  snprintf( chExpectedText, elCount(chExpectedText), "Breakpoint hit in Os_Entry_Task_Core0_5ms\\14 function"); 
  //TestStepAddActionExpected( chActionText, chExpectedText );  
  E_DBGR_BreakpointCheckForHalt("Os_Entry_Task_Core0_5ms\\14");
  
  /***************************************************************************************************************/    
                                              // Test Step  Delete all Breakpoints
  /***************************************************************************************************************/
  snprintf( chActionText, elCount(chActionText), "Flash the Software and ECU is running "); 
  snprintf( chExpectedText, elCount(chExpectedText), "ECU should be in running state"); 
  TestStepAddActionExpected( chActionText, chExpectedText );
  A_DBGR_BreakpointDeleteAll();
  
  
  /***************************************************************************************************************/    
                                              // Test Step 11 Set Breakpoint Spi_lQspiSyncTransmitData32Bit\\24 callback function
  /***************************************************************************************************************/
  snprintf( chActionText, elCount(chActionText), "Set Breakpoint Spi_lQspiSyncTransmitData32Bit\\24 callback function "); 
  snprintf( chExpectedText, elCount(chExpectedText), "Breakpoint is Set in Spi_lQspiSyncTransmitData32Bit\\24"); 
  //TestStepAddActionExpected( chActionText, chExpectedText );   
  A_DBGR_BreakpointSet("Spi_lQspiSyncTransmitData32Bit\\24");  
  
  /***************************************************************************************************************/    
                                              // Test Step 12 Run the debugger
  /***************************************************************************************************************/
  snprintf( chActionText, elCount(chActionText), "Run the software "); 
  snprintf( chExpectedText, elCount(chExpectedText), "ECU should be in running state"); 
  A_DBGR_Go();
  
   /***************************************************************************************************************/    
                                              // Test Step 13 Wait for the breakpoint to hit
  /***************************************************************************************************************/
  snprintf( chActionText, elCount(chActionText), "Verify Breakpoint should hit in Spi_lQspiSyncTransmitData32Bit\\24 "); 
  snprintf( chExpectedText, elCount(chExpectedText), "Breakpoint hit in Spi_lQspiSyncTransmitData32Bit\\24 function"); 
  //TestStepAddActionExpected( chActionText, chExpectedText );  
  E_DBGR_BreakpointCheckForHalt("Spi_lQspiSyncTransmitData32Bit\\24");
  
  /***************************************************************************************************************/    
                                              // Test Step 14 set Timeout variable to 5 to inject TxFIFO overflow fault.
  /***************************************************************************************************************/
  snprintf( chActionText, elCount(chActionText), "Configure Timeout variable"); 
  snprintf( chExpectedText, elCount(chExpectedText), "Verify Timeout is configured as 0"); 
  TestStepAddActionExpected( chActionText, chExpectedText );
  A_DBGR_VariableSet("Timeout","0");
  E_DBGR_VariableCheck("Timeout",0,Equal);
  
  /***************************************************************************************************************/    
                                              // Test Step 15 Delete all Breakpoints
  /***************************************************************************************************************/
  snprintf( chActionText, elCount(chActionText), "Flash the Software and ECU is running "); 
  snprintf( chExpectedText, elCount(chExpectedText), "ECU should be in running state"); 
  TestStepAddActionExpected( chActionText, chExpectedText );
  A_DBGR_BreakpointDeleteAll();
  
   /***************************************************************************************************************/    
                                              // Test Step 16 Set a breakpoint at line BUS_DEVICE_ID = GetHWIO_e_BusDeviceID(void); inside function void Test_GetHWIO_e_BusDeviceID( void ) 
  /***************************************************************************************************************/
  snprintf( chActionText, elCount(chActionText), "Set Breakpoint Test_GetHWIO_e_BusDeviceID\\8 callback function "); 
  snprintf( chExpectedText, elCount(chExpectedText), "Breakpoint is Set in Test_GetHWIO_e_BusDeviceID\\8"); 
  //TestStepAddActionExpected( chActionText, chExpectedText );   
  A_DBGR_BreakpointSet("Test_GetHWIO_e_BusDeviceID\\8"); 
  
  /***************************************************************************************************************/    
                                              // Test Step 17 Run the debugger
  /***************************************************************************************************************/
  snprintf( chActionText, elCount(chActionText), "Run the software "); 
  snprintf( chExpectedText, elCount(chExpectedText), "ECU should be in running state"); 
  A_DBGR_Go();

  /***************************************************************************************************************/    
                                              // Test Step 18 Wait for the breakpoint to hit
  /***************************************************************************************************************/
  snprintf( chActionText, elCount(chActionText), "Verify Breakpoint should hit in Test_GetHWIO_e_BusDeviceID\\8 "); 
  snprintf( chExpectedText, elCount(chExpectedText), "Breakpoint hit in Test_GetHWIO_e_BusDeviceID\\8 function"); 
  //TestStepAddActionExpected( chActionText, chExpectedText );  
  E_DBGR_BreakpointCheckForHalt("Test_GetHWIO_e_BusDeviceID\\8");
  
  /***************************************************************************************************************/    
                                              // Test Step 19 	Verify BUS_DEVICE_ID value as 5.
  /***************************************************************************************************************/
  snprintf( chActionText, elCount(chActionText), "Configure BUSID variable"); 
  snprintf( chExpectedText, elCount(chExpectedText), "Verify BUSID is configured as 5"); 
  TestStepAddActionExpected( chActionText, chExpectedText );
  E_DBGR_VariableCheck("BUS_DEVICE_ID",5,Equal);


}

testcase Verify_bitwise_OR_operation_for_multiple_device_faults_ie_CAN8TCVR_and_PMIC_TLF4D_scenario_3()
{
    /***************************************************************************************************************/    
                                                // Variable Definition
  /***************************************************************************************************************/ 
  

  
  /***************************************************************************************************************/    
                                               // Local Values
  /***************************************************************************************************************/ 
  

  
  /***************************************************************************************************************/    
                                              // Test Case Info
  /***************************************************************************************************************/
  setWriteDbgLevel(DebugOff);
  snprintf( chTestTitle, elCount(chTestTitle), "Verify_bitwise_OR_operation_for_multiple_device_faults_ie_CAN8TCVR_and_PMIC_TLF4D_scenario_3" );
  snprintf( chTestDescription, elCount(chTestDescription), "Purpose:To check the GetHWIO_e_BusDeviceID interface ");
  TestCaseAddInfo( chTestTitle, "TC_L30SW_Q-36629488", chTestDescription );

  /***************************************************************************************************************/    
                                              // Test Step 0 PRECONDITIONS
  /***************************************************************************************************************/
  snprintf( chActionText, elCount(chActionText), "Flash the Software and ECU is running "); 
  snprintf( chExpectedText, elCount(chExpectedText), "ECU should be in running state"); 
  TestStepAddActionExpected( chActionText, chExpectedText );
  A_DBGR_BreakpointDeleteAll();
  
  snprintf( chActionText, elCount(chActionText), "Flash the Software and ECU is running "); 
  snprintf( chExpectedText, elCount(chExpectedText), "ECU should be in running state"); 
 
  A_DBGR_R();
  
  A_DBGR_Go();
  /***************************************************************************************************************/    
                                              // Test Step 1 Set a breakpoint at line TestCanTrcv_Getmode(void); in OS_Tasks.c file
  /***************************************************************************************************************/
  snprintf( chActionText, elCount(chActionText), "Set Breakpoint Os_Entry_Task_Core0_5ms\\13 callback function "); 
  snprintf( chExpectedText, elCount(chExpectedText), "Breakpoint is Set in Os_Entry_Task_Core0_5ms\\13"); 
  //TestStepAddActionExpected( chActionText, chExpectedText );   
  A_DBGR_BreakpointSet("Os_Entry_Task_Core0_5ms\\13");  
  
  
   /***************************************************************************************************************/    
                                              // Test Step 2 Run the debugger
  /***************************************************************************************************************/
  snprintf( chActionText, elCount(chActionText), "Run the software "); 
  snprintf( chExpectedText, elCount(chExpectedText), "ECU should be in running state"); 
  A_DBGR_Go();
  
  /***************************************************************************************************************/    
                                              // Test Step  Set a Channel_ID 1 and Channel_ID_B to 1 to call GetCNDD_e_CanTrcvOpMode(1U, &Getcantravmode);
  /***************************************************************************************************************/
  snprintf( chActionText, elCount(chActionText), "Configure Channel_ID variable"); 
  snprintf( chExpectedText, elCount(chExpectedText), "Verify TransferCount is configured as 1"); 
  //TestStepAddActionExpected( chActionText, chExpectedText );
  A_DBGR_VariableSet("Channel_ID","1");
  E_DBGR_VariableCheck("Channel_ID",1,Equal);
  
  snprintf( chActionText, elCount(chActionText), "Configure Channel_ID_B variable"); 
  snprintf( chExpectedText, elCount(chExpectedText), "Verify TransferCount is configured as 1"); 
  TestStepAddActionExpected( chActionText, chExpectedText );
  A_DBGR_VariableSet("Channel_ID_B","1");
  E_DBGR_VariableCheck("Channel_ID_B",1,Equal);
  
  
   /***************************************************************************************************************/    
                                              // Test Step 3 Wait for the breakpoint to hit
  /***************************************************************************************************************/
  snprintf( chActionText, elCount(chActionText), "Verify Breakpoint should hit in Os_Entry_Task_Core0_5ms\\13 "); 
  snprintf( chExpectedText, elCount(chExpectedText), "Breakpoint hit in Os_Entry_Task_Core0_5ms\\13 function"); 
  TestStepAddActionExpected( chActionText, chExpectedText );  
  E_DBGR_BreakpointCheckForHalt("Os_Entry_Task_Core0_5ms\\13");
  
  snprintf( chActionText, elCount(chActionText), "Flash the Software and ECU is running "); 
  snprintf( chExpectedText, elCount(chExpectedText), "ECU should be in running state"); 
  TestStepAddActionExpected( chActionText, chExpectedText );
  A_DBGR_BreakpointDeleteAll();
  /***************************************************************************************************************/    
                                              // Test Step 4 MCALUTIL_SFRWRITE(SPI_HW_MODULE[KernelId].MC.U, ((uint32)TransferCount<<IFX_QSPI_MC_MCOUNT_OFF));
  /***************************************************************************************************************/
  snprintf( chActionText, elCount(chActionText), "Set Breakpoint Spi_lQspiHWSetJobConfig\\18 callback function "); 
  snprintf( chExpectedText, elCount(chExpectedText), "Breakpoint is Set in Spi_lQspiHWSetJobConfig\\18"); 
  //TestStepAddActionExpected( chActionText, chExpectedText );   
  A_DBGR_BreakpointSet("Spi_lQspiHWSetJobConfig\\18");  
  
  /***************************************************************************************************************/    
                                              // Test Step 5 Run the debugger
  /***************************************************************************************************************/
  snprintf( chActionText, elCount(chActionText), "Run the software "); 
  snprintf( chExpectedText, elCount(chExpectedText), "ECU should be in running state"); 
  A_DBGR_Go();
  testWaitForTimeout(500);
   /***************************************************************************************************************/    
                                              // Test Step 6 Wait for the breakpoint to hit
  /***************************************************************************************************************/
  snprintf( chActionText, elCount(chActionText), "Verify Breakpoint should hit in Os_Entry_Task_Core0_5ms\\13 "); 
  snprintf( chExpectedText, elCount(chExpectedText), "Breakpoint hit in Os_Entry_Task_Core0_5ms\\13 function"); 
  //TestStepAddActionExpected( chActionText, chExpectedText );  
  E_DBGR_BreakpointCheckForHalt("Spi_lQspiHWSetJobConfig\\18");
  
  /***************************************************************************************************************/    
                                              // Test Step 7 set TransferCount variable to 5 to inject TxFIFO overflow fault.
  /***************************************************************************************************************/
  snprintf( chActionText, elCount(chActionText), "Configure TransferCount variable"); 
  snprintf( chExpectedText, elCount(chExpectedText), "Verify TransferCount is configured as 0"); 
  TestStepAddActionExpected( chActionText, chExpectedText );
  A_DBGR_VariableSet("TransferCount","5");
  E_DBGR_VariableCheck("TransferCount",5,Equal);
  
  snprintf( chActionText, elCount(chActionText), "Flash the Software and ECU is running "); 
  snprintf( chExpectedText, elCount(chExpectedText), "ECU should be in running state"); 
  TestStepAddActionExpected( chActionText, chExpectedText );
  A_DBGR_BreakpointDeleteAll();
  /***************************************************************************************************************/    
                                              // Test Step 8 Set a breakpoint at line TestCanTrcv_Getmode(void); in OS_Tasks.c file
  /***************************************************************************************************************/
  snprintf( chActionText, elCount(chActionText), "Set Breakpoint Os_Entry_Task_Core0_5ms\\14 callback function "); 
  snprintf( chExpectedText, elCount(chExpectedText), "Breakpoint is Set in Os_Entry_Task_Core0_5ms\\14"); 
  //TestStepAddActionExpected( chActionText, chExpectedText );   
  A_DBGR_BreakpointSet("Os_Entry_Task_Core0_5ms\\14");  
  
  
   /***************************************************************************************************************/    
                                              // Test Step 9 Run the debugger
  /***************************************************************************************************************/
  snprintf( chActionText, elCount(chActionText), "Run the software "); 
  snprintf( chExpectedText, elCount(chExpectedText), "ECU should be in running state"); 
  A_DBGR_Go();
  
   /***************************************************************************************************************/    
                                              // Test Step 10 Wait for the breakpoint to hit
  /***************************************************************************************************************/
  snprintf( chActionText, elCount(chActionText), "Verify Breakpoint should hit in Os_Entry_Task_Core0_5ms\\14 "); 
  snprintf( chExpectedText, elCount(chExpectedText), "Breakpoint hit in Os_Entry_Task_Core0_5ms\\14 function"); 
  //TestStepAddActionExpected( chActionText, chExpectedText );  
  E_DBGR_BreakpointCheckForHalt("Os_Entry_Task_Core0_5ms\\14");
  
  /***************************************************************************************************************/    
                                              // Test Step  Delete all Breakpoints
  /***************************************************************************************************************/
  snprintf( chActionText, elCount(chActionText), "Flash the Software and ECU is running "); 
  snprintf( chExpectedText, elCount(chExpectedText), "ECU should be in running state"); 
  TestStepAddActionExpected( chActionText, chExpectedText );
  A_DBGR_BreakpointDeleteAll();
  
  
  /***************************************************************************************************************/    
                                              // Test Step 11 Set Breakpoint Spi_lQspiSyncTransmitData32Bit\\24 callback function
  /***************************************************************************************************************/
  snprintf( chActionText, elCount(chActionText), "Set Breakpoint Spi_lQspiSyncTransmitData32Bit\\24 callback function "); 
  snprintf( chExpectedText, elCount(chExpectedText), "Breakpoint is Set in Spi_lQspiSyncTransmitData32Bit\\24"); 
  //TestStepAddActionExpected( chActionText, chExpectedText );   
  A_DBGR_BreakpointSet("Spi_lQspiSyncTransmitData32Bit\\24");  
  
  /***************************************************************************************************************/    
                                              // Test Step 12 Run the debugger
  /***************************************************************************************************************/
  snprintf( chActionText, elCount(chActionText), "Run the software "); 
  snprintf( chExpectedText, elCount(chExpectedText), "ECU should be in running state"); 
  A_DBGR_Go();
  
   /***************************************************************************************************************/    
                                              // Test Step 13 Wait for the breakpoint to hit
  /***************************************************************************************************************/
  snprintf( chActionText, elCount(chActionText), "Verify Breakpoint should hit in Spi_lQspiSyncTransmitData32Bit\\24 "); 
  snprintf( chExpectedText, elCount(chExpectedText), "Breakpoint hit in Spi_lQspiSyncTransmitData32Bit\\24 function"); 
  //TestStepAddActionExpected( chActionText, chExpectedText );  
  E_DBGR_BreakpointCheckForHalt("Spi_lQspiSyncTransmitData32Bit\\24");
  
  /***************************************************************************************************************/    
                                              // Test Step 14 set Timeout variable to 5 to inject TxFIFO overflow fault.
  /***************************************************************************************************************/
  snprintf( chActionText, elCount(chActionText), "Configure Timeout variable"); 
  snprintf( chExpectedText, elCount(chExpectedText), "Verify Timeout is configured as 0"); 
  TestStepAddActionExpected( chActionText, chExpectedText );
  A_DBGR_VariableSet("Timeout","0");
  E_DBGR_VariableCheck("Timeout",0,Equal);
  
  /***************************************************************************************************************/    
                                              // Test Step 15 Delete all Breakpoints
  /***************************************************************************************************************/
  snprintf( chActionText, elCount(chActionText), "Flash the Software and ECU is running "); 
  snprintf( chExpectedText, elCount(chExpectedText), "ECU should be in running state"); 
  TestStepAddActionExpected( chActionText, chExpectedText );
  A_DBGR_BreakpointDeleteAll();
  
   /***************************************************************************************************************/    
                                              // Test Step 16 Set a breakpoint at line BUS_DEVICE_ID = GetHWIO_e_BusDeviceID(void); inside function void Test_GetHWIO_e_BusDeviceID( void ) 
  /***************************************************************************************************************/
  snprintf( chActionText, elCount(chActionText), "Set Breakpoint Test_GetHWIO_e_BusDeviceID\\8 callback function "); 
  snprintf( chExpectedText, elCount(chExpectedText), "Breakpoint is Set in Test_GetHWIO_e_BusDeviceID\\8"); 
  //TestStepAddActionExpected( chActionText, chExpectedText );   
  A_DBGR_BreakpointSet("Test_GetHWIO_e_BusDeviceID\\8"); 
  
  /***************************************************************************************************************/    
                                              // Test Step 17 Run the debugger
  /***************************************************************************************************************/
  snprintf( chActionText, elCount(chActionText), "Run the software "); 
  snprintf( chExpectedText, elCount(chExpectedText), "ECU should be in running state"); 
  A_DBGR_Go();

  /***************************************************************************************************************/    
                                              // Test Step 18 Wait for the breakpoint to hit
  /***************************************************************************************************************/
  snprintf( chActionText, elCount(chActionText), "Verify Breakpoint should hit in Test_GetHWIO_e_BusDeviceID\\8 "); 
  snprintf( chExpectedText, elCount(chExpectedText), "Breakpoint hit in Test_GetHWIO_e_BusDeviceID\\8 function"); 
  //TestStepAddActionExpected( chActionText, chExpectedText );  
  E_DBGR_BreakpointCheckForHalt("Test_GetHWIO_e_BusDeviceID\\8");
  
  /***************************************************************************************************************/    
                                              // Test Step 19 	Verify BUS_DEVICE_ID value as 6.
  /***************************************************************************************************************/
  snprintf( chActionText, elCount(chActionText), "Configure BUSID variable"); 
  snprintf( chExpectedText, elCount(chExpectedText), "Verify BUSID is configured as 6"); 
  TestStepAddActionExpected( chActionText, chExpectedText );
  E_DBGR_VariableCheck("BUS_DEVICE_ID",6,Equal);



}

testcase Verify_bitwise_OR_operation_for_multiple_device_faults_ie_CAN8TCVR_CAN8TCVR_and_PMIC_TLF4D_scenario_4()
{
    /***************************************************************************************************************/    
                                                // Variable Definition
  /***************************************************************************************************************/ 
  

  
  /***************************************************************************************************************/    
                                               // Local Values
  /***************************************************************************************************************/ 
  

  
  /***************************************************************************************************************/    
                                              // Test Case Info
  /***************************************************************************************************************/
  setWriteDbgLevel(DebugOff);
  snprintf( chTestTitle, elCount(chTestTitle), "Verify_bitwise_OR_operation_for_multiple_device_faults_ie_CAN8TCVR_CAN8TCVR_and_PMIC_TLF4D_scenario_4" );
  snprintf( chTestDescription, elCount(chTestDescription), "Purpose:To check the GetHWIO_e_BusID interface ");
  TestCaseAddInfo( chTestTitle, "TC_L30SW_Q-37208093", chTestDescription );

  /***************************************************************************************************************/    
                                              // Test Step 0 PRECONDITIONS
  /***************************************************************************************************************/
  snprintf( chActionText, elCount(chActionText), "Flash the Software and ECU is running "); 
  snprintf( chExpectedText, elCount(chExpectedText), "ECU should be in running state"); 
  TestStepAddActionExpected( chActionText, chExpectedText );
  A_DBGR_BreakpointDeleteAll();
  
  snprintf( chActionText, elCount(chActionText), "Flash the Software and ECU is running "); 
  snprintf( chExpectedText, elCount(chExpectedText), "ECU should be in running state"); 
 
  A_DBGR_R();
  A_DBGR_Go();
  
/***************************************************************************************************************/    
                                              // Test Step 1 Set a breakpoint at line TestCanTrcv_Getmode(void); in OS_Tasks.c file
  /***************************************************************************************************************/
  snprintf( chActionText, elCount(chActionText), "Set Breakpoint Os_Entry_Task_Core0_5ms\\13 callback function "); 
  snprintf( chExpectedText, elCount(chExpectedText), "Breakpoint is Set in Os_Entry_Task_Core0_5ms\\13"); 
  //TestStepAddActionExpected( chActionText, chExpectedText );   
  A_DBGR_BreakpointSet("Os_Entry_Task_Core0_5ms\\13");  
  
  
   /***************************************************************************************************************/    
                                              // Test Step 2 Run the debugger
  /***************************************************************************************************************/
  snprintf( chActionText, elCount(chActionText), "Run the software "); 
  snprintf( chExpectedText, elCount(chExpectedText), "ECU should be in running state"); 
  A_DBGR_Go();
  
   /***************************************************************************************************************/    
                                              // Test Step 3 Wait for the breakpoint to hit
  /***************************************************************************************************************/
  snprintf( chActionText, elCount(chActionText), "Verify Breakpoint should hit in Os_Entry_Task_Core0_5ms\\13 "); 
  snprintf( chExpectedText, elCount(chExpectedText), "Breakpoint hit in Os_Entry_Task_Core0_5ms\\13 function"); 
  //TestStepAddActionExpected( chActionText, chExpectedText );  
  E_DBGR_BreakpointCheckForHalt("Os_Entry_Task_Core0_5ms\\13");
  
  snprintf( chActionText, elCount(chActionText), "Flash the Software and ECU is running "); 
  snprintf( chExpectedText, elCount(chExpectedText), "ECU should be in running state"); 
  TestStepAddActionExpected( chActionText, chExpectedText );
  A_DBGR_BreakpointDeleteAll();
  /***************************************************************************************************************/    
                                              // Test Step 4 CAN_COMMAND_STATUS = GetCNDD_e_CanTrcvOpMode(0U, &Getcantravmode);
  /***************************************************************************************************************/
  snprintf( chActionText, elCount(chActionText), "Set Breakpoint TestCanTrcv_Getmode\\5 callback function "); 
  snprintf( chExpectedText, elCount(chExpectedText), "Breakpoint is Set in TestCanTrcv_Getmode\\5"); 
 // TestStepAddActionExpected( chActionText, chExpectedText );   
  A_DBGR_BreakpointSet("TestCanTrcv_Getmode\\5");  
  
  snprintf( chActionText, elCount(chActionText), "Run the software "); 
  snprintf( chExpectedText, elCount(chExpectedText), "ECU should be in running state"); 
  A_DBGR_Go();
  
  snprintf( chActionText, elCount(chActionText), "Verify Breakpoint should hit in Os_Entry_Task_Core0_5ms\\13 "); 
  snprintf( chExpectedText, elCount(chExpectedText), "Breakpoint hit in Os_Entry_Task_Core0_5ms\\13 function"); 
  //TestStepAddActionExpected( chActionText, chExpectedText );  
  E_DBGR_BreakpointCheckForHalt("TestCanTrcv_Getmode\\5");
  
  snprintf( chActionText, elCount(chActionText), "Flash the Software and ECU is running "); 
  snprintf( chExpectedText, elCount(chExpectedText), "ECU should be in running state"); 
  TestStepAddActionExpected( chActionText, chExpectedText );
  A_DBGR_BreakpointDeleteAll();
  /***************************************************************************************************************/    
                                              // Test Step 5 Set ChannelID_B to 1 to call GetCNDD_e_CanTrcvOpMode(1U, &Getcantravmode);
  /***************************************************************************************************************/

  snprintf( chActionText, elCount(chActionText), "Configure Channel_ID_B variable to invoke GetCNDD_e_CanTrcvOpMode interface"); 
  snprintf( chExpectedText, elCount(chExpectedText), "Verify Channel_ID_B is configured as 1"); 
  //TestStepAddActionExpected( chActionText, chExpectedText );
  A_DBGR_VariableSet("Channel_ID_B","1");
  E_DBGR_VariableCheck("Channel_ID_B",1,Equal);
  
  /***************************************************************************************************************/    
                                              // Test Step 6 MCALUTIL_SFRWRITE(SPI_HW_MODULE[KernelId].MC.U, ((uint32)TransferCount<<IFX_QSPI_MC_MCOUNT_OFF));
  /***************************************************************************************************************/
  snprintf( chActionText, elCount(chActionText), "Set Breakpoint Spi_lQspiHWSetJobConfig\\18 callback function "); 
  snprintf( chExpectedText, elCount(chExpectedText), "Breakpoint is Set in Spi_lQspiHWSetJobConfig\\18"); 
  TestStepAddActionExpected( chActionText, chExpectedText );   
  A_DBGR_BreakpointSet("Spi_lQspiHWSetJobConfig\\18");  
  
  /***************************************************************************************************************/    
                                              // Test Step 7 Run the debugger
  /***************************************************************************************************************/
  snprintf( chActionText, elCount(chActionText), "Run the software "); 
  snprintf( chExpectedText, elCount(chExpectedText), "ECU should be in running state"); 
  A_DBGR_Go();
  
   /***************************************************************************************************************/    
                                              // Test Step 8 Wait for the breakpoint to hit
  /***************************************************************************************************************/
  snprintf( chActionText, elCount(chActionText), "Verify Breakpoint should hit in Os_Entry_Task_Core0_5ms\\13 "); 
  snprintf( chExpectedText, elCount(chExpectedText), "Breakpoint hit in Os_Entry_Task_Core0_5ms\\13 function"); 
  //TestStepAddActionExpected( chActionText, chExpectedText );  
  E_DBGR_BreakpointCheckForHalt("Spi_lQspiHWSetJobConfig\\18");
  
  snprintf( chActionText, elCount(chActionText), "Flash the Software and ECU is running "); 
  snprintf( chExpectedText, elCount(chExpectedText), "ECU should be in running state"); 
  TestStepAddActionExpected( chActionText, chExpectedText );
  A_DBGR_BreakpointDeleteAll();
  
  /***************************************************************************************************************/    
                                              // Test Step 9 set TransferCount variable to 5 to inject TxFIFO overflow fault.
  /***************************************************************************************************************/
  snprintf( chActionText, elCount(chActionText), "Configure TransferCount variable"); 
  snprintf( chExpectedText, elCount(chExpectedText), "Verify TransferCount is configured as 0"); 
  //TestStepAddActionExpected( chActionText, chExpectedText );
  A_DBGR_VariableSet("TransferCount","5");
  E_DBGR_VariableCheck("TransferCount",5,Equal);
  
  /***************************************************************************************************************/    
                                              // Test Step 10 CAN_COMMAND_STATUS = GetCNDD_e_CanTrcvOpMode(1U, &Getcantravmode);
  /***************************************************************************************************************/
  snprintf( chActionText, elCount(chActionText), "Set Breakpoint TestCanTrcv_Getmode\\10 callback function "); 
  snprintf( chExpectedText, elCount(chExpectedText), "Breakpoint is Set in TestCanTrcv_Getmode\\10"); 
  TestStepAddActionExpected( chActionText, chExpectedText );   
  A_DBGR_BreakpointSet("TestCanTrcv_Getmode\\10");  
  
  /***************************************************************************************************************/    
                                              // Test Step 11  Run the debugger
  /***************************************************************************************************************/
  snprintf( chActionText, elCount(chActionText), "Run the software "); 
  snprintf( chExpectedText, elCount(chExpectedText), "ECU should be in running state"); 
  A_DBGR_Go();
  
  snprintf( chActionText, elCount(chActionText), "Verify Breakpoint should hit in Os_Entry_Task_Core0_5ms\\13 "); 
  snprintf( chExpectedText, elCount(chExpectedText), "Breakpoint hit in Os_Entry_Task_Core0_5ms\\13 function"); 
  //TestStepAddActionExpected( chActionText, chExpectedText );  
  E_DBGR_BreakpointCheckForHalt("TestCanTrcv_Getmode\\10");
  
   snprintf( chActionText, elCount(chActionText), "Flash the Software and ECU is running "); 
  snprintf( chExpectedText, elCount(chExpectedText), "ECU should be in running state"); 
  TestStepAddActionExpected( chActionText, chExpectedText );
  A_DBGR_BreakpointDeleteAll();
  
  /***************************************************************************************************************/    
                                              // Test Step 12 MCALUTIL_SFRWRITE(SPI_HW_MODULE[KernelId].MC.U, ((uint32)TransferCount<<IFX_QSPI_MC_MCOUNT_OFF));
  /***************************************************************************************************************/
  snprintf( chActionText, elCount(chActionText), "Set Breakpoint Spi_lQspiHWSetJobConfig\\18 callback function "); 
  snprintf( chExpectedText, elCount(chExpectedText), "Breakpoint is Set in Spi_lQspiHWSetJobConfig\\18"); 
  //TestStepAddActionExpected( chActionText, chExpectedText );   
  A_DBGR_BreakpointSet("Spi_lQspiHWSetJobConfig\\18");  
  
  /***************************************************************************************************************/    
                                              // Test Step 13 Run the debugger
  /***************************************************************************************************************/
  snprintf( chActionText, elCount(chActionText), "Run the software "); 
  snprintf( chExpectedText, elCount(chExpectedText), "ECU should be in running state"); 
  A_DBGR_Go();
  
   /***************************************************************************************************************/    
                                              // Test Step 14 Wait for the breakpoint to hit
  /***************************************************************************************************************/
  snprintf( chActionText, elCount(chActionText), "Verify Breakpoint should hit in Os_Entry_Task_Core0_5ms\\13 "); 
  snprintf( chExpectedText, elCount(chExpectedText), "Breakpoint hit in Os_Entry_Task_Core0_5ms\\13 function"); 
  //TestStepAddActionExpected( chActionText, chExpectedText );  
  E_DBGR_BreakpointCheckForHalt("Spi_lQspiHWSetJobConfig\\18");
  
  snprintf( chActionText, elCount(chActionText), "Flash the Software and ECU is running "); 
  snprintf( chExpectedText, elCount(chExpectedText), "ECU should be in running state"); 
  TestStepAddActionExpected( chActionText, chExpectedText );
  A_DBGR_BreakpointDeleteAll();
  /***************************************************************************************************************/    
                                              // Test Step 15 set TransferCount variable to 5 to inject TxFIFO overflow fault.
  /***************************************************************************************************************/
  snprintf( chActionText, elCount(chActionText), "Configure TransferCount variable"); 
  snprintf( chExpectedText, elCount(chExpectedText), "Verify TransferCount is configured as 0"); 
  //TestStepAddActionExpected( chActionText, chExpectedText );
  A_DBGR_VariableSet("TransferCount","5");
  E_DBGR_VariableCheck("TransferCount",5,Equal);
   
  snprintf( chActionText, elCount(chActionText), "Flash the Software and ECU is running "); 
  snprintf( chExpectedText, elCount(chExpectedText), "ECU should be in running state"); 
  TestStepAddActionExpected( chActionText, chExpectedText );
  A_DBGR_BreakpointDeleteAll();
  /***************************************************************************************************************/    
                                              // Test Step 8 Set a breakpoint at line TestCanTrcv_Getmode(void); in OS_Tasks.c file
  /***************************************************************************************************************/
  snprintf( chActionText, elCount(chActionText), "Set Breakpoint Os_Entry_Task_Core0_5ms\\14 callback function "); 
  snprintf( chExpectedText, elCount(chExpectedText), "Breakpoint is Set in Os_Entry_Task_Core0_5ms\\14"); 
  //TestStepAddActionExpected( chActionText, chExpectedText );   
  A_DBGR_BreakpointSet("Os_Entry_Task_Core0_5ms\\14");  
  
  
   /***************************************************************************************************************/    
                                              // Test Step 9 Run the debugger
  /***************************************************************************************************************/
  snprintf( chActionText, elCount(chActionText), "Run the software "); 
  snprintf( chExpectedText, elCount(chExpectedText), "ECU should be in running state"); 
  A_DBGR_Go();
  
   /***************************************************************************************************************/    
                                              // Test Step 10 Wait for the breakpoint to hit
  /***************************************************************************************************************/
  snprintf( chActionText, elCount(chActionText), "Verify Breakpoint should hit in Os_Entry_Task_Core0_5ms\\14 "); 
  snprintf( chExpectedText, elCount(chExpectedText), "Breakpoint hit in Os_Entry_Task_Core0_5ms\\14 function"); 
  //TestStepAddActionExpected( chActionText, chExpectedText );  
  E_DBGR_BreakpointCheckForHalt("Os_Entry_Task_Core0_5ms\\14");
  
  /***************************************************************************************************************/    
                                              // Test Step  Delete all Breakpoints
  /***************************************************************************************************************/
  snprintf( chActionText, elCount(chActionText), "Flash the Software and ECU is running "); 
  snprintf( chExpectedText, elCount(chExpectedText), "ECU should be in running state"); 
  TestStepAddActionExpected( chActionText, chExpectedText );
  A_DBGR_BreakpointDeleteAll();
  
  
  /***************************************************************************************************************/    
                                              // Test Step 11 Set Breakpoint Spi_lQspiSyncTransmitData32Bit\\24 callback function
  /***************************************************************************************************************/
  snprintf( chActionText, elCount(chActionText), "Set Breakpoint Spi_lQspiSyncTransmitData32Bit\\24 callback function "); 
  snprintf( chExpectedText, elCount(chExpectedText), "Breakpoint is Set in Spi_lQspiSyncTransmitData32Bit\\24"); 
  //TestStepAddActionExpected( chActionText, chExpectedText );   
  A_DBGR_BreakpointSet("Spi_lQspiSyncTransmitData32Bit\\24");  
  
  /***************************************************************************************************************/    
                                              // Test Step 12 Run the debugger
  /***************************************************************************************************************/
  snprintf( chActionText, elCount(chActionText), "Run the software "); 
  snprintf( chExpectedText, elCount(chExpectedText), "ECU should be in running state"); 
  A_DBGR_Go();
  
   /***************************************************************************************************************/    
                                              // Test Step 13 Wait for the breakpoint to hit
  /***************************************************************************************************************/
  snprintf( chActionText, elCount(chActionText), "Verify Breakpoint should hit in Spi_lQspiSyncTransmitData32Bit\\24 "); 
  snprintf( chExpectedText, elCount(chExpectedText), "Breakpoint hit in Spi_lQspiSyncTransmitData32Bit\\24 function"); 
  //TestStepAddActionExpected( chActionText, chExpectedText );  
  E_DBGR_BreakpointCheckForHalt("Spi_lQspiSyncTransmitData32Bit\\24");
  
  /***************************************************************************************************************/    
                                              // Test Step 14 set Timeout variable to 5 to inject TxFIFO overflow fault.
  /***************************************************************************************************************/
  snprintf( chActionText, elCount(chActionText), "Configure Timeout variable"); 
  snprintf( chExpectedText, elCount(chExpectedText), "Verify Timeout is configured as 0"); 
  TestStepAddActionExpected( chActionText, chExpectedText );
  A_DBGR_VariableSet("Timeout","0");
  E_DBGR_VariableCheck("Timeout",0,Equal);
  
  
  /***************************************************************************************************************/    
                                              // Test Step 14 Delete all Breakpoints
  /***************************************************************************************************************/
  snprintf( chActionText, elCount(chActionText), "Flash the Software and ECU is running "); 
  snprintf( chExpectedText, elCount(chExpectedText), "ECU should be in running state"); 
  TestStepAddActionExpected( chActionText, chExpectedText );
  A_DBGR_BreakpointDeleteAll();
    

   /***************************************************************************************************************/    
                                              // Test Step 15 Set a breakpoint at line BUS_DEVICE_ID = GetHWIO_e_BusDeviceID(void); inside function void Test_GetHWIO_e_BusDeviceID( void ) 
  /***************************************************************************************************************/
  snprintf( chActionText, elCount(chActionText), "Set Breakpoint Test_GetHWIO_e_BusDeviceID\\8 callback function "); 
  snprintf( chExpectedText, elCount(chExpectedText), "Breakpoint is Set in Test_GetHWIO_e_BusDeviceID\\8"); 
  //TestStepAddActionExpected( chActionText, chExpectedText );   
  A_DBGR_BreakpointSet("Test_GetHWIO_e_BusDeviceID\\8"); 
  
  /***************************************************************************************************************/    
                                              // Test Step 16 Run the debugger
  /***************************************************************************************************************/
  snprintf( chActionText, elCount(chActionText), "Run the software "); 
  snprintf( chExpectedText, elCount(chExpectedText), "ECU should be in running state"); 
  A_DBGR_Go();

  /***************************************************************************************************************/    
                                              // Test Step 17 Wait for the breakpoint to hit
  /***************************************************************************************************************/
  snprintf( chActionText, elCount(chActionText), "Verify Breakpoint should hit in Test_GetHWIO_e_BusDeviceID\\8 "); 
  snprintf( chExpectedText, elCount(chExpectedText), "Breakpoint hit in Test_GetHWIO_e_BusDeviceID\\8 function"); 
  //TestStepAddActionExpected( chActionText, chExpectedText );  
  E_DBGR_BreakpointCheckForHalt("Test_GetHWIO_e_BusDeviceID\\8");
  
  /***************************************************************************************************************/    
                                              // Test Step 18 	Verify BUS_DEVICE_ID value as 7.
  /***************************************************************************************************************/
  snprintf( chActionText, elCount(chActionText), "Configure BUSID variable"); 
  snprintf( chExpectedText, elCount(chExpectedText), "Verify BUSID is configured as 7"); 
  TestStepAddActionExpected( chActionText, chExpectedText );
  E_DBGR_VariableCheck("BUS_DEVICE_ID",7,Equal);

}

testcase Verify_GetHWIO_e_BusID_function_returns_SPI_MCU_PMIC_TLF4D_Bus_Network_3()
{
  /***************************************************************************************************************/    
                                                // Variable Definition
  /***************************************************************************************************************/ 
  

  
  /***************************************************************************************************************/    
                                               // Local Values
  /***************************************************************************************************************/ 
  

  
  /***************************************************************************************************************/    
                                              // Test Case Info
  /***************************************************************************************************************/
  setWriteDbgLevel(DebugOff);
  snprintf( chTestTitle, elCount(chTestTitle), "Verify_GetHWIO_e_BusID_function_returns_SPI_MCU_PMIC_TLF4D_Bus_Network_3" );
  snprintf( chTestDescription, elCount(chTestDescription), "Purpose:To check the GetHWIO_e_BusID interface ");
  TestCaseAddInfo( chTestTitle, "TC_L30SW_Q-36629491", chTestDescription );

  /***************************************************************************************************************/    
                                              // Test Step 0 PRECONDITIONS
  /***************************************************************************************************************/
  snprintf( chActionText, elCount(chActionText), "Flash the Software and ECU is running "); 
  snprintf( chExpectedText, elCount(chExpectedText), "ECU should be in running state"); 
  TestStepAddActionExpected( chActionText, chExpectedText );
  A_DBGR_BreakpointDeleteAll();
  
  snprintf( chActionText, elCount(chActionText), "Flash the Software and ECU is running "); 
  snprintf( chExpectedText, elCount(chExpectedText), "ECU should be in running state"); 
 
  A_DBGR_R();
  A_DBGR_Go();
  /***************************************************************************************************************/    
                                              // Test Step 1 Set a breakpoint at line TestCanTrcv_Getmode(void); in OS_Tasks.c file
  /***************************************************************************************************************/
  snprintf( chActionText, elCount(chActionText), "Set Breakpoint Os_Entry_Task_Core0_5ms\\14 callback function "); 
  snprintf( chExpectedText, elCount(chExpectedText), "Breakpoint is Set in Os_Entry_Task_Core0_5ms\\14"); 
  //TestStepAddActionExpected( chActionText, chExpectedText );   
  A_DBGR_BreakpointSet("Os_Entry_Task_Core0_5ms\\14");  
  
  
   /***************************************************************************************************************/    
                                              // Test Step 2 Run the debugger
  /***************************************************************************************************************/
  snprintf( chActionText, elCount(chActionText), "Run the software "); 
  snprintf( chExpectedText, elCount(chExpectedText), "ECU should be in running state"); 
  A_DBGR_Go();
  
   /***************************************************************************************************************/    
                                              // Test Step 3 Wait for the breakpoint to hit
  /***************************************************************************************************************/
  snprintf( chActionText, elCount(chActionText), "Verify Breakpoint should hit in Os_Entry_Task_Core0_5ms\\14 "); 
  snprintf( chExpectedText, elCount(chExpectedText), "Breakpoint hit in Os_Entry_Task_Core0_5ms\\14 function"); 
  //TestStepAddActionExpected( chActionText, chExpectedText );  
  E_DBGR_BreakpointCheckForHalt("Os_Entry_Task_Core0_5ms\\14");
  
  /***************************************************************************************************************/    
                                              // Test Step 4 Delete all Breakpoints
  /***************************************************************************************************************/
  snprintf( chActionText, elCount(chActionText), "Flash the Software and ECU is running "); 
  snprintf( chExpectedText, elCount(chExpectedText), "ECU should be in running state"); 
  TestStepAddActionExpected( chActionText, chExpectedText );
  A_DBGR_BreakpointDeleteAll();
  
  
  /***************************************************************************************************************/    
                                              // Test Step 5 Set Breakpoint Spi_lQspiSyncTransmitData32Bit\\24 callback function
  /***************************************************************************************************************/
  snprintf( chActionText, elCount(chActionText), "Set Breakpoint Spi_lQspiSyncTransmitData32Bit\\24 callback function "); 
  snprintf( chExpectedText, elCount(chExpectedText), "Breakpoint is Set in Spi_lQspiSyncTransmitData32Bit\\24"); 
  //TestStepAddActionExpected( chActionText, chExpectedText );   
  A_DBGR_BreakpointSet("Spi_lQspiSyncTransmitData32Bit\\24");  
  
  /***************************************************************************************************************/    
                                              // Test Step 6 Run the debugger
  /***************************************************************************************************************/
  snprintf( chActionText, elCount(chActionText), "Run the software "); 
  snprintf( chExpectedText, elCount(chExpectedText), "ECU should be in running state"); 
  A_DBGR_Go();
  
   /***************************************************************************************************************/    
                                              // Test Step 7 Wait for the breakpoint to hit
  /***************************************************************************************************************/
  snprintf( chActionText, elCount(chActionText), "Verify Breakpoint should hit in Spi_lQspiSyncTransmitData32Bit\\24 "); 
  snprintf( chExpectedText, elCount(chExpectedText), "Breakpoint hit in Spi_lQspiSyncTransmitData32Bit\\24 function"); 
  //TestStepAddActionExpected( chActionText, chExpectedText );  
  E_DBGR_BreakpointCheckForHalt("Spi_lQspiSyncTransmitData32Bit\\24");
  
  /***************************************************************************************************************/    
                                              // Test Step 8 set Timeout variable to 5 to inject TxFIFO overflow fault.
  /***************************************************************************************************************/
  snprintf( chActionText, elCount(chActionText), "Configure Timeout variable"); 
  snprintf( chExpectedText, elCount(chExpectedText), "Verify Timeout is configured as 0"); 
  TestStepAddActionExpected( chActionText, chExpectedText );
  A_DBGR_VariableSet("Timeout","0");
  E_DBGR_VariableCheck("Timeout",0,Equal);
  
  /***************************************************************************************************************/    
                                              // Test Step 9 Delete all Breakpoints
  /***************************************************************************************************************/
  snprintf( chActionText, elCount(chActionText), "Flash the Software and ECU is running "); 
  snprintf( chExpectedText, elCount(chExpectedText), "ECU should be in running state"); 
  TestStepAddActionExpected( chActionText, chExpectedText );
  A_DBGR_BreakpointDeleteAll();
  
   /***************************************************************************************************************/    
                                              // Test Step 10 Set a breakpoint at line BUS_ID = GetHWIO_e_BusID(void); inside function void Test_GetHWIO_e_BusID( void ) 
  /***************************************************************************************************************/
  snprintf( chActionText, elCount(chActionText), "Set Breakpoint Test_GetHWIO_e_BusID\\8 callback function "); 
  snprintf( chExpectedText, elCount(chExpectedText), "Breakpoint is Set in Test_GetHWIO_e_BusID\\8"); 
  //TestStepAddActionExpected( chActionText, chExpectedText );   
  A_DBGR_BreakpointSet("Test_GetHWIO_e_BusID\\8"); 
  
  /***************************************************************************************************************/    
                                              // Test Step 11 Run the debugger
  /***************************************************************************************************************/
  snprintf( chActionText, elCount(chActionText), "Run the software "); 
  snprintf( chExpectedText, elCount(chExpectedText), "ECU should be in running state"); 
  A_DBGR_Go();

  /***************************************************************************************************************/    
                                              // Test Step 12 Wait for the breakpoint to hit
  /***************************************************************************************************************/
  snprintf( chActionText, elCount(chActionText), "Verify Breakpoint should hit in Test_GetHWIO_e_BusID\\8 "); 
  snprintf( chExpectedText, elCount(chExpectedText), "Breakpoint hit in Test_GetHWIO_e_BusID\\8 function"); 
  //TestStepAddActionExpected( chActionText, chExpectedText );  
  E_DBGR_BreakpointCheckForHalt("Test_GetHWIO_e_BusID\\8");
  
  /***************************************************************************************************************/    
                                              // Test Step 13 	Verify BUS_ID value as 4.
  /***************************************************************************************************************/
  snprintf( chActionText, elCount(chActionText), "Configure BUSID variable"); 
  snprintf( chExpectedText, elCount(chExpectedText), "Verify BUSID is configured as 4"); 
  TestStepAddActionExpected( chActionText, chExpectedText );
  E_DBGR_VariableCheck("BUS_ID",4,Equal);

}

testcase Verify_GetHWIO_e_BusID_function_returns_SPI_MCU_CAN8TCVR_Bus_Network_2()
{
  /***************************************************************************************************************/    
                                                // Variable Definition
  /***************************************************************************************************************/ 
  

  
  /***************************************************************************************************************/    
                                               // Local Values
  /***************************************************************************************************************/ 
  

  
  /***************************************************************************************************************/    
                                              // Test Case Info
  /***************************************************************************************************************/
  setWriteDbgLevel(DebugOff);
  snprintf( chTestTitle, elCount(chTestTitle), "Verify_GetHWIO_e_BusID_function_returns_SPI_MCU_CAN8TCVR_Bus_Network_2" );
  snprintf( chTestDescription, elCount(chTestDescription), "Purpose:To check the GetHWIO_e_BusID interface ");
  TestCaseAddInfo( chTestTitle, "TC_L30SW_Q-36629492", chTestDescription );

  /***************************************************************************************************************/    
                                              // Test Step 0 PRECONDITIONS
  /***************************************************************************************************************/
  snprintf( chActionText, elCount(chActionText), "Flash the Software and ECU is running "); 
  snprintf( chExpectedText, elCount(chExpectedText), "ECU should be in running state"); 
  TestStepAddActionExpected( chActionText, chExpectedText );
  A_DBGR_BreakpointDeleteAll();
  
  snprintf( chActionText, elCount(chActionText), "Flash the Software and ECU is running "); 
  snprintf( chExpectedText, elCount(chExpectedText), "ECU should be in running state"); 
 
  A_DBGR_R();
  
  A_DBGR_Go();
  /***************************************************************************************************************/    
                                              // Test Step 1 Set a breakpoint at line TestCanTrcv_Getmode(void); in OS_Tasks.c file
  /***************************************************************************************************************/
  snprintf( chActionText, elCount(chActionText), "Set Breakpoint Os_Entry_Task_Core0_5ms\\13 callback function "); 
  snprintf( chExpectedText, elCount(chExpectedText), "Breakpoint is Set in Os_Entry_Task_Core0_5ms\\13"); 
  //TestStepAddActionExpected( chActionText, chExpectedText );   
  A_DBGR_BreakpointSet("Os_Entry_Task_Core0_5ms\\13");  
  
  
   /***************************************************************************************************************/    
                                              // Test Step 2 Run the debugger
  /***************************************************************************************************************/
  snprintf( chActionText, elCount(chActionText), "Run the software "); 
  snprintf( chExpectedText, elCount(chExpectedText), "ECU should be in running state"); 
  A_DBGR_Go();
  
  /***************************************************************************************************************/    
                                              // Test Step 3 Set a Channel_ID 1 and Channel_ID_B to 1 to call GetCNDD_e_CanTrcvOpMode(1U, &Getcantravmode);
  /***************************************************************************************************************/
  snprintf( chActionText, elCount(chActionText), "Configure Channel_ID variable"); 
  snprintf( chExpectedText, elCount(chExpectedText), "Verify TransferCount is configured as 1"); 
  //TestStepAddActionExpected( chActionText, chExpectedText );
  A_DBGR_VariableSet("Channel_ID","1");
  E_DBGR_VariableCheck("Channel_ID",1,Equal);
  
  snprintf( chActionText, elCount(chActionText), "Configure Channel_ID_B variable"); 
  snprintf( chExpectedText, elCount(chExpectedText), "Verify TransferCount is configured as 1"); 
  TestStepAddActionExpected( chActionText, chExpectedText );
  A_DBGR_VariableSet("Channel_ID_B","1");
  E_DBGR_VariableCheck("Channel_ID_B",1,Equal);
  
  
   /***************************************************************************************************************/    
                                              // Test Step 4 Wait for the breakpoint to hit
  /***************************************************************************************************************/
  snprintf( chActionText, elCount(chActionText), "Verify Breakpoint should hit in Os_Entry_Task_Core0_5ms\\13 "); 
  snprintf( chExpectedText, elCount(chExpectedText), "Breakpoint hit in Os_Entry_Task_Core0_5ms\\13 function"); 
  TestStepAddActionExpected( chActionText, chExpectedText );  
  E_DBGR_BreakpointCheckForHalt("Os_Entry_Task_Core0_5ms\\13");
  
  snprintf( chActionText, elCount(chActionText), "Flash the Software and ECU is running "); 
  snprintf( chExpectedText, elCount(chExpectedText), "ECU should be in running state"); 
  TestStepAddActionExpected( chActionText, chExpectedText );
  A_DBGR_BreakpointDeleteAll();
  /***************************************************************************************************************/    
                                              // Test Step 5 MCALUTIL_SFRWRITE(SPI_HW_MODULE[KernelId].MC.U, ((uint32)TransferCount<<IFX_QSPI_MC_MCOUNT_OFF));
  /***************************************************************************************************************/
  snprintf( chActionText, elCount(chActionText), "Set Breakpoint Spi_lQspiHWSetJobConfig\\18 callback function "); 
  snprintf( chExpectedText, elCount(chExpectedText), "Breakpoint is Set in Spi_lQspiHWSetJobConfig\\18"); 
  //TestStepAddActionExpected( chActionText, chExpectedText );   
  A_DBGR_BreakpointSet("Spi_lQspiHWSetJobConfig\\18");  
  
  /***************************************************************************************************************/    
                                              // Test Step 6 Run the debugger
  /***************************************************************************************************************/
  snprintf( chActionText, elCount(chActionText), "Run the software "); 
  snprintf( chExpectedText, elCount(chExpectedText), "ECU should be in running state"); 
  A_DBGR_Go();
  
   /***************************************************************************************************************/    
                                              // Test Step 7 Wait for the breakpoint to hit
  /***************************************************************************************************************/
  snprintf( chActionText, elCount(chActionText), "Verify Breakpoint should hit in Os_Entry_Task_Core0_5ms\\13 "); 
  snprintf( chExpectedText, elCount(chExpectedText), "Breakpoint hit in Os_Entry_Task_Core0_5ms\\13 function"); 
  //TestStepAddActionExpected( chActionText, chExpectedText );  
  E_DBGR_BreakpointCheckForHalt("Spi_lQspiHWSetJobConfig\\18");
  
  
  /***************************************************************************************************************/    
                                              // Test Step 8 set TransferCount variable to 5 to inject TxFIFO overflow fault.
  /***************************************************************************************************************/
  snprintf( chActionText, elCount(chActionText), "Configure TransferCount variable"); 
  snprintf( chExpectedText, elCount(chExpectedText), "Verify TransferCount is configured as 0"); 
  TestStepAddActionExpected( chActionText, chExpectedText );
  A_DBGR_VariableSet("TransferCount","5");
  E_DBGR_VariableCheck("TransferCount",5,Equal);
  
  
  /***************************************************************************************************************/    
                                              // Test Step 9 Delete all Breakpoints
  /***************************************************************************************************************/
  snprintf( chActionText, elCount(chActionText), "Flash the Software and ECU is running "); 
  snprintf( chExpectedText, elCount(chExpectedText), "ECU should be in running state"); 
  TestStepAddActionExpected( chActionText, chExpectedText );
  A_DBGR_BreakpointDeleteAll();
  
   /***************************************************************************************************************/    
                                              // Test Step 10 Set a breakpoint at line BUS_ID = GetHWIO_e_BusID(void); inside function void Test_GetHWIO_e_BusID( void ) 
  /***************************************************************************************************************/
  snprintf( chActionText, elCount(chActionText), "Set Breakpoint Test_GetHWIO_e_BusID\\8 callback function "); 
  snprintf( chExpectedText, elCount(chExpectedText), "Breakpoint is Set in Test_GetHWIO_e_BusID\\8"); 
  //TestStepAddActionExpected( chActionText, chExpectedText );   
  A_DBGR_BreakpointSet("Test_GetHWIO_e_BusID\\8"); 
  
  /***************************************************************************************************************/    
                                              // Test Step 11 Run the debugger
  /***************************************************************************************************************/
  snprintf( chActionText, elCount(chActionText), "Run the software "); 
  snprintf( chExpectedText, elCount(chExpectedText), "ECU should be in running state"); 
  A_DBGR_Go();

  /***************************************************************************************************************/    
                                              // Test Step 12 Wait for the breakpoint to hit
  /***************************************************************************************************************/
  snprintf( chActionText, elCount(chActionText), "Verify Breakpoint should hit in Test_GetHWIO_e_BusID\\8 "); 
  snprintf( chExpectedText, elCount(chExpectedText), "Breakpoint hit in Test_GetHWIO_e_BusID\\8 function"); 
  //TestStepAddActionExpected( chActionText, chExpectedText );  
  E_DBGR_BreakpointCheckForHalt("Test_GetHWIO_e_BusID\\8");
  
  /***************************************************************************************************************/    
                                              // Test Step 13 	Verify BUS_ID value as 2.
  /***************************************************************************************************************/
  snprintf( chActionText, elCount(chActionText), "Configure BUSID variable"); 
  snprintf( chExpectedText, elCount(chExpectedText), "Verify BUSID is configured as 2"); 
  TestStepAddActionExpected( chActionText, chExpectedText );
  E_DBGR_VariableCheck("BUS_ID",2,Equal);


}

testcase Verify_GetHWIO_e_BusID_function_returns_SPI_MCU_CAN2TCVR_Bus_Network_1()
{
  /***************************************************************************************************************/    
                                                // Variable Definition
  /***************************************************************************************************************/ 
  

  
  /***************************************************************************************************************/    
                                               // Local Values
  /***************************************************************************************************************/ 
  

  
  /***************************************************************************************************************/    
                                              // Test Case Info
  /***************************************************************************************************************/
  setWriteDbgLevel(DebugOff);
  snprintf( chTestTitle, elCount(chTestTitle), "Verify_GetHWIO_e_BusID_function_returns_SPI_MCU_CAN2TCVR_Bus_Network_1" );
  snprintf( chTestDescription, elCount(chTestDescription), "Purpose:To check the GetHWIO_e_BusID interface ");
  TestCaseAddInfo( chTestTitle, "TC_L30SW_Q-36629493", chTestDescription );

  /***************************************************************************************************************/    
                                              // Test Step 0 PRECONDITIONS
  /***************************************************************************************************************/
  snprintf( chActionText, elCount(chActionText), "Flash the Software and ECU is running "); 
  snprintf( chExpectedText, elCount(chExpectedText), "ECU should be in running state"); 
  TestStepAddActionExpected( chActionText, chExpectedText );
  A_DBGR_BreakpointDeleteAll();
  
  snprintf( chActionText, elCount(chActionText), "Flash the Software and ECU is running "); 
  snprintf( chExpectedText, elCount(chExpectedText), "ECU should be in running state"); 
 
  A_DBGR_R();
  A_DBGR_Go();
  
  /***************************************************************************************************************/    
                                              // Test Step 1 Set a breakpoint at line TestCanTrcv_Getmode(void); in OS_Tasks.c file
  /***************************************************************************************************************/
  snprintf( chActionText, elCount(chActionText), "Set Breakpoint Os_Entry_Task_Core0_5ms\\13 callback function "); 
  snprintf( chExpectedText, elCount(chExpectedText), "Breakpoint is Set in Os_Entry_Task_Core0_5ms\\13"); 
  //TestStepAddActionExpected( chActionText, chExpectedText );   
  A_DBGR_BreakpointSet("Os_Entry_Task_Core0_5ms\\13");  
  
  
   /***************************************************************************************************************/    
                                              // Test Step 2 Run the debugger
  /***************************************************************************************************************/
  snprintf( chActionText, elCount(chActionText), "Run the software "); 
  snprintf( chExpectedText, elCount(chExpectedText), "ECU should be in running state"); 
  A_DBGR_Go();
  
   /***************************************************************************************************************/    
                                              // Test Step 3 Wait for the breakpoint to hit
  /***************************************************************************************************************/
  snprintf( chActionText, elCount(chActionText), "Verify Breakpoint should hit in Os_Entry_Task_Core0_5ms\\13 "); 
  snprintf( chExpectedText, elCount(chExpectedText), "Breakpoint hit in Os_Entry_Task_Core0_5ms\\13 function"); 
  //TestStepAddActionExpected( chActionText, chExpectedText );  
  E_DBGR_BreakpointCheckForHalt("Os_Entry_Task_Core0_5ms\\13");
  
  snprintf( chActionText, elCount(chActionText), "Flash the Software and ECU is running "); 
  snprintf( chExpectedText, elCount(chExpectedText), "ECU should be in running state"); 
  TestStepAddActionExpected( chActionText, chExpectedText );
  A_DBGR_BreakpointDeleteAll();
  /***************************************************************************************************************/    
                                              // Test Step 4 MCALUTIL_SFRWRITE(SPI_HW_MODULE[KernelId].MC.U, ((uint32)TransferCount<<IFX_QSPI_MC_MCOUNT_OFF));
  /***************************************************************************************************************/
  snprintf( chActionText, elCount(chActionText), "Set Breakpoint Spi_lQspiHWSetJobConfig\\18 callback function "); 
  snprintf( chExpectedText, elCount(chExpectedText), "Breakpoint is Set in Spi_lQspiHWSetJobConfig\\18"); 
  //TestStepAddActionExpected( chActionText, chExpectedText );   
  A_DBGR_BreakpointSet("Spi_lQspiHWSetJobConfig\\18");  
  
  /***************************************************************************************************************/    
                                              // Test Step 5 Run the debugger
  /***************************************************************************************************************/
  snprintf( chActionText, elCount(chActionText), "Run the software "); 
  snprintf( chExpectedText, elCount(chExpectedText), "ECU should be in running state"); 
  A_DBGR_Go();
  
   /***************************************************************************************************************/    
                                              // Test Step 6 Wait for the breakpoint to hit
  /***************************************************************************************************************/
  snprintf( chActionText, elCount(chActionText), "Verify Breakpoint should hit in Os_Entry_Task_Core0_5ms\\13 "); 
  snprintf( chExpectedText, elCount(chExpectedText), "Breakpoint hit in Os_Entry_Task_Core0_5ms\\13 function"); 
  //TestStepAddActionExpected( chActionText, chExpectedText );  
  E_DBGR_BreakpointCheckForHalt("Spi_lQspiHWSetJobConfig\\18");
  
  /***************************************************************************************************************/    
                                              // Test Step 7 set TransferCount variable to 5 to inject TxFIFO overflow fault.
  /***************************************************************************************************************/
  snprintf( chActionText, elCount(chActionText), "Configure TransferCount variable"); 
  snprintf( chExpectedText, elCount(chExpectedText), "Verify TransferCount is configured as 0"); 
  TestStepAddActionExpected( chActionText, chExpectedText );
  A_DBGR_VariableSet("TransferCount","5");
  E_DBGR_VariableCheck("TransferCount",5,Equal);
  
  
  /***************************************************************************************************************/    
                                              // Test Step 8 Delete all Breakpoints
  /***************************************************************************************************************/
  snprintf( chActionText, elCount(chActionText), "Flash the Software and ECU is running "); 
  snprintf( chExpectedText, elCount(chExpectedText), "ECU should be in running state"); 
  TestStepAddActionExpected( chActionText, chExpectedText );
  A_DBGR_BreakpointDeleteAll();
  
   /***************************************************************************************************************/    
                                              // Test Step 9 Set a breakpoint at line BUS_ID = GetHWIO_e_BusID(void); inside function void Test_GetHWIO_e_BusID( void ) 
  /***************************************************************************************************************/
  snprintf( chActionText, elCount(chActionText), "Set Breakpoint Test_GetHWIO_e_BusID\\8 callback function "); 
  snprintf( chExpectedText, elCount(chExpectedText), "Breakpoint is Set in Test_GetHWIO_e_BusID\\8"); 
  //TestStepAddActionExpected( chActionText, chExpectedText );   
  A_DBGR_BreakpointSet("Test_GetHWIO_e_BusID\\8"); 
  
  /***************************************************************************************************************/    
                                              // Test Step 10 Run the debugger
  /***************************************************************************************************************/
  snprintf( chActionText, elCount(chActionText), "Run the software "); 
  snprintf( chExpectedText, elCount(chExpectedText), "ECU should be in running state"); 
  A_DBGR_Go();

  /***************************************************************************************************************/    
                                              // Test Step 11 Wait for the breakpoint to hit
  /***************************************************************************************************************/
  snprintf( chActionText, elCount(chActionText), "Verify Breakpoint should hit in Test_GetHWIO_e_BusID\\8 "); 
  snprintf( chExpectedText, elCount(chExpectedText), "Breakpoint hit in Test_GetHWIO_e_BusID\\8 function"); 
  //TestStepAddActionExpected( chActionText, chExpectedText );  
  E_DBGR_BreakpointCheckForHalt("Test_GetHWIO_e_BusID\\8");
  
  /***************************************************************************************************************/    
                                              // Test Step 12 	Verify BUS_ID value as 1.
  /***************************************************************************************************************/
  snprintf( chActionText, elCount(chActionText), "Configure BUSID variable"); 
  snprintf( chExpectedText, elCount(chExpectedText), "Verify BUSID is configured as 1"); 
  TestStepAddActionExpected( chActionText, chExpectedText );
  E_DBGR_VariableCheck("BUS_ID",1,Equal);


}

testcase Verify_GetHWIO_e_BusDeviceID_function_returns_PMIC_TLF4D_Device_3_Failed()
{
    /***************************************************************************************************************/    
                                                // Variable Definition
  /***************************************************************************************************************/ 
  

  
  /***************************************************************************************************************/    
                                               // Local Values
  /***************************************************************************************************************/ 
  

  
  /***************************************************************************************************************/    
                                              // Test Case Info
  /***************************************************************************************************************/
  setWriteDbgLevel(DebugOff);
  snprintf( chTestTitle, elCount(chTestTitle), "Verify_GetHWIO_e_BusDeviceID_function_returns_PMIC_TLF4D_Device_3_Failed" );
  snprintf( chTestDescription, elCount(chTestDescription), "Purpose:To check the GetHWIO_e_BusDeviceID interface ");
  TestCaseAddInfo( chTestTitle, "TC_L30SW_Q-36629501", chTestDescription );

  /***************************************************************************************************************/    
                                              // Test Step 0 PRECONDITIONS
  /***************************************************************************************************************/
  snprintf( chActionText, elCount(chActionText), "Flash the Software and ECU is running "); 
  snprintf( chExpectedText, elCount(chExpectedText), "ECU should be in running state"); 
  TestStepAddActionExpected( chActionText, chExpectedText );
  A_DBGR_BreakpointDeleteAll();
  
  snprintf( chActionText, elCount(chActionText), "Flash the Software and ECU is running "); 
  snprintf( chExpectedText, elCount(chExpectedText), "ECU should be in running state"); 
 
  A_DBGR_R();
  A_DBGR_Go();
  /***************************************************************************************************************/    
                                              // Test Step 1 Set a breakpoint at line TestCanTrcv_Getmode(void); in OS_Tasks.c file
  /***************************************************************************************************************/
  snprintf( chActionText, elCount(chActionText), "Set Breakpoint Os_Entry_Task_Core0_5ms\\14 callback function "); 
  snprintf( chExpectedText, elCount(chExpectedText), "Breakpoint is Set in Os_Entry_Task_Core0_5ms\\14"); 
  //TestStepAddActionExpected( chActionText, chExpectedText );   
  A_DBGR_BreakpointSet("Os_Entry_Task_Core0_5ms\\14");  
  
  
   /***************************************************************************************************************/    
                                              // Test Step 2 Run the debugger
  /***************************************************************************************************************/
  snprintf( chActionText, elCount(chActionText), "Run the software "); 
  snprintf( chExpectedText, elCount(chExpectedText), "ECU should be in running state"); 
  A_DBGR_Go();
  
   /***************************************************************************************************************/    
                                              // Test Step 3 Wait for the breakpoint to hit
  /***************************************************************************************************************/
  snprintf( chActionText, elCount(chActionText), "Verify Breakpoint should hit in Os_Entry_Task_Core0_5ms\\14 "); 
  snprintf( chExpectedText, elCount(chExpectedText), "Breakpoint hit in Os_Entry_Task_Core0_5ms\\14 function"); 
  //TestStepAddActionExpected( chActionText, chExpectedText );  
  E_DBGR_BreakpointCheckForHalt("Os_Entry_Task_Core0_5ms\\14");
  
  /***************************************************************************************************************/    
                                              // Test Step 4 Delete all Breakpoints
  /***************************************************************************************************************/
  snprintf( chActionText, elCount(chActionText), "Flash the Software and ECU is running "); 
  snprintf( chExpectedText, elCount(chExpectedText), "ECU should be in running state"); 
  TestStepAddActionExpected( chActionText, chExpectedText );
  A_DBGR_BreakpointDeleteAll();
  
  
  /***************************************************************************************************************/    
                                              // Test Step 5 Set Breakpoint Spi_lQspiSyncTransmitData32Bit\\24 callback function
  /***************************************************************************************************************/
  snprintf( chActionText, elCount(chActionText), "Set Breakpoint Spi_lQspiSyncTransmitData32Bit\\24 callback function "); 
  snprintf( chExpectedText, elCount(chExpectedText), "Breakpoint is Set in Spi_lQspiSyncTransmitData32Bit\\24"); 
  //TestStepAddActionExpected( chActionText, chExpectedText );   
  A_DBGR_BreakpointSet("Spi_lQspiSyncTransmitData32Bit\\24");  
  
  /***************************************************************************************************************/    
                                              // Test Step 6 Run the debugger
  /***************************************************************************************************************/
  snprintf( chActionText, elCount(chActionText), "Run the software "); 
  snprintf( chExpectedText, elCount(chExpectedText), "ECU should be in running state"); 
  A_DBGR_Go();
  
   /***************************************************************************************************************/    
                                              // Test Step 7 Wait for the breakpoint to hit
  /***************************************************************************************************************/
  snprintf( chActionText, elCount(chActionText), "Verify Breakpoint should hit in Spi_lQspiSyncTransmitData32Bit\\24 "); 
  snprintf( chExpectedText, elCount(chExpectedText), "Breakpoint hit in Spi_lQspiSyncTransmitData32Bit\\24 function"); 
  //TestStepAddActionExpected( chActionText, chExpectedText );  
  E_DBGR_BreakpointCheckForHalt("Spi_lQspiSyncTransmitData32Bit\\24");
  
  /***************************************************************************************************************/    
                                              // Test Step 8 set Timeout variable to 5 to inject TxFIFO overflow fault.
  /***************************************************************************************************************/
  snprintf( chActionText, elCount(chActionText), "Configure Timeout variable"); 
  snprintf( chExpectedText, elCount(chExpectedText), "Verify Timeout is configured as 0"); 
  TestStepAddActionExpected( chActionText, chExpectedText );
  A_DBGR_VariableSet("Timeout","0");
  E_DBGR_VariableCheck("Timeout",0,Equal);
  
  /***************************************************************************************************************/    
                                              // Test Step 9 Delete all Breakpoints
  /***************************************************************************************************************/
  snprintf( chActionText, elCount(chActionText), "Flash the Software and ECU is running "); 
  snprintf( chExpectedText, elCount(chExpectedText), "ECU should be in running state"); 
  TestStepAddActionExpected( chActionText, chExpectedText );
  A_DBGR_BreakpointDeleteAll();
  
   /***************************************************************************************************************/    
                                              // Test Step 10 Set a breakpoint at line BUS_DEVICE_ID = GetHWIO_e_BusDeviceID(void); inside function void Test_GetHWIO_e_BusDeviceID( void ) 
  /***************************************************************************************************************/
  snprintf( chActionText, elCount(chActionText), "Set Breakpoint Test_GetHWIO_e_BusDeviceID\\8 callback function "); 
  snprintf( chExpectedText, elCount(chExpectedText), "Breakpoint is Set in Test_GetHWIO_e_BusDeviceID\\8"); 
  //TestStepAddActionExpected( chActionText, chExpectedText );   
  A_DBGR_BreakpointSet("Test_GetHWIO_e_BusDeviceID\\8"); 
  
  /***************************************************************************************************************/    
                                              // Test Step 11 Run the debugger
  /***************************************************************************************************************/
  snprintf( chActionText, elCount(chActionText), "Run the software "); 
  snprintf( chExpectedText, elCount(chExpectedText), "ECU should be in running state"); 
  A_DBGR_Go();

  /***************************************************************************************************************/    
                                              // Test Step 12 Wait for the breakpoint to hit
  /***************************************************************************************************************/
  snprintf( chActionText, elCount(chActionText), "Verify Breakpoint should hit in Test_GetHWIO_e_BusDeviceID\\8 "); 
  snprintf( chExpectedText, elCount(chExpectedText), "Breakpoint hit in Test_GetHWIO_e_BusDeviceID\\8 function"); 
  //TestStepAddActionExpected( chActionText, chExpectedText );  
  E_DBGR_BreakpointCheckForHalt("Test_GetHWIO_e_BusDeviceID\\8");
  
  /***************************************************************************************************************/    
                                              // Test Step 13 	Verify BUS_DEVICE_ID value as 4.
  /***************************************************************************************************************/
  snprintf( chActionText, elCount(chActionText), "Configure BUSID variable"); 
  snprintf( chExpectedText, elCount(chExpectedText), "Verify BUSID is configured as 4"); 
  TestStepAddActionExpected( chActionText, chExpectedText );
  E_DBGR_VariableCheck("BUS_DEVICE_ID",4,Equal);

}

testcase Verify_GetHWIO_e_BusDeviceID_function_returns_CAN8TCVR_Device_2_Failed()
{
    /***************************************************************************************************************/    
                                                // Variable Definition
  /***************************************************************************************************************/ 
  

  
  /***************************************************************************************************************/    
                                               // Local Values
  /***************************************************************************************************************/ 
  

  
  /***************************************************************************************************************/    
                                              // Test Case Info
  /***************************************************************************************************************/
  setWriteDbgLevel(DebugOff);
  snprintf( chTestTitle, elCount(chTestTitle), "Verify_GetHWIO_e_BusDeviceID_function_returns_CAN8TCVR_Device_2_Failed" );
  snprintf( chTestDescription, elCount(chTestDescription), "Purpose:To check the GetHWIO_e_BusDeviceID interface ");
  TestCaseAddInfo( chTestTitle, "TC_L30SW_Q-36629502", chTestDescription );

  /***************************************************************************************************************/    
                                              // Test Step 0 PRECONDITIONS
  /***************************************************************************************************************/
  snprintf( chActionText, elCount(chActionText), "Flash the Software and ECU is running "); 
  snprintf( chExpectedText, elCount(chExpectedText), "ECU should be in running state"); 
  TestStepAddActionExpected( chActionText, chExpectedText );
  A_DBGR_BreakpointDeleteAll();
  
  snprintf( chActionText, elCount(chActionText), "Flash the Software and ECU is running "); 
  snprintf( chExpectedText, elCount(chExpectedText), "ECU should be in running state"); 
 
  A_DBGR_R();
  
  A_DBGR_Go();
  /***************************************************************************************************************/    
                                              // Test Step 1 Set a breakpoint at line TestCanTrcv_Getmode(void); in OS_Tasks.c file
  /***************************************************************************************************************/
  snprintf( chActionText, elCount(chActionText), "Set Breakpoint Os_Entry_Task_Core0_5ms\\13 callback function "); 
  snprintf( chExpectedText, elCount(chExpectedText), "Breakpoint is Set in Os_Entry_Task_Core0_5ms\\13"); 
  //TestStepAddActionExpected( chActionText, chExpectedText );   
  A_DBGR_BreakpointSet("Os_Entry_Task_Core0_5ms\\13");  
  
  
   /***************************************************************************************************************/    
                                              // Test Step 2 Run the debugger
  /***************************************************************************************************************/
  snprintf( chActionText, elCount(chActionText), "Run the software "); 
  snprintf( chExpectedText, elCount(chExpectedText), "ECU should be in running state"); 
  A_DBGR_Go();
  
  /***************************************************************************************************************/    
                                              // Test Step 3 Set a Channel_ID 1 and Channel_ID_B to 1 to call GetCNDD_e_CanTrcvOpMode(1U, &Getcantravmode);
  /***************************************************************************************************************/
  snprintf( chActionText, elCount(chActionText), "Configure Channel_ID variable"); 
  snprintf( chExpectedText, elCount(chExpectedText), "Verify TransferCount is configured as 1"); 
  //TestStepAddActionExpected( chActionText, chExpectedText );
  A_DBGR_VariableSet("Channel_ID","1");
  E_DBGR_VariableCheck("Channel_ID",1,Equal);
  
  snprintf( chActionText, elCount(chActionText), "Configure Channel_ID_B variable"); 
  snprintf( chExpectedText, elCount(chExpectedText), "Verify TransferCount is configured as 1"); 
  TestStepAddActionExpected( chActionText, chExpectedText );
  A_DBGR_VariableSet("Channel_ID_B","1");
  E_DBGR_VariableCheck("Channel_ID_B",1,Equal);
  
  
   /***************************************************************************************************************/    
                                              // Test Step 4 Wait for the breakpoint to hit
  /***************************************************************************************************************/
  snprintf( chActionText, elCount(chActionText), "Verify Breakpoint should hit in Os_Entry_Task_Core0_5ms\\13 "); 
  snprintf( chExpectedText, elCount(chExpectedText), "Breakpoint hit in Os_Entry_Task_Core0_5ms\\13 function"); 
  TestStepAddActionExpected( chActionText, chExpectedText );  
  E_DBGR_BreakpointCheckForHalt("Os_Entry_Task_Core0_5ms\\13");
  
   snprintf( chActionText, elCount(chActionText), "Flash the Software and ECU is running "); 
  snprintf( chExpectedText, elCount(chExpectedText), "ECU should be in running state"); 
  TestStepAddActionExpected( chActionText, chExpectedText );
  A_DBGR_BreakpointDeleteAll();
  /***************************************************************************************************************/    
                                              // Test Step 5 MCALUTIL_SFRWRITE(SPI_HW_MODULE[KernelId].MC.U, ((uint32)TransferCount<<IFX_QSPI_MC_MCOUNT_OFF));
  /***************************************************************************************************************/
  snprintf( chActionText, elCount(chActionText), "Set Breakpoint Spi_lQspiHWSetJobConfig\\18 callback function "); 
  snprintf( chExpectedText, elCount(chExpectedText), "Breakpoint is Set in Spi_lQspiHWSetJobConfig\\18"); 
  //TestStepAddActionExpected( chActionText, chExpectedText );   
  A_DBGR_BreakpointSet("Spi_lQspiHWSetJobConfig\\18");  
  
  /***************************************************************************************************************/    
                                              // Test Step 6 Run the debugger
  /***************************************************************************************************************/
  snprintf( chActionText, elCount(chActionText), "Run the software "); 
  snprintf( chExpectedText, elCount(chExpectedText), "ECU should be in running state"); 
  A_DBGR_Go();
  
   /***************************************************************************************************************/    
                                              // Test Step 7 Wait for the breakpoint to hit
  /***************************************************************************************************************/
  snprintf( chActionText, elCount(chActionText), "Verify Breakpoint should hit in Os_Entry_Task_Core0_5ms\\13 "); 
  snprintf( chExpectedText, elCount(chExpectedText), "Breakpoint hit in Os_Entry_Task_Core0_5ms\\13 function"); 
  //TestStepAddActionExpected( chActionText, chExpectedText );  
  E_DBGR_BreakpointCheckForHalt("Spi_lQspiHWSetJobConfig\\18");
  
  /***************************************************************************************************************/    
                                              // Test Step 8 set TransferCount variable to 5 to inject TxFIFO overflow fault.
  /***************************************************************************************************************/
  snprintf( chActionText, elCount(chActionText), "Configure TransferCount variable"); 
  snprintf( chExpectedText, elCount(chExpectedText), "Verify TransferCount is configured as 0"); 
  TestStepAddActionExpected( chActionText, chExpectedText );
  A_DBGR_VariableSet("TransferCount","5");
  E_DBGR_VariableCheck("TransferCount",5,Equal);
  
  
  /***************************************************************************************************************/    
                                              // Test Step 9 Delete all Breakpoints
  /***************************************************************************************************************/
  snprintf( chActionText, elCount(chActionText), "Flash the Software and ECU is running "); 
  snprintf( chExpectedText, elCount(chExpectedText), "ECU should be in running state"); 
  TestStepAddActionExpected( chActionText, chExpectedText );
  A_DBGR_BreakpointDeleteAll();
  
   /***************************************************************************************************************/    
                                              // Test Step 10 Set a breakpoint at line BUS_DEVICE_ID = GetHWIO_e_BusDeviceID(void); inside function void Test_GetHWIO_e_BusDeviceID( void ) 
  /***************************************************************************************************************/
  snprintf( chActionText, elCount(chActionText), "Set Breakpoint Test_GetHWIO_e_BusDeviceID\\8 callback function "); 
  snprintf( chExpectedText, elCount(chExpectedText), "Breakpoint is Set in Test_GetHWIO_e_BusDeviceID\\8"); 
  //TestStepAddActionExpected( chActionText, chExpectedText );   
  A_DBGR_BreakpointSet("Test_GetHWIO_e_BusDeviceID\\8"); 
  
  /***************************************************************************************************************/    
                                              // Test Step 11 Run the debugger
  /***************************************************************************************************************/
  snprintf( chActionText, elCount(chActionText), "Run the software "); 
  snprintf( chExpectedText, elCount(chExpectedText), "ECU should be in running state"); 
  A_DBGR_Go();

  /***************************************************************************************************************/    
                                              // Test Step 12 Wait for the breakpoint to hit
  /***************************************************************************************************************/
  snprintf( chActionText, elCount(chActionText), "Verify Breakpoint should hit in Test_GetHWIO_e_BusDeviceID\\8 "); 
  snprintf( chExpectedText, elCount(chExpectedText), "Breakpoint hit in Test_GetHWIO_e_BusDeviceID\\8 function"); 
  //TestStepAddActionExpected( chActionText, chExpectedText );  
  E_DBGR_BreakpointCheckForHalt("Test_GetHWIO_e_BusDeviceID\\8");
  
  /***************************************************************************************************************/    
                                              // Test Step 13 	Verify BUS_DEVICE_ID value as 2.
  /***************************************************************************************************************/
  snprintf( chActionText, elCount(chActionText), "Configure BUSID variable"); 
  snprintf( chExpectedText, elCount(chExpectedText), "Verify BUSID is configured as 2"); 
  TestStepAddActionExpected( chActionText, chExpectedText );
  E_DBGR_VariableCheck("BUS_DEVICE_ID",2,Equal);


}

testcase Verify_GetHWIO_e_BusDeviceID_function_returns_CAN2TCVR_Device_1_Failed()
{
    /***************************************************************************************************************/    
                                                // Variable Definition
  /***************************************************************************************************************/ 
  

  
  /***************************************************************************************************************/    
                                               // Local Values
  /***************************************************************************************************************/ 
  

  
  /***************************************************************************************************************/    
                                              // Test Case Info
  /***************************************************************************************************************/
  setWriteDbgLevel(DebugOff);
  snprintf( chTestTitle, elCount(chTestTitle), "Verify_GetHWIO_e_BusDeviceID_function_returns_CAN2TCVR_Device_1_Failed" );
  snprintf( chTestDescription, elCount(chTestDescription), "Purpose:To check the GetHWIO_e_BusDeviceID interface ");
  TestCaseAddInfo( chTestTitle, "TC_L30SW_Q-36629503", chTestDescription );

  /***************************************************************************************************************/    
                                              // Test Step 0 PRECONDITIONS
  /***************************************************************************************************************/
  snprintf( chActionText, elCount(chActionText), "Flash the Software and ECU is running "); 
  snprintf( chExpectedText, elCount(chExpectedText), "ECU should be in running state"); 
  TestStepAddActionExpected( chActionText, chExpectedText );
  A_DBGR_BreakpointDeleteAll();
  
  snprintf( chActionText, elCount(chActionText), "Flash the Software and ECU is running "); 
  snprintf( chExpectedText, elCount(chExpectedText), "ECU should be in running state"); 
 
  A_DBGR_R();
  
  A_DBGR_Go();
  /***************************************************************************************************************/    
                                              // Test Step 1 Set a breakpoint at line TestCanTrcv_Getmode(void); in OS_Tasks.c file
  /***************************************************************************************************************/
  snprintf( chActionText, elCount(chActionText), "Set Breakpoint Os_Entry_Task_Core0_5ms\\13 callback function "); 
  snprintf( chExpectedText, elCount(chExpectedText), "Breakpoint is Set in Os_Entry_Task_Core0_5ms\\13"); 
  //TestStepAddActionExpected( chActionText, chExpectedText );   
  A_DBGR_BreakpointSet("Os_Entry_Task_Core0_5ms\\13");  
  
  
   /***************************************************************************************************************/    
                                              // Test Step 2 Run the debugger
  /***************************************************************************************************************/
  snprintf( chActionText, elCount(chActionText), "Run the software "); 
  snprintf( chExpectedText, elCount(chExpectedText), "ECU should be in running state"); 
  A_DBGR_Go();
  
   /***************************************************************************************************************/    
                                              // Test Step 3 Wait for the breakpoint to hit
  /***************************************************************************************************************/
  snprintf( chActionText, elCount(chActionText), "Verify Breakpoint should hit in Os_Entry_Task_Core0_5ms\\13 "); 
  snprintf( chExpectedText, elCount(chExpectedText), "Breakpoint hit in Os_Entry_Task_Core0_5ms\\13 function"); 
  //TestStepAddActionExpected( chActionText, chExpectedText );  
  E_DBGR_BreakpointCheckForHalt("Os_Entry_Task_Core0_5ms\\13");
  
   snprintf( chActionText, elCount(chActionText), "Flash the Software and ECU is running "); 
  snprintf( chExpectedText, elCount(chExpectedText), "ECU should be in running state"); 
  TestStepAddActionExpected( chActionText, chExpectedText );
  A_DBGR_BreakpointDeleteAll();
  /***************************************************************************************************************/    
                                              // Test Step 4 MCALUTIL_SFRWRITE(SPI_HW_MODULE[KernelId].MC.U, ((uint32)TransferCount<<IFX_QSPI_MC_MCOUNT_OFF));
  /***************************************************************************************************************/
  snprintf( chActionText, elCount(chActionText), "Set Breakpoint Spi_lQspiHWSetJobConfig\\18 callback function "); 
  snprintf( chExpectedText, elCount(chExpectedText), "Breakpoint is Set in Spi_lQspiHWSetJobConfig\\18"); 
  //TestStepAddActionExpected( chActionText, chExpectedText );   
  A_DBGR_BreakpointSet("Spi_lQspiHWSetJobConfig\\18");  
  
  /***************************************************************************************************************/    
                                              // Test Step 5 Run the debugger
  /***************************************************************************************************************/
  snprintf( chActionText, elCount(chActionText), "Run the software "); 
  snprintf( chExpectedText, elCount(chExpectedText), "ECU should be in running state"); 
  A_DBGR_Go();
  
   /***************************************************************************************************************/    
                                              // Test Step 6 Wait for the breakpoint to hit
  /***************************************************************************************************************/
  snprintf( chActionText, elCount(chActionText), "Verify Breakpoint should hit in Os_Entry_Task_Core0_5ms\\13 "); 
  snprintf( chExpectedText, elCount(chExpectedText), "Breakpoint hit in Os_Entry_Task_Core0_5ms\\13 function"); 
  //TestStepAddActionExpected( chActionText, chExpectedText );  
  E_DBGR_BreakpointCheckForHalt("Spi_lQspiHWSetJobConfig\\18");
  
  /***************************************************************************************************************/    
                                              // Test Step 7 set TransferCount variable to 5 to inject TxFIFO overflow fault.
  /***************************************************************************************************************/
  snprintf( chActionText, elCount(chActionText), "Configure TransferCount variable"); 
  snprintf( chExpectedText, elCount(chExpectedText), "Verify TransferCount is configured as 0"); 
  TestStepAddActionExpected( chActionText, chExpectedText );
  A_DBGR_VariableSet("TransferCount","5");
  E_DBGR_VariableCheck("TransferCount",5,Equal);
  
  
  /***************************************************************************************************************/    
                                              // Test Step 8 Delete all Breakpoints
  /***************************************************************************************************************/
  snprintf( chActionText, elCount(chActionText), "Flash the Software and ECU is running "); 
  snprintf( chExpectedText, elCount(chExpectedText), "ECU should be in running state"); 
  TestStepAddActionExpected( chActionText, chExpectedText );
  A_DBGR_BreakpointDeleteAll();
  
   /***************************************************************************************************************/    
                                              // Test Step 9 Set a breakpoint at line BUS_DEVICE_ID = GetHWIO_e_BusDeviceID(void); inside function void Test_GetHWIO_e_BusDeviceID( void ) 
  /***************************************************************************************************************/
  snprintf( chActionText, elCount(chActionText), "Set Breakpoint Test_GetHWIO_e_BusDeviceID\\8 callback function "); 
  snprintf( chExpectedText, elCount(chExpectedText), "Breakpoint is Set in Test_GetHWIO_e_BusDeviceID\\8"); 
  //TestStepAddActionExpected( chActionText, chExpectedText );   
  A_DBGR_BreakpointSet("Test_GetHWIO_e_BusDeviceID\\8"); 
  
  /***************************************************************************************************************/    
                                              // Test Step 10 Run the debugger
  /***************************************************************************************************************/
  snprintf( chActionText, elCount(chActionText), "Run the software "); 
  snprintf( chExpectedText, elCount(chExpectedText), "ECU should be in running state"); 
  A_DBGR_Go();

  /***************************************************************************************************************/    
                                              // Test Step 11 Wait for the breakpoint to hit
  /***************************************************************************************************************/
  snprintf( chActionText, elCount(chActionText), "Verify Breakpoint should hit in Test_GetHWIO_e_BusDeviceID\\8 "); 
  snprintf( chExpectedText, elCount(chExpectedText), "Breakpoint hit in Test_GetHWIO_e_BusDeviceID\\8 function"); 
  //TestStepAddActionExpected( chActionText, chExpectedText );  
  E_DBGR_BreakpointCheckForHalt("Test_GetHWIO_e_BusDeviceID\\8");
  
  /***************************************************************************************************************/    
                                              // Test Step 12 	Verify BUS_DEVICE_ID value as 5.
  /***************************************************************************************************************/
  snprintf( chActionText, elCount(chActionText), "Configure BUSID variable"); 
  snprintf( chExpectedText, elCount(chExpectedText), "Verify BUSID is configured as 1"); 
  TestStepAddActionExpected( chActionText, chExpectedText );
  E_DBGR_VariableCheck("BUS_DEVICE_ID",1,Equal);


}

