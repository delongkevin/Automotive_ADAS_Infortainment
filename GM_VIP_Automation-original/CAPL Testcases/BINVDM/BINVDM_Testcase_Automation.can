/*@!Encoding:1252*/

includes
{
 #include "..\..\AutomationDependent\ProjectSpecific\GenLib_Includes.cin"
}
variables
{
  char chTestDescription[500];
  char chActionText[500];
  char chExpectedText[500];
  char chTestTitle[100];
  char canIdValue[256];
  byte dat_102[3] = {0xAA,0x55,0xAA};
  byte dat_8byte[8] =  {0x00,0x01,0x12,0xAA,0x00,0x01,0x12,0xAA};
  byte CANA_Wakeup[8] =  {0x08,0x00,0x00,0x00,0x00,0x00,0x00,0x01};
  byte CANB_Wakeup[4] =  {0x00,0x00,0x01,0x00};
  byte dat_tcno[1] =  {0xAA};
  byte dat_64byte[64] = {0xAA,0x55,0xAA,0x55,0xAA,0x55,0xAA,0x55,0xAA,0x55,0xAA,0x55,0xAA,0x55,0xAA,0x55,0xAA,0x55,0xAA,0x55,0xAA,0x55,0xAA,0x55,0xAA,0x55,0xAA,0x55,0xAA,0x55,0xAA,0x55,0xAA,0x55,0xAA,0x55,0xAA,0x55,0xAA,0x55,0xAA,0x55,0xAA,0x55,0xAA,0x55,0xAA,0x55,0xAA,0x55,0xAA,0x55,0xAA,0x55,0xAA,0x55,0xAA,0x55,0xAA,0x55,0xAA,0x55,0xAA,0x55};
  byte Output[64];
  char breakpoint[100] = "SetCANR_e_CanIfTxConfirmation\5";
  long CANID[70] = { 0x00000401, 0x00000301, 0x00000201, 0x40000042, 0x4000039E, 0x40000211, 0x40000212, 0x4000039D, 0x4000020D, 0x4000039B, 0x4000003E, 0x400002B3, 0x40000398, 0x400000BA, 0x40000397, 0x40000270, 0x40000585, 0x4000056B, 0x4000052C, 0x400002D7, 0x40000523, 0x40000568, 0x40000522, 0x40000505, 0x40000593, 0x40000594, 0x40000582, 0x400005A4, 0x400000B6, 0x40000584, 0x400003C3, 0x400003C4, 0x400003C2, 0x400002D5, 0x400003A2, 0x400002D6, 0x4000057F, 0x40000590, 0x400005A1, 0x400005F9, 0x400000C0, 0x400002BF, 0x400003AA, 0x400003B1, 0x40000596, 0x400005C9, 0x400003A5, 0x4000003F, 0x400003A6, 0x400005D2, 0x400004F0, 0x40000599, 0x4000006F, 0x400005CA, 0x400005CB, 0x400005BA, 0x4000059B, 0x40000293, 0x400004E1, 0x400004DC, 0x400000AF, 0x400000AE, 0x40000595, 0x400005C4, 0x40000140, 0x400002D8, 0xC0000100, 0x80007000, 0x00000140, 0x00000140};
  long CANID_B[70] = { 0x40000401, 0x40000301, 0x40000201, 0x40000042, 0x4000039E, 0x40000211, 0x40000212, 0x4000039D, 0x4000020D, 0x4000039B, 0x4000003E, 0x400002B3, 0x40000398, 0x400000BA, 0x40000397, 0x40000270, 0x40000585, 0x4000056B, 0x4000052C, 0x400002D7, 0x40000523, 0x40000568, 0x40000522, 0x40000505, 0x40000593, 0x40000594, 0x40000582, 0x400005A4, 0x400000B6, 0x40000584, 0x400003C3, 0x400003C4, 0x400003C2, 0x400002D5, 0x400003A2, 0x400002D6, 0x4000057F, 0x40000590, 0x400005A1, 0x400005F9, 0x400000C0, 0x400002BF, 0x400003AA, 0x400003B1, 0x40000596, 0x400005C9, 0x400003A5, 0x4000003F, 0x400003A6, 0x400005D2, 0x400004F0, 0x40000599, 0x4000006F, 0x400005CA, 0x400005CB, 0x400005BA, 0x4000059B, 0x40000293, 0x400004E1, 0x400004DC, 0x400000AF, 0x400000AE, 0x40000595, 0x400005C4, 0x40000140, 0x400002D8, 0xC0000100, 0x80007000, 0x00000140, 0x00000140};
  int i =0, voltage,current;
  char variableName[256];
}


testcase Testcase_Verify_BINVDM_Initial_Read_Status()
{
  /***************************************************************************************************************/    
                                                // Variable Definition
  /***************************************************************************************************************/ 
  
  long taskvalue;
  
  /***************************************************************************************************************/    
                                               // Local Values
  /***************************************************************************************************************/ 
  

  
  /***************************************************************************************************************/    
                                              // Test Case Info
  /***************************************************************************************************************/
  
  setWriteDbgLevel(DebugOff);
  snprintf( chTestTitle, elCount(chTestTitle), "Testcase_Verify_BINVDM_Initial_Read_Status" );
  snprintf( chTestDescription, elCount(chTestDescription), "Purpose:The software shall set the BINVDM read status to Idle during Reset Initialization until an operation is requested.");
  TestCaseAddInfo( chTestTitle, "TC_L30SW_QT_36619138", chTestDescription );

  /***************************************************************************************************************/    
                                              // Start of Test Case
  /***************************************************************************************************************/
  
  /***************************************************************************************************************/    
                                              // Test Step 1 PRECONDITIONS
  /***************************************************************************************************************/
  
  snprintf( chActionText, elCount(chActionText), "Flash the Software and ECU is running"); 
  snprintf( chExpectedText, elCount(chExpectedText), "ECU should be in running state"); 
  TestStepAddActionExpected( chActionText, chExpectedText );

  A_DBGR_BreakpointDeleteAll();
  A_DBGR_RnGo();
  E_DBGR_CheckState(T32_State_Running);
  
  /*******************************************************************************************************************************************************/    
    // Test Step 3: Set a breakpoint at "TstReadstatus = ( Binvdmreadstatus )GetHWIO_e_BatNonVltlReadSt();" inside "BYTE TestBinvdm_ReadGetStatus( void )" in test_binvdm_hwio.c and run the application
  /*******************************************************************************************************************************************************/
  
  snprintf( chActionText, elCount(chActionText), "Set a breakpoint at TstReadstatus = ( Binvdmreadstatus )GetHWIO_e_BatNonVltlReadSt(); inside BYTE TestBinvdm_ReadGetStatus( void ) in test_binvdm_hwio.c and run the application"); 
  snprintf( chExpectedText, elCount(chExpectedText), "Breakpoint is set."); 
  TestStepAddActionExpected( chActionText, chExpectedText );
  //A_DBGR_R();
  A_DBGR_BreakpointSet("TestBinvdm_ReadGetStatus\\3");  
  A_DBGR_Go();
  E_DBGR_BreakpointCheckForHalt("TestBinvdm_ReadGetStatus\\3");
    
  /*******************************************************************************************************************************************************/    
    // Test Step 4: Verify TstReadstatus value in trace32 watch window
  /*******************************************************************************************************************************************************/

  snprintf( chActionText, elCount(chActionText), "Verify TstReadstatus value in trace32 watch window"); 
  snprintf( chExpectedText, elCount(chExpectedText), "TstReadstatus = BINVDM_READ_IDLE"); 
  TestStepAddActionExpected( chActionText, chExpectedText );
  E_DBGR_VariableCheck("TstReadstatus",0,Equal);
}

testcase Testcase_Verify_Default_Read_Status_Until_Operation_Completion_in_Blocking_Mode()
{
  /***************************************************************************************************************/    
                                                // Variable Definition
  /***************************************************************************************************************/ 
  long taskvalue;
  /***************************************************************************************************************/    
                                               // Local Values
  /***************************************************************************************************************/ 

  /***************************************************************************************************************/    
                                              // Test Case Info
  /***************************************************************************************************************/
  setWriteDbgLevel(DebugOff);
  snprintf( chTestTitle, elCount(chTestTitle), "Testcase_Verify_Default_Read_Status_Until_Operation_Completion_in_Blocking_Mode" );
  snprintf( chTestDescription, elCount(chTestDescription), "Purpose:The software shall return the BINVDM Read status as InProgress from the time of the read request operation until Completed, MemoryError or Canceled statuses have been determined.");
  TestCaseAddInfo( chTestTitle, "TC_L30SW_QT_36728636", chTestDescription );
  /***************************************************************************************************************/    
                                              // Start of Test Case
  /***************************************************************************************************************/
  /***************************************************************************************************************/    
                                              // Test Step 1 PRECONDITIONS
  /***************************************************************************************************************/
  snprintf( chActionText, elCount(chActionText), "Flash the Software and ECU is running"); 
  snprintf( chExpectedText, elCount(chExpectedText), "ECU should be in running state"); 
  TestStepAddActionExpected( chActionText, chExpectedText );

  A_DBGR_BreakpointDeleteAll();
  A_DBGR_RnGo();
  E_DBGR_CheckState(T32_State_Running);
  
  
  
    
   
  /*******************************************************************************************************************************************************/    
    // Test Step 2: Set a breakpoint at "TstReadstatus = ( Binvdmreadstatus )ReadHWIO_h_BatNonVltl( BLOCKING_MODE, &binvdmaddr, 72U, ( BYTE *)&Nvmdataread );" and run the application
  /*******************************************************************************************************************************************************/
  
  snprintf( chActionText, elCount(chActionText), "Set a breakpoint at TstReadstatus = ( Binvdmreadstatus )ReadHWIO_h_BatNonVltl( BLOCKING_MODE, &binvdmaddr, 72U, ( BYTE *)&Nvmdataread ); and run the application"); 
  snprintf( chExpectedText, elCount(chExpectedText), "Breakpoint is set."); 
  TestStepAddActionExpected( chActionText, chExpectedText );
  //A_DBGR_R();
  A_DBGR_BreakpointSet("TestBinvdm_NonblockingRead\\5");  
  A_DBGR_Go();
  E_DBGR_BreakpointCheckForHalt("TestBinvdm_NonblockingRead\\5");
 
   /*******************************************************************************************************************************************************/    
    // Test Step 3: Set a breakpoint at "TstReadstatus = ( Binvdmreadstatus )ReadHWIO_h_BatNonVltl( BLOCKING_MODE, &binvdmaddr, 72U, ( BYTE *)&Nvmdataread );" and run the application
  /*******************************************************************************************************************************************************/
  
  snprintf( chActionText, elCount(chActionText), "Set binvdmreadrequest = TRUE in trace32 watch window"); 
  snprintf( chExpectedText, elCount(chExpectedText), "binvdmreadrequest = TRUE"); 
  TestStepAddActionExpected( chActionText, chExpectedText );
  A_DBGR_VariableSet("binvdmreadrequest", "1"); 
  E_DBGR_VariableCheck("binvdmreadrequest",1,Equal);
  
   /*******************************************************************************************************************************************************/    
    // Test Step 4: Set a breakpoint at "if( BINVDM_BLOCKING_MODE == binvdmSchmode )
  /*******************************************************************************************************************************************************/
  
  snprintf( chActionText, elCount(chActionText), "Set a breakpoint at return( ( BYTE )Readstatus ); and run the application"); 
  snprintf( chExpectedText, elCount(chExpectedText), "Breakpoint is set."); 
  TestStepAddActionExpected( chActionText, chExpectedText );
  //A_DBGR_R();
  A_DBGR_BreakpointSet("ReadHWIO_h_BatNonVltl\\14");  
  A_DBGR_Go();
  E_DBGR_BreakpointCheckForHalt("ReadHWIO_h_BatNonVltl\\14");
  
  
  snprintf( chActionText, elCount(chActionText), "Set binvdmSchmode = 0 in trace32 watch window"); 
  snprintf( chExpectedText, elCount(chExpectedText), "binvdmSchmode = 0"); 
  TestStepAddActionExpected( chActionText, chExpectedText );
  A_DBGR_VariableSet("binvdmSchmode", "0"); 
  E_DBGR_VariableCheck("binvdmSchmode",0,Equal);
   /*******************************************************************************************************************************************************/    
    // Test Step 5: Set a breakpoint at "ret = MemAcc_Read( Address_Instance, ( Targetaddr - BINVDM_DFLASH_PHY_START_ADDR ), binvdmramaddr,\

  /*******************************************************************************************************************************************************/

  snprintf( chActionText, elCount(chActionText), " 1 - set run"); 
  snprintf( chExpectedText, elCount(chExpectedText), "Breakpoint is set."); 
  TestStepAddActionExpected( chActionText, chExpectedText );
  //A_DBGR_R();
  A_DBGR_BreakpointSet("ReadHWIO_h_BatNonVltl\\32");  
  A_DBGR_Go();
  E_DBGR_BreakpointCheckForHalt("ReadHWIO_h_BatNonVltl\\32");
  
  
   /*******************************************************************************************************************************************************/    
    // Test Step 6: check Readstatus = BINVDM_READ_INPROGRESS
  /*******************************************************************************************************************************************************/
  
  
  snprintf( chActionText, elCount(chActionText), " complete state "); 
  snprintf( chExpectedText, elCount(chExpectedText), "Breakpoint is set."); 
  TestStepAddActionExpected( chActionText, chExpectedText );
  //A_DBGR_R();
  A_DBGR_BreakpointSet("ReadHWIO_h_BatNonVltl\\124");  
  A_DBGR_Go();
   A_DBGR_Go();
  E_DBGR_BreakpointCheckForHalt("ReadHWIO_h_BatNonVltl\\124");
  
  snprintf( chActionText, elCount(chActionText), "Verify Readstatus  value in trace32 watch window"); 
  snprintf( chExpectedText, elCount(chExpectedText), "Readstatus = BINVDM_READ_INPROGRESS"); 
  TestStepAddActionExpected( chActionText, chExpectedText );
  E_DBGR_VariableCheck("Readstatus",2,Equal);
 /*******************************************************************************************************************************************************/    
    // Test Step 7:check  Readstatus = BINVDM_READ_IDLE
  /*******************************************************************************************************************************************************/
  
//  snprintf( chActionText, elCount(chActionText), "Set a breakpoint at TstReadstatus = ( Binvdmreadstatus )GetHWIO_e_BatNonVltlReadSt(); inside BYTE TestBinvdm_ReadGetStatus( void ) in test_binvdm_hwio.c and run the application"); 
//  snprintf( chExpectedText, elCount(chExpectedText), "Breakpoint is set."); 
//  TestStepAddActionExpected( chActionText, chExpectedText );
//  //A_DBGR_R();
//  A_DBGR_BreakpointSet("TestBinvdm_NonblockingRead\\5");  
//  A_DBGR_Go();
//  E_DBGR_BreakpointCheckForHalt("TestBinvdm_NonblockingRead\\5");
  
  
//  snprintf( chActionText, elCount(chActionText), "Verify TstReadstatus value in trace32 watch window"); 
//  snprintf( chExpectedText, elCount(chExpectedText), "Readstatus = BINVDM_READ_IDLE"); 
//  TestStepAddActionExpected( chActionText, chExpectedText );
//  E_DBGR_VariableCheck("Readstatus",0,Equal);  
 
}


testcase Testcase_Verify_Default_Read_Status_Until_Operation_Completion_in_NON_Blocking_Mode()
{
  /***************************************************************************************************************/    
                                                // Variable Definition
  /***************************************************************************************************************/ 
  long taskvalue;
  /***************************************************************************************************************/    
                                               // Local Values
  /***************************************************************************************************************/ 

  /***************************************************************************************************************/    
                                              // Test Case Info
  /***************************************************************************************************************/
  setWriteDbgLevel(DebugOff);
  snprintf( chTestTitle, elCount(chTestTitle), "Testcase_Verify_Default_Read_Status_Until_Operation_Completion_in_Blocking_Mode" );
  snprintf( chTestDescription, elCount(chTestDescription), "Purpose:The software shall return the BINVDM Read status as InProgress from the time of the read request operation until Completed, MemoryError or Canceled statuses have been determined.");
  TestCaseAddInfo( chTestTitle, "TC_L30SW_QT_36728636", chTestDescription );
  /***************************************************************************************************************/    
                                              // Start of Test Case
  /***************************************************************************************************************/
  /***************************************************************************************************************/    
                                              // Test Step 1 PRECONDITIONS
  /***************************************************************************************************************/
  snprintf( chActionText, elCount(chActionText), "Flash the Software and ECU is running"); 
  snprintf( chExpectedText, elCount(chExpectedText), "ECU should be in running state"); 
  TestStepAddActionExpected( chActionText, chExpectedText );

  A_DBGR_BreakpointDeleteAll();
  A_DBGR_RnGo();
  E_DBGR_CheckState(T32_State_Running);
  
  
  
    
   
  /*******************************************************************************************************************************************************/    
    // Test Step 2: Set a breakpoint at "TstReadstatus = ( Binvdmreadstatus )ReadHWIO_h_BatNonVltl( BLOCKING_MODE, &binvdmaddr, 72U, ( BYTE *)&Nvmdataread );" and run the application
  /*******************************************************************************************************************************************************/
  
  snprintf( chActionText, elCount(chActionText), "Set a breakpoint at TstReadstatus = ( Binvdmreadstatus )ReadHWIO_h_BatNonVltl( BLOCKING_MODE, &binvdmaddr, 72U, ( BYTE *)&Nvmdataread ); and run the application"); 
  snprintf( chExpectedText, elCount(chExpectedText), "Breakpoint is set."); 
  TestStepAddActionExpected( chActionText, chExpectedText );
  //A_DBGR_R();
  A_DBGR_BreakpointSet("TestBinvdm_NonblockingRead\\5");  
  A_DBGR_Go();
  E_DBGR_BreakpointCheckForHalt("TestBinvdm_NonblockingRead\\5");
 
   /*******************************************************************************************************************************************************/    
    // Test Step 3: Set a breakpoint at "TstReadstatus = ( Binvdmreadstatus )ReadHWIO_h_BatNonVltl( BLOCKING_MODE, &binvdmaddr, 72U, ( BYTE *)&Nvmdataread );" and run the application
  /*******************************************************************************************************************************************************/
  
  snprintf( chActionText, elCount(chActionText), "Set binvdmreadrequest = TRUE in trace32 watch window"); 
  snprintf( chExpectedText, elCount(chExpectedText), "binvdmreadrequest = TRUE"); 
  TestStepAddActionExpected( chActionText, chExpectedText );
  A_DBGR_VariableSet("binvdmreadrequest", "1"); 
  E_DBGR_VariableCheck("binvdmreadrequest",1,Equal);
  
   /*******************************************************************************************************************************************************/    
    // Test Step 4: Set a breakpoint at "if( BINVDM_BLOCKING_MODE == binvdmSchmode )
  /*******************************************************************************************************************************************************/
  
//  snprintf( chActionText, elCount(chActionText), "Set a breakpoint at return( ( BYTE )Readstatus ); and run the application"); 
//  snprintf( chExpectedText, elCount(chExpectedText), "Breakpoint is set."); 
//  TestStepAddActionExpected( chActionText, chExpectedText );
//  //A_DBGR_R();
//  A_DBGR_BreakpointSet("ReadHWIO_h_BatNonVltl\\14");  
//  A_DBGR_Go();
//  E_DBGR_BreakpointCheckForHalt("ReadHWIO_h_BatNonVltl\\14");
  
  
//  snprintf( chActionText, elCount(chActionText), "Set binvdmSchmode = 0 in trace32 watch window"); 
//  snprintf( chExpectedText, elCount(chExpectedText), "binvdmSchmode = 0"); 
//  TestStepAddActionExpected( chActionText, chExpectedText );
//  A_DBGR_VariableSet("binvdmSchmode", "0"); 
//  E_DBGR_VariableCheck("binvdmSchmode",0,Equal);
   /*******************************************************************************************************************************************************/    
    // Test Step 5: Set a breakpoint at "ret = MemAcc_Read( Address_Instance, ( Targetaddr - BINVDM_DFLASH_PHY_START_ADDR ), binvdmramaddr,\

  /*******************************************************************************************************************************************************/

  snprintf( chActionText, elCount(chActionText), " 1 - set run"); 
  snprintf( chExpectedText, elCount(chExpectedText), "Breakpoint is set."); 
  TestStepAddActionExpected( chActionText, chExpectedText );
  //A_DBGR_R();
  A_DBGR_BreakpointSet("ReadHWIO_h_BatNonVltl\\54");  
  A_DBGR_Go();
  E_DBGR_BreakpointCheckForHalt("ReadHWIO_h_BatNonVltl\\54");
  
  
   /*******************************************************************************************************************************************************/    
    // Test Step 6: check Readstatus = BINVDM_READ_INPROGRESS
  /*******************************************************************************************************************************************************/
  
  
  snprintf( chActionText, elCount(chActionText), " complete state "); 
  snprintf( chExpectedText, elCount(chExpectedText), "Breakpoint is set."); 
  TestStepAddActionExpected( chActionText, chExpectedText );
  //A_DBGR_R();
  A_DBGR_BreakpointSet("ReadHWIO_h_BatNonVltl\\124");  
  A_DBGR_Go();
  E_DBGR_BreakpointCheckForHalt("ReadHWIO_h_BatNonVltl\\124");
  
  snprintf( chActionText, elCount(chActionText), "Verify Readstatus  value in trace32 watch window"); 
  snprintf( chExpectedText, elCount(chExpectedText), "Readstatus = BINVDM_READ_INPROGRESS"); 
  TestStepAddActionExpected( chActionText, chExpectedText );
  E_DBGR_VariableCheck("Readstatus",1,Equal);
 /*******************************************************************************************************************************************************/    
    // Test Step 7:check  Readstatus = BINVDM_READ_IDLE
  /*******************************************************************************************************************************************************/
  
//  snprintf( chActionText, elCount(chActionText), "Set a breakpoint at TstReadstatus = ( Binvdmreadstatus )GetHWIO_e_BatNonVltlReadSt(); inside BYTE TestBinvdm_ReadGetStatus( void ) in test_binvdm_hwio.c and run the application"); 
//  snprintf( chExpectedText, elCount(chExpectedText), "Breakpoint is set."); 
//  TestStepAddActionExpected( chActionText, chExpectedText );
//  //A_DBGR_R();
//  A_DBGR_BreakpointSet("TestBinvdm_NonblockingRead\\5");  
//  A_DBGR_Go();
//  E_DBGR_BreakpointCheckForHalt("TestBinvdm_NonblockingRead\\5");
  
  
//  snprintf( chActionText, elCount(chActionText), "Verify TstReadstatus value in trace32 watch window"); 
//  snprintf( chExpectedText, elCount(chExpectedText), "Readstatus = BINVDM_READ_IDLE"); 
//  TestStepAddActionExpected( chActionText, chExpectedText );
//  E_DBGR_VariableCheck("Readstatus",0,Equal);  
 
}


testcase Testcase_Verify_Successful_Read_Operation_Status_in_Blocking_Mode()
{
  /***************************************************************************************************************/    
                                                // Variable Definition
  /***************************************************************************************************************/ 
  long taskvalue;
  /***************************************************************************************************************/    
                                               // Local Values
  /***************************************************************************************************************/ 

  /***************************************************************************************************************/    
                                              // Test Case Info
  /***************************************************************************************************************/
  setWriteDbgLevel(DebugOff);
  snprintf( chTestTitle, elCount(chTestTitle), "Testcase_Verify_Default_Read_Status_Until_Operation_Completion_in_Blocking_Mode" );
  snprintf( chTestDescription, elCount(chTestDescription), "Purpose:The software shall return the BINVDM Read status as InProgress from the time of the read request operation until Completed, MemoryError or Canceled statuses have been determined.");
  TestCaseAddInfo( chTestTitle, "TC_L30SW_QT_36728636", chTestDescription );
  /***************************************************************************************************************/    
                                              // Start of Test Case
  /***************************************************************************************************************/
  /***************************************************************************************************************/    
                                              // Test Step 1 PRECONDITIONS
  /***************************************************************************************************************/
  snprintf( chActionText, elCount(chActionText), "Flash the Software and ECU is running"); 
  snprintf( chExpectedText, elCount(chExpectedText), "ECU should be in running state"); 
  TestStepAddActionExpected( chActionText, chExpectedText );

  A_DBGR_BreakpointDeleteAll();
  A_DBGR_RnGo();
  E_DBGR_CheckState(T32_State_Running);
  
  
  
    
   
  /*******************************************************************************************************************************************************/    
    // Test Step 2: Set a breakpoint at "TstReadstatus = ( Binvdmreadstatus )ReadHWIO_h_BatNonVltl( BLOCKING_MODE, &binvdmaddr, 72U, ( BYTE *)&Nvmdataread );" and run the application
  /*******************************************************************************************************************************************************/
  
  snprintf( chActionText, elCount(chActionText), "Set a breakpoint at TstReadstatus = ( Binvdmreadstatus )ReadHWIO_h_BatNonVltl( BLOCKING_MODE, &binvdmaddr, 72U, ( BYTE *)&Nvmdataread ); and run the application"); 
  snprintf( chExpectedText, elCount(chExpectedText), "Breakpoint is set."); 
  TestStepAddActionExpected( chActionText, chExpectedText );
  //A_DBGR_R();
  A_DBGR_BreakpointSet("TestBinvdm_NonblockingRead\\5");  
  A_DBGR_Go();
  E_DBGR_BreakpointCheckForHalt("TestBinvdm_NonblockingRead\\5");
 
   /*******************************************************************************************************************************************************/    
    // Test Step 3: Set a breakpoint at "TstReadstatus = ( Binvdmreadstatus )ReadHWIO_h_BatNonVltl( BLOCKING_MODE, &binvdmaddr, 72U, ( BYTE *)&Nvmdataread );" and run the application
  /*******************************************************************************************************************************************************/
  
  snprintf( chActionText, elCount(chActionText), "Set binvdmreadrequest = TRUE in trace32 watch window"); 
  snprintf( chExpectedText, elCount(chExpectedText), "binvdmreadrequest = TRUE"); 
  TestStepAddActionExpected( chActionText, chExpectedText );
  A_DBGR_VariableSet("binvdmreadrequest", "1"); 
  E_DBGR_VariableCheck("binvdmreadrequest",1,Equal);
  
   /*******************************************************************************************************************************************************/    
    // Test Step 4: Set a breakpoint at "if( BINVDM_BLOCKING_MODE == binvdmSchmode )
  /*******************************************************************************************************************************************************/
  
  snprintf( chActionText, elCount(chActionText), "Set a breakpoint at return( ( BYTE )Readstatus ); and run the application"); 
  snprintf( chExpectedText, elCount(chExpectedText), "Breakpoint is set."); 
  TestStepAddActionExpected( chActionText, chExpectedText );
  //A_DBGR_R();
  A_DBGR_BreakpointSet("ReadHWIO_h_BatNonVltl\\14");  
  A_DBGR_Go();
  E_DBGR_BreakpointCheckForHalt("ReadHWIO_h_BatNonVltl\\14");
  
  
  snprintf( chActionText, elCount(chActionText), "Set binvdmSchmode = 0 in trace32 watch window"); 
  snprintf( chExpectedText, elCount(chExpectedText), "binvdmSchmode = 0"); 
  TestStepAddActionExpected( chActionText, chExpectedText );
  A_DBGR_VariableSet("binvdmSchmode", "0"); 
  E_DBGR_VariableCheck("binvdmSchmode",0,Equal);
   /*******************************************************************************************************************************************************/    
    // Test Step 5: Set a breakpoint at "ret = MemAcc_Read( Address_Instance, ( Targetaddr - BINVDM_DFLASH_PHY_START_ADDR ), binvdmramaddr,\

  /*******************************************************************************************************************************************************/

  snprintf( chActionText, elCount(chActionText), " 1 - set run"); 
  snprintf( chExpectedText, elCount(chExpectedText), "Breakpoint is set."); 
  TestStepAddActionExpected( chActionText, chExpectedText );
  //A_DBGR_R();
  A_DBGR_BreakpointSet("ReadHWIO_h_BatNonVltl\\32");  
  A_DBGR_Go();
   A_DBGR_Go();
  E_DBGR_BreakpointCheckForHalt("ReadHWIO_h_BatNonVltl\\32");
  
  
   /*******************************************************************************************************************************************************/    
    // Test Step 6: check Readstatus = BINVDM_READ_COMPLETE
  /*******************************************************************************************************************************************************/
  
  
  snprintf( chActionText, elCount(chActionText), " complete state "); 
  snprintf( chExpectedText, elCount(chExpectedText), "Breakpoint is set."); 
  TestStepAddActionExpected( chActionText, chExpectedText );
  //A_DBGR_R();
  A_DBGR_BreakpointSet("ReadHWIO_h_BatNonVltl\\124");  
  A_DBGR_Go();
  E_DBGR_BreakpointCheckForHalt("ReadHWIO_h_BatNonVltl\\124");
  
  snprintf( chActionText, elCount(chActionText), "Verify Readstatus  value in trace32 watch window"); 
  snprintf( chExpectedText, elCount(chExpectedText), "Readstatus = BINVDM_READ_COMPLETE"); 
  TestStepAddActionExpected( chActionText, chExpectedText );
  E_DBGR_VariableCheck("Readstatus",2,Equal);
 /*******************************************************************************************************************************************************/    
    // Test Step 7:check  Readstatus = BINVDM_READ_IDLE
  /*******************************************************************************************************************************************************/
  
//  snprintf( chActionText, elCount(chActionText), "Set a breakpoint at TstReadstatus = ( Binvdmreadstatus )GetHWIO_e_BatNonVltlReadSt(); inside BYTE TestBinvdm_ReadGetStatus( void ) in test_binvdm_hwio.c and run the application"); 
//  snprintf( chExpectedText, elCount(chExpectedText), "Breakpoint is set."); 
//  TestStepAddActionExpected( chActionText, chExpectedText );
//  //A_DBGR_R();
//  A_DBGR_BreakpointSet("TestBinvdm_NonblockingRead\\5");  
//  A_DBGR_Go();
//  E_DBGR_BreakpointCheckForHalt("TestBinvdm_NonblockingRead\\5");
  
  
//  snprintf( chActionText, elCount(chActionText), "Verify TstReadstatus value in trace32 watch window"); 
//  snprintf( chExpectedText, elCount(chExpectedText), "Readstatus = BINVDM_READ_IDLE"); 
//  TestStepAddActionExpected( chActionText, chExpectedText );
//  E_DBGR_VariableCheck("Readstatus",0,Equal);  
 
}
testcase Testcase_Verify_Successful_Read_Operation_Status_in_NON_Blocking_Mode()
{
  /***************************************************************************************************************/    
                                                // Variable Definition
  /***************************************************************************************************************/ 
  long taskvalue;
  /***************************************************************************************************************/    
                                               // Local Values
  /***************************************************************************************************************/ 

  /***************************************************************************************************************/    
                                              // Test Case Info
  /***************************************************************************************************************/
  setWriteDbgLevel(DebugOff);
  snprintf( chTestTitle, elCount(chTestTitle), "Testcase_Verify_Default_Read_Status_Until_Operation_Completion_in_Blocking_Mode" );
  snprintf( chTestDescription, elCount(chTestDescription), "Purpose:The software shall return the BINVDM Read status as InProgress from the time of the read request operation until Completed, MemoryError or Canceled statuses have been determined.");
  TestCaseAddInfo( chTestTitle, "TC_L30SW_QT_36728636", chTestDescription );
  /***************************************************************************************************************/    
                                              // Start of Test Case
  /***************************************************************************************************************/
  /***************************************************************************************************************/    
                                              // Test Step 1 PRECONDITIONS
  /***************************************************************************************************************/
  snprintf( chActionText, elCount(chActionText), "Flash the Software and ECU is running"); 
  snprintf( chExpectedText, elCount(chExpectedText), "ECU should be in running state"); 
  TestStepAddActionExpected( chActionText, chExpectedText );

  A_DBGR_BreakpointDeleteAll();
  A_DBGR_RnGo();
  E_DBGR_CheckState(T32_State_Running);
  
  
  
    
   
  /*******************************************************************************************************************************************************/    
    // Test Step 2: Set a breakpoint at "TstReadstatus = ( Binvdmreadstatus )ReadHWIO_h_BatNonVltl( BLOCKING_MODE, &binvdmaddr, 72U, ( BYTE *)&Nvmdataread );" and run the application
  /*******************************************************************************************************************************************************/
  
  snprintf( chActionText, elCount(chActionText), "Set a breakpoint at TstReadstatus = ( Binvdmreadstatus )ReadHWIO_h_BatNonVltl( BLOCKING_MODE, &binvdmaddr, 72U, ( BYTE *)&Nvmdataread ); and run the application"); 
  snprintf( chExpectedText, elCount(chExpectedText), "Breakpoint is set."); 
  TestStepAddActionExpected( chActionText, chExpectedText );
  //A_DBGR_R();
  A_DBGR_BreakpointSet("TestBinvdm_NonblockingRead\\5");  
  A_DBGR_Go();
  E_DBGR_BreakpointCheckForHalt("TestBinvdm_NonblockingRead\\5");
 
   /*******************************************************************************************************************************************************/    
    // Test Step 3: Set a breakpoint at "TstReadstatus = ( Binvdmreadstatus )ReadHWIO_h_BatNonVltl( BLOCKING_MODE, &binvdmaddr, 72U, ( BYTE *)&Nvmdataread );" and run the application
  /*******************************************************************************************************************************************************/
  
  snprintf( chActionText, elCount(chActionText), "Set binvdmreadrequest = TRUE in trace32 watch window"); 
  snprintf( chExpectedText, elCount(chExpectedText), "binvdmreadrequest = TRUE"); 
  TestStepAddActionExpected( chActionText, chExpectedText );
  A_DBGR_VariableSet("binvdmreadrequest", "1"); 
  E_DBGR_VariableCheck("binvdmreadrequest",1,Equal);
  
   /*******************************************************************************************************************************************************/    
    // Test Step 4: Set a breakpoint at "if( BINVDM_BLOCKING_MODE == binvdmSchmode )
  /*******************************************************************************************************************************************************/
  
  snprintf( chActionText, elCount(chActionText), "Set a breakpoint at return( ( BYTE )Readstatus ); and run the application"); 
  snprintf( chExpectedText, elCount(chExpectedText), "Breakpoint is set."); 
  TestStepAddActionExpected( chActionText, chExpectedText );
  //A_DBGR_R();
  A_DBGR_BreakpointSet("ReadHWIO_h_BatNonVltl\\54");  
  A_DBGR_Go();
  E_DBGR_BreakpointCheckForHalt("ReadHWIO_h_BatNonVltl\\54");
  
  
   
  
   /*******************************************************************************************************************************************************/    
    // Test Step 6: check Readstatus = BINVDM_READ_COMPLETE
  /*******************************************************************************************************************************************************/
  
  
  snprintf( chActionText, elCount(chActionText), " complete state "); 
  snprintf( chExpectedText, elCount(chExpectedText), "Breakpoint is set."); 
  TestStepAddActionExpected( chActionText, chExpectedText );
  //A_DBGR_R();
  A_DBGR_BreakpointSet("ReadHWIO_h_BatNonVltl\\124");  
  A_DBGR_Go();
  E_DBGR_BreakpointCheckForHalt("ReadHWIO_h_BatNonVltl\\124");
  
  snprintf( chActionText, elCount(chActionText), "Verify Readstatus  value in trace32 watch window"); 
  snprintf( chExpectedText, elCount(chExpectedText), "Readstatus = BINVDM_READ_COMPLETE"); 
  TestStepAddActionExpected( chActionText, chExpectedText );
  E_DBGR_VariableCheck("Readstatus",1,Equal);
 /*******************************************************************************************************************************************************/    
    // Test Step 7:check  Readstatus = BINVDM_READ_IDLE
  /*******************************************************************************************************************************************************/
  
//  snprintf( chActionText, elCount(chActionText), "Set a breakpoint at TstReadstatus = ( Binvdmreadstatus )GetHWIO_e_BatNonVltlReadSt(); inside BYTE TestBinvdm_ReadGetStatus( void ) in test_binvdm_hwio.c and run the application"); 
//  snprintf( chExpectedText, elCount(chExpectedText), "Breakpoint is set."); 
//  TestStepAddActionExpected( chActionText, chExpectedText );
//  //A_DBGR_R();
//  A_DBGR_BreakpointSet("TestBinvdm_NonblockingRead\\5");  
//  A_DBGR_Go();
//  E_DBGR_BreakpointCheckForHalt("TestBinvdm_NonblockingRead\\5");
  
  
//  snprintf( chActionText, elCount(chActionText), "Verify TstReadstatus value in trace32 watch window"); 
//  snprintf( chExpectedText, elCount(chExpectedText), "Readstatus = BINVDM_READ_IDLE"); 
//  TestStepAddActionExpected( chActionText, chExpectedText );
//  E_DBGR_VariableCheck("Readstatus",0,Equal);  
 
}

testcase Testcase_Verify_Canceled_Read_Operation_Status_in_Blocking_Mode()
{
  /***************************************************************************************************************/    
                                                // Variable Definition
  /***************************************************************************************************************/ 
  long taskvalue;
  /***************************************************************************************************************/    
                                               // Local Values
  /***************************************************************************************************************/ 

  /***************************************************************************************************************/    
                                              // Test Case Info
  /***************************************************************************************************************/
  setWriteDbgLevel(DebugOff);
  snprintf( chTestTitle, elCount(chTestTitle), "Testcase_Verify_Default_Read_Status_Until_Operation_Completion_in_Blocking_Mode" );
  snprintf( chTestDescription, elCount(chTestDescription), "Purpose:The software shall return the BINVDM Read status as InProgress from the time of the read request operation until Completed, MemoryError or Canceled statuses have been determined.");
  TestCaseAddInfo( chTestTitle, "TC_L30SW_QT_36728636", chTestDescription );
  /***************************************************************************************************************/    
                                              // Start of Test Case
  /***************************************************************************************************************/
  /***************************************************************************************************************/    
                                              // Test Step 1 PRECONDITIONS
  /***************************************************************************************************************/
  snprintf( chActionText, elCount(chActionText), "Flash the Software and ECU is running"); 
  snprintf( chExpectedText, elCount(chExpectedText), "ECU should be in running state"); 
  TestStepAddActionExpected( chActionText, chExpectedText );

  A_DBGR_BreakpointDeleteAll();
  A_DBGR_RnGo();
  E_DBGR_CheckState(T32_State_Running);
  
  
  
    
   
  /*******************************************************************************************************************************************************/    
    // Test Step 2: Set a breakpoint at "TstReadstatus = ( Binvdmreadstatus )ReadHWIO_h_BatNonVltl( BLOCKING_MODE, &binvdmaddr, 72U, ( BYTE *)&Nvmdataread );" and run the application
  /*******************************************************************************************************************************************************/
  
  snprintf( chActionText, elCount(chActionText), "Set a breakpoint at TstReadstatus = ( Binvdmreadstatus )ReadHWIO_h_BatNonVltl( BLOCKING_MODE, &binvdmaddr, 72U, ( BYTE *)&Nvmdataread ); and run the application"); 
  snprintf( chExpectedText, elCount(chExpectedText), "Breakpoint is set."); 
  TestStepAddActionExpected( chActionText, chExpectedText );
  //A_DBGR_R();
  A_DBGR_BreakpointSet("TestBinvdm_NonblockingRead\\5");  
  A_DBGR_Go();
  E_DBGR_BreakpointCheckForHalt("TestBinvdm_NonblockingRead\\5");
 
   /*******************************************************************************************************************************************************/    
    // Test Step 3: Set a breakpoint at "TstReadstatus = ( Binvdmreadstatus )ReadHWIO_h_BatNonVltl( BLOCKING_MODE, &binvdmaddr, 72U, ( BYTE *)&Nvmdataread );" and run the application
  /*******************************************************************************************************************************************************/
  
  snprintf( chActionText, elCount(chActionText), "Set binvdmreadrequest = TRUE in trace32 watch window"); 
  snprintf( chExpectedText, elCount(chExpectedText), "binvdmreadrequest = TRUE"); 
  TestStepAddActionExpected( chActionText, chExpectedText );
  A_DBGR_VariableSet("binvdmreadrequest", "1"); 
  E_DBGR_VariableCheck("binvdmreadrequest",1,Equal);
  
   /*******************************************************************************************************************************************************/    
    // Test Step 4: Set a breakpoint at "if( BINVDM_BLOCKING_MODE == binvdmSchmode )
  /*******************************************************************************************************************************************************/
  
  snprintf( chActionText, elCount(chActionText), "Set a breakpoint at return( ( BYTE )Readstatus ); and run the application"); 
  snprintf( chExpectedText, elCount(chExpectedText), "Breakpoint is set."); 
  TestStepAddActionExpected( chActionText, chExpectedText );
  //A_DBGR_R();
  A_DBGR_BreakpointSet("ReadHWIO_h_BatNonVltl\\14");  
  A_DBGR_Go();
  E_DBGR_BreakpointCheckForHalt("ReadHWIO_h_BatNonVltl\\14");
  
  
  snprintf( chActionText, elCount(chActionText), "Set binvdmSchmode = 0 in trace32 watch window"); 
  snprintf( chExpectedText, elCount(chExpectedText), "binvdmSchmode = 0"); 
  TestStepAddActionExpected( chActionText, chExpectedText );
  A_DBGR_VariableSet("binvdmSchmode", "0"); 
  E_DBGR_VariableCheck("binvdmSchmode",0,Equal);
   /*******************************************************************************************************************************************************/    
    // Test Step 5: Set a breakpoint at "ret = MemAcc_Read( Address_Instance, ( Targetaddr - BINVDM_DFLASH_PHY_START_ADDR ), binvdmramaddr,\

  /*******************************************************************************************************************************************************/

  
  
  snprintf( chActionText, elCount(chActionText), " 1 - set run"); 
  snprintf( chExpectedText, elCount(chExpectedText), "Breakpoint is set."); 
  TestStepAddActionExpected( chActionText, chExpectedText );
  //A_DBGR_R();
  A_DBGR_BreakpointSet("ReadHWIO_h_BatNonVltl\\32");  
  A_DBGR_Go();
  E_DBGR_BreakpointCheckForHalt("ReadHWIO_h_BatNonVltl\\32");
  
  
  snprintf( chActionText, elCount(chActionText), " 1 - set run"); 
  snprintf( chExpectedText, elCount(chExpectedText), "Breakpoint is set."); 
  TestStepAddActionExpected( chActionText, chExpectedText );
  A_DBGR_BreakpointSet("TestBinvdm_ReadCancel\\2");  
  A_DBGR_Go();
  E_DBGR_BreakpointCheckForHalt("TestBinvdm_ReadCancel\\2");

   /*******************************************************************************************************************************************************/    
    // Test Step 5_1: Set a breakpoint at "ret = MemAcc_Read( Address_Instance, ( Targetaddr - BINVDM_DFLASH_PHY_START_ADDR ), binvdmramaddr,\

  /*******************************************************************************************************************************************************/

  snprintf( chActionText, elCount(chActionText), "Set binvdmreadcancel = 1 in trace32 watch window"); 
  snprintf( chExpectedText, elCount(chExpectedText), "binvdmreadcancel = 1"); 
  TestStepAddActionExpected( chActionText, chExpectedText );
  A_DBGR_VariableSet("binvdmreadcancel", "1"); 
  E_DBGR_VariableCheck("binvdmreadcancel",1,Equal);
  
  
  
  snprintf( chActionText, elCount(chActionText), " 1 - set run"); 
  snprintf( chExpectedText, elCount(chExpectedText), "Breakpoint is set."); 
  TestStepAddActionExpected( chActionText, chExpectedText );
  A_DBGR_BreakpointSet("TestBinvdm_ReadCancel\\5");  
  A_DBGR_Go();
  E_DBGR_BreakpointCheckForHalt("TestBinvdm_ReadCancel\\5");


   /*******************************************************************************************************************************************************/    
    // Test Step 6: check Readstatus = BINVDM_ERASE_CANCELED
  /*******************************************************************************************************************************************************/
  
  
  snprintf( chActionText, elCount(chActionText), " BINVDM_ERASE_CANCELED state "); 
  snprintf( chExpectedText, elCount(chExpectedText), "Breakpoint is set."); 
  TestStepAddActionExpected( chActionText, chExpectedText );
  //A_DBGR_R();
  A_DBGR_BreakpointSet("ReadHWIO_h_BatNonVltl\\124");  
  A_DBGR_Go();
  E_DBGR_BreakpointCheckForHalt("ReadHWIO_h_BatNonVltl\\124");
  
  snprintf( chActionText, elCount(chActionText), "Verify Readstatus  value in trace32 watch window"); 
  snprintf( chExpectedText, elCount(chExpectedText), "Readstatus = BINVDM_ERASE_CANCELED"); 
  TestStepAddActionExpected( chActionText, chExpectedText );
  E_DBGR_VariableCheck("Readstatus",5,Equal);

 /*******************************************************************************************************************************************************/    
    // Test Step 7:check  Readstatus = BINVDM_READ_IDLE
  /*******************************************************************************************************************************************************/
  
//  snprintf( chActionText, elCount(chActionText), "Set a breakpoint at TstReadstatus = ( Binvdmreadstatus )GetHWIO_e_BatNonVltlReadSt(); inside BYTE TestBinvdm_ReadGetStatus( void ) in test_binvdm_hwio.c and run the application"); 
//  snprintf( chExpectedText, elCount(chExpectedText), "Breakpoint is set."); 
//  TestStepAddActionExpected( chActionText, chExpectedText );
//  //A_DBGR_R();
//  A_DBGR_BreakpointSet("TestBinvdm_NonblockingRead\\5");  
//  A_DBGR_Go();
//  E_DBGR_BreakpointCheckForHalt("TestBinvdm_NonblockingRead\\5");
  
  
//  snprintf( chActionText, elCount(chActionText), "Verify TstReadstatus value in trace32 watch window"); 
//  snprintf( chExpectedText, elCount(chExpectedText), "Readstatus = BINVDM_READ_IDLE"); 
//  TestStepAddActionExpected( chActionText, chExpectedText );
//  E_DBGR_VariableCheck("Readstatus",0,Equal);  
 
}
testcase Testcase_Verify_Canceled_Read_Operation_Status_in_NONBlocking_Mode()
{
  /***************************************************************************************************************/    
                                                // Variable Definition
  /***************************************************************************************************************/ 
  long taskvalue;
  /***************************************************************************************************************/    
                                               // Local Values
  /***************************************************************************************************************/ 

  /***************************************************************************************************************/    
                                              // Test Case Info
  /***************************************************************************************************************/
  setWriteDbgLevel(DebugOff);
  snprintf( chTestTitle, elCount(chTestTitle), "Testcase_Verify_Default_Read_Status_Until_Operation_Completion_in_Blocking_Mode" );
  snprintf( chTestDescription, elCount(chTestDescription), "Purpose:The software shall return the BINVDM Read status as InProgress from the time of the read request operation until Completed, MemoryError or Canceled statuses have been determined.");
  TestCaseAddInfo( chTestTitle, "TC_L30SW_QT_36728636", chTestDescription );
  /***************************************************************************************************************/    
                                              // Start of Test Case
  /***************************************************************************************************************/
  /***************************************************************************************************************/    
                                              // Test Step 1 PRECONDITIONS
  /***************************************************************************************************************/
  snprintf( chActionText, elCount(chActionText), "Flash the Software and ECU is running"); 
  snprintf( chExpectedText, elCount(chExpectedText), "ECU should be in running state"); 
  TestStepAddActionExpected( chActionText, chExpectedText );

  A_DBGR_BreakpointDeleteAll();
  A_DBGR_RnGo();
  E_DBGR_CheckState(T32_State_Running);
  
  
  
    
   
  /*******************************************************************************************************************************************************/    
    // Test Step 2: Set a breakpoint at "TstReadstatus = ( Binvdmreadstatus )ReadHWIO_h_BatNonVltl( BLOCKING_MODE, &binvdmaddr, 72U, ( BYTE *)&Nvmdataread );" and run the application
  /*******************************************************************************************************************************************************/
  
  snprintf( chActionText, elCount(chActionText), "Set a breakpoint at TstReadstatus = ( Binvdmreadstatus )ReadHWIO_h_BatNonVltl( BLOCKING_MODE, &binvdmaddr, 72U, ( BYTE *)&Nvmdataread ); and run the application"); 
  snprintf( chExpectedText, elCount(chExpectedText), "Breakpoint is set."); 
  TestStepAddActionExpected( chActionText, chExpectedText );
  //A_DBGR_R();
  A_DBGR_BreakpointSet("TestBinvdm_NonblockingRead\\5");  
  A_DBGR_Go();
  E_DBGR_BreakpointCheckForHalt("TestBinvdm_NonblockingRead\\5");
 
   /*******************************************************************************************************************************************************/    
    // Test Step 3: Set a breakpoint at "TstReadstatus = ( Binvdmreadstatus )ReadHWIO_h_BatNonVltl( BLOCKING_MODE, &binvdmaddr, 72U, ( BYTE *)&Nvmdataread );" and run the application
  /*******************************************************************************************************************************************************/
  
  snprintf( chActionText, elCount(chActionText), "Set binvdmreadrequest = TRUE in trace32 watch window"); 
  snprintf( chExpectedText, elCount(chExpectedText), "binvdmreadrequest = TRUE"); 
  TestStepAddActionExpected( chActionText, chExpectedText );
  A_DBGR_VariableSet("binvdmreadrequest", "1"); 
  E_DBGR_VariableCheck("binvdmreadrequest",1,Equal);
  
  
  /*******************************************************************************************************************************************************/    
    // Test Step 4: Set a breakpoint at "TstReadstatus = ( Binvdmreadstatus )ReadHWIO_h_BatNonVltl( BLOCKING_MODE, &binvdmaddr, 72U, ( BYTE *)&Nvmdataread );" and run the application
  /*******************************************************************************************************************************************************/
  
  
  snprintf( chActionText, elCount(chActionText), " 1 - set run"); 
  snprintf( chExpectedText, elCount(chExpectedText), "Breakpoint is set."); 
  TestStepAddActionExpected( chActionText, chExpectedText );
  //A_DBGR_R();
  A_DBGR_BreakpointSet("ReadHWIO_h_BatNonVltl\\54");  
  A_DBGR_Go();
  E_DBGR_BreakpointCheckForHalt("ReadHWIO_h_BatNonVltl\\54");
  /*******************************************************************************************************************************************************/    
    // Test Step 5: Set a breakpoint at "TstReadstatus = ( Binvdmreadstatus )ReadHWIO_h_BatNonVltl( BLOCKING_MODE, &binvdmaddr, 72U, ( BYTE *)&Nvmdataread );" and run the application
  /*******************************************************************************************************************************************************/
  
  
  snprintf( chActionText, elCount(chActionText), " 1 - set run"); 
  snprintf( chExpectedText, elCount(chExpectedText), "Breakpoint is set."); 
  TestStepAddActionExpected( chActionText, chExpectedText );
  A_DBGR_BreakpointSet("TestBinvdm_ReadCancel\\2");  
  A_DBGR_Go();
  E_DBGR_BreakpointCheckForHalt("TestBinvdm_ReadCancel\\2");

   /*******************************************************************************************************************************************************/    
    // Test Step 5_1: Set a breakpoint at "ret = MemAcc_Read( Address_Instance, ( Targetaddr - BINVDM_DFLASH_PHY_START_ADDR ), binvdmramaddr,\

  /*******************************************************************************************************************************************************/

  snprintf( chActionText, elCount(chActionText), "Set binvdmreadcancel = 1 in trace32 watch window"); 
  snprintf( chExpectedText, elCount(chExpectedText), "binvdmreadcancel = 1"); 
  TestStepAddActionExpected( chActionText, chExpectedText );
  A_DBGR_VariableSet("binvdmreadcancel", "1"); 
  E_DBGR_VariableCheck("binvdmreadcancel",1,Equal);
  
  
  snprintf( chActionText, elCount(chActionText), " 1 - set run"); 
  snprintf( chExpectedText, elCount(chExpectedText), "Breakpoint is set."); 
  TestStepAddActionExpected( chActionText, chExpectedText );
  A_DBGR_BreakpointSet("TestBinvdm_ReadCancel\\5");  
  A_DBGR_Go();
  E_DBGR_BreakpointCheckForHalt("TestBinvdm_ReadCancel\\5");
 //A_DBGR_BreakpointDeleteAll();

   /*******************************************************************************************************************************************************/    
    // Test Step 6: check Readstatus = BINVDM_ERASE_CANCELED
  /*******************************************************************************************************************************************************/
  
  
  snprintf( chActionText, elCount(chActionText), " BINVDM_ERASE_CANCELED state "); 
  snprintf( chExpectedText, elCount(chExpectedText), "Breakpoint is set."); 
  TestStepAddActionExpected( chActionText, chExpectedText );
  //A_DBGR_R();
  A_DBGR_BreakpointSet("ReadHWIO_h_BatNonVltl\\124");  
  A_DBGR_Go();
  E_DBGR_BreakpointCheckForHalt("ReadHWIO_h_BatNonVltl\\124");
  
  snprintf( chActionText, elCount(chActionText), "Verify Readstatus  value in trace32 watch window"); 
  snprintf( chExpectedText, elCount(chExpectedText), "Readstatus = BINVDM_ERASE_CANCELED"); 
  TestStepAddActionExpected( chActionText, chExpectedText );
  E_DBGR_VariableCheck("Readstatus",1,Equal);

 /*******************************************************************************************************************************************************/    
    // Test Step 7:check  Readstatus = BINVDM_READ_IDLE
  /*******************************************************************************************************************************************************/
  
//  snprintf( chActionText, elCount(chActionText), "Set a breakpoint at TstReadstatus = ( Binvdmreadstatus )GetHWIO_e_BatNonVltlReadSt(); inside BYTE TestBinvdm_ReadGetStatus( void ) in test_binvdm_hwio.c and run the application"); 
//  snprintf( chExpectedText, elCount(chExpectedText), "Breakpoint is set."); 
//  TestStepAddActionExpected( chActionText, chExpectedText );
//  //A_DBGR_R();
//  A_DBGR_BreakpointSet("TestBinvdm_NonblockingRead\\5");  
//  A_DBGR_Go();
//  E_DBGR_BreakpointCheckForHalt("TestBinvdm_NonblockingRead\\5");
  
  
//  snprintf( chActionText, elCount(chActionText), "Verify TstReadstatus value in trace32 watch window"); 
//  snprintf( chExpectedText, elCount(chExpectedText), "Readstatus = BINVDM_READ_IDLE"); 
//  TestStepAddActionExpected( chActionText, chExpectedText );
//  E_DBGR_VariableCheck("Readstatus",0,Equal);  
 
}

testcase Testcase_Verify_Read_Request_Operation_for_Erased_Memory_Location_in_Blocking_Mode()
{
 /***************************************************************************************************************/    
                                                // Variable Definition
  /***************************************************************************************************************/ 
  long taskvalue;
  /***************************************************************************************************************/    
                                               // Local Values
  /***************************************************************************************************************/ 

  /***************************************************************************************************************/    
                                              // Test Case Info
  /***************************************************************************************************************/
  setWriteDbgLevel(DebugOff);
  snprintf( chTestTitle, elCount(chTestTitle), "Testcase_Verify_Default_Read_Status_Until_Operation_Completion_in_Blocking_Mode" );
  snprintf( chTestDescription, elCount(chTestDescription), "Purpose:The software shall return the BINVDM Read status as InProgress from the time of the read request operation until Completed, MemoryError or Canceled statuses have been determined.");
  TestCaseAddInfo( chTestTitle, "TC_L30SW_QT_36728636", chTestDescription );
  /***************************************************************************************************************/    
                                              // Start of Test Case
  /***************************************************************************************************************/
  /***************************************************************************************************************/    
                                              // Test Step 1 PRECONDITIONS
  /***************************************************************************************************************/
  snprintf( chActionText, elCount(chActionText), "Flash the Software and ECU is running"); 
  snprintf( chExpectedText, elCount(chExpectedText), "ECU should be in running state"); 
  TestStepAddActionExpected( chActionText, chExpectedText );

  A_DBGR_BreakpointDeleteAll();
  A_DBGR_RnGo();
  E_DBGR_CheckState(T32_State_Running);
  
  
  
    
   
  /*******************************************************************************************************************************************************/    
    // Test Step 2: Set a breakpoint at "TstReadstatus = ( Binvdmreadstatus )ReadHWIO_h_BatNonVltl( BLOCKING_MODE, &binvdmaddr, 72U, ( BYTE *)&Nvmdataread );" and run the application
  /*******************************************************************************************************************************************************/
  
  snprintf( chActionText, elCount(chActionText), "Set a breakpoint at TstReadstatus = ( Binvdmreadstatus )ReadHWIO_h_BatNonVltl( BLOCKING_MODE, &binvdmaddr, 72U, ( BYTE *)&Nvmdataread ); and run the application"); 
  snprintf( chExpectedText, elCount(chExpectedText), "Breakpoint is set."); 
  TestStepAddActionExpected( chActionText, chExpectedText );
  //A_DBGR_R();
  A_DBGR_BreakpointSet("TestBinvdm_NonblockingRead\\5");  
  A_DBGR_Go();
  E_DBGR_BreakpointCheckForHalt("TestBinvdm_NonblockingRead\\5");
 
   /*******************************************************************************************************************************************************/    
    // Test Step 3: Set a breakpoint at "TstReadstatus = ( Binvdmreadstatus )ReadHWIO_h_BatNonVltl( BLOCKING_MODE, &binvdmaddr, 72U, ( BYTE *)&Nvmdataread );" and run the application
  /*******************************************************************************************************************************************************/
  
  snprintf( chActionText, elCount(chActionText), "Set binvdmreadrequest = TRUE in trace32 watch window"); 
  snprintf( chExpectedText, elCount(chExpectedText), "binvdmreadrequest = TRUE"); 
  TestStepAddActionExpected( chActionText, chExpectedText );
  A_DBGR_VariableSet("binvdmreadrequest", "1"); 
  E_DBGR_VariableCheck("binvdmreadrequest",1,Equal);
  
   /*******************************************************************************************************************************************************/    
    // Test Step 4: Set a breakpoint at "if( BINVDM_BLOCKING_MODE == binvdmSchmode )
  /*******************************************************************************************************************************************************/
  
  snprintf( chActionText, elCount(chActionText), "Set a breakpoint at return( ( BYTE )Readstatus ); and run the application"); 
  snprintf( chExpectedText, elCount(chExpectedText), "Breakpoint is set."); 
  TestStepAddActionExpected( chActionText, chExpectedText );
  //A_DBGR_R();
  A_DBGR_BreakpointSet("ReadHWIO_h_BatNonVltl\\14");  
  A_DBGR_Go();
  E_DBGR_BreakpointCheckForHalt("ReadHWIO_h_BatNonVltl\\14");
  
  
  snprintf( chActionText, elCount(chActionText), "Set binvdmSchmode = 0 in trace32 watch window"); 
  snprintf( chExpectedText, elCount(chExpectedText), "binvdmSchmode = 0"); 
  TestStepAddActionExpected( chActionText, chExpectedText );
  A_DBGR_VariableSet("binvdmSchmode", "0"); 
  E_DBGR_VariableCheck("binvdmSchmode",0,Equal);
   /*******************************************************************************************************************************************************/    
    // Test Step 5: Set a breakpoint at "ret = MemAcc_Read( Address_Instance, ( Targetaddr - BINVDM_DFLASH_PHY_START_ADDR ), binvdmramaddr,\

  /*******************************************************************************************************************************************************/

  snprintf( chActionText, elCount(chActionText), " 1 - set run"); 
  snprintf( chExpectedText, elCount(chExpectedText), "Breakpoint is set."); 
  TestStepAddActionExpected( chActionText, chExpectedText );
  //A_DBGR_R();
  A_DBGR_BreakpointSet("ReadHWIO_h_BatNonVltl\\32");  
  A_DBGR_Go();
  E_DBGR_BreakpointCheckForHalt("ReadHWIO_h_BatNonVltl\\32");
  
  
   /*******************************************************************************************************************************************************/    
    // Test Step 6: check Readstatus = BINVDM_READ_INPROGRESS
  /*******************************************************************************************************************************************************/
  
  
  snprintf( chActionText, elCount(chActionText), " complete state "); 
  snprintf( chExpectedText, elCount(chExpectedText), "Breakpoint is set."); 
  TestStepAddActionExpected( chActionText, chExpectedText );
  //A_DBGR_R();
  A_DBGR_BreakpointSet("ReadHWIO_h_BatNonVltl\\124");  
  A_DBGR_Go();
   A_DBGR_Go();
  E_DBGR_BreakpointCheckForHalt("ReadHWIO_h_BatNonVltl\\124");
  
  snprintf( chActionText, elCount(chActionText), "Verify Readstatus  value in trace32 watch window"); 
  snprintf( chExpectedText, elCount(chExpectedText), "Readstatus = BINVDM_ERASE_COMPLETE"); 
  TestStepAddActionExpected( chActionText, chExpectedText );
  E_DBGR_VariableCheck("Readstatus",2,Equal);
 
}


testcase Testcase_Verify_Read_Request_Operation_for_Erased_Memory_Location_in_NON_Blocking_Mode()
{
  /***************************************************************************************************************/    
                                                // Variable Definition
  /***************************************************************************************************************/ 
  long taskvalue;
  /***************************************************************************************************************/    
                                               // Local Values
  /***************************************************************************************************************/ 

  /***************************************************************************************************************/    
                                              // Test Case Info
  /***************************************************************************************************************/
  setWriteDbgLevel(DebugOff);
  snprintf( chTestTitle, elCount(chTestTitle), "Testcase_Verify_Default_Read_Status_Until_Operation_Completion_in_Blocking_Mode" );
  snprintf( chTestDescription, elCount(chTestDescription), "Purpose:The software shall return the BINVDM Read status as InProgress from the time of the read request operation until Completed, MemoryError or Canceled statuses have been determined.");
  TestCaseAddInfo( chTestTitle, "TC_L30SW_QT_36728636", chTestDescription );
  /***************************************************************************************************************/    
                                              // Start of Test Case
  /***************************************************************************************************************/
  /***************************************************************************************************************/    
                                              // Test Step 1 PRECONDITIONS
  /***************************************************************************************************************/
  snprintf( chActionText, elCount(chActionText), "Flash the Software and ECU is running"); 
  snprintf( chExpectedText, elCount(chExpectedText), "ECU should be in running state"); 
  TestStepAddActionExpected( chActionText, chExpectedText );

  A_DBGR_BreakpointDeleteAll();
  A_DBGR_RnGo();
  E_DBGR_CheckState(T32_State_Running);
  
  
  
    
   
  /*******************************************************************************************************************************************************/    
    // Test Step 2: Set a breakpoint at "TstReadstatus = ( Binvdmreadstatus )ReadHWIO_h_BatNonVltl( BLOCKING_MODE, &binvdmaddr, 72U, ( BYTE *)&Nvmdataread );" and run the application
  /*******************************************************************************************************************************************************/
  
  snprintf( chActionText, elCount(chActionText), "Set a breakpoint at TstReadstatus = ( Binvdmreadstatus )ReadHWIO_h_BatNonVltl( BLOCKING_MODE, &binvdmaddr, 72U, ( BYTE *)&Nvmdataread ); and run the application"); 
  snprintf( chExpectedText, elCount(chExpectedText), "Breakpoint is set."); 
  TestStepAddActionExpected( chActionText, chExpectedText );
  //A_DBGR_R();
  A_DBGR_BreakpointSet("TestBinvdm_NonblockingRead\\5");  
  A_DBGR_Go();
  E_DBGR_BreakpointCheckForHalt("TestBinvdm_NonblockingRead\\5");
 
   /*******************************************************************************************************************************************************/    
    // Test Step 3: Set a breakpoint at "TstReadstatus = ( Binvdmreadstatus )ReadHWIO_h_BatNonVltl( BLOCKING_MODE, &binvdmaddr, 72U, ( BYTE *)&Nvmdataread );" and run the application
  /*******************************************************************************************************************************************************/
  
  snprintf( chActionText, elCount(chActionText), "Set binvdmreadrequest = TRUE in trace32 watch window"); 
  snprintf( chExpectedText, elCount(chExpectedText), "binvdmreadrequest = TRUE"); 
  TestStepAddActionExpected( chActionText, chExpectedText );
  A_DBGR_VariableSet("binvdmreadrequest", "1"); 
  E_DBGR_VariableCheck("binvdmreadrequest",1,Equal);
  
  
   /*******************************************************************************************************************************************************/    
    // Test Step 5: Set a breakpoint at "ret = MemAcc_Read( Address_Instance, ( Targetaddr - BINVDM_DFLASH_PHY_START_ADDR ), binvdmramaddr,\

  /*******************************************************************************************************************************************************/

  snprintf( chActionText, elCount(chActionText), " 1 - set run"); 
  snprintf( chExpectedText, elCount(chExpectedText), "Breakpoint is set."); 
  TestStepAddActionExpected( chActionText, chExpectedText );
  //A_DBGR_R();
  A_DBGR_BreakpointSet("ReadHWIO_h_BatNonVltl\\54");  
  A_DBGR_Go();
  E_DBGR_BreakpointCheckForHalt("ReadHWIO_h_BatNonVltl\\54");
  
  
   /*******************************************************************************************************************************************************/    
    // Test Step 6: check Readstatus = BINVDM_READ_INPROGRESS
  /*******************************************************************************************************************************************************/
  
  
  snprintf( chActionText, elCount(chActionText), " complete state "); 
  snprintf( chExpectedText, elCount(chExpectedText), "Breakpoint is set."); 
  TestStepAddActionExpected( chActionText, chExpectedText );
  //A_DBGR_R();
  A_DBGR_BreakpointSet("ReadHWIO_h_BatNonVltl\\124");  
  A_DBGR_Go();
  E_DBGR_BreakpointCheckForHalt("ReadHWIO_h_BatNonVltl\\124");
  
  snprintf( chActionText, elCount(chActionText), "Verify Readstatus  value in trace32 watch window"); 
  snprintf( chExpectedText, elCount(chExpectedText), "Readstatus = BINVDM_READ_INPROGRESS"); 
  TestStepAddActionExpected( chActionText, chExpectedText );
  E_DBGR_VariableCheck("Readstatus",1,Equal);  
 
}

testcase Testcase_Verify_Memory_Error_during_Read_Operation_in_Blocking_Mode()
{
  /***************************************************************************************************************/    
                                                // Variable Definition
  /***************************************************************************************************************/ 
  long taskvalue;
  /***************************************************************************************************************/    
                                               // Local Values
  /***************************************************************************************************************/ 

  /***************************************************************************************************************/    
                                              // Test Case Info
  /***************************************************************************************************************/
  setWriteDbgLevel(DebugOff);
  snprintf( chTestTitle, elCount(chTestTitle), "Testcase_Verify_Default_Read_Status_Until_Operation_Completion_in_Blocking_Mode" );
  snprintf( chTestDescription, elCount(chTestDescription), "Purpose:The software shall return the BINVDM Read status as InProgress from the time of the read request operation until Completed, MemoryError or Canceled statuses have been determined.");
  TestCaseAddInfo( chTestTitle, "TC_L30SW_QT_36728636", chTestDescription );
  /***************************************************************************************************************/    
                                              // Start of Test Case
  /***************************************************************************************************************/
  /***************************************************************************************************************/    
                                              // Test Step 1 PRECONDITIONS
  /***************************************************************************************************************/
  snprintf( chActionText, elCount(chActionText), "Flash the Software and ECU is running"); 
  snprintf( chExpectedText, elCount(chExpectedText), "ECU should be in running state"); 
  TestStepAddActionExpected( chActionText, chExpectedText );

  A_DBGR_BreakpointDeleteAll();
  A_DBGR_RnGo();
  E_DBGR_CheckState(T32_State_Running);
  
  
  
    
   
  /*******************************************************************************************************************************************************/    
    // Test Step 2: Set a breakpoint at "TstReadstatus = ( Binvdmreadstatus )ReadHWIO_h_BatNonVltl( BLOCKING_MODE, &binvdmaddr, 72U, ( BYTE *)&Nvmdataread );" and run the application
  /*******************************************************************************************************************************************************/
  
  snprintf( chActionText, elCount(chActionText), "Set a breakpoint at TstReadstatus = ( Binvdmreadstatus )ReadHWIO_h_BatNonVltl( BLOCKING_MODE, &binvdmaddr, 72U, ( BYTE *)&Nvmdataread ); and run the application"); 
  snprintf( chExpectedText, elCount(chExpectedText), "Breakpoint is set."); 
  TestStepAddActionExpected( chActionText, chExpectedText );
  //A_DBGR_R();
  A_DBGR_BreakpointSet("TestBinvdm_blockingRead\\5");  
  A_DBGR_Go();
  E_DBGR_BreakpointCheckForHalt("TestBinvdm_blockingRead\\5");
 
   /*******************************************************************************************************************************************************/    
    // Test Step 3: Set a breakpoint at "TstReadstatus = ( Binvdmreadstatus )ReadHWIO_h_BatNonVltl( BLOCKING_MODE, &binvdmaddr, 72U, ( BYTE *)&Nvmdataread );" and run the application
  /*******************************************************************************************************************************************************/
  
  snprintf( chActionText, elCount(chActionText), "Set binvdmreadrequest = TRUE in trace32 watch window"); 
  snprintf( chExpectedText, elCount(chExpectedText), "binvdmreadrequest = TRUE"); 
  TestStepAddActionExpected( chActionText, chExpectedText );
  A_DBGR_VariableSet("binvdmreadrequest", "1"); 
  E_DBGR_VariableCheck("binvdmreadrequest",1,Equal);
  
   /*******************************************************************************************************************************************************/    
    // Test Step 4: Set a breakpoint at "if( BINVDM_BLOCKING_MODE == binvdmSchmode )
  /*******************************************************************************************************************************************************/
  
  snprintf( chActionText, elCount(chActionText), "Set a breakpoint at return( ( BYTE )Readstatus ); and run the application"); 
  snprintf( chExpectedText, elCount(chExpectedText), "Breakpoint is set."); 
  TestStepAddActionExpected( chActionText, chExpectedText );
  //A_DBGR_R();
  A_DBGR_BreakpointSet("ReadHWIO_h_BatNonVltl\\14");  
  A_DBGR_Go();
  E_DBGR_BreakpointCheckForHalt("ReadHWIO_h_BatNonVltl\\14");
  
  
  snprintf( chActionText, elCount(chActionText), "Set binvdmSchmode = 0 in trace32 watch window"); 
  snprintf( chExpectedText, elCount(chExpectedText), "binvdmSchmode = 0"); 
  TestStepAddActionExpected( chActionText, chExpectedText );
  A_DBGR_VariableSet("binvdmSchmode", "0"); 
  E_DBGR_VariableCheck("binvdmSchmode",0,Equal);
   /*******************************************************************************************************************************************************/    
    // Test Step 5: Set a breakpoint at "ret = MemAcc_Read( Address_Instance, ( Targetaddr - BINVDM_DFLASH_PHY_START_ADDR ), binvdmramaddr,\

  /*******************************************************************************************************************************************************/

  snprintf( chActionText, elCount(chActionText), " 1 - set run"); 
  snprintf( chExpectedText, elCount(chExpectedText), "Breakpoint is set."); 
  TestStepAddActionExpected( chActionText, chExpectedText );
  //A_DBGR_R();
  A_DBGR_BreakpointSet("ReadHWIO_h_BatNonVltl\\17");  
  A_DBGR_Go();
  E_DBGR_BreakpointCheckForHalt("ReadHWIO_h_BatNonVltl\\17");
  
  
   /*******************************************************************************************************************************************************/    
    // Test Step 6: check Readstatus = BINVDM_READ_COMPLETE
  /*******************************************************************************************************************************************************/
  
  
  snprintf( chActionText, elCount(chActionText), " complete state "); 
  snprintf( chExpectedText, elCount(chExpectedText), "Breakpoint is set."); 
  TestStepAddActionExpected( chActionText, chExpectedText );
  //A_DBGR_R();
  A_DBGR_BreakpointSet("ReadHWIO_h_BatNonVltl\\42");  
  A_DBGR_Go();
  E_DBGR_BreakpointCheckForHalt("ReadHWIO_h_BatNonVltl\\42");
  
  snprintf( chActionText, elCount(chActionText), "Verify Readstatus  value in trace32 watch window"); 
  snprintf( chExpectedText, elCount(chExpectedText), "Readstatus = BINVDM_READ_COMPLETE"); 
  TestStepAddActionExpected( chActionText, chExpectedText );
  E_DBGR_VariableCheck("Readstatus",2,Equal);
 /*******************************************************************************************************************************************************/    
    // Test Step 7:check  Readstatus = BINVDM_READ_IDLE
  /*******************************************************************************************************************************************************/
  
  snprintf( chActionText, elCount(chActionText), "Set a breakpoint at TstReadstatus = ( Binvdmreadstatus )GetHWIO_e_BatNonVltlReadSt(); inside BYTE TestBinvdm_ReadGetStatus( void ) in test_binvdm_hwio.c and run the application"); 
  snprintf( chExpectedText, elCount(chExpectedText), "Breakpoint is set."); 
  TestStepAddActionExpected( chActionText, chExpectedText );
  //A_DBGR_R();
  A_DBGR_BreakpointSet("TestBinvdm_NonblockingRead\\5");  
  A_DBGR_Go();
  E_DBGR_BreakpointCheckForHalt("TestBinvdm_NonblockingRead\\5");
  
  
  snprintf( chActionText, elCount(chActionText), "Verify TstReadstatus value in trace32 watch window"); 
  snprintf( chExpectedText, elCount(chExpectedText), "Readstatus = BINVDM_READ_IDLE"); 
  TestStepAddActionExpected( chActionText, chExpectedText );
  E_DBGR_VariableCheck("Readstatus",0,Equal);  
 
}


testcase Testcase_Verify_Memory_Error_during_Read_Operation_in_NON_Blocking_Mode()
{
  /***************************************************************************************************************/    
                                                // Variable Definition
  /***************************************************************************************************************/ 
  long taskvalue;
  /***************************************************************************************************************/    
                                               // Local Values
  /***************************************************************************************************************/ 

  /***************************************************************************************************************/    
                                              // Test Case Info
  /***************************************************************************************************************/
  setWriteDbgLevel(DebugOff);
  snprintf( chTestTitle, elCount(chTestTitle), "Testcase_Verify_Default_Read_Status_Until_Operation_Completion_in_Blocking_Mode" );
  snprintf( chTestDescription, elCount(chTestDescription), "Purpose:The software shall return the BINVDM Read status as InProgress from the time of the read request operation until Completed, MemoryError or Canceled statuses have been determined.");
  TestCaseAddInfo( chTestTitle, "TC_L30SW_QT_36728636", chTestDescription );
  /***************************************************************************************************************/    
                                              // Start of Test Case
  /***************************************************************************************************************/
  /***************************************************************************************************************/    
                                              // Test Step 1 PRECONDITIONS
  /***************************************************************************************************************/
  snprintf( chActionText, elCount(chActionText), "Flash the Software and ECU is running"); 
  snprintf( chExpectedText, elCount(chExpectedText), "ECU should be in running state"); 
  TestStepAddActionExpected( chActionText, chExpectedText );

  A_DBGR_BreakpointDeleteAll();
  A_DBGR_RnGo();
  E_DBGR_CheckState(T32_State_Running);
  
  
  
    
   
  /*******************************************************************************************************************************************************/    
    // Test Step 2: Set a breakpoint at "TstReadstatus = ( Binvdmreadstatus )ReadHWIO_h_BatNonVltl( BLOCKING_MODE, &binvdmaddr, 72U, ( BYTE *)&Nvmdataread );" and run the application
  /*******************************************************************************************************************************************************/
  
  snprintf( chActionText, elCount(chActionText), "Set a breakpoint at TstReadstatus = ( Binvdmreadstatus )ReadHWIO_h_BatNonVltl( BLOCKING_MODE, &binvdmaddr, 72U, ( BYTE *)&Nvmdataread ); and run the application"); 
  snprintf( chExpectedText, elCount(chExpectedText), "Breakpoint is set."); 
  TestStepAddActionExpected( chActionText, chExpectedText );
  //A_DBGR_R();
  A_DBGR_BreakpointSet("TestBinvdm_blockingRead\\5");  
  A_DBGR_Go();
  E_DBGR_BreakpointCheckForHalt("TestBinvdm_blockingRead\\5");
 
   /*******************************************************************************************************************************************************/    
    // Test Step 3: Set a breakpoint at "TstReadstatus = ( Binvdmreadstatus )ReadHWIO_h_BatNonVltl( BLOCKING_MODE, &binvdmaddr, 72U, ( BYTE *)&Nvmdataread );" and run the application
  /*******************************************************************************************************************************************************/
  
  snprintf( chActionText, elCount(chActionText), "Set binvdmreadrequest = TRUE in trace32 watch window"); 
  snprintf( chExpectedText, elCount(chExpectedText), "binvdmreadrequest = TRUE"); 
  TestStepAddActionExpected( chActionText, chExpectedText );
  A_DBGR_VariableSet("binvdmreadrequest", "1"); 
  E_DBGR_VariableCheck("binvdmreadrequest",1,Equal);
  
   /*******************************************************************************************************************************************************/    
    // Test Step 4: Set a breakpoint at "if( BINVDM_BLOCKING_MODE == binvdmSchmode )
  /*******************************************************************************************************************************************************/
  
  snprintf( chActionText, elCount(chActionText), "Set a breakpoint at return( ( BYTE )Readstatus ); and run the application"); 
  snprintf( chExpectedText, elCount(chExpectedText), "Breakpoint is set."); 
  TestStepAddActionExpected( chActionText, chExpectedText );
  //A_DBGR_R();
  A_DBGR_BreakpointSet("ReadHWIO_h_BatNonVltl\\14");  
  A_DBGR_Go();
  E_DBGR_BreakpointCheckForHalt("ReadHWIO_h_BatNonVltl\\14");
  
  
  snprintf( chActionText, elCount(chActionText), "Set binvdmSchmode = 0 in trace32 watch window"); 
  snprintf( chExpectedText, elCount(chExpectedText), "binvdmSchmode = 0"); 
  TestStepAddActionExpected( chActionText, chExpectedText );
  A_DBGR_VariableSet("binvdmSchmode", "0"); 
  E_DBGR_VariableCheck("binvdmSchmode",0,Equal);
   /*******************************************************************************************************************************************************/    
    // Test Step 5: Set a breakpoint at "ret = MemAcc_Read( Address_Instance, ( Targetaddr - BINVDM_DFLASH_PHY_START_ADDR ), binvdmramaddr,\

  /*******************************************************************************************************************************************************/

  snprintf( chActionText, elCount(chActionText), " 1 - set run"); 
  snprintf( chExpectedText, elCount(chExpectedText), "Breakpoint is set."); 
  TestStepAddActionExpected( chActionText, chExpectedText );
  //A_DBGR_R();
  A_DBGR_BreakpointSet("ReadHWIO_h_BatNonVltl\\17");  
  A_DBGR_Go();
  E_DBGR_BreakpointCheckForHalt("ReadHWIO_h_BatNonVltl\\17");
  
  
   /*******************************************************************************************************************************************************/    
    // Test Step 6: check Readstatus = BINVDM_READ_COMPLETE
  /*******************************************************************************************************************************************************/
  
  
  snprintf( chActionText, elCount(chActionText), " complete state "); 
  snprintf( chExpectedText, elCount(chExpectedText), "Breakpoint is set."); 
  TestStepAddActionExpected( chActionText, chExpectedText );
  //A_DBGR_R();
  A_DBGR_BreakpointSet("ReadHWIO_h_BatNonVltl\\42");  
  A_DBGR_Go();
  E_DBGR_BreakpointCheckForHalt("ReadHWIO_h_BatNonVltl\\42");
  
  snprintf( chActionText, elCount(chActionText), "Verify Readstatus  value in trace32 watch window"); 
  snprintf( chExpectedText, elCount(chExpectedText), "Readstatus = BINVDM_READ_COMPLETE"); 
  TestStepAddActionExpected( chActionText, chExpectedText );
  E_DBGR_VariableCheck("Readstatus",2,Equal);
 /*******************************************************************************************************************************************************/    
    // Test Step 7:check  Readstatus = BINVDM_READ_IDLE
  /*******************************************************************************************************************************************************/
  
  snprintf( chActionText, elCount(chActionText), "Set a breakpoint at TstReadstatus = ( Binvdmreadstatus )GetHWIO_e_BatNonVltlReadSt(); inside BYTE TestBinvdm_ReadGetStatus( void ) in test_binvdm_hwio.c and run the application"); 
  snprintf( chExpectedText, elCount(chExpectedText), "Breakpoint is set."); 
  TestStepAddActionExpected( chActionText, chExpectedText );
  //A_DBGR_R();
  A_DBGR_BreakpointSet("TestBinvdm_NonblockingRead\\5");  
  A_DBGR_Go();
  E_DBGR_BreakpointCheckForHalt("TestBinvdm_NonblockingRead\\5");
  
  
  snprintf( chActionText, elCount(chActionText), "Verify TstReadstatus value in trace32 watch window"); 
  snprintf( chExpectedText, elCount(chExpectedText), "Readstatus = BINVDM_READ_IDLE"); 
  TestStepAddActionExpected( chActionText, chExpectedText );
  E_DBGR_VariableCheck("Readstatus",0,Equal);  
 
}

testcase Testcase_Verify_BINVDM_Initial_Erase_Status()
{
  /***************************************************************************************************************/    
                                                // Variable Definition
  /***************************************************************************************************************/ 
  long taskvalue;
  /***************************************************************************************************************/    
                                               // Local Values
  /***************************************************************************************************************/ 

  /***************************************************************************************************************/    
                                              // Test Case Info
  /***************************************************************************************************************/
  setWriteDbgLevel(DebugOff);
  snprintf( chTestTitle, elCount(chTestTitle), "Testcase_Verify_Default_Read_Status_Until_Operation_Completion_in_Blocking_Mode" );
  snprintf( chTestDescription, elCount(chTestDescription), "Purpose:The software shall return the BINVDM Read status as InProgress from the time of the read request operation until Completed, MemoryError or Canceled statuses have been determined.");
  TestCaseAddInfo( chTestTitle, "TC_L30SW_QT_36728636", chTestDescription );
  /***************************************************************************************************************/    
                                              // Start of Test Case
  /***************************************************************************************************************/
  /***************************************************************************************************************/    
                                              // Test Step 1 PRECONDITIONS
  /***************************************************************************************************************/
  snprintf( chActionText, elCount(chActionText), "Flash the Software and ECU is running"); 
  snprintf( chExpectedText, elCount(chExpectedText), "ECU should be in running state"); 
  TestStepAddActionExpected( chActionText, chExpectedText );

  A_DBGR_BreakpointDeleteAll();
  A_DBGR_RnGo();
  E_DBGR_CheckState(T32_State_Running);
  
  
  
    
   
  /*******************************************************************************************************************************************************/    
    // Test Step 2: Set a breakpoint at "TstReadstatus = ( Binvdmreadstatus )ReadHWIO_h_BatNonVltl( BLOCKING_MODE, &binvdmaddr, 72U, ( BYTE *)&Nvmdataread );" and run the application
  /*******************************************************************************************************************************************************/
  
  snprintf( chActionText, elCount(chActionText), "Set a breakpoint at TstReadstatus = ( Binvdmreadstatus )ReadHWIO_h_BatNonVltl( BLOCKING_MODE, &binvdmaddr, 72U, ( BYTE *)&Nvmdataread ); and run the application"); 
  snprintf( chExpectedText, elCount(chExpectedText), "Breakpoint is set."); 
  TestStepAddActionExpected( chActionText, chExpectedText );
  //A_DBGR_R();
  A_DBGR_BreakpointSet("TestBinvdm_EraseGetStatus\\4");  
  A_DBGR_Go();
  E_DBGR_BreakpointCheckForHalt("TestBinvdm_EraseGetStatus\\4");
 
   
  
  snprintf( chActionText, elCount(chActionText), "Verify TstErasestatus  value in trace32 watch window"); 
  snprintf( chExpectedText, elCount(chExpectedText), "Erasestatus = BINVDM_ERASE_IDLE"); 
  TestStepAddActionExpected( chActionText, chExpectedText );
  E_DBGR_VariableCheck("TstErasestatus",0,Equal);
 
 
}
testcase Verify_Erased_Segment_Verification_in_Blocking_Mode()
{
  /***************************************************************************************************************/    
                                                // Variable Definition
  /***************************************************************************************************************/ 
  long taskvalue;
  /***************************************************************************************************************/    
                                               // Local Values
  /***************************************************************************************************************/ 

  /***************************************************************************************************************/    
                                              // Test Case Info
  /***************************************************************************************************************/
  setWriteDbgLevel(DebugOff);
  snprintf( chTestTitle, elCount(chTestTitle), "Testcase_Verify_Default_Read_Status_Until_Operation_Completion_in_Blocking_Mode" );
  snprintf( chTestDescription, elCount(chTestDescription), "Purpose:The software shall return the BINVDM Read status as InProgress from the time of the read request operation until Completed, MemoryError or Canceled statuses have been determined.");
  TestCaseAddInfo( chTestTitle, "TC_L30SW_QT_36728636", chTestDescription );
  /***************************************************************************************************************/    
                                              // Start of Test Case
  /***************************************************************************************************************/
  /***************************************************************************************************************/    
                                              // Test Step 1 PRECONDITIONS
  /***************************************************************************************************************/
  snprintf( chActionText, elCount(chActionText), "Flash the Software and ECU is running"); 
  snprintf( chExpectedText, elCount(chExpectedText), "ECU should be in running state"); 
  TestStepAddActionExpected( chActionText, chExpectedText );

  A_DBGR_BreakpointDeleteAll();
  A_DBGR_RnGo();
  E_DBGR_CheckState(T32_State_Running);
  
  
  
    
   
  /*******************************************************************************************************************************************************/    
    // Test Step 2: Set a breakpoint at "TstReadstatus = ( Binvdmreadstatus )ReadHWIO_h_BatNonVltl( BLOCKING_MODE, &binvdmaddr, 72U, ( BYTE *)&Nvmdataread );" and run the application
  /*******************************************************************************************************************************************************/
  
  snprintf( chActionText, elCount(chActionText), "Set a breakpoint at TstReadstatus = ( Binvdmreadstatus )ReadHWIO_h_BatNonVltl( BLOCKING_MODE, &binvdmaddr, 72U, ( BYTE *)&Nvmdataread ); and run the application"); 
  snprintf( chExpectedText, elCount(chExpectedText), "Breakpoint is set."); 
  TestStepAddActionExpected( chActionText, chExpectedText );
  //A_DBGR_R();
  A_DBGR_BreakpointSet("TestBinvdm_NonblockingErase\\4");  
  A_DBGR_Go();
  E_DBGR_BreakpointCheckForHalt("TestBinvdm_NonblockingErase\\4");
 
   /*******************************************************************************************************************************************************/    
    // Test Step 3: Set a breakpoint at "TstReadstatus = ( Binvdmreadstatus )ReadHWIO_h_BatNonVltl( BLOCKING_MODE, &binvdmaddr, 72U, ( BYTE *)&Nvmdataread );" and run the application
  /*******************************************************************************************************************************************************/
  
  snprintf( chActionText, elCount(chActionText), "Set binvdmeraserequest = TRUE in trace32 watch window"); 
  snprintf( chExpectedText, elCount(chExpectedText), "binvdmeraserequest = TRUE"); 
  TestStepAddActionExpected( chActionText, chExpectedText );
  A_DBGR_VariableSet("binvdmeraserequest", "1"); 
  E_DBGR_VariableCheck("binvdmeraserequest",1,Equal);
  
   /*******************************************************************************************************************************************************/    
    // Test Step 4: Set a breakpoint at "if( BINVDM_BLOCKING_MODE == binvdmSchmode )
  /*******************************************************************************************************************************************************/
  
  snprintf( chActionText, elCount(chActionText), "Set a breakpoint at return( ( BYTE )Readstatus ); and run the application"); 
  snprintf( chExpectedText, elCount(chExpectedText), "Breakpoint is set."); 
  TestStepAddActionExpected( chActionText, chExpectedText );
  
  A_DBGR_BreakpointSet("EraseHWIO_h_BatNonVltl\\20");  
  A_DBGR_Go();
  E_DBGR_BreakpointCheckForHalt("EraseHWIO_h_BatNonVltl\\20");
  
  
  snprintf( chActionText, elCount(chActionText), "Set binvdmSchmode = 0 in trace32 watch window"); 
  snprintf( chExpectedText, elCount(chExpectedText), "binvdmSchmode = 0"); 
  TestStepAddActionExpected( chActionText, chExpectedText );
  A_DBGR_VariableSet("binvdmSchmode", "0"); 
  E_DBGR_VariableCheck("binvdmSchmode",0,Equal);
  
   /*******************************************************************************************************************************************************/    
    // Test Step 5: Set a breakpoint at "ret = MemAcc_Read( Address_Instance, ( Targetaddr - BINVDM_DFLASH_PHY_START_ADDR ), binvdmramaddr,\

  /*******************************************************************************************************************************************************/

  snprintf( chActionText, elCount(chActionText), " 1 - set run"); 
  snprintf( chExpectedText, elCount(chExpectedText), "Breakpoint is set."); 
  TestStepAddActionExpected( chActionText, chExpectedText );
  //A_DBGR_R();
  A_DBGR_BreakpointSet("EraseHWIO_h_BatNonVltl\\46");  
  A_DBGR_Go();
  E_DBGR_BreakpointCheckForHalt("EraseHWIO_h_BatNonVltl\\46");
  
  
   /*******************************************************************************************************************************************************/    
    // Test Step 6: check Readstatus = BINVDM_READ_COMPLETE
  /*******************************************************************************************************************************************************/
  
  snprintf( chActionText, elCount(chActionText), "Verify Erasestatus  value in trace32 watch window"); 
  snprintf( chExpectedText, elCount(chExpectedText), "Erasestatus = BINVDM_ERASE_COMPLETE"); 
  TestStepAddActionExpected( chActionText, chExpectedText );
  E_DBGR_VariableCheck("Erasestatus",2,Equal);
 
  
  /*******************************************************************************************************************************************************/    
    // Test Step 7: Set a breakpoint at "TstReadstatus = ( Binvdmreadstatus )ReadHWIO_h_BatNonVltl( BLOCKING_MODE, &binvdmaddr, 72U, ( BYTE *)&Nvmdataread );" and run the application
  /*******************************************************************************************************************************************************/
  

 snprintf( chActionText, elCount(chActionText), "Set a breakpoint at TstReadstatus = ( Binvdmreadstatus )ReadHWIO_h_BatNonVltl( BLOCKING_MODE, &binvdmaddr, 72U, ( BYTE *)&Nvmdataread ); and run the application"); 
  snprintf( chExpectedText, elCount(chExpectedText), "Breakpoint is set."); 
  TestStepAddActionExpected( chActionText, chExpectedText );
  //A_DBGR_R();
  A_DBGR_BreakpointSet("TestBinvdm_NonblockingErase\\4");  
  A_DBGR_Go();
  E_DBGR_BreakpointCheckForHalt("TestBinvdm_NonblockingErase\\4");
 
  
  
  snprintf( chActionText, elCount(chActionText), "Verify Erasestatus  value in trace32 watch window"); 
  snprintf( chExpectedText, elCount(chExpectedText), "Erasestatus = BINVDM_ERASE_IDLE"); 
  TestStepAddActionExpected( chActionText, chExpectedText );
  E_DBGR_VariableCheck("Erasestatus",0,Equal);
 
}

testcase Verify_Erased_Segment_Verification_in_NON_Blocking_Mode()
{
  /***************************************************************************************************************/    
                                                // Variable Definition
  /***************************************************************************************************************/ 
  long taskvalue;
  /***************************************************************************************************************/    
                                               // Local Values
  /***************************************************************************************************************/ 

  /***************************************************************************************************************/    
                                              // Test Case Info
  /***************************************************************************************************************/
  setWriteDbgLevel(DebugOff);
  snprintf( chTestTitle, elCount(chTestTitle), "Testcase_Verify_Default_Read_Status_Until_Operation_Completion_in_Blocking_Mode" );
  snprintf( chTestDescription, elCount(chTestDescription), "Purpose:The software shall return the BINVDM Read status as InProgress from the time of the read request operation until Completed, MemoryError or Canceled statuses have been determined.");
  TestCaseAddInfo( chTestTitle, "TC_L30SW_QT_36728636", chTestDescription );
  /***************************************************************************************************************/    
                                              // Start of Test Case
  /***************************************************************************************************************/
  /***************************************************************************************************************/    
                                              // Test Step 1 PRECONDITIONS
  /***************************************************************************************************************/
  snprintf( chActionText, elCount(chActionText), "Flash the Software and ECU is running"); 
  snprintf( chExpectedText, elCount(chExpectedText), "ECU should be in running state"); 
  TestStepAddActionExpected( chActionText, chExpectedText );

  A_DBGR_BreakpointDeleteAll();
  A_DBGR_RnGo();
  E_DBGR_CheckState(T32_State_Running);
  
  
  
    
   
  /*******************************************************************************************************************************************************/    
    // Test Step 2: Set a breakpoint at "TstReadstatus = ( Binvdmreadstatus )ReadHWIO_h_BatNonVltl( BLOCKING_MODE, &binvdmaddr, 72U, ( BYTE *)&Nvmdataread );" and run the application
  /*******************************************************************************************************************************************************/
  
  snprintf( chActionText, elCount(chActionText), "Set a breakpoint at TstReadstatus = ( Binvdmreadstatus )ReadHWIO_h_BatNonVltl( BLOCKING_MODE, &binvdmaddr, 72U, ( BYTE *)&Nvmdataread ); and run the application"); 
  snprintf( chExpectedText, elCount(chExpectedText), "Breakpoint is set."); 
  TestStepAddActionExpected( chActionText, chExpectedText );
  //A_DBGR_R();
  A_DBGR_BreakpointSet("TestBinvdm_NonblockingErase\\4");  
  A_DBGR_Go();
  E_DBGR_BreakpointCheckForHalt("TestBinvdm_NonblockingErase\\4");
 
   /*******************************************************************************************************************************************************/    
    // Test Step 3: Set a breakpoint at "TstReadstatus = ( Binvdmreadstatus )ReadHWIO_h_BatNonVltl( BLOCKING_MODE, &binvdmaddr, 72U, ( BYTE *)&Nvmdataread );" and run the application
  /*******************************************************************************************************************************************************/
  
  snprintf( chActionText, elCount(chActionText), "Set binvdmeraserequest = TRUE in trace32 watch window"); 
  snprintf( chExpectedText, elCount(chExpectedText), "binvdmeraserequest = TRUE"); 
  TestStepAddActionExpected( chActionText, chExpectedText );
  A_DBGR_VariableSet("binvdmeraserequest", "1"); 
  E_DBGR_VariableCheck("binvdmeraserequest",1,Equal);
  
   /*******************************************************************************************************************************************************/    
    // Test Step 4: Set a breakpoint at "if( BINVDM_BLOCKING_MODE == binvdmSchmode )
  /*******************************************************************************************************************************************************/
  
  snprintf( chActionText, elCount(chActionText), "Set a breakpoint at return( ( BYTE )Readstatus ); and run the application"); 
  snprintf( chExpectedText, elCount(chExpectedText), "Breakpoint is set."); 
  TestStepAddActionExpected( chActionText, chExpectedText );
  
  A_DBGR_BreakpointSet("EraseHWIO_h_BatNonVltl\\20");  
  A_DBGR_Go();
  E_DBGR_BreakpointCheckForHalt("EraseHWIO_h_BatNonVltl\\20");
  
  
  snprintf( chActionText, elCount(chActionText), "Set binvdmSchmode = 0 in trace32 watch window"); 
  snprintf( chExpectedText, elCount(chExpectedText), "binvdmSchmode = 0"); 
  TestStepAddActionExpected( chActionText, chExpectedText );
  A_DBGR_VariableSet("binvdmSchmode", "0"); 
  E_DBGR_VariableCheck("binvdmSchmode",0,Equal);
  
   /*******************************************************************************************************************************************************/    
    // Test Step 5: Set a breakpoint at "ret = MemAcc_Read( Address_Instance, ( Targetaddr - BINVDM_DFLASH_PHY_START_ADDR ), binvdmramaddr,\

  /*******************************************************************************************************************************************************/

  snprintf( chActionText, elCount(chActionText), " 1 - set run"); 
  snprintf( chExpectedText, elCount(chExpectedText), "Breakpoint is set."); 
  TestStepAddActionExpected( chActionText, chExpectedText );
  //A_DBGR_R();
  A_DBGR_BreakpointSet("EraseHWIO_h_BatNonVltl\\46");  
  A_DBGR_Go();
  E_DBGR_BreakpointCheckForHalt("EraseHWIO_h_BatNonVltl\\46");
  
  
   /*******************************************************************************************************************************************************/    
    // Test Step 6: check Readstatus = BINVDM_READ_COMPLETE
  /*******************************************************************************************************************************************************/
  
  snprintf( chActionText, elCount(chActionText), "Verify Erasestatus  value in trace32 watch window"); 
  snprintf( chExpectedText, elCount(chExpectedText), "Erasestatus = BINVDM_ERASE_COMPLETE"); 
  TestStepAddActionExpected( chActionText, chExpectedText );
  E_DBGR_VariableCheck("Erasestatus",2,Equal);
 
  
  /*******************************************************************************************************************************************************/    
    // Test Step 7: Set a breakpoint at "TstReadstatus = ( Binvdmreadstatus )ReadHWIO_h_BatNonVltl( BLOCKING_MODE, &binvdmaddr, 72U, ( BYTE *)&Nvmdataread );" and run the application
  /*******************************************************************************************************************************************************/
  
  snprintf( chActionText, elCount(chActionText), "Set a breakpoint at TstReadstatus = ( Binvdmreadstatus )ReadHWIO_h_BatNonVltl( BLOCKING_MODE, &binvdmaddr, 72U, ( BYTE *)&Nvmdataread ); and run the application"); 
  snprintf( chExpectedText, elCount(chExpectedText), "Breakpoint is set."); 
  TestStepAddActionExpected( chActionText, chExpectedText );
  //A_DBGR_R();
  A_DBGR_BreakpointSet("TestBinvdm_NonblockingErase\\4");  
  A_DBGR_Go();
  E_DBGR_BreakpointCheckForHalt("TestBinvdm_NonblockingErase\\4");
 
 
  
  snprintf( chActionText, elCount(chActionText), "Verify Erasestatus  value in trace32 watch window"); 
  snprintf( chExpectedText, elCount(chExpectedText), "Erasestatus = BINVDM_ERASE_IDLE"); 
  TestStepAddActionExpected( chActionText, chExpectedText );
  E_DBGR_VariableCheck("Erasestatus",0,Equal);
 
}
testcase Verify_Successful_Erase_Operation_Verified_in_Blocking_Mode()
{
  /***************************************************************************************************************/    
                                                // Variable Definition
  /***************************************************************************************************************/ 
  long taskvalue;
  /***************************************************************************************************************/    
                                               // Local Values
  /***************************************************************************************************************/ 

  /***************************************************************************************************************/    
                                              // Test Case Info
  /***************************************************************************************************************/
  setWriteDbgLevel(DebugOff);
  snprintf( chTestTitle, elCount(chTestTitle), "Testcase_Verify_Default_Read_Status_Until_Operation_Completion_in_Blocking_Mode" );
  snprintf( chTestDescription, elCount(chTestDescription), "Purpose:The software shall return the BINVDM Read status as InProgress from the time of the read request operation until Completed, MemoryError or Canceled statuses have been determined.");
  TestCaseAddInfo( chTestTitle, "TC_L30SW_QT_36728636", chTestDescription );
  /***************************************************************************************************************/    
                                              // Start of Test Case
  /***************************************************************************************************************/
  /***************************************************************************************************************/    
                                              // Test Step 1 PRECONDITIONS
  /***************************************************************************************************************/
  snprintf( chActionText, elCount(chActionText), "Flash the Software and ECU is running"); 
  snprintf( chExpectedText, elCount(chExpectedText), "ECU should be in running state"); 
  TestStepAddActionExpected( chActionText, chExpectedText );

  A_DBGR_BreakpointDeleteAll();
  A_DBGR_RnGo();
  E_DBGR_CheckState(T32_State_Running);
  
  
  
    
   
  /*******************************************************************************************************************************************************/    
    // Test Step 2: Set a breakpoint at "TstReadstatus = ( Binvdmreadstatus )ReadHWIO_h_BatNonVltl( BLOCKING_MODE, &binvdmaddr, 72U, ( BYTE *)&Nvmdataread );" and run the application
  /*******************************************************************************************************************************************************/
  
  snprintf( chActionText, elCount(chActionText), "Set a breakpoint at TstReadstatus = ( Binvdmreadstatus )ReadHWIO_h_BatNonVltl( BLOCKING_MODE, &binvdmaddr, 72U, ( BYTE *)&Nvmdataread ); and run the application"); 
  snprintf( chExpectedText, elCount(chExpectedText), "Breakpoint is set."); 
  TestStepAddActionExpected( chActionText, chExpectedText );
  //A_DBGR_R();
  A_DBGR_BreakpointSet("TestBinvdm_NonblockingErase\\4");  
  A_DBGR_Go();
  E_DBGR_BreakpointCheckForHalt("TestBinvdm_NonblockingErase\\4");
 
   /*******************************************************************************************************************************************************/    
    // Test Step 3: Set a breakpoint at "TstReadstatus = ( Binvdmreadstatus )ReadHWIO_h_BatNonVltl( BLOCKING_MODE, &binvdmaddr, 72U, ( BYTE *)&Nvmdataread );" and run the application
  /*******************************************************************************************************************************************************/
  
  snprintf( chActionText, elCount(chActionText), "Set binvdmeraserequest = TRUE in trace32 watch window"); 
  snprintf( chExpectedText, elCount(chExpectedText), "binvdmeraserequest = TRUE"); 
  TestStepAddActionExpected( chActionText, chExpectedText );
  A_DBGR_VariableSet("binvdmeraserequest", "1"); 
  E_DBGR_VariableCheck("binvdmeraserequest",1,Equal);
  
   /*******************************************************************************************************************************************************/    
    // Test Step 4: Set a breakpoint at "if( BINVDM_BLOCKING_MODE == binvdmSchmode )
  /*******************************************************************************************************************************************************/
  
  snprintf( chActionText, elCount(chActionText), "Set a breakpoint at return( ( BYTE )Readstatus ); and run the application"); 
  snprintf( chExpectedText, elCount(chExpectedText), "Breakpoint is set."); 
  TestStepAddActionExpected( chActionText, chExpectedText );
  
  A_DBGR_BreakpointSet("EraseHWIO_h_BatNonVltl\\20");  
  A_DBGR_Go();
  E_DBGR_BreakpointCheckForHalt("EraseHWIO_h_BatNonVltl\\20");
  
  
  snprintf( chActionText, elCount(chActionText), "Set binvdmSchmode = 0 in trace32 watch window"); 
  snprintf( chExpectedText, elCount(chExpectedText), "binvdmSchmode = 0"); 
  TestStepAddActionExpected( chActionText, chExpectedText );
  A_DBGR_VariableSet("binvdmSchmode", "0"); 
  E_DBGR_VariableCheck("binvdmSchmode",0,Equal);
  
   /*******************************************************************************************************************************************************/    
    // Test Step 5: Set a breakpoint at "ret = MemAcc_Read( Address_Instance, ( Targetaddr - BINVDM_DFLASH_PHY_START_ADDR ), binvdmramaddr,\

  /*******************************************************************************************************************************************************/

  snprintf( chActionText, elCount(chActionText), " 1 - set run"); 
  snprintf( chExpectedText, elCount(chExpectedText), "Breakpoint is set."); 
  TestStepAddActionExpected( chActionText, chExpectedText );
  //A_DBGR_R();
  A_DBGR_BreakpointSet("EraseHWIO_h_BatNonVltl\\46");  
  A_DBGR_Go();
  E_DBGR_BreakpointCheckForHalt("EraseHWIO_h_BatNonVltl\\46");
  
  
   /*******************************************************************************************************************************************************/    
    // Test Step 6: check Readstatus = BINVDM_READ_COMPLETE
  /*******************************************************************************************************************************************************/
  
  snprintf( chActionText, elCount(chActionText), "Verify Erasestatus  value in trace32 watch window"); 
  snprintf( chExpectedText, elCount(chExpectedText), "Erasestatus = BINVDM_ERASE_COMPLETE"); 
  TestStepAddActionExpected( chActionText, chExpectedText );
  E_DBGR_VariableCheck("Erasestatus",2,Equal);
 
  
  /*******************************************************************************************************************************************************/    
    // Test Step 7: Set a breakpoint at "TstReadstatus = ( Binvdmreadstatus )ReadHWIO_h_BatNonVltl( BLOCKING_MODE, &binvdmaddr, 72U, ( BYTE *)&Nvmdataread );" and run the application
  /*******************************************************************************************************************************************************/
  
  snprintf( chActionText, elCount(chActionText), "Set a breakpoint at TstReadstatus = ( Binvdmreadstatus )ReadHWIO_h_BatNonVltl( BLOCKING_MODE, &binvdmaddr, 72U, ( BYTE *)&Nvmdataread ); and run the application"); 
  snprintf( chExpectedText, elCount(chExpectedText), "Breakpoint is set."); 
  TestStepAddActionExpected( chActionText, chExpectedText );
  //A_DBGR_R();
  A_DBGR_BreakpointSet("TestBinvdm_ReadGetStatus\\4");  
  A_DBGR_Go();
  E_DBGR_BreakpointCheckForHalt("TestBinvdm_ReadGetStatus\\4");
 
  
  snprintf( chActionText, elCount(chActionText), "Verify Erasestatus  value in trace32 watch window"); 
  snprintf( chExpectedText, elCount(chExpectedText), "Erasestatus = BINVDM_ERASE_IDLE"); 
  TestStepAddActionExpected( chActionText, chExpectedText );
  E_DBGR_VariableCheck("Erasestatus",0,Equal);
 
}

testcase Verify_Successful_Erase_Operation_Verified_in_NON_Blocking_Mode()
{
  /***************************************************************************************************************/    
                                                // Variable Definition
  /***************************************************************************************************************/ 
  long taskvalue;
  /***************************************************************************************************************/    
                                               // Local Values
  /***************************************************************************************************************/ 

  /***************************************************************************************************************/    
                                              // Test Case Info
  /***************************************************************************************************************/
  setWriteDbgLevel(DebugOff);
  snprintf( chTestTitle, elCount(chTestTitle), "Testcase_Verify_Default_Read_Status_Until_Operation_Completion_in_Blocking_Mode" );
  snprintf( chTestDescription, elCount(chTestDescription), "Purpose:The software shall return the BINVDM Read status as InProgress from the time of the read request operation until Completed, MemoryError or Canceled statuses have been determined.");
  TestCaseAddInfo( chTestTitle, "TC_L30SW_QT_36728636", chTestDescription );
  /***************************************************************************************************************/    
                                              // Start of Test Case
  /***************************************************************************************************************/
  /***************************************************************************************************************/    
                                              // Test Step 1 PRECONDITIONS
  /***************************************************************************************************************/
  snprintf( chActionText, elCount(chActionText), "Flash the Software and ECU is running"); 
  snprintf( chExpectedText, elCount(chExpectedText), "ECU should be in running state"); 
  TestStepAddActionExpected( chActionText, chExpectedText );

  A_DBGR_BreakpointDeleteAll();
  A_DBGR_RnGo();
  E_DBGR_CheckState(T32_State_Running);
  
  
  
    
   
  /*******************************************************************************************************************************************************/    
    // Test Step 2: Set a breakpoint at "TstReadstatus = ( Binvdmreadstatus )ReadHWIO_h_BatNonVltl( BLOCKING_MODE, &binvdmaddr, 72U, ( BYTE *)&Nvmdataread );" and run the application
  /*******************************************************************************************************************************************************/
  
  snprintf( chActionText, elCount(chActionText), "Set a breakpoint at TstReadstatus = ( Binvdmreadstatus )ReadHWIO_h_BatNonVltl( BLOCKING_MODE, &binvdmaddr, 72U, ( BYTE *)&Nvmdataread ); and run the application"); 
  snprintf( chExpectedText, elCount(chExpectedText), "Breakpoint is set."); 
  TestStepAddActionExpected( chActionText, chExpectedText );
  //A_DBGR_R();
  A_DBGR_BreakpointSet("TestBinvdm_NonblockingErase\\4");  
  A_DBGR_Go();
  E_DBGR_BreakpointCheckForHalt("TestBinvdm_NonblockingErase\\4");
 
   /*******************************************************************************************************************************************************/    
    // Test Step 3: Set a breakpoint at "TstReadstatus = ( Binvdmreadstatus )ReadHWIO_h_BatNonVltl( BLOCKING_MODE, &binvdmaddr, 72U, ( BYTE *)&Nvmdataread );" and run the application
  /*******************************************************************************************************************************************************/
  
  snprintf( chActionText, elCount(chActionText), "Set binvdmeraserequest = TRUE in trace32 watch window"); 
  snprintf( chExpectedText, elCount(chExpectedText), "binvdmeraserequest = TRUE"); 
  TestStepAddActionExpected( chActionText, chExpectedText );
  A_DBGR_VariableSet("binvdmeraserequest", "1"); 
  E_DBGR_VariableCheck("binvdmeraserequest",1,Equal);
  
   /*******************************************************************************************************************************************************/    
    // Test Step 4: Set a breakpoint at "if( BINVDM_BLOCKING_MODE == binvdmSchmode )
  /*******************************************************************************************************************************************************/
  
  snprintf( chActionText, elCount(chActionText), "Set a breakpoint at return( ( BYTE )Readstatus ); and run the application"); 
  snprintf( chExpectedText, elCount(chExpectedText), "Breakpoint is set."); 
  TestStepAddActionExpected( chActionText, chExpectedText );
  
  A_DBGR_BreakpointSet("EraseHWIO_h_BatNonVltl\\20");  
  A_DBGR_Go();
  E_DBGR_BreakpointCheckForHalt("EraseHWIO_h_BatNonVltl\\20");
  
  
  snprintf( chActionText, elCount(chActionText), "Set binvdmSchmode = 0 in trace32 watch window"); 
  snprintf( chExpectedText, elCount(chExpectedText), "binvdmSchmode = 0"); 
  TestStepAddActionExpected( chActionText, chExpectedText );
  A_DBGR_VariableSet("binvdmSchmode", "0"); 
  E_DBGR_VariableCheck("binvdmSchmode",0,Equal);
  
   /*******************************************************************************************************************************************************/    
    // Test Step 5: Set a breakpoint at "ret = MemAcc_Read( Address_Instance, ( Targetaddr - BINVDM_DFLASH_PHY_START_ADDR ), binvdmramaddr,\

  /*******************************************************************************************************************************************************/

  snprintf( chActionText, elCount(chActionText), " 1 - set run"); 
  snprintf( chExpectedText, elCount(chExpectedText), "Breakpoint is set."); 
  TestStepAddActionExpected( chActionText, chExpectedText );
  //A_DBGR_R();
  A_DBGR_BreakpointSet("EraseHWIO_h_BatNonVltl\\46");  
  A_DBGR_Go();
  E_DBGR_BreakpointCheckForHalt("EraseHWIO_h_BatNonVltl\\46");
  
  
   /*******************************************************************************************************************************************************/    
    // Test Step 6: check Readstatus = BINVDM_READ_COMPLETE
  /*******************************************************************************************************************************************************/
  
  snprintf( chActionText, elCount(chActionText), "Verify Erasestatus  value in trace32 watch window"); 
  snprintf( chExpectedText, elCount(chExpectedText), "Erasestatus = BINVDM_ERASE_COMPLETE"); 
  TestStepAddActionExpected( chActionText, chExpectedText );
  E_DBGR_VariableCheck("Erasestatus",2,Equal);
 
  
  /*******************************************************************************************************************************************************/    
    // Test Step 7: Set a breakpoint at "TstReadstatus = ( Binvdmreadstatus )ReadHWIO_h_BatNonVltl( BLOCKING_MODE, &binvdmaddr, 72U, ( BYTE *)&Nvmdataread );" and run the application
  /*******************************************************************************************************************************************************/
  
  snprintf( chActionText, elCount(chActionText), "Set a breakpoint at TstReadstatus = ( Binvdmreadstatus )ReadHWIO_h_BatNonVltl( BLOCKING_MODE, &binvdmaddr, 72U, ( BYTE *)&Nvmdataread ); and run the application"); 
  snprintf( chExpectedText, elCount(chExpectedText), "Breakpoint is set."); 
  TestStepAddActionExpected( chActionText, chExpectedText );
  //A_DBGR_R();
  A_DBGR_BreakpointSet("TestBinvdm_NonblockingErase\\4");  
  A_DBGR_Go();
  E_DBGR_BreakpointCheckForHalt("TestBinvdm_NonblockingErase\\4");
 
 
  
  snprintf( chActionText, elCount(chActionText), "Verify Erasestatus  value in trace32 watch window"); 
  snprintf( chExpectedText, elCount(chExpectedText), "Erasestatus = BINVDM_ERASE_IDLE"); 
  TestStepAddActionExpected( chActionText, chExpectedText );
  E_DBGR_VariableCheck("Erasestatus",0,Equal);
 
}

testcase Verify_Memory_Error_during_Erase_Operation_in_Blocking_Mode()
{
 /***************************************************************************************************************/    
                                                // Variable Definition
  /***************************************************************************************************************/ 
  long taskvalue;
  /***************************************************************************************************************/    
                                               // Local Values
  /***************************************************************************************************************/ 

  /***************************************************************************************************************/    
                                              // Test Case Info
  /***************************************************************************************************************/
  setWriteDbgLevel(DebugOff);
  snprintf( chTestTitle, elCount(chTestTitle), "Testcase_Verify_Default_Read_Status_Until_Operation_Completion_in_Blocking_Mode" );
  snprintf( chTestDescription, elCount(chTestDescription), "Purpose:The software shall return the BINVDM Read status as InProgress from the time of the read request operation until Completed, MemoryError or Canceled statuses have been determined.");
  TestCaseAddInfo( chTestTitle, "TC_L30SW_QT_36728636", chTestDescription );
  /***************************************************************************************************************/    
                                              // Start of Test Case
  /***************************************************************************************************************/
  /***************************************************************************************************************/    
                                              // Test Step 1 PRECONDITIONS
  /***************************************************************************************************************/
  snprintf( chActionText, elCount(chActionText), "Flash the Software and ECU is running"); 
  snprintf( chExpectedText, elCount(chExpectedText), "ECU should be in running state"); 
  TestStepAddActionExpected( chActionText, chExpectedText );

  A_DBGR_BreakpointDeleteAll();
  A_DBGR_RnGo();
  E_DBGR_CheckState(T32_State_Running);
  
  
  
    
   
  /*******************************************************************************************************************************************************/    
    // Test Step 2: Set a breakpoint at "TstReadstatus = ( Binvdmreadstatus )ReadHWIO_h_BatNonVltl( BLOCKING_MODE, &binvdmaddr, 72U, ( BYTE *)&Nvmdataread );" and run the application
  /*******************************************************************************************************************************************************/
  
  snprintf( chActionText, elCount(chActionText), "Set a breakpoint at TstReadstatus = ( Binvdmreadstatus )ReadHWIO_h_BatNonVltl( BLOCKING_MODE, &binvdmaddr, 72U, ( BYTE *)&Nvmdataread ); and run the application"); 
  snprintf( chExpectedText, elCount(chExpectedText), "Breakpoint is set."); 
  TestStepAddActionExpected( chActionText, chExpectedText );
  //A_DBGR_R();
  A_DBGR_BreakpointSet("TestBinvdm_NonblockingErase\\4");  
  A_DBGR_Go();
  E_DBGR_BreakpointCheckForHalt("TestBinvdm_NonblockingErase\\4");
  
  
}

testcase Verify_Memory_Error_during_Erase_Operation_in_NON_Blocking_Mode()
{
  /***************************************************************************************************************/    
                                                // Variable Definition
  /***************************************************************************************************************/ 
  long taskvalue;
  /***************************************************************************************************************/    
                                               // Local Values
  /***************************************************************************************************************/ 

  /***************************************************************************************************************/    
                                              // Test Case Info
  /***************************************************************************************************************/
  setWriteDbgLevel(DebugOff);
  snprintf( chTestTitle, elCount(chTestTitle), "Testcase_Verify_Default_Read_Status_Until_Operation_Completion_in_Blocking_Mode" );
  snprintf( chTestDescription, elCount(chTestDescription), "Purpose:The software shall return the BINVDM Read status as InProgress from the time of the read request operation until Completed, MemoryError or Canceled statuses have been determined.");
  TestCaseAddInfo( chTestTitle, "TC_L30SW_QT_36728636", chTestDescription );
  /***************************************************************************************************************/    
                                              // Start of Test Case
  /***************************************************************************************************************/
  /***************************************************************************************************************/    
                                              // Test Step 1 PRECONDITIONS
  /***************************************************************************************************************/
  snprintf( chActionText, elCount(chActionText), "Flash the Software and ECU is running"); 
  snprintf( chExpectedText, elCount(chExpectedText), "ECU should be in running state"); 
  TestStepAddActionExpected( chActionText, chExpectedText );

  A_DBGR_BreakpointDeleteAll();
  A_DBGR_RnGo();
  E_DBGR_CheckState(T32_State_Running);
  
  
  
    
   
  /*******************************************************************************************************************************************************/    
    // Test Step 2: Set a breakpoint at "TstReadstatus = ( Binvdmreadstatus )ReadHWIO_h_BatNonVltl( BLOCKING_MODE, &binvdmaddr, 72U, ( BYTE *)&Nvmdataread );" and run the application
  /*******************************************************************************************************************************************************/
  
  snprintf( chActionText, elCount(chActionText), "Set a breakpoint at TstReadstatus = ( Binvdmreadstatus )ReadHWIO_h_BatNonVltl( BLOCKING_MODE, &binvdmaddr, 72U, ( BYTE *)&Nvmdataread ); and run the application"); 
  snprintf( chExpectedText, elCount(chExpectedText), "Breakpoint is set."); 
  TestStepAddActionExpected( chActionText, chExpectedText );
  //A_DBGR_R();
  A_DBGR_BreakpointSet("TestBinvdm_NonblockingErase\\4");  
  A_DBGR_Go();
  E_DBGR_BreakpointCheckForHalt("TestBinvdm_NonblockingErase\\4");
 
  
}

testcase Verify_Error_for_Erase_Operation_in_Blocking_Mode()
{
  /***************************************************************************************************************/    
                                                // Variable Definition
  /***************************************************************************************************************/ 
  long taskvalue;
  /***************************************************************************************************************/    
                                               // Local Values
  /***************************************************************************************************************/ 

  /***************************************************************************************************************/    
                                              // Test Case Info
  /***************************************************************************************************************/
  setWriteDbgLevel(DebugOff);
  snprintf( chTestTitle, elCount(chTestTitle), "Testcase_Verify_Default_Read_Status_Until_Operation_Completion_in_Blocking_Mode" );
  snprintf( chTestDescription, elCount(chTestDescription), "Purpose:The software shall return the BINVDM Read status as InProgress from the time of the read request operation until Completed, MemoryError or Canceled statuses have been determined.");
  TestCaseAddInfo( chTestTitle, "TC_L30SW_QT_36728636", chTestDescription );
  /***************************************************************************************************************/    
                                              // Start of Test Case
  /***************************************************************************************************************/
  /***************************************************************************************************************/    
                                              // Test Step 1 PRECONDITIONS
  /***************************************************************************************************************/
  snprintf( chActionText, elCount(chActionText), "Flash the Software and ECU is running"); 
  snprintf( chExpectedText, elCount(chExpectedText), "ECU should be in running state"); 
  TestStepAddActionExpected( chActionText, chExpectedText );

  A_DBGR_BreakpointDeleteAll();
  A_DBGR_RnGo();
  E_DBGR_CheckState(T32_State_Running);
  
  
  
    
   
  /*******************************************************************************************************************************************************/    
    // Test Step 2: Set a breakpoint at "TstReadstatus = ( Binvdmreadstatus )ReadHWIO_h_BatNonVltl( BLOCKING_MODE, &binvdmaddr, 72U, ( BYTE *)&Nvmdataread );" and run the application
  /*******************************************************************************************************************************************************/
  
  snprintf( chActionText, elCount(chActionText), "Set a breakpoint at TstReadstatus = ( Binvdmreadstatus )ReadHWIO_h_BatNonVltl( BLOCKING_MODE, &binvdmaddr, 72U, ( BYTE *)&Nvmdataread ); and run the application"); 
  snprintf( chExpectedText, elCount(chExpectedText), "Breakpoint is set."); 
  TestStepAddActionExpected( chActionText, chExpectedText );
  //A_DBGR_R();
  A_DBGR_BreakpointSet("TestBinvdm_NonblockingErase\\4");  
  A_DBGR_Go();
  E_DBGR_BreakpointCheckForHalt("TestBinvdm_NonblockingErase\\4");
 
   /*******************************************************************************************************************************************************/    
    // Test Step 3: Set a breakpoint at "TstReadstatus = ( Binvdmreadstatus )ReadHWIO_h_BatNonVltl( BLOCKING_MODE, &binvdmaddr, 72U, ( BYTE *)&Nvmdataread );" and run the application
  /*******************************************************************************************************************************************************/
  
  snprintf( chActionText, elCount(chActionText), "Set binvdmeraserequest = TRUE in trace32 watch window"); 
  snprintf( chExpectedText, elCount(chExpectedText), "binvdmeraserequest = TRUE"); 
  TestStepAddActionExpected( chActionText, chExpectedText );
  A_DBGR_VariableSet("binvdmeraserequest", "1"); 
  E_DBGR_VariableCheck("binvdmeraserequest",1,Equal);
  
   /*******************************************************************************************************************************************************/    
    // Test Step 4: Set a breakpoint at "if( BINVDM_BLOCKING_MODE == binvdmSchmode )
  /*******************************************************************************************************************************************************/
  
  snprintf( chActionText, elCount(chActionText), "Set a breakpoint at return( ( BYTE )Readstatus ); and run the application"); 
  snprintf( chExpectedText, elCount(chExpectedText), "Breakpoint is set."); 
  TestStepAddActionExpected( chActionText, chExpectedText );
  
  A_DBGR_BreakpointSet("EraseHWIO_h_BatNonVltl\\20");  
  A_DBGR_Go();
  E_DBGR_BreakpointCheckForHalt("EraseHWIO_h_BatNonVltl\\20");
  
  
  snprintf( chActionText, elCount(chActionText), "Set binvdmSchmode = 0 in trace32 watch window"); 
  snprintf( chExpectedText, elCount(chExpectedText), "binvdmSchmode = 0"); 
  TestStepAddActionExpected( chActionText, chExpectedText );
  A_DBGR_VariableSet("binvdmSchmode", "0"); 
  E_DBGR_VariableCheck("binvdmSchmode",0,Equal);
  
   /*******************************************************************************************************************************************************/    
    // Test Step 5: Set a breakpoint at "ret = MemAcc_Read( Address_Instance, ( Targetaddr - BINVDM_DFLASH_PHY_START_ADDR ), binvdmramaddr,\

  /*******************************************************************************************************************************************************/

  snprintf( chActionText, elCount(chActionText), " 1 - set run"); 
  snprintf( chExpectedText, elCount(chExpectedText), "Breakpoint is set."); 
  TestStepAddActionExpected( chActionText, chExpectedText );
  //A_DBGR_R();
  A_DBGR_BreakpointSet("BinvdmEFlashGetErrorFlag\\32");  
  A_DBGR_Go();
  E_DBGR_BreakpointCheckForHalt("BinvdmEFlashGetErrorFlag\\32");
  

  snprintf( chActionText, elCount(chActionText), "Set FlsRegData = 128 in trace32 watch window"); 
  snprintf( chExpectedText, elCount(chExpectedText), "FlsRegData = 128"); 
  TestStepAddActionExpected( chActionText, chExpectedText );
  A_DBGR_VariableSet("FlsRegData", "128"); 
  E_DBGR_VariableCheck("FlsRegData",128,Equal);
  
  snprintf( chActionText, elCount(chActionText), " 1 - set run"); 
  snprintf( chExpectedText, elCount(chExpectedText), "Breakpoint is set."); 
  TestStepAddActionExpected( chActionText, chExpectedText );
  //A_DBGR_R();
  A_DBGR_BreakpointSet("EraseHWIO_h_BatNonVltl\\48");  
  A_DBGR_Go();
  E_DBGR_BreakpointCheckForHalt("EraseHWIO_h_BatNonVltl\\48");

  
  snprintf( chActionText, elCount(chActionText), "Verify Erasestatus  value in trace32 watch window"); 
  snprintf( chExpectedText, elCount(chExpectedText), "Erasestatus = BINVDM_ERASE_VERIFYERROR"); 
  TestStepAddActionExpected( chActionText, chExpectedText );
  E_DBGR_VariableCheck("Erasestatus",4,Equal);
 
}

testcase Verify_Error_for_Erase_Operation_in_NON_Blocking_Mode()
{
  /***************************************************************************************************************/    
                                                // Variable Definition
  /***************************************************************************************************************/ 
  long taskvalue;
  /***************************************************************************************************************/    
                                               // Local Values
  /***************************************************************************************************************/ 

  /***************************************************************************************************************/    
                                              // Test Case Info
  /***************************************************************************************************************/
  setWriteDbgLevel(DebugOff);
  snprintf( chTestTitle, elCount(chTestTitle), "Testcase_Verify_Default_Read_Status_Until_Operation_Completion_in_Blocking_Mode" );
  snprintf( chTestDescription, elCount(chTestDescription), "Purpose:The software shall return the BINVDM Read status as InProgress from the time of the read request operation until Completed, MemoryError or Canceled statuses have been determined.");
  TestCaseAddInfo( chTestTitle, "TC_L30SW_QT_36728636", chTestDescription );
  /***************************************************************************************************************/    
                                              // Start of Test Case
  /***************************************************************************************************************/
  /***************************************************************************************************************/    
                                              // Test Step 1 PRECONDITIONS
  /***************************************************************************************************************/
  snprintf( chActionText, elCount(chActionText), "Flash the Software and ECU is running"); 
  snprintf( chExpectedText, elCount(chExpectedText), "ECU should be in running state"); 
  TestStepAddActionExpected( chActionText, chExpectedText );

  A_DBGR_BreakpointDeleteAll();
  A_DBGR_RnGo();
  E_DBGR_CheckState(T32_State_Running);
  
  
  
    
   
  /*******************************************************************************************************************************************************/    
    // Test Step 2: Set a breakpoint at "TstReadstatus = ( Binvdmreadstatus )ReadHWIO_h_BatNonVltl( BLOCKING_MODE, &binvdmaddr, 72U, ( BYTE *)&Nvmdataread );" and run the application
  /*******************************************************************************************************************************************************/
  
  snprintf( chActionText, elCount(chActionText), "Set a breakpoint at TstReadstatus = ( Binvdmreadstatus )ReadHWIO_h_BatNonVltl( BLOCKING_MODE, &binvdmaddr, 72U, ( BYTE *)&Nvmdataread ); and run the application"); 
  snprintf( chExpectedText, elCount(chExpectedText), "Breakpoint is set."); 
  TestStepAddActionExpected( chActionText, chExpectedText );
  //A_DBGR_R();
  A_DBGR_BreakpointSet("TestBinvdm_NonblockingErase\\4");  
  A_DBGR_Go();
  E_DBGR_BreakpointCheckForHalt("TestBinvdm_NonblockingErase\\4");
 
   /*******************************************************************************************************************************************************/    
    // Test Step 3: Set a breakpoint at "TstReadstatus = ( Binvdmreadstatus )ReadHWIO_h_BatNonVltl( BLOCKING_MODE, &binvdmaddr, 72U, ( BYTE *)&Nvmdataread );" and run the application
  /*******************************************************************************************************************************************************/
  
  snprintf( chActionText, elCount(chActionText), "Set binvdmeraserequest = TRUE in trace32 watch window"); 
  snprintf( chExpectedText, elCount(chExpectedText), "binvdmeraserequest = TRUE"); 
  TestStepAddActionExpected( chActionText, chExpectedText );
  A_DBGR_VariableSet("binvdmeraserequest", "1"); 
  E_DBGR_VariableCheck("binvdmeraserequest",1,Equal);
  
   /*******************************************************************************************************************************************************/    
    // Test Step 4: Set a breakpoint at "if( BINVDM_BLOCKING_MODE == binvdmSchmode )
  /*******************************************************************************************************************************************************/
  
  snprintf( chActionText, elCount(chActionText), "Set a breakpoint at return( ( BYTE )Readstatus ); and run the application"); 
  snprintf( chExpectedText, elCount(chExpectedText), "Breakpoint is set."); 
  TestStepAddActionExpected( chActionText, chExpectedText );
  
  A_DBGR_BreakpointSet("EraseHWIO_h_BatNonVltl\\20");  
  A_DBGR_Go();
  E_DBGR_BreakpointCheckForHalt("EraseHWIO_h_BatNonVltl\\20");
  
  
  snprintf( chActionText, elCount(chActionText), "Set binvdmSchmode = 0 in trace32 watch window"); 
  snprintf( chExpectedText, elCount(chExpectedText), "binvdmSchmode = 0"); 
  TestStepAddActionExpected( chActionText, chExpectedText );
  A_DBGR_VariableSet("binvdmSchmode", "0"); 
  E_DBGR_VariableCheck("binvdmSchmode",0,Equal);
  
   /*******************************************************************************************************************************************************/    
    // Test Step 5: Set a breakpoint at "ret = MemAcc_Read( Address_Instance, ( Targetaddr - BINVDM_DFLASH_PHY_START_ADDR ), binvdmramaddr,\

  /*******************************************************************************************************************************************************/

  snprintf( chActionText, elCount(chActionText), " 1 - set run"); 
  snprintf( chExpectedText, elCount(chExpectedText), "Breakpoint is set."); 
  TestStepAddActionExpected( chActionText, chExpectedText );
  //A_DBGR_R();
  A_DBGR_BreakpointSet("BinvdmEFlashGetErrorFlag\\32");  
  A_DBGR_Go();
  E_DBGR_BreakpointCheckForHalt("BinvdmEFlashGetErrorFlag\\32");
  

  snprintf( chActionText, elCount(chActionText), "Set FlsRegData = 128 in trace32 watch window"); 
  snprintf( chExpectedText, elCount(chExpectedText), "FlsRegData = 128"); 
  TestStepAddActionExpected( chActionText, chExpectedText );
  A_DBGR_VariableSet("FlsRegData", "128"); 
  E_DBGR_VariableCheck("FlsRegData",128,Equal);
  
  snprintf( chActionText, elCount(chActionText), " 1 - set run"); 
  snprintf( chExpectedText, elCount(chExpectedText), "Breakpoint is set."); 
  TestStepAddActionExpected( chActionText, chExpectedText );
  //A_DBGR_R();
  A_DBGR_BreakpointSet("EraseHWIO_h_BatNonVltl\\48");  
  A_DBGR_Go();
  E_DBGR_BreakpointCheckForHalt("EraseHWIO_h_BatNonVltl\\48");

  
  snprintf( chActionText, elCount(chActionText), "Verify Erasestatus  value in trace32 watch window"); 
  snprintf( chExpectedText, elCount(chExpectedText), "Erasestatus = BINVDM_ERASE_VERIFYERROR"); 
  TestStepAddActionExpected( chActionText, chExpectedText );
  E_DBGR_VariableCheck("Erasestatus",4,Equal);
  
}

testcase Verify_Failed_Erase_Operation_Status_in_Blocking_Mode()
{
  /***************************************************************************************************************/    
                                                // Variable Definition
  /***************************************************************************************************************/ 
  long taskvalue;
  /***************************************************************************************************************/    
                                               // Local Values
  /***************************************************************************************************************/ 

  /***************************************************************************************************************/    
                                              // Test Case Info
  /***************************************************************************************************************/
  setWriteDbgLevel(DebugOff);
  snprintf( chTestTitle, elCount(chTestTitle), "Testcase_Verify_Default_Read_Status_Until_Operation_Completion_in_Blocking_Mode" );
  snprintf( chTestDescription, elCount(chTestDescription), "Purpose:The software shall return the BINVDM Read status as InProgress from the time of the read request operation until Completed, MemoryError or Canceled statuses have been determined.");
  TestCaseAddInfo( chTestTitle, "TC_L30SW_QT_36728636", chTestDescription );
  /***************************************************************************************************************/    
                                              // Start of Test Case
  /***************************************************************************************************************/
  /***************************************************************************************************************/    
                                              // Test Step 1 PRECONDITIONS
  /***************************************************************************************************************/
  snprintf( chActionText, elCount(chActionText), "Flash the Software and ECU is running"); 
  snprintf( chExpectedText, elCount(chExpectedText), "ECU should be in running state"); 
  TestStepAddActionExpected( chActionText, chExpectedText );

  A_DBGR_BreakpointDeleteAll();
  A_DBGR_RnGo();
  E_DBGR_CheckState(T32_State_Running);
  
  
  
    
   
  /*******************************************************************************************************************************************************/    
    // Test Step 2: Set a breakpoint at "TstReadstatus = ( Binvdmreadstatus )ReadHWIO_h_BatNonVltl( BLOCKING_MODE, &binvdmaddr, 72U, ( BYTE *)&Nvmdataread );" and run the application
  /*******************************************************************************************************************************************************/
  
  snprintf( chActionText, elCount(chActionText), "Set a breakpoint at TstReadstatus = ( Binvdmreadstatus )ReadHWIO_h_BatNonVltl( BLOCKING_MODE, &binvdmaddr, 72U, ( BYTE *)&Nvmdataread ); and run the application"); 
  snprintf( chExpectedText, elCount(chExpectedText), "Breakpoint is set."); 
  TestStepAddActionExpected( chActionText, chExpectedText );
  //A_DBGR_R();
  A_DBGR_BreakpointSet("TestBinvdm_NonblockingErase\\4");  
  A_DBGR_Go();
  E_DBGR_BreakpointCheckForHalt("TestBinvdm_NonblockingErase\\4");
 
   /*******************************************************************************************************************************************************/    
    // Test Step 3: Set a breakpoint at "TstReadstatus = ( Binvdmreadstatus )ReadHWIO_h_BatNonVltl( BLOCKING_MODE, &binvdmaddr, 72U, ( BYTE *)&Nvmdataread );" and run the application
  /*******************************************************************************************************************************************************/
  
  snprintf( chActionText, elCount(chActionText), "Set binvdmeraserequest = TRUE in trace32 watch window"); 
  snprintf( chExpectedText, elCount(chExpectedText), "binvdmeraserequest = TRUE"); 
  TestStepAddActionExpected( chActionText, chExpectedText );
  A_DBGR_VariableSet("binvdmeraserequest", "1"); 
  E_DBGR_VariableCheck("binvdmeraserequest",1,Equal);
  
   /*******************************************************************************************************************************************************/    
    // Test Step 4: Set a breakpoint at "if( BINVDM_BLOCKING_MODE == binvdmSchmode )
  /*******************************************************************************************************************************************************/
  
  snprintf( chActionText, elCount(chActionText), "Set a breakpoint at return( ( BYTE )Readstatus ); and run the application"); 
  snprintf( chExpectedText, elCount(chExpectedText), "Breakpoint is set."); 
  TestStepAddActionExpected( chActionText, chExpectedText );
  
  A_DBGR_BreakpointSet("EraseHWIO_h_BatNonVltl\\20");  
  A_DBGR_Go();
  E_DBGR_BreakpointCheckForHalt("EraseHWIO_h_BatNonVltl\\20");
  
  
  snprintf( chActionText, elCount(chActionText), "Set binvdmSchmode = 0 in trace32 watch window"); 
  snprintf( chExpectedText, elCount(chExpectedText), "binvdmSchmode = 0"); 
  TestStepAddActionExpected( chActionText, chExpectedText );
  A_DBGR_VariableSet("binvdmSchmode", "0"); 
  E_DBGR_VariableCheck("binvdmSchmode",0,Equal);
  
   /*******************************************************************************************************************************************************/    
    // Test Step 5: Set a breakpoint at "ret = MemAcc_Read( Address_Instance, ( Targetaddr - BINVDM_DFLASH_PHY_START_ADDR ), binvdmramaddr,\

  /*******************************************************************************************************************************************************/

  snprintf( chActionText, elCount(chActionText), " 1 - set run"); 
  snprintf( chExpectedText, elCount(chExpectedText), "Breakpoint is set."); 
  TestStepAddActionExpected( chActionText, chExpectedText );
  //A_DBGR_R();
  A_DBGR_BreakpointSet("BinvdmEFlashGetErrorFlag\\32");  
  A_DBGR_Go();
  E_DBGR_BreakpointCheckForHalt("BinvdmEFlashGetErrorFlag\\32");
  

  snprintf( chActionText, elCount(chActionText), "Set FlsRegData = 128 in trace32 watch window"); 
  snprintf( chExpectedText, elCount(chExpectedText), "FlsRegData = 128"); 
  TestStepAddActionExpected( chActionText, chExpectedText );
  A_DBGR_VariableSet("FlsRegData", "128"); 
  E_DBGR_VariableCheck("FlsRegData",128,Equal);
  
  snprintf( chActionText, elCount(chActionText), " 1 - set run"); 
  snprintf( chExpectedText, elCount(chExpectedText), "Breakpoint is set."); 
  TestStepAddActionExpected( chActionText, chExpectedText );
  //A_DBGR_R();
  A_DBGR_BreakpointSet("EraseHWIO_h_BatNonVltl\\48");  
  A_DBGR_Go();
  E_DBGR_BreakpointCheckForHalt("EraseHWIO_h_BatNonVltl\\48");

  
  snprintf( chActionText, elCount(chActionText), "Verify Erasestatus  value in trace32 watch window"); 
  snprintf( chExpectedText, elCount(chExpectedText), "Erasestatus = BINVDM_ERASE_FAILED"); 
  TestStepAddActionExpected( chActionText, chExpectedText );
  E_DBGR_VariableCheck("Erasestatus",4,Equal);
 
}

testcase Verify_Failed_Erase_Operation_Status_in_NON_Blocking_Mode()
{
  /***************************************************************************************************************/    
                                                // Variable Definition
  /***************************************************************************************************************/ 
  long taskvalue;
  /***************************************************************************************************************/    
                                               // Local Values
  /***************************************************************************************************************/ 

  /***************************************************************************************************************/    
                                              // Test Case Info
  /***************************************************************************************************************/
  setWriteDbgLevel(DebugOff);
  snprintf( chTestTitle, elCount(chTestTitle), "Testcase_Verify_Default_Read_Status_Until_Operation_Completion_in_Blocking_Mode" );
  snprintf( chTestDescription, elCount(chTestDescription), "Purpose:The software shall return the BINVDM Read status as InProgress from the time of the read request operation until Completed, MemoryError or Canceled statuses have been determined.");
  TestCaseAddInfo( chTestTitle, "TC_L30SW_QT_36728636", chTestDescription );
  /***************************************************************************************************************/    
                                              // Start of Test Case
  /***************************************************************************************************************/
  /***************************************************************************************************************/    
                                              // Test Step 1 PRECONDITIONS
  /***************************************************************************************************************/
  snprintf( chActionText, elCount(chActionText), "Flash the Software and ECU is running"); 
  snprintf( chExpectedText, elCount(chExpectedText), "ECU should be in running state"); 
  TestStepAddActionExpected( chActionText, chExpectedText );

  A_DBGR_BreakpointDeleteAll();
  A_DBGR_RnGo();
  E_DBGR_CheckState(T32_State_Running);
  
  
  
    
   
  /*******************************************************************************************************************************************************/    
    // Test Step 2: Set a breakpoint at "TstReadstatus = ( Binvdmreadstatus )ReadHWIO_h_BatNonVltl( BLOCKING_MODE, &binvdmaddr, 72U, ( BYTE *)&Nvmdataread );" and run the application
  /*******************************************************************************************************************************************************/
  
  snprintf( chActionText, elCount(chActionText), "Set a breakpoint at TstReadstatus = ( Binvdmreadstatus )ReadHWIO_h_BatNonVltl( BLOCKING_MODE, &binvdmaddr, 72U, ( BYTE *)&Nvmdataread ); and run the application"); 
  snprintf( chExpectedText, elCount(chExpectedText), "Breakpoint is set."); 
  TestStepAddActionExpected( chActionText, chExpectedText );
  //A_DBGR_R();
  A_DBGR_BreakpointSet("TestBinvdm_NonblockingErase\\4");  
  A_DBGR_Go();
  E_DBGR_BreakpointCheckForHalt("TestBinvdm_NonblockingErase\\4");
 
   /*******************************************************************************************************************************************************/    
    // Test Step 3: Set a breakpoint at "TstReadstatus = ( Binvdmreadstatus )ReadHWIO_h_BatNonVltl( BLOCKING_MODE, &binvdmaddr, 72U, ( BYTE *)&Nvmdataread );" and run the application
  /*******************************************************************************************************************************************************/
  
  snprintf( chActionText, elCount(chActionText), "Set binvdmeraserequest = TRUE in trace32 watch window"); 
  snprintf( chExpectedText, elCount(chExpectedText), "binvdmeraserequest = TRUE"); 
  TestStepAddActionExpected( chActionText, chExpectedText );
  A_DBGR_VariableSet("binvdmeraserequest", "1"); 
  E_DBGR_VariableCheck("binvdmeraserequest",1,Equal);
  
   /*******************************************************************************************************************************************************/    
    // Test Step 4: Set a breakpoint at "if( BINVDM_BLOCKING_MODE == binvdmSchmode )
  /*******************************************************************************************************************************************************/
  
  snprintf( chActionText, elCount(chActionText), "Set a breakpoint at return( ( BYTE )Readstatus ); and run the application"); 
  snprintf( chExpectedText, elCount(chExpectedText), "Breakpoint is set."); 
  TestStepAddActionExpected( chActionText, chExpectedText );
  
  A_DBGR_BreakpointSet("EraseHWIO_h_BatNonVltl\\20");  
  A_DBGR_Go();
  E_DBGR_BreakpointCheckForHalt("EraseHWIO_h_BatNonVltl\\20");
  
  
  snprintf( chActionText, elCount(chActionText), "Set binvdmSchmode = 0 in trace32 watch window"); 
  snprintf( chExpectedText, elCount(chExpectedText), "binvdmSchmode = 0"); 
  TestStepAddActionExpected( chActionText, chExpectedText );
  A_DBGR_VariableSet("binvdmSchmode", "0"); 
  E_DBGR_VariableCheck("binvdmSchmode",0,Equal);
  
   /*******************************************************************************************************************************************************/    
    // Test Step 5: Set a breakpoint at "ret = MemAcc_Read( Address_Instance, ( Targetaddr - BINVDM_DFLASH_PHY_START_ADDR ), binvdmramaddr,\

  /*******************************************************************************************************************************************************/

  snprintf( chActionText, elCount(chActionText), " 1 - set run"); 
  snprintf( chExpectedText, elCount(chExpectedText), "Breakpoint is set."); 
  TestStepAddActionExpected( chActionText, chExpectedText );
  //A_DBGR_R();
  A_DBGR_BreakpointSet("BinvdmEFlashGetErrorFlag\\32");  
  A_DBGR_Go();
  E_DBGR_BreakpointCheckForHalt("BinvdmEFlashGetErrorFlag\\32");
  

  snprintf( chActionText, elCount(chActionText), "Set FlsRegData = 128 in trace32 watch window"); 
  snprintf( chExpectedText, elCount(chExpectedText), "FlsRegData = 128"); 
  TestStepAddActionExpected( chActionText, chExpectedText );
  A_DBGR_VariableSet("FlsRegData", "128"); 
  E_DBGR_VariableCheck("FlsRegData",128,Equal);
  
  snprintf( chActionText, elCount(chActionText), " 1 - set run"); 
  snprintf( chExpectedText, elCount(chExpectedText), "Breakpoint is set."); 
  TestStepAddActionExpected( chActionText, chExpectedText );
  //A_DBGR_R();
  A_DBGR_BreakpointSet("EraseHWIO_h_BatNonVltl\\48");  
  A_DBGR_Go();
  E_DBGR_BreakpointCheckForHalt("EraseHWIO_h_BatNonVltl\\48");

  
  snprintf( chActionText, elCount(chActionText), "Verify Erasestatus  value in trace32 watch window"); 
  snprintf( chExpectedText, elCount(chExpectedText), "Erasestatus = BINVDM_ERASE_FAILED"); 
  TestStepAddActionExpected( chActionText, chExpectedText );
  E_DBGR_VariableCheck("Erasestatus",4,Equal);
  
}

testcase Verify_Successful_Erase_Operation_Status_in_Blocking_Mode()
{
  /***************************************************************************************************************/    
                                                // Variable Definition
  /***************************************************************************************************************/ 
  long taskvalue;
  /***************************************************************************************************************/    
                                               // Local Values
  /***************************************************************************************************************/ 

  /***************************************************************************************************************/    
                                              // Test Case Info
  /***************************************************************************************************************/
  setWriteDbgLevel(DebugOff);
  snprintf( chTestTitle, elCount(chTestTitle), "Testcase_Verify_Default_Read_Status_Until_Operation_Completion_in_Blocking_Mode" );
  snprintf( chTestDescription, elCount(chTestDescription), "Purpose:The software shall return the BINVDM Read status as InProgress from the time of the read request operation until Completed, MemoryError or Canceled statuses have been determined.");
  TestCaseAddInfo( chTestTitle, "TC_L30SW_QT_36728636", chTestDescription );
  /***************************************************************************************************************/    
                                              // Start of Test Case
  /***************************************************************************************************************/
  /***************************************************************************************************************/    
                                              // Test Step 1 PRECONDITIONS
  /***************************************************************************************************************/
  snprintf( chActionText, elCount(chActionText), "Flash the Software and ECU is running"); 
  snprintf( chExpectedText, elCount(chExpectedText), "ECU should be in running state"); 
  TestStepAddActionExpected( chActionText, chExpectedText );

  A_DBGR_BreakpointDeleteAll();
  A_DBGR_RnGo();
  E_DBGR_CheckState(T32_State_Running);
  
  
  
    
   
  /*******************************************************************************************************************************************************/    
    // Test Step 2: Set a breakpoint at "TstReadstatus = ( Binvdmreadstatus )ReadHWIO_h_BatNonVltl( BLOCKING_MODE, &binvdmaddr, 72U, ( BYTE *)&Nvmdataread );" and run the application
  /*******************************************************************************************************************************************************/
  
  snprintf( chActionText, elCount(chActionText), "Set a breakpoint at TstReadstatus = ( Binvdmreadstatus )ReadHWIO_h_BatNonVltl( BLOCKING_MODE, &binvdmaddr, 72U, ( BYTE *)&Nvmdataread ); and run the application"); 
  snprintf( chExpectedText, elCount(chExpectedText), "Breakpoint is set."); 
  TestStepAddActionExpected( chActionText, chExpectedText );
  //A_DBGR_R();
  A_DBGR_BreakpointSet("TestBinvdm_NonblockingErase\\4");  
  A_DBGR_Go();
  E_DBGR_BreakpointCheckForHalt("TestBinvdm_NonblockingErase\\4");
 
   /*******************************************************************************************************************************************************/    
    // Test Step 3: Set a breakpoint at "TstReadstatus = ( Binvdmreadstatus )ReadHWIO_h_BatNonVltl( BLOCKING_MODE, &binvdmaddr, 72U, ( BYTE *)&Nvmdataread );" and run the application
  /*******************************************************************************************************************************************************/
  
  snprintf( chActionText, elCount(chActionText), "Set binvdmeraserequest = TRUE in trace32 watch window"); 
  snprintf( chExpectedText, elCount(chExpectedText), "binvdmeraserequest = TRUE"); 
  TestStepAddActionExpected( chActionText, chExpectedText );
  A_DBGR_VariableSet("binvdmeraserequest", "1"); 
  E_DBGR_VariableCheck("binvdmeraserequest",1,Equal);
  
   /*******************************************************************************************************************************************************/    
    // Test Step 4: Set a breakpoint at "if( BINVDM_BLOCKING_MODE == binvdmSchmode )
  /*******************************************************************************************************************************************************/
  
  snprintf( chActionText, elCount(chActionText), "Set a breakpoint at return( ( BYTE )Readstatus ); and run the application"); 
  snprintf( chExpectedText, elCount(chExpectedText), "Breakpoint is set."); 
  TestStepAddActionExpected( chActionText, chExpectedText );
  
  A_DBGR_BreakpointSet("EraseHWIO_h_BatNonVltl\\20");  
  A_DBGR_Go();
  E_DBGR_BreakpointCheckForHalt("EraseHWIO_h_BatNonVltl\\20");
  
  
  snprintf( chActionText, elCount(chActionText), "Set binvdmSchmode = 0 in trace32 watch window"); 
  snprintf( chExpectedText, elCount(chExpectedText), "binvdmSchmode = 0"); 
  TestStepAddActionExpected( chActionText, chExpectedText );
  A_DBGR_VariableSet("binvdmSchmode", "0"); 
  E_DBGR_VariableCheck("binvdmSchmode",0,Equal);
  
   /*******************************************************************************************************************************************************/    
    // Test Step 5: Set a breakpoint at "ret = MemAcc_Read( Address_Instance, ( Targetaddr - BINVDM_DFLASH_PHY_START_ADDR ), binvdmramaddr,\

  /*******************************************************************************************************************************************************/

  snprintf( chActionText, elCount(chActionText), " 1 - set run"); 
  snprintf( chExpectedText, elCount(chExpectedText), "Breakpoint is set."); 
  TestStepAddActionExpected( chActionText, chExpectedText );
  //A_DBGR_R();
  A_DBGR_BreakpointSet("EraseHWIO_h_BatNonVltl\\46");  
  A_DBGR_Go();
  E_DBGR_BreakpointCheckForHalt("EraseHWIO_h_BatNonVltl\\46");
  
  
   /*******************************************************************************************************************************************************/    
    // Test Step 6: check Readstatus = BINVDM_READ_COMPLETE
  /*******************************************************************************************************************************************************/
  
  snprintf( chActionText, elCount(chActionText), "Verify Erasestatus  value in trace32 watch window"); 
  snprintf( chExpectedText, elCount(chExpectedText), "Erasestatus = BINVDM_ERASE_COMPLETE"); 
  TestStepAddActionExpected( chActionText, chExpectedText );
  E_DBGR_VariableCheck("Erasestatus",2,Equal);
 
  
  /*******************************************************************************************************************************************************/    
    // Test Step 7: Set a breakpoint at "TstReadstatus = ( Binvdmreadstatus )ReadHWIO_h_BatNonVltl( BLOCKING_MODE, &binvdmaddr, 72U, ( BYTE *)&Nvmdataread );" and run the application
  /*******************************************************************************************************************************************************/
  

 snprintf( chActionText, elCount(chActionText), "Set a breakpoint at TstReadstatus = ( Binvdmreadstatus )ReadHWIO_h_BatNonVltl( BLOCKING_MODE, &binvdmaddr, 72U, ( BYTE *)&Nvmdataread ); and run the application"); 
  snprintf( chExpectedText, elCount(chExpectedText), "Breakpoint is set."); 
  TestStepAddActionExpected( chActionText, chExpectedText );
  //A_DBGR_R();
  A_DBGR_BreakpointSet("TestBinvdm_NonblockingErase\\4");  
  A_DBGR_Go();
  E_DBGR_BreakpointCheckForHalt("TestBinvdm_NonblockingErase\\4");
 
  
  
  snprintf( chActionText, elCount(chActionText), "Verify Erasestatus  value in trace32 watch window"); 
  snprintf( chExpectedText, elCount(chExpectedText), "Erasestatus = BINVDM_ERASE_IDLE"); 
  TestStepAddActionExpected( chActionText, chExpectedText );
  E_DBGR_VariableCheck("Erasestatus",0,Equal);
 
}

testcase Verify_Successful_Erase_Operation_Status_in_NON_Blocking_Mode()
{
  /***************************************************************************************************************/    
                                                // Variable Definition
  /***************************************************************************************************************/ 
  long taskvalue;
  /***************************************************************************************************************/    
                                               // Local Values
  /***************************************************************************************************************/ 

  /***************************************************************************************************************/    
                                              // Test Case Info
  /***************************************************************************************************************/
  setWriteDbgLevel(DebugOff);
  snprintf( chTestTitle, elCount(chTestTitle), "Testcase_Verify_Default_Read_Status_Until_Operation_Completion_in_Blocking_Mode" );
  snprintf( chTestDescription, elCount(chTestDescription), "Purpose:The software shall return the BINVDM Read status as InProgress from the time of the read request operation until Completed, MemoryError or Canceled statuses have been determined.");
  TestCaseAddInfo( chTestTitle, "TC_L30SW_QT_36728636", chTestDescription );
  /***************************************************************************************************************/    
                                              // Start of Test Case
  /***************************************************************************************************************/
  /***************************************************************************************************************/    
                                              // Test Step 1 PRECONDITIONS
  /***************************************************************************************************************/
  snprintf( chActionText, elCount(chActionText), "Flash the Software and ECU is running"); 
  snprintf( chExpectedText, elCount(chExpectedText), "ECU should be in running state"); 
  TestStepAddActionExpected( chActionText, chExpectedText );

  A_DBGR_BreakpointDeleteAll();
  A_DBGR_RnGo();
  E_DBGR_CheckState(T32_State_Running);
  
  
  
    
   
  /*******************************************************************************************************************************************************/    
    // Test Step 2: Set a breakpoint at "TstReadstatus = ( Binvdmreadstatus )ReadHWIO_h_BatNonVltl( BLOCKING_MODE, &binvdmaddr, 72U, ( BYTE *)&Nvmdataread );" and run the application
  /*******************************************************************************************************************************************************/
  
  snprintf( chActionText, elCount(chActionText), "Set a breakpoint at TstReadstatus = ( Binvdmreadstatus )ReadHWIO_h_BatNonVltl( BLOCKING_MODE, &binvdmaddr, 72U, ( BYTE *)&Nvmdataread ); and run the application"); 
  snprintf( chExpectedText, elCount(chExpectedText), "Breakpoint is set."); 
  TestStepAddActionExpected( chActionText, chExpectedText );
  //A_DBGR_R();
  A_DBGR_BreakpointSet("TestBinvdm_NonblockingErase\\4");  
  A_DBGR_Go();
  E_DBGR_BreakpointCheckForHalt("TestBinvdm_NonblockingErase\\4");
 
   /*******************************************************************************************************************************************************/    
    // Test Step 3: Set a breakpoint at "TstReadstatus = ( Binvdmreadstatus )ReadHWIO_h_BatNonVltl( BLOCKING_MODE, &binvdmaddr, 72U, ( BYTE *)&Nvmdataread );" and run the application
  /*******************************************************************************************************************************************************/
  
  snprintf( chActionText, elCount(chActionText), "Set binvdmeraserequest = TRUE in trace32 watch window"); 
  snprintf( chExpectedText, elCount(chExpectedText), "binvdmeraserequest = TRUE"); 
  TestStepAddActionExpected( chActionText, chExpectedText );
  A_DBGR_VariableSet("binvdmeraserequest", "1"); 
  E_DBGR_VariableCheck("binvdmeraserequest",1,Equal);
  
   /*******************************************************************************************************************************************************/    
    // Test Step 4: Set a breakpoint at "if( BINVDM_BLOCKING_MODE == binvdmSchmode )
  /*******************************************************************************************************************************************************/
  
  snprintf( chActionText, elCount(chActionText), "Set a breakpoint at return( ( BYTE )Readstatus ); and run the application"); 
  snprintf( chExpectedText, elCount(chExpectedText), "Breakpoint is set."); 
  TestStepAddActionExpected( chActionText, chExpectedText );
  
  A_DBGR_BreakpointSet("EraseHWIO_h_BatNonVltl\\20");  
  A_DBGR_Go();
  E_DBGR_BreakpointCheckForHalt("EraseHWIO_h_BatNonVltl\\20");
  
  
  snprintf( chActionText, elCount(chActionText), "Set binvdmSchmode = 0 in trace32 watch window"); 
  snprintf( chExpectedText, elCount(chExpectedText), "binvdmSchmode = 0"); 
  TestStepAddActionExpected( chActionText, chExpectedText );
  A_DBGR_VariableSet("binvdmSchmode", "0"); 
  E_DBGR_VariableCheck("binvdmSchmode",0,Equal);
  
   /*******************************************************************************************************************************************************/    
    // Test Step 5: Set a breakpoint at "ret = MemAcc_Read( Address_Instance, ( Targetaddr - BINVDM_DFLASH_PHY_START_ADDR ), binvdmramaddr,\

  /*******************************************************************************************************************************************************/

  snprintf( chActionText, elCount(chActionText), " 1 - set run"); 
  snprintf( chExpectedText, elCount(chExpectedText), "Breakpoint is set."); 
  TestStepAddActionExpected( chActionText, chExpectedText );
  //A_DBGR_R();
  A_DBGR_BreakpointSet("EraseHWIO_h_BatNonVltl\\46");  
  A_DBGR_Go();
  E_DBGR_BreakpointCheckForHalt("EraseHWIO_h_BatNonVltl\\46");
  
  
   /*******************************************************************************************************************************************************/    
    // Test Step 6: check Readstatus = BINVDM_READ_COMPLETE
  /*******************************************************************************************************************************************************/
  
  snprintf( chActionText, elCount(chActionText), "Verify Erasestatus  value in trace32 watch window"); 
  snprintf( chExpectedText, elCount(chExpectedText), "Erasestatus = BINVDM_ERASE_COMPLETE"); 
  TestStepAddActionExpected( chActionText, chExpectedText );
  E_DBGR_VariableCheck("Erasestatus",2,Equal);
 
  
  /*******************************************************************************************************************************************************/    
    // Test Step 7: Set a breakpoint at "TstReadstatus = ( Binvdmreadstatus )ReadHWIO_h_BatNonVltl( BLOCKING_MODE, &binvdmaddr, 72U, ( BYTE *)&Nvmdataread );" and run the application
  /*******************************************************************************************************************************************************/
  
  snprintf( chActionText, elCount(chActionText), "Set a breakpoint at TstReadstatus = ( Binvdmreadstatus )ReadHWIO_h_BatNonVltl( BLOCKING_MODE, &binvdmaddr, 72U, ( BYTE *)&Nvmdataread ); and run the application"); 
  snprintf( chExpectedText, elCount(chExpectedText), "Breakpoint is set."); 
  TestStepAddActionExpected( chActionText, chExpectedText );
  //A_DBGR_R();
  A_DBGR_BreakpointSet("TestBinvdm_NonblockingErase\\4");  
  A_DBGR_Go();
  E_DBGR_BreakpointCheckForHalt("TestBinvdm_NonblockingErase\\4");
 
 
  
  snprintf( chActionText, elCount(chActionText), "Verify Erasestatus  value in trace32 watch window"); 
  snprintf( chExpectedText, elCount(chExpectedText), "Erasestatus = BINVDM_ERASE_IDLE"); 
  TestStepAddActionExpected( chActionText, chExpectedText );
  E_DBGR_VariableCheck("Erasestatus",0,Equal);
 
}

testcase Verify_Canceled_Erase_Operation_Status_in_Blocking_Mode()
{
  /***************************************************************************************************************/    
                                                // Variable Definition
  /***************************************************************************************************************/ 
  long taskvalue;
  /***************************************************************************************************************/    
                                               // Local Values
  /***************************************************************************************************************/ 

  /***************************************************************************************************************/    
                                              // Test Case Info
  /***************************************************************************************************************/
  setWriteDbgLevel(DebugOff);
  snprintf( chTestTitle, elCount(chTestTitle), "Testcase_Verify_Default_Read_Status_Until_Operation_Completion_in_Blocking_Mode" );
  snprintf( chTestDescription, elCount(chTestDescription), "Purpose:The software shall return the BINVDM Read status as InProgress from the time of the read request operation until Completed, MemoryError or Canceled statuses have been determined.");
  TestCaseAddInfo( chTestTitle, "TC_L30SW_QT_36728636", chTestDescription );
  /***************************************************************************************************************/    
                                              // Start of Test Case
  /***************************************************************************************************************/
  /***************************************************************************************************************/    
                                              // Test Step 1 PRECONDITIONS
  /***************************************************************************************************************/
  snprintf( chActionText, elCount(chActionText), "Flash the Software and ECU is running"); 
  snprintf( chExpectedText, elCount(chExpectedText), "ECU should be in running state"); 
  TestStepAddActionExpected( chActionText, chExpectedText );

  A_DBGR_BreakpointDeleteAll();
  A_DBGR_RnGo();
  E_DBGR_CheckState(T32_State_Running);
  
  
  
    
   
  /*******************************************************************************************************************************************************/    
    // Test Step 2: Set a breakpoint at "TstReadstatus = ( Binvdmreadstatus )ReadHWIO_h_BatNonVltl( BLOCKING_MODE, &binvdmaddr, 72U, ( BYTE *)&Nvmdataread );" and run the application
  /*******************************************************************************************************************************************************/
  
  snprintf( chActionText, elCount(chActionText), "Set a breakpoint at TstReadstatus = ( Binvdmreadstatus )ReadHWIO_h_BatNonVltl( BLOCKING_MODE, &binvdmaddr, 72U, ( BYTE *)&Nvmdataread ); and run the application"); 
  snprintf( chExpectedText, elCount(chExpectedText), "Breakpoint is set."); 
  TestStepAddActionExpected( chActionText, chExpectedText );
  //A_DBGR_R();
  A_DBGR_BreakpointSet("TestBinvdm_NonblockingErase\\4");  
  A_DBGR_Go();
  E_DBGR_BreakpointCheckForHalt("TestBinvdm_NonblockingErase\\4");
 
   /*******************************************************************************************************************************************************/    
    // Test Step 3: Set a breakpoint at "TstReadstatus = ( Binvdmreadstatus )ReadHWIO_h_BatNonVltl( BLOCKING_MODE, &binvdmaddr, 72U, ( BYTE *)&Nvmdataread );" and run the application
  /*******************************************************************************************************************************************************/
  
  snprintf( chActionText, elCount(chActionText), "Set binvdmeraserequest = TRUE in trace32 watch window"); 
  snprintf( chExpectedText, elCount(chExpectedText), "binvdmeraserequest = TRUE"); 
  TestStepAddActionExpected( chActionText, chExpectedText );
  A_DBGR_VariableSet("binvdmeraserequest", "1"); 
  E_DBGR_VariableCheck("binvdmeraserequest",1,Equal);
  
   /*******************************************************************************************************************************************************/    
    // Test Step 4: Set a breakpoint at "if( BINVDM_BLOCKING_MODE == binvdmSchmode )
  /*******************************************************************************************************************************************************/
  
  snprintf( chActionText, elCount(chActionText), "Set a breakpoint at return( ( BYTE )Readstatus ); and run the application"); 
  snprintf( chExpectedText, elCount(chExpectedText), "Breakpoint is set."); 
  TestStepAddActionExpected( chActionText, chExpectedText );
  
  A_DBGR_BreakpointSet("EraseHWIO_h_BatNonVltl\\20");  
  A_DBGR_Go();
  E_DBGR_BreakpointCheckForHalt("EraseHWIO_h_BatNonVltl\\20");
  
  
  snprintf( chActionText, elCount(chActionText), "Set binvdmSchmode = 0 in trace32 watch window"); 
  snprintf( chExpectedText, elCount(chExpectedText), "binvdmSchmode = 0"); 
  TestStepAddActionExpected( chActionText, chExpectedText );
  A_DBGR_VariableSet("binvdmSchmode", "0"); 
  E_DBGR_VariableCheck("binvdmSchmode",0,Equal);
  
   /*******************************************************************************************************************************************************/    
    // Test Step 5: Set a breakpoint at "ret = MemAcc_Read( Address_Instance, ( Targetaddr - BINVDM_DFLASH_PHY_START_ADDR ), binvdmramaddr,\

  /*******************************************************************************************************************************************************/

  snprintf( chActionText, elCount(chActionText), " 1 - set run"); 
  snprintf( chExpectedText, elCount(chExpectedText), "Breakpoint is set."); 
  TestStepAddActionExpected( chActionText, chExpectedText );
  //A_DBGR_R();
  A_DBGR_BreakpointSet("EraseHWIO_h_BatNonVltl\\46");  
  A_DBGR_Go();
  E_DBGR_BreakpointCheckForHalt("EraseHWIO_h_BatNonVltl\\46");
  
  
   /*******************************************************************************************************************************************************/    
    // Test Step 6: check Readstatus = BINVDM_READ_COMPLETE
  /*******************************************************************************************************************************************************/
  
  snprintf( chActionText, elCount(chActionText), "Verify Erasestatus  value in trace32 watch window"); 
  snprintf( chExpectedText, elCount(chExpectedText), "Erasestatus = BINVDM_ERASE_COMPLETE"); 
  TestStepAddActionExpected( chActionText, chExpectedText );
  E_DBGR_VariableCheck("Erasestatus",2,Equal);
 
  
  /*******************************************************************************************************************************************************/    
    // Test Step 7: Set a breakpoint at "TstReadstatus = ( Binvdmreadstatus )ReadHWIO_h_BatNonVltl( BLOCKING_MODE, &binvdmaddr, 72U, ( BYTE *)&Nvmdataread );" and run the application
  /*******************************************************************************************************************************************************/
  

 snprintf( chActionText, elCount(chActionText), "Set a breakpoint at TstReadstatus = ( Binvdmreadstatus )ReadHWIO_h_BatNonVltl( BLOCKING_MODE, &binvdmaddr, 72U, ( BYTE *)&Nvmdataread ); and run the application"); 
  snprintf( chExpectedText, elCount(chExpectedText), "Breakpoint is set."); 
  TestStepAddActionExpected( chActionText, chExpectedText );
  //A_DBGR_R();
  A_DBGR_BreakpointSet("TestBinvdm_NonblockingErase\\4");  
  A_DBGR_Go();
  E_DBGR_BreakpointCheckForHalt("TestBinvdm_NonblockingErase\\4");
 
  
  
  snprintf( chActionText, elCount(chActionText), "Verify Erasestatus  value in trace32 watch window"); 
  snprintf( chExpectedText, elCount(chExpectedText), "Erasestatus = BINVDM_ERASE_IDLE"); 
  TestStepAddActionExpected( chActionText, chExpectedText );
  E_DBGR_VariableCheck("Erasestatus",0,Equal);
 
}

testcase Verify_Canceled_Erase_Operation_Status_in_NON_Blocking_Mode()
{
  /***************************************************************************************************************/    
                                                // Variable Definition
  /***************************************************************************************************************/ 
  long taskvalue;
  /***************************************************************************************************************/    
                                               // Local Values
  /***************************************************************************************************************/ 

  /***************************************************************************************************************/    
                                              // Test Case Info
  /***************************************************************************************************************/
  setWriteDbgLevel(DebugOff);
  snprintf( chTestTitle, elCount(chTestTitle), "Testcase_Verify_Default_Read_Status_Until_Operation_Completion_in_Blocking_Mode" );
  snprintf( chTestDescription, elCount(chTestDescription), "Purpose:The software shall return the BINVDM Read status as InProgress from the time of the read request operation until Completed, MemoryError or Canceled statuses have been determined.");
  TestCaseAddInfo( chTestTitle, "TC_L30SW_QT_36728636", chTestDescription );
  /***************************************************************************************************************/    
                                              // Start of Test Case
  /***************************************************************************************************************/
  /***************************************************************************************************************/    
                                              // Test Step 1 PRECONDITIONS
  /***************************************************************************************************************/
  snprintf( chActionText, elCount(chActionText), "Flash the Software and ECU is running"); 
  snprintf( chExpectedText, elCount(chExpectedText), "ECU should be in running state"); 
  TestStepAddActionExpected( chActionText, chExpectedText );

  A_DBGR_BreakpointDeleteAll();
  A_DBGR_RnGo();
  E_DBGR_CheckState(T32_State_Running);
  
  
  
    
   
  /*******************************************************************************************************************************************************/    
    // Test Step 2: Set a breakpoint at "TstReadstatus = ( Binvdmreadstatus )ReadHWIO_h_BatNonVltl( BLOCKING_MODE, &binvdmaddr, 72U, ( BYTE *)&Nvmdataread );" and run the application
  /*******************************************************************************************************************************************************/
  
  snprintf( chActionText, elCount(chActionText), "Set a breakpoint at TstReadstatus = ( Binvdmreadstatus )ReadHWIO_h_BatNonVltl( BLOCKING_MODE, &binvdmaddr, 72U, ( BYTE *)&Nvmdataread ); and run the application"); 
  snprintf( chExpectedText, elCount(chExpectedText), "Breakpoint is set."); 
  TestStepAddActionExpected( chActionText, chExpectedText );
  //A_DBGR_R();
  A_DBGR_BreakpointSet("TestBinvdm_NonblockingErase\\4");  
  A_DBGR_Go();
  E_DBGR_BreakpointCheckForHalt("TestBinvdm_NonblockingErase\\4");
 
   /*******************************************************************************************************************************************************/    
    // Test Step 3: Set a breakpoint at "TstReadstatus = ( Binvdmreadstatus )ReadHWIO_h_BatNonVltl( BLOCKING_MODE, &binvdmaddr, 72U, ( BYTE *)&Nvmdataread );" and run the application
  /*******************************************************************************************************************************************************/
  
  snprintf( chActionText, elCount(chActionText), "Set binvdmeraserequest = TRUE in trace32 watch window"); 
  snprintf( chExpectedText, elCount(chExpectedText), "binvdmeraserequest = TRUE"); 
  TestStepAddActionExpected( chActionText, chExpectedText );
  A_DBGR_VariableSet("binvdmeraserequest", "1"); 
  E_DBGR_VariableCheck("binvdmeraserequest",1,Equal);
  
   /*******************************************************************************************************************************************************/    
    // Test Step 4: Set a breakpoint at "if( BINVDM_BLOCKING_MODE == binvdmSchmode )
  /*******************************************************************************************************************************************************/
  
  snprintf( chActionText, elCount(chActionText), "Set a breakpoint at return( ( BYTE )Readstatus ); and run the application"); 
  snprintf( chExpectedText, elCount(chExpectedText), "Breakpoint is set."); 
  TestStepAddActionExpected( chActionText, chExpectedText );
  
  A_DBGR_BreakpointSet("EraseHWIO_h_BatNonVltl\\20");  
  A_DBGR_Go();
  E_DBGR_BreakpointCheckForHalt("EraseHWIO_h_BatNonVltl\\20");
  
  
  snprintf( chActionText, elCount(chActionText), "Set binvdmSchmode = 0 in trace32 watch window"); 
  snprintf( chExpectedText, elCount(chExpectedText), "binvdmSchmode = 0"); 
  TestStepAddActionExpected( chActionText, chExpectedText );
  A_DBGR_VariableSet("binvdmSchmode", "0"); 
  E_DBGR_VariableCheck("binvdmSchmode",0,Equal);
  
   /*******************************************************************************************************************************************************/    
    // Test Step 5: Set a breakpoint at "ret = MemAcc_Read( Address_Instance, ( Targetaddr - BINVDM_DFLASH_PHY_START_ADDR ), binvdmramaddr,\

  /*******************************************************************************************************************************************************/

  snprintf( chActionText, elCount(chActionText), " 1 - set run"); 
  snprintf( chExpectedText, elCount(chExpectedText), "Breakpoint is set."); 
  TestStepAddActionExpected( chActionText, chExpectedText );
  //A_DBGR_R();
  A_DBGR_BreakpointSet("EraseHWIO_h_BatNonVltl\\46");  
  A_DBGR_Go();
  E_DBGR_BreakpointCheckForHalt("EraseHWIO_h_BatNonVltl\\46");
  
  
   /*******************************************************************************************************************************************************/    
    // Test Step 6: check Readstatus = BINVDM_READ_COMPLETE
  /*******************************************************************************************************************************************************/
  
  snprintf( chActionText, elCount(chActionText), "Verify Erasestatus  value in trace32 watch window"); 
  snprintf( chExpectedText, elCount(chExpectedText), "Erasestatus = BINVDM_ERASE_COMPLETE"); 
  TestStepAddActionExpected( chActionText, chExpectedText );
  E_DBGR_VariableCheck("Erasestatus",2,Equal);
 
  
  /*******************************************************************************************************************************************************/    
    // Test Step 7: Set a breakpoint at "TstReadstatus = ( Binvdmreadstatus )ReadHWIO_h_BatNonVltl( BLOCKING_MODE, &binvdmaddr, 72U, ( BYTE *)&Nvmdataread );" and run the application
  /*******************************************************************************************************************************************************/
  
  snprintf( chActionText, elCount(chActionText), "Set a breakpoint at TstReadstatus = ( Binvdmreadstatus )ReadHWIO_h_BatNonVltl( BLOCKING_MODE, &binvdmaddr, 72U, ( BYTE *)&Nvmdataread ); and run the application"); 
  snprintf( chExpectedText, elCount(chExpectedText), "Breakpoint is set."); 
  TestStepAddActionExpected( chActionText, chExpectedText );
  //A_DBGR_R();
  A_DBGR_BreakpointSet("TestBinvdm_NonblockingErase\\4");  
  A_DBGR_Go();
  E_DBGR_BreakpointCheckForHalt("TestBinvdm_NonblockingErase\\4");
 
 
  
  snprintf( chActionText, elCount(chActionText), "Verify Erasestatus  value in trace32 watch window"); 
  snprintf( chExpectedText, elCount(chExpectedText), "Erasestatus = BINVDM_ERASE_IDLE"); 
  TestStepAddActionExpected( chActionText, chExpectedText );
  E_DBGR_VariableCheck("Erasestatus",0,Equal);
 
}


testcase Verify_Default_Erase_Status_Until_Operation_Completion_in_Blocking_Mode()
{
 /***************************************************************************************************************/    
                                                // Variable Definition
  /***************************************************************************************************************/ 
  long taskvalue;
  /***************************************************************************************************************/    
                                               // Local Values
  /***************************************************************************************************************/ 

  /***************************************************************************************************************/    
                                              // Test Case Info
  /***************************************************************************************************************/
  setWriteDbgLevel(DebugOff);
  snprintf( chTestTitle, elCount(chTestTitle), "Testcase_Verify_Default_Read_Status_Until_Operation_Completion_in_Blocking_Mode" );
  snprintf( chTestDescription, elCount(chTestDescription), "Purpose:The software shall return the BINVDM Read status as InProgress from the time of the read request operation until Completed, MemoryError or Canceled statuses have been determined.");
  TestCaseAddInfo( chTestTitle, "TC_L30SW_QT_36728636", chTestDescription );
  /***************************************************************************************************************/    
                                              // Start of Test Case
  /***************************************************************************************************************/
  /***************************************************************************************************************/    
                                              // Test Step 1 PRECONDITIONS
  /***************************************************************************************************************/
  snprintf( chActionText, elCount(chActionText), "Flash the Software and ECU is running"); 
  snprintf( chExpectedText, elCount(chExpectedText), "ECU should be in running state"); 
  TestStepAddActionExpected( chActionText, chExpectedText );

  A_DBGR_BreakpointDeleteAll();
  A_DBGR_RnGo();
  E_DBGR_CheckState(T32_State_Running);
  
  
  
    
   
  /*******************************************************************************************************************************************************/    
    // Test Step 2: Set a breakpoint at "TstReadstatus = ( Binvdmreadstatus )ReadHWIO_h_BatNonVltl( BLOCKING_MODE, &binvdmaddr, 72U, ( BYTE *)&Nvmdataread );" and run the application
  /*******************************************************************************************************************************************************/
  
  snprintf( chActionText, elCount(chActionText), "Set a breakpoint at TstReadstatus = ( Binvdmreadstatus )ReadHWIO_h_BatNonVltl( BLOCKING_MODE, &binvdmaddr, 72U, ( BYTE *)&Nvmdataread ); and run the application"); 
  snprintf( chExpectedText, elCount(chExpectedText), "Breakpoint is set."); 
  TestStepAddActionExpected( chActionText, chExpectedText );
  //A_DBGR_R();
  A_DBGR_BreakpointSet("TestBinvdm_NonblockingErase\\4");  
  A_DBGR_Go();
  E_DBGR_BreakpointCheckForHalt("TestBinvdm_NonblockingErase\\4");
  
  
}

testcase Verify_Default_Erase_Status_Until_Operation_Completion_in_NON_Blocking_Mode()
{
  /***************************************************************************************************************/    
                                                // Variable Definition
  /***************************************************************************************************************/ 
  long taskvalue;
  /***************************************************************************************************************/    
                                               // Local Values
  /***************************************************************************************************************/ 

  /***************************************************************************************************************/    
                                              // Test Case Info
  /***************************************************************************************************************/
  setWriteDbgLevel(DebugOff);
  snprintf( chTestTitle, elCount(chTestTitle), "Testcase_Verify_Default_Read_Status_Until_Operation_Completion_in_Blocking_Mode" );
  snprintf( chTestDescription, elCount(chTestDescription), "Purpose:The software shall return the BINVDM Read status as InProgress from the time of the read request operation until Completed, MemoryError or Canceled statuses have been determined.");
  TestCaseAddInfo( chTestTitle, "TC_L30SW_QT_36728636", chTestDescription );
  /***************************************************************************************************************/    
                                              // Start of Test Case
  /***************************************************************************************************************/
  /***************************************************************************************************************/    
                                              // Test Step 1 PRECONDITIONS
  /***************************************************************************************************************/
  snprintf( chActionText, elCount(chActionText), "Flash the Software and ECU is running"); 
  snprintf( chExpectedText, elCount(chExpectedText), "ECU should be in running state"); 
  TestStepAddActionExpected( chActionText, chExpectedText );

  A_DBGR_BreakpointDeleteAll();
  A_DBGR_RnGo();
  E_DBGR_CheckState(T32_State_Running);
  
  
  
    
   
  /*******************************************************************************************************************************************************/    
    // Test Step 2: Set a breakpoint at "TstReadstatus = ( Binvdmreadstatus )ReadHWIO_h_BatNonVltl( BLOCKING_MODE, &binvdmaddr, 72U, ( BYTE *)&Nvmdataread );" and run the application
  /*******************************************************************************************************************************************************/
  
  snprintf( chActionText, elCount(chActionText), "Set a breakpoint at TstReadstatus = ( Binvdmreadstatus )ReadHWIO_h_BatNonVltl( BLOCKING_MODE, &binvdmaddr, 72U, ( BYTE *)&Nvmdataread ); and run the application"); 
  snprintf( chExpectedText, elCount(chExpectedText), "Breakpoint is set."); 
  TestStepAddActionExpected( chActionText, chExpectedText );
  //A_DBGR_R();
  A_DBGR_BreakpointSet("TestBinvdm_NonblockingErase\\4");  
  A_DBGR_Go();
  E_DBGR_BreakpointCheckForHalt("TestBinvdm_NonblockingErase\\4");
 
  
}


testcase Testcase_Verify_BINVDM_Initial_Write_Status()
{
  /***************************************************************************************************************/    
                                                // Variable Definition
  /***************************************************************************************************************/ 
  long taskvalue;
  /***************************************************************************************************************/    
                                               // Local Values
  /***************************************************************************************************************/ 

  /***************************************************************************************************************/    
                                              // Test Case Info
  /***************************************************************************************************************/
  setWriteDbgLevel(DebugOff);
  snprintf( chTestTitle, elCount(chTestTitle), "Testcase_Verify_Default_Read_Status_Until_Operation_Completion_in_Blocking_Mode" );
  snprintf( chTestDescription, elCount(chTestDescription), "Purpose:The software shall return the BINVDM Read status as InProgress from the time of the read request operation until Completed, MemoryError or Canceled statuses have been determined.");
  TestCaseAddInfo( chTestTitle, "TC_L30SW_QT_36728636", chTestDescription );
  /***************************************************************************************************************/    
                                              // Start of Test Case
  /***************************************************************************************************************/
  /***************************************************************************************************************/    
                                              // Test Step 1 PRECONDITIONS
  /***************************************************************************************************************/
  snprintf( chActionText, elCount(chActionText), "Flash the Software and ECU is running"); 
  snprintf( chExpectedText, elCount(chExpectedText), "ECU should be in running state"); 
  TestStepAddActionExpected( chActionText, chExpectedText );

  A_DBGR_BreakpointDeleteAll();
  A_DBGR_RnGo();
  E_DBGR_CheckState(T32_State_Running);
  
  
  
    
   
  /*******************************************************************************************************************************************************/    
    // Test Step 2: Set a breakpoint at "TstReadstatus = ( Binvdmreadstatus )ReadHWIO_h_BatNonVltl( BLOCKING_MODE, &binvdmaddr, 72U, ( BYTE *)&Nvmdataread );" and run the application
  /*******************************************************************************************************************************************************/
  
   snprintf( chActionText, elCount(chActionText), "Set a breakpoint at TstWritestatus = ( Binvdmreadstatus )WriteHWIO_h_BatNonVltl( BLOCKING_MODE, &binvdmaddr, 72U, ( BYTE *)&Nvmdataread ); and run the application"); 
  snprintf( chExpectedText, elCount(chExpectedText), "Breakpoint is set."); 
  TestStepAddActionExpected( chActionText, chExpectedText );
  //A_DBGR_R();
  A_DBGR_BreakpointSet("TestBinvdm_NonblockingWrite\\5");  
  A_DBGR_Go();
  E_DBGR_BreakpointCheckForHalt("TestBinvdm_NonblockingWrite\\5");
 
   
  
  snprintf( chActionText, elCount(chActionText), "Verify  TstWritestatus value in trace32 watch window"); 
  snprintf( chExpectedText, elCount(chExpectedText), " TstWritestatus= BINVDM_WRITE_IDLE"); 
  TestStepAddActionExpected( chActionText, chExpectedText );
  E_DBGR_VariableCheck("TstWritestatus",0,Equal);
  
}
