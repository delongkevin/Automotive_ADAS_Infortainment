/*@!Encoding:1252*/

includes
{
  
  #include "..\..\AutomationDependent\ProjectSpecific\GenLib_Includes.cin"
  #include "..\..\AutomationDependent\PowerSupply_libraries\Power_ctrl.can"
}

variables
{
  char chTestDescription[500];
  char chActionText[500];
  char chExpectedText[500];
  char chTestTitle[100];
  char canIdValue[256];
  int result;
  char searchString[256];
  char command[256];
  byte CANA_Wakeup[8] =  {0x08,0x08,0x00,0x00,0x00,0x00,0x00,0x01};
  byte CANA_Wakeup_1[8] =  {0x00,0x00,0x00,0x00,0x00,0x00,0x00,0x01};
  byte CANA_Wakeup_2[8] =  {0x08,0x00,0x00,0x00,0x00,0x00,0x00,0x00};
  byte CANB_Wakeup[4] =  {0x00,0x00,0x01,0x00};
  message 0x123 msg_2; // Define the CAN message with ID 0x123
  message 0x456 msg_8; // Define the CAN message with ID 0x456
   int Stress =0;
  long CANID[70] = {0x00000401, 0x00000301, 0x00000201, 0x00000042, 0x0000039E, 0x00000211, 0x00000212, 0x0000039D, 0x0000020D, 0x0000039B, 0x0000003E, 0x000002B3, 0x00000398, 0x000000BA, 0x00000397, 0x00000270, 0x00000585, 0x0000056B, 0x0000052C, 0x000002D7, 0x00000523, 0x00000568, 0x00000522, 0x00000505, 0x00000593, 0x00000594, 0x00000582, 0x000005A4, 0x000000B6, 0x00000584, 0x000003C3, 0x000003C4, 0x000003C2, 0x000002D5, 0x000003A2, 0x000002D6, 0x0000057F, 0x00000590, 0x000005A1, 0x000005F9, 0x000000C0, 0x000002BF, 0x000003AA, 0x000003B1, 0x00000596, 0x000005C9, 0x000003A5, 0x0000003F, 0x000003A6, 0x000005D2, 0x000004F0, 0x00000599, 0x0000006F, 0x000005CA, 0x000005CB, 0x000005BA, 0x0000059B, 0x00000293, 0x000004E1, 0x000004DC, 0x000000AF, 0x000000AE, 0x00000595, 0x000005C4, 0x00000140, 0x000002D8, 0xC0000100, 0x00007000, 0x00000140, 0x00000140 };
  byte dat_64byte[64] = {0xAA,0x55,0xAA,0x55,0xAA,0x55,0xAA,0x55,0xAA,0x55,0xAA,0x55,0xAA,0x55,0xAA,0x55,0xAA,0x55,0xAA,0x55,0xAA,0x55,0xAA,0x55,0xAA,0x55,0xAA,0x55,0xAA,0x55,0xAA,0x55,0xAA,0x55,0xAA,0x55,0xAA,0x55,0xAA,0x55,0xAA,0x55,0xAA,0x55,0xAA,0x55,0xAA,0x55,0xAA,0x55,0xAA,0x55,0xAA,0x55,0xAA,0x55,0xAA,0x55,0xAA,0x55,0xAA,0x55,0xAA,0x55};
  
  char variableName[256];
}

testcase Verify_that_FAILED_REGISTER_ID_initialized_to_default_values_during_PowerUp_Reset_initialization()
{
  /***************************************************************************************************************/    
                                                // Variable Definition
  /***************************************************************************************************************/ 
  

  
  /***************************************************************************************************************/    
                                               // Local Values
  /***************************************************************************************************************/ 
  

  
  /***************************************************************************************************************/    
                                              // Test Case Info
  /***************************************************************************************************************/
  setWriteDbgLevel(DebugOff);
  snprintf( chTestTitle, elCount(chTestTitle), "Verify_that_FAILED_REGISTER_ID_initialized_to_default_values_during_PowerUp_Reset_initialization" );
  snprintf( chTestDescription, elCount(chTestDescription), "Purpose:To check the GetHWIO_e_FailedRegID interface  ");
  TestCaseAddInfo( chTestTitle, "TC_L30SW_Q-37024444", chTestDescription );

  /***************************************************************************************************************/    
                                              // Start of Test Case
  /***************************************************************************************************************/
  
  /***************************************************************************************************************/    
                                              // Test Step 0 PRECONDITIONS
  /***************************************************************************************************************/
   snprintf( chActionText, elCount(chActionText), "Flash the Software and ECU is running "); 
  snprintf( chExpectedText, elCount(chExpectedText), "Ecu is should be in running state"); 
  TestStepAddActionExpected( chActionText, chExpectedText );
  
  A_DBGR_BreakpointDeleteAll();
  A_DBGR_R();
  A_DBGR_Go_Safe();

  /***************************************************************************************************************/    
                                              // Test Step 1 Set a breakpoint at line Failed_Register_ID = GetHWIO_e_FailedRegID();                                                   
  /***************************************************************************************************************/
  snprintf( chActionText, elCount(chActionText), "Set Breakpoint in Test_ConfigRegister\\4 "); 
  snprintf( chExpectedText, elCount(chExpectedText), "verify is Breakpoint Set Test_ConfigRegister\\4"); 
  
  A_DBGR_BreakpointSet("Test_ConfigRegister\\4");  

  /***************************************************************************************************************/    
                                              // Test Step 2 Verify that Failed_Register_ID variable is initialized to default values                                                   
  /***************************************************************************************************************/
  snprintf( chActionText, elCount(chActionText), "Verify default value of Failed_Register_ID"); 
  snprintf( chExpectedText, elCount(chExpectedText), "default value Failed_Register_ID"); 
  //TestStepAddActionExpected( chActionText, chExpectedText );
  E_DBGR_VariableCheck("Failed_Register_ID",0,Equal);
  
}
testcase Verify_that_FAILED_BIT_ID_initialized_to_default_values_during_PowerUp_Reset_initialization()
{
  /***************************************************************************************************************/    
                                                // Variable Definition
  /***************************************************************************************************************/ 
  

  
  /***************************************************************************************************************/    
                                               // Local Values
  /***************************************************************************************************************/ 
  

  
  /***************************************************************************************************************/    
                                              // Test Case Info
  /***************************************************************************************************************/
  setWriteDbgLevel(DebugOff);
  snprintf( chTestTitle, elCount(chTestTitle), "Verify_that_FAILED_BIT_ID_initialized_to_default_values_during_PowerUp_Reset_initialization" );
  snprintf( chTestDescription, elCount(chTestDescription), "Purpose:To check the GetHWIO_e_FailedBitID interface  ");
  TestCaseAddInfo( chTestTitle, "TC_L30SW_Q-37024445", chTestDescription );

  /***************************************************************************************************************/    
                                              // Start of Test Case
  /***************************************************************************************************************/
  
  /***************************************************************************************************************/    
                                              // Test Step 0 PRECONDITIONS
  /***************************************************************************************************************/
   snprintf( chActionText, elCount(chActionText), "Flash the Software and ECU is running "); 
  snprintf( chExpectedText, elCount(chExpectedText), "Ecu is should be in running state"); 
  TestStepAddActionExpected( chActionText, chExpectedText );
  
  A_DBGR_BreakpointDeleteAll();
  A_DBGR_R();
  A_DBGR_Go_Safe();

  /***************************************************************************************************************/    
                                              // Test Step 1 Set a breakpoint at line Failed_BIT_ID = GetHWIO_e_FailedBitID();                                                                                                           
  /***************************************************************************************************************/
  snprintf( chActionText, elCount(chActionText), "Set Breakpoint in Test_ConfigRegister\\5 "); 
  snprintf( chExpectedText, elCount(chExpectedText), "verify is Breakpoint Set Test_ConfigRegister\\5"); 
  
  A_DBGR_BreakpointSet("Test_ConfigRegister\\5");  

  /***************************************************************************************************************/    
                                              // Test Step 2 Verify that Failed_BIT_ID variable is initialized to default values                                                   
  /***************************************************************************************************************/
  snprintf( chActionText, elCount(chActionText), "Verify default value of Failed_BIT_ID"); 
  snprintf( chExpectedText, elCount(chExpectedText), "default value Failed_BIT_ID"); 
  //TestStepAddActionExpected( chActionText, chExpectedText );
  E_DBGR_VariableCheck("Failed_BIT_ID",0,Equal);
  
}

testcase Verify_that_FAILED_REGISTER_RECOVER_STATUS_initialized_to_default_values_during_PowerUp_Reset_initialization()
{
  /***************************************************************************************************************/    
                                                // Variable Definition
  /***************************************************************************************************************/ 
  

  
  /***************************************************************************************************************/    
                                               // Local Values
  /***************************************************************************************************************/ 
  

  
  /***************************************************************************************************************/    
                                              // Test Case Info
  /***************************************************************************************************************/
  setWriteDbgLevel(DebugOff);
  snprintf( chTestTitle, elCount(chTestTitle), "Verify_that_FAILED_REGISTER_RECOVER_STATUS_initialized_to_default_values_during_PowerUp_Reset_initialization" );
  snprintf( chTestDescription, elCount(chTestDescription), "Purpose:To check the GetHWIO_b_FailedRegRecovSt interface  ");
  TestCaseAddInfo( chTestTitle, "TC_L30SW_Q-37024446", chTestDescription );

  /***************************************************************************************************************/    
                                              // Start of Test Case
  /***************************************************************************************************************/
  
  /***************************************************************************************************************/    
                                              // Test Step 0 PRECONDITIONS
  /***************************************************************************************************************/
   snprintf( chActionText, elCount(chActionText), "Flash the Software and ECU is running "); 
  snprintf( chExpectedText, elCount(chExpectedText), "Ecu is should be in running state"); 
  TestStepAddActionExpected( chActionText, chExpectedText );
  
  A_DBGR_BreakpointDeleteAll();
  A_DBGR_R();
  A_DBGR_Go_Safe();

  /***************************************************************************************************************/    
                                              // Test Step 1 Set a breakpoint at line Failed_Register_Recover_Status = GetHWIO_b_FailedRegRecovSt();/* To Do*/                                                                                                                                   
  /***************************************************************************************************************/
  snprintf( chActionText, elCount(chActionText), "Set Breakpoint in Test_ConfigRegister\\6 "); 
  snprintf( chExpectedText, elCount(chExpectedText), "verify is Breakpoint Set Test_ConfigRegister\\6"); 
  
  A_DBGR_BreakpointSet("Test_ConfigRegister\\6");  

  /***************************************************************************************************************/    
                                              // Test Step 2 Verify that Failed_Register_Recover_Status variable is initialized to default values                                                   
  /***************************************************************************************************************/
  snprintf( chActionText, elCount(chActionText), "Verify default value of Failed_Register_Recover_Status"); 
  snprintf( chExpectedText, elCount(chExpectedText), "default value Failed_Register_Recover_Status"); 
  //TestStepAddActionExpected( chActionText, chExpectedText );
  E_DBGR_VariableCheck("Failed_Register_Recover_Status",0,Equal);

}

testcase Verify_PerfmHWIO_b_ConfigRegTest_interface_for_test_status_returning_1_when_the_test_is_passed()
{
  /***************************************************************************************************************/    
                                                // Variable Definition
  /***************************************************************************************************************/ 
  

  
  /***************************************************************************************************************/    
                                               // Local Values
  /***************************************************************************************************************/ 
  

  
  /***************************************************************************************************************/    
                                              // Test Case Info
  /***************************************************************************************************************/
  setWriteDbgLevel(DebugOff);
  snprintf( chTestTitle, elCount(chTestTitle), "Verify_PerfmHWIO_b_ConfigRegTest_interface_for_test_status_returning_1_when_the_test_is_passed" );
  snprintf( chTestDescription, elCount(chTestDescription), "Purpose:To check the PerfmHWIO_b_ConfigRegTest interface  ");
  TestCaseAddInfo( chTestTitle, "TC_L30SW_Q-37024448", chTestDescription );

  /***************************************************************************************************************/    
                                              // Start of Test Case
  /***************************************************************************************************************/
  
  /***************************************************************************************************************/    
                                              // Test Step 0 PRECONDITIONS
  /***************************************************************************************************************/
   snprintf( chActionText, elCount(chActionText), "Flash the Software and ECU is running "); 
  snprintf( chExpectedText, elCount(chExpectedText), "Ecu is should be in running state"); 
  TestStepAddActionExpected( chActionText, chExpectedText );
  
  A_DBGR_BreakpointDeleteAll();
  A_DBGR_R();
  A_DBGR_Go_Safe();

  /***************************************************************************************************************/    
                                              // Test Step 1 Set a breakpoint at line Configuration_Registers_Test_Status = PerfmHWIO_b_ConfigRegTest();                                                                                                                                                        
  /***************************************************************************************************************/
  snprintf( chActionText, elCount(chActionText), "Set Breakpoint in Test_ConfigRegister "); 
  snprintf( chExpectedText, elCount(chExpectedText), "verify is Breakpoint Set Test_ConfigRegister"); 
  
  A_DBGR_BreakpointSet("Test_ConfigRegister\\4");  
  /***************************************************************************************************************/
                                              // Test Step 2 Verify the interface returns 1 when the configuration register value is the same as the expected value.                                        
  /***************************************************************************************************************/
  snprintf( chActionText, elCount(chActionText), "Verify default value of Configuration_Registers_Test_Status"); 
  snprintf( chExpectedText, elCount(chExpectedText), "default value Configuration_Registers_Test_Status"); 
  //TestStepAddActionExpected( chActionText, chExpectedText );
  E_DBGR_VariableCheck("Configuration_Registers_Test_Status",1,Equal);

}

testcase Verify_the_interface_GetHWIO_e_FailedRegID_returns_the_ID_as_0_when_no_failed_registers_last_test_cycle()
{
  /***************************************************************************************************************/    
                                                // Variable Definition
  /***************************************************************************************************************/ 
  

  
  /***************************************************************************************************************/    
                                               // Local Values
  /***************************************************************************************************************/ 
  

  
  /***************************************************************************************************************/    
                                              // Test Case Info
  /***************************************************************************************************************/
  setWriteDbgLevel(DebugOff);
  snprintf( chTestTitle, elCount(chTestTitle), "Verify_the_interface_GetHWIO_e_FailedRegID_returns_the_ID_as_0_when_no_failed_registers_last_test_cycle" );
  snprintf( chTestDescription, elCount(chTestDescription), "Purpose:To check the GetHWIO_e_FailedRegID interface  ");
  TestCaseAddInfo( chTestTitle, "TC_L30SW_Q-37024455", chTestDescription );

  /***************************************************************************************************************/    
                                              // Start of Test Case
  /***************************************************************************************************************/
  
  /***************************************************************************************************************/    
                                              // Test Step 0 PRECONDITIONS
  /***************************************************************************************************************/
   snprintf( chActionText, elCount(chActionText), "Flash the Software and ECU is running "); 
  snprintf( chExpectedText, elCount(chExpectedText), "Ecu is should be in running state"); 
  TestStepAddActionExpected( chActionText, chExpectedText );
  
  A_DBGR_BreakpointDeleteAll();
  A_DBGR_R();
  A_DBGR_Go_Safe();

  /***************************************************************************************************************/    
                                              // Test Step 1 Set a breakpoint at the line `FAILED_REGISTER_ID = GetHWIO_e_FailedRegID();`                                                                                                                                                   
  /***************************************************************************************************************/
  snprintf( chActionText, elCount(chActionText), "Set Breakpoint in Test_ConfigRegister\\4 "); 
  snprintf( chExpectedText, elCount(chExpectedText), "verify is Breakpoint Set Test_ConfigRegister"); 
  
  A_DBGR_BreakpointSet("Test_ConfigRegister\\4");  
  /***************************************************************************************************************/
                                              // Test Step 2 Verify the interface returns 0 when the test is passed.                                      
  /***************************************************************************************************************/
  snprintf( chActionText, elCount(chActionText), "Verify value of Failed_Register_ID is 0"); 
  snprintf( chExpectedText, elCount(chExpectedText), "Failed_Register_ID is 0"); 
  //TestStepAddActionExpected( chActionText, chExpectedText );
  E_DBGR_VariableCheck("Failed_Register_ID",0,Equal);

}

testcase Verify_the_interface_GetHWIO_e_FailedBitID_returns_the_ID_as_0_when_there_is_no_last_failed_register()
{
    /***************************************************************************************************************/    
                                                // Variable Definition
  /***************************************************************************************************************/ 
  

  
  /***************************************************************************************************************/    
                                               // Local Values
  /***************************************************************************************************************/ 
  

  
  /***************************************************************************************************************/    
                                              // Test Case Info
  /***************************************************************************************************************/
  setWriteDbgLevel(DebugOff);
  snprintf( chTestTitle, elCount(chTestTitle), "Verify_the_interface_GetHWIO_e_FailedBitID_returns_the_ID_as_0_when_there_is_no_last_failed_register" );
  snprintf( chTestDescription, elCount(chTestDescription), "Purpose:To check the GetHWIO_e_FailedBitID interface  ");
  TestCaseAddInfo( chTestTitle, "TC_L30SW_Q-37024457", chTestDescription );

  /***************************************************************************************************************/    
                                              // Start of Test Case
  /***************************************************************************************************************/
  
  /***************************************************************************************************************/    
                                              // Test Step 0 PRECONDITIONS
  /***************************************************************************************************************/
   snprintf( chActionText, elCount(chActionText), "Flash the Software and ECU is running "); 
  snprintf( chExpectedText, elCount(chExpectedText), "Ecu is should be in running state"); 
  TestStepAddActionExpected( chActionText, chExpectedText );
  
  A_DBGR_BreakpointDeleteAll();
  A_DBGR_R();
  A_DBGR_Go_Safe();

  /***************************************************************************************************************/    
                                              // Test Step 1 Set a breakpoint at the line `FAILED_BIT_ID = GetHWIO_e_FailedBitID();`.	                                                                                                                                                   
  /***************************************************************************************************************/
  snprintf( chActionText, elCount(chActionText), "Set Breakpoint in Test_ConfigRegister\\5 "); 
  snprintf( chExpectedText, elCount(chExpectedText), "verify is Breakpoint Set Test_ConfigRegister"); 
  
  A_DBGR_BreakpointSet("Test_ConfigRegister\\5");  
  /***************************************************************************************************************/
                                              // Test Step 2 Verify the interface returns 0 when the test is passed.                                      
  /***************************************************************************************************************/
  snprintf( chActionText, elCount(chActionText), "Verify value of Failed_BIT_ID is 0"); 
  snprintf( chExpectedText, elCount(chExpectedText), "Failed_BIT_ID is 0"); 
  //TestStepAddActionExpected( chActionText, chExpectedText );
  E_DBGR_VariableCheck("Failed_BIT_ID",0,Equal);

}

testcase Verify_the_interface_GetHWIO_b_FailedRegRecovSt_returns_the_recovery_status_as_0_when_success_for_the_last_failed_register_ID()
{
  /***************************************************************************************************************/    
                                                // Variable Definition
  /***************************************************************************************************************/ 
  

  
  /***************************************************************************************************************/    
                                               // Local Values
  /***************************************************************************************************************/ 
  

  
  /***************************************************************************************************************/    
                                              // Test Case Info
  /***************************************************************************************************************/
  setWriteDbgLevel(DebugOff);
  snprintf( chTestTitle, elCount(chTestTitle), "Verify_the_interface_GetHWIO_b_FailedRegRecovSt_returns_the_recovery_status_as_0_when_success_for_the_last_failed_register_ID" );
  snprintf( chTestDescription, elCount(chTestDescription), "Purpose:To check the GetHWIO_b_FailedRegRecovSt interface  ");
  TestCaseAddInfo( chTestTitle, "TC_L30SW_Q-37024460", chTestDescription );

  /***************************************************************************************************************/    
                                              // Start of Test Case
  /***************************************************************************************************************/
  
  /***************************************************************************************************************/    
                                              // Test Step 0 PRECONDITIONS
  /***************************************************************************************************************/
   snprintf( chActionText, elCount(chActionText), "Flash the Software and ECU is running "); 
  snprintf( chExpectedText, elCount(chExpectedText), "Ecu is should be in running state"); 
  TestStepAddActionExpected( chActionText, chExpectedText );
  
  A_DBGR_BreakpointDeleteAll();
  A_DBGR_R();
  A_DBGR_Go_Safe();

  /***************************************************************************************************************/    
                                              // Test Step 1 Set a breakpoint at the line Failed_Register_Recover_Status = GetHWIO_b_FailedRegRecovSt();/* To Do*/                                                                                                                                                   
  /***************************************************************************************************************/
  snprintf( chActionText, elCount(chActionText), "Set Breakpoint in Test_ConfigRegister\\6 "); 
  snprintf( chExpectedText, elCount(chExpectedText), "verify is Breakpoint Set Test_ConfigRegister"); 
  
  A_DBGR_BreakpointSet("Test_ConfigRegister\\6");  
  /***************************************************************************************************************/
                                              // Test Step 2 Verify the interface returns 0 when the test is passed.                                      
  /***************************************************************************************************************/
  snprintf( chActionText, elCount(chActionText), "Verify value of Failed_Register_Recover_Status is 0"); 
  snprintf( chExpectedText, elCount(chExpectedText), "Failed_Register_Recover_Status is 0"); 
  //TestStepAddActionExpected( chActionText, chExpectedText );
  E_DBGR_VariableCheck("Failed_Register_Recover_Status",0,Equal);

}

