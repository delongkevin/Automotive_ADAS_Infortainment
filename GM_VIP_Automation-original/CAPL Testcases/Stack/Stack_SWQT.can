/*@!Encoding:65001*/
includes
{
  
  #include "..\..\AutomationDependent\ProjectSpecific\GenLib_Includes.cin"
}

variables
{
  char chTestDescription[500];
  char chActionText[500];
  char chExpectedText[500];
  char chTestTitle[100];
  char address[5000];
  long value;
}
/***************************************************************************************************************/    
                                              // ROM_SWIT_Testcases
/***************************************************************************************************************/
testcase To_verify_the_SMU_Init_Software_interface() 
{
  /***************************************************************************************************************/    
                                              // Test Case Info
  /***************************************************************************************************************/
  setWriteDbgLevel(DebugOff);
  snprintf( chTestTitle, elCount(chTestTitle), "To_verify_the_SMU_Init_Software_interface" );
  snprintf( chTestDescription, elCount(chTestDescription), "Purpose:To check the To_verify_the_SMU_Init_Software_interface_interface");
  TestCaseAddInfo( chTestTitle, "TC_L30SW_Q-36623750", chTestDescription );
  
  /***************************************************************************************************************/    
                                              // Start of Test Case
  /***************************************************************************************************************/
  
  /***************************************************************************************************************/    
                                              // Test Step 0 PRECONDITIONS
  /***************************************************************************************************************/
  snprintf( chActionText, elCount(chActionText), "Flash the Software and ECU is running "); 
  snprintf( chExpectedText, elCount(chExpectedText), "Ecu is should be in running state"); 
  TestStepAddActionExpected( chActionText, chExpectedText );
  A_DBGR_BreakpointDeleteAll();
  A_DBGR_R();

  /***************************************************************************************************************/    
                                              // Test Step 1 Add the break point at function call side 
  /***************************************************************************************************************/
  snprintf( chActionText, elCount(chActionText), "Set Breakpoint in App_MCALInit\\51 Function call side  "); 
  snprintf( chExpectedText, elCount(chExpectedText), "verify is Breakpoint Set App_MCALInit\\51 in Function call side"); 
  A_DBGR_BreakpointSet("App_MCALInit\\51");  
  A_DBGR_Go();
  
  snprintf( chActionText, elCount(chActionText), "verify Breakpoint should hit in App_MCALInit\\51"); 
  snprintf( chExpectedText, elCount(chExpectedText), "Breakpoint hit in App_MCALInit\\50 function"); 
  E_DBGR_BreakpointCheckForHalt("App_MCALInit\\51");
  /***************************************************************************************************************/    
                                              // Test Step2 add break point at function defination side 
  /***************************************************************************************************************/
  snprintf( chActionText, elCount(chActionText), "Set Breakpoint in Smu_Init  Function defination  side  "); 
  snprintf( chExpectedText, elCount(chExpectedText), "verify is Breakpoint Set Smu_Init in funaction defination side"); 
  TestStepAddActionExpected( chActionText, chExpectedText );
  A_DBGR_BreakpointSet("Smu_Init"); 

  A_DBGR_Go();;
  snprintf( chActionText, elCount(chActionText), "verify Breakpoint should hit in Smu_Init function defination side  "); 
  snprintf( chExpectedText, elCount(chExpectedText), "Breakpoint hit in Smu_Init function function defination side "); 
  E_DBGR_BreakpointCheckForHalt("Smu_Init");
}
testcase To_verify_the_SDLAdaptor_init_ROM_Software_interface() 
{
  /***************************************************************************************************************/    
                                              // Test Case Info
  /***************************************************************************************************************/
  setWriteDbgLevel(DebugOff);
  snprintf( chTestTitle, elCount(chTestTitle), "To_verify_the_SDLAdaptor_init_Software_interface" );
  snprintf( chTestDescription, elCount(chTestDescription), "Purpose:To check the To_verify_the_SDLAdaptor_init_Software_interface_interface");
  TestCaseAddInfo( chTestTitle, "TC_L30SW_Q-36623750", chTestDescription);
  
  /***************************************************************************************************************/    
                                              // Start of Test Case
  /***************************************************************************************************************/
  
  /***************************************************************************************************************/    
                                              // Test Step 0 PRECONDITIONS
  /***************************************************************************************************************/
  snprintf( chActionText, elCount(chActionText), "Flash the Software and ECU is running"); 
  snprintf( chExpectedText, elCount(chExpectedText), "Ecu is should be in running state"); 
  TestStepAddActionExpected(chActionText, chExpectedText);
  A_DBGR_BreakpointDeleteAll();
  A_DBGR_R();

  /***************************************************************************************************************/    
                                              // Test Step 1 Add the break point at function call side 
  /***************************************************************************************************************/
  snprintf( chActionText, elCount(chActionText), "Set Breakpoint in App_MCALInit\\53 Function call side"); 
  snprintf( chExpectedText, elCount(chExpectedText), "verify is Breakpoint Set App_MCALInit\\53 in Function call side"); 
  A_DBGR_BreakpointSet("App_MCALInit\\53");  
  A_DBGR_Go();
  
  snprintf( chExpectedText, elCount(chExpectedText), "Breakpoint hit in App_MCALInit\\53 function"); 
  E_DBGR_BreakpointCheckForHalt("App_MCALInit\\53");
  /***************************************************************************************************************/    
                                              // Test Step2 add break point at function defination side 
  /***************************************************************************************************************/
  snprintf( chActionText, elCount(chActionText), "Set Breakpoint in SDLAdaptor_init  Function defination  side "); 
  snprintf( chExpectedText, elCount(chExpectedText), "verify is Breakpoint Set SDLAdaptor_init in funaction defination side"); 
  TestStepAddActionExpected( chActionText, chExpectedText);
  A_DBGR_BreakpointSet("SDLAdaptor_init");

  A_DBGR_Go();
  
  snprintf( chActionText, elCount(chActionText), "verify Breakpoint should hit in SDLAdaptor_init function defination side"); 
  snprintf( chExpectedText, elCount(chExpectedText), "Breakpoint hit in SDLAdaptor_init function function defination side ");
  E_DBGR_BreakpointCheckForHalt("SDLAdaptor_init");
}
testcase To_verify_the_os_main_Software_interface() 
{
  /***************************************************************************************************************/    
                                              // Test Case Info
  /***************************************************************************************************************/
  setWriteDbgLevel(DebugOff);
  snprintf( chTestTitle, elCount(chTestTitle), "To_verify_the_os_main_Software_interface" );
  snprintf( chTestDescription, elCount(chTestDescription), "Purpose:To check the To_verify_the_os_main_interface_interface");
  TestCaseAddInfo( chTestTitle, "TC_L30SW_Q-36623750", chTestDescription );
  
  /***************************************************************************************************************/    
                                              // Start of Test Case
  /***************************************************************************************************************/
  
  /***************************************************************************************************************/    
                                              // Test Step 0 PRECONDITIONS
  /***************************************************************************************************************/
  snprintf( chActionText, elCount(chActionText), "Flash the Software and ECU is running "); 
  snprintf( chExpectedText, elCount(chExpectedText), "Ecu is should be in running state"); 
  TestStepAddActionExpected( chActionText, chExpectedText );
  A_DBGR_BreakpointDeleteAll();
  A_DBGR_R();

  /***************************************************************************************************************/    
                                              // Test Step 1 Add the break point at function call side 
  /***************************************************************************************************************/
  snprintf( chActionText, elCount(chActionText), "Set Breakpoint in core0_main\\29 Function call side  "); 
  snprintf( chExpectedText, elCount(chExpectedText), "verify is Breakpoint Set core0_main\\29 in Function call side"); 
  A_DBGR_BreakpointSet("core0_main\\29");  
  A_DBGR_Go();
  
  snprintf( chActionText, elCount(chActionText), "verify Breakpoint should hit in core0_main\\29"); 
  snprintf( chExpectedText, elCount(chExpectedText), "Breakpoint hit in core0_main\\29 function"); 
  E_DBGR_BreakpointCheckForHalt("core0_main\\29");
  /***************************************************************************************************************/    
                                              // Test Step2 add break point at function defination side 
  /***************************************************************************************************************/
  snprintf( chActionText, elCount(chActionText), "Set Breakpoint in os_main  Function defination side"); 
  snprintf( chExpectedText, elCount(chExpectedText), "verify is Breakpoint Set os_main in funaction defination side"); 
  TestStepAddActionExpected( chActionText, chExpectedText );
  A_DBGR_BreakpointSet("os_main"); 


  A_DBGR_Go();
  snprintf( chActionText, elCount(chActionText), "verify Breakpoint should hit in os_main function defination side"); 
  snprintf( chExpectedText, elCount(chExpectedText), "Breakpoint hit in os_main function function defination side");
  E_DBGR_BreakpointCheckForHalt("os_main");
}
testcase To_verify_the_GetHWIO_e_CPU_Software_interface() 
{
  /***************************************************************************************************************/    
                                              // Test Case Info
  /***************************************************************************************************************/
  setWriteDbgLevel(DebugOff);
  snprintf( chTestTitle, elCount(chTestTitle), "To_verify_the_GetHWIO_e_CPU_Software_interface" );
  snprintf( chTestDescription, elCount(chTestDescription), "Purpose:To check the To_verify_the_GetHWIO_e_CPU_interface_interface");
  TestCaseAddInfo( chTestTitle, "TC_L30SW_Q-36623750", chTestDescription );
  
  /***************************************************************************************************************/    
                                              // Start of Test Case
  /***************************************************************************************************************/
  
  /***************************************************************************************************************/    
                                              // Test Step 0 PRECONDITIONS
  /***************************************************************************************************************/
  snprintf( chActionText, elCount(chActionText), "Flash the Software and ECU is running "); 
  snprintf( chExpectedText, elCount(chExpectedText), "Ecu is should be in running state"); 
  TestStepAddActionExpected( chActionText, chExpectedText );
  A_DBGR_BreakpointDeleteAll();
  A_DBGR_R();

  /***************************************************************************************************************/    
                                              // Test Step 1 Add the break point at function call side 
  /***************************************************************************************************************/
  snprintf( chActionText, elCount(chActionText), "Set Breakpoint in  StartupHook Function call side  "); 
  snprintf( chExpectedText, elCount(chExpectedText), "verify is Breakpoint Set StartupHook in Function call side"); 
  A_DBGR_BreakpointSet("StartupHook");  
  A_DBGR_Go();
  
  snprintf( chActionText, elCount(chActionText), "verify Breakpoint should hit in StartupHook"); 
  snprintf( chExpectedText, elCount(chExpectedText), "Breakpoint hit in StartupHook function"); 
  E_DBGR_BreakpointCheckForHalt("StartupHook");
  /***************************************************************************************************************/    
                                              // Test Step2 add break point at function defination side 
  /***************************************************************************************************************/
  snprintf( chActionText, elCount(chActionText), "Set Breakpoint in  GetHWIO_e_CPU  Function defination side"); 
  snprintf( chExpectedText, elCount(chExpectedText), "verify is Breakpoint Set GetHWIO_e_CPU in funaction defination side"); 
  TestStepAddActionExpected( chActionText, chExpectedText );
  A_DBGR_BreakpointSet("GetHWIO_e_CPU"); 


  A_DBGR_Go();
  snprintf( chActionText, elCount(chActionText), "verify Breakpoint should hit in GetHWIO_e_CPU function defination side"); 
  snprintf( chExpectedText, elCount(chExpectedText), "Breakpoint hit in GetHWIO_e_CPU function function defination side");
  E_DBGR_BreakpointCheckForHalt("GetHWIO_e_CPU");
}
testcase To_verify_the_CntrlRBSR_Background_Software_interface() 
{
  /***************************************************************************************************************/    
                                              // Test Case Info
  /***************************************************************************************************************/
  setWriteDbgLevel(DebugOff);
  snprintf( chTestTitle, elCount(chTestTitle), "To_verify_the_CntrlRBSR_Background_Software_interface" );
  snprintf( chTestDescription, elCount(chTestDescription), "Purpose:To check the CntrlRBSR_Background_Software_interface");
  TestCaseAddInfo( chTestTitle, "TC_L30SW_Q-36623750", chTestDescription );
  
  /***************************************************************************************************************/    
                                              // Start of Test Case
  /***************************************************************************************************************/
  
  /***************************************************************************************************************/    
                                              // Test Step 0 PRECONDITIONS
  /***************************************************************************************************************/
  snprintf( chActionText, elCount(chActionText), "Flash the Software and ECU is running "); 
  snprintf( chExpectedText, elCount(chExpectedText), "Ecu is should be in running state"); 
  TestStepAddActionExpected( chActionText, chExpectedText );
  A_DBGR_BreakpointDeleteAll();
  A_DBGR_R();

  /***************************************************************************************************************/    
                                              // Test Step 1 Add the break point at function call side 
  /***************************************************************************************************************/
  snprintf( chActionText, elCount(chActionText), "Set Breakpoint in Os_Entry_Task_Core0_BackgroundTask\\7 Function call side  "); 
  snprintf( chExpectedText, elCount(chExpectedText), "verify is Breakpoint Set Os_Entry_Task_Core0_BackgroundTask\\7 in Function call side"); 
  A_DBGR_BreakpointSet("Os_Entry_Task_Core0_BackgroundTask\\7");  
  A_DBGR_Go();
  
  snprintf( chActionText, elCount(chActionText), "verify Breakpoint should hit in Os_Entry_Task_Core0_BackgroundTask\\7"); 
  snprintf( chExpectedText, elCount(chExpectedText), "Breakpoint hit in Os_Entry_Task_Core0_BackgroundTask\\7 function"); 
  E_DBGR_BreakpointCheckForHalt("Os_Entry_Task_Core0_BackgroundTask\\7");
  /***************************************************************************************************************/    
                                              // Test Step2 add break point at function defination side 
  /***************************************************************************************************************/
  snprintf( chActionText, elCount(chActionText), "Set Breakpoint in CntrlRBSR_Background  Function defination  side  "); 
  snprintf( chExpectedText, elCount(chExpectedText), "verify is Breakpoint Set CntrlRBSR_Background in funaction defination side"); 
  TestStepAddActionExpected( chActionText, chExpectedText );
  A_DBGR_BreakpointSet("CntrlRBSR_Background"); 

  A_DBGR_Go();
  snprintf( chActionText, elCount(chActionText), "verify Breakpoint should hit in CntrlRBSR_Background function defination side  "); 
  snprintf( chExpectedText, elCount(chExpectedText), "Breakpoint hit in CntrlRBSR_Background function function defination side "); 
  E_DBGR_BreakpointCheckForHalt("CntrlRBSR_Background");
}
testcase To_verify_the_Os_Entry_OS_SMUSafety_ISR1_Software_interface() 
{
  /***************************************************************************************************************/    
                                              // Test Case Info
  /***************************************************************************************************************/
  setWriteDbgLevel(DebugOff);
  snprintf( chTestTitle, elCount(chTestTitle), "To_verify_the_Os_Entry_OS_SMUSafety_ISR1_Software_interface" );
  snprintf( chTestDescription, elCount(chTestDescription), "Purpose:To check the Os_Entry_OS_SMUSafety_ISR1_Software_interface");
  TestCaseAddInfo( chTestTitle, "TC_L30SW_Q-36623750", chTestDescription );
  
  /***************************************************************************************************************/    
                                              // Start of Test Case
  /***************************************************************************************************************/
  
  /***************************************************************************************************************/    
                                              // Test Step 0 PRECONDITIONS
  /***************************************************************************************************************/
  snprintf( chActionText, elCount(chActionText), "Flash the Software and ECU is running "); 
  snprintf( chExpectedText, elCount(chExpectedText), "Ecu is should be in running state"); 
  TestStepAddActionExpected( chActionText, chExpectedText );
  A_DBGR_BreakpointDeleteAll();
  A_DBGR_R();

  /***************************************************************************************************************/    
                                              // Test Step 1 Add the break point at function call side 
  /***************************************************************************************************************/
  snprintf( chActionText, elCount(chActionText), "Set Breakpoint in Os_Cbk_Idle\\24 Function call side  "); 
  snprintf( chExpectedText, elCount(chExpectedText), "verify is Breakpoint Set Os_Cbk_Idle\\24 in Function call side"); 
  A_DBGR_BreakpointSet("Os_Cbk_Idle\\24");  
  A_DBGR_Go();
  
  snprintf( chActionText, elCount(chActionText), "verify Breakpoint should hit in core0_main\\20 "); 
  snprintf( chExpectedText, elCount(chExpectedText), "Breakpoint hit in Os_Cbk_Idle\\24 function"); 
  E_DBGR_BreakpointCheckForHalt("Os_Cbk_Idle\\24");
  /***************************************************************************************************************/    
                                              // Test Step2 add break point at function defination side 
  /***************************************************************************************************************/
  snprintf( chActionText, elCount(chActionText), "Set Breakpoint in CntrlRBSR_Background  Function defination  side  "); 
  snprintf( chExpectedText, elCount(chExpectedText), "verify is Breakpoint Set CntrlRBSR_Background in funaction defination side"); 
  TestStepAddActionExpected( chActionText, chExpectedText );
  A_DBGR_BreakpointSet("CntrlRBSR_Background"); 

  A_DBGR_Go();
  snprintf( chActionText, elCount(chActionText), "verify Breakpoint should hit in CntrlRBSR_Background function defination side  "); 
  snprintf( chExpectedText, elCount(chExpectedText), "Breakpoint hit in CntrlRBSR_Background function function defination side "); 
  //TestStepAddActionExpected( chActionText, chExpectedText );
  E_DBGR_BreakpointCheckForHalt("CntrlRBSR_Background");
}
testcase To_verify_the_Os_Entry_Task_Core0_10ms_Software_interface() 
{
  /***************************************************************************************************************/    
                                              // Test Case Info
  /***************************************************************************************************************/
  setWriteDbgLevel(DebugOff);
  snprintf( chTestTitle, elCount(chTestTitle), "To_verify_the_Os_Entry_Task_Core0_10ms_Software_interface" );
  snprintf( chTestDescription, elCount(chTestDescription), "Purpose:To check the Os_Entry_Os_Entry_Task_Core0_10ms_Software_interface");
  TestCaseAddInfo( chTestTitle, "TC_L30SW_Q-36623750", chTestDescription );
  
  /***************************************************************************************************************/    
                                              // Start of Test Case
  /***************************************************************************************************************/
  
  /***************************************************************************************************************/    
                                              // Test Step 0 PRECONDITIONS
  /***************************************************************************************************************/
  snprintf( chActionText, elCount(chActionText), "Flash the Software and ECU is running "); 
  snprintf( chExpectedText, elCount(chExpectedText), "Ecu is should be in running state"); 
  TestStepAddActionExpected( chActionText, chExpectedText );
  A_DBGR_BreakpointDeleteAll();
  A_DBGR_R();

  /***************************************************************************************************************/    
                                              // Test Step 1 Add the break point at function call side 
  /***************************************************************************************************************/
  snprintf( chActionText, elCount(chActionText), "Set Breakpoint in Os_Entry_Task_Core0_10ms Function call side  "); 
  snprintf( chExpectedText, elCount(chExpectedText), "verify is Breakpoint Set Os_Entry_Task_Core0_10ms in Function call side"); 
  A_DBGR_BreakpointSet("Os_Entry_Task_Core0_10ms");  
  A_DBGR_Go();
  
  snprintf( chActionText, elCount(chActionText), "verify Breakpoint should hit in Os_Entry_Task_Core0_10ms"); 
  snprintf( chExpectedText, elCount(chExpectedText), "Breakpoint hit in Os_Entry_Task_Core0_10ms function"); 
  E_DBGR_BreakpointCheckForHalt("Os_Entry_Task_Core0_10ms");
}
testcase To_verify_the_Os_Entry_Task_Core0_250ms_Software_interface() 
{
  /***************************************************************************************************************/    
                                              // Test Case Info
  /***************************************************************************************************************/
  setWriteDbgLevel(DebugOff);
  snprintf( chTestTitle, elCount(chTestTitle), "To_verify_the_Os_Entry_Task_Core0_250ms_Software_interface" );
  snprintf( chTestDescription, elCount(chTestDescription), "Purpose:To check the Os_Entry_Os_Entry_Task_Core0_250ms_Software_interface");
  TestCaseAddInfo( chTestTitle, "TC_L30SW_Q-36623750", chTestDescription );
  
  /***************************************************************************************************************/    
                                              // Start of Test Case
  /***************************************************************************************************************/
  
  /***************************************************************************************************************/    
                                              // Test Step 0 PRECONDITIONS
  /***************************************************************************************************************/
  snprintf( chActionText, elCount(chActionText), "Flash the Software and ECU is running "); 
  snprintf( chExpectedText, elCount(chExpectedText), "Ecu is should be in running state"); 
  TestStepAddActionExpected( chActionText, chExpectedText );
  A_DBGR_BreakpointDeleteAll();
  A_DBGR_R();

  /***************************************************************************************************************/    
                                              // Test Step 1 Add the break point at function call side 
  /***************************************************************************************************************/
  snprintf( chActionText, elCount(chActionText), "Set Breakpoint in Os_Entry_Task_Core0_250ms Function call side  "); 
  snprintf( chExpectedText, elCount(chExpectedText), "verify is Breakpoint Set Os_Entry_Task_Core0_250ms in Function call side"); 
  A_DBGR_BreakpointSet("Os_Entry_Task_Core0_250ms");  
  A_DBGR_Go();
  
  snprintf( chActionText, elCount(chActionText), "verify Breakpoint should hit in Os_Entry_Task_Core0_10ms"); 
  snprintf( chExpectedText, elCount(chExpectedText), "Breakpoint hit in Os_Entry_Task_Core0_10ms function"); 
  E_DBGR_BreakpointCheckForHalt("Os_Entry_Task_Core0_250ms");
}
testcase To_verify_the_GetHWIO_e_RstSrc_Software_interface() 
{
  /***************************************************************************************************************/    
                                              // Test Case Info
  /***************************************************************************************************************/
  setWriteDbgLevel(DebugOff);
  snprintf( chTestTitle, elCount(chTestTitle), "To_verify_the_Os_Entry_OS_SMUSafety_ISR1_Software_interface" );
  snprintf( chTestDescription, elCount(chTestDescription), "Purpose:To check the Os_Entry_OS_SMUSafety_ISR1_Software_interface");
  TestCaseAddInfo( chTestTitle, "TC_L30SW_Q-36623750", chTestDescription );
  
  /***************************************************************************************************************/    
                                              // Start of Test Case
  /***************************************************************************************************************/
  
  /***************************************************************************************************************/    
                                              // Test Step 0 PRECONDITIONS
  /***************************************************************************************************************/
  snprintf( chActionText, elCount(chActionText), "Flash the Software and ECU is running "); 
  snprintf( chExpectedText, elCount(chExpectedText), "Ecu is should be in running state"); 
  TestStepAddActionExpected( chActionText, chExpectedText );
  A_DBGR_BreakpointDeleteAll();
  A_DBGR_R();

  /***************************************************************************************************************/    
                                              // Test Step 1 Add the break point at function call side 
  /***************************************************************************************************************/
  snprintf( chActionText, elCount(chActionText), "Set Breakpoint in   Ipt_F_part1_v Function call side  "); 
  snprintf( chExpectedText, elCount(chExpectedText), "verify is Breakpoint Set Ipt_F_part1_v in Function call side"); 
  A_DBGR_BreakpointSet("Ipt_F_part1_v");  
  A_DBGR_Go();
  
  snprintf( chActionText, elCount(chActionText), "verify Breakpoint should hit in Ipt_F_part1_v"); 
  snprintf( chExpectedText, elCount(chExpectedText), "Breakpoint hit in Ipt_F_part1_v function"); 
  E_DBGR_BreakpointCheckForHalt("Ipt_F_part1_v");
  /***************************************************************************************************************/    
                                              // Test Step2 add break point at function defination side 
  /***************************************************************************************************************/
  snprintf( chActionText, elCount(chActionText), "Set Breakpoint in GetHWIO_e_RstSrc   Function defination  side  "); 
  snprintf( chExpectedText, elCount(chExpectedText), "verify is Breakpoint Set GetHWIO_e_RstSrc  in funaction defination side"); 
  TestStepAddActionExpected( chActionText, chExpectedText );
  A_DBGR_BreakpointSet("GetHWIO_e_RstSrc"); 

  A_DBGR_Go();
  snprintf( chActionText, elCount(chActionText), "verify Breakpoint should hit in GetHWIO_e_RstSrc  function defination side  "); 
  snprintf( chExpectedText, elCount(chExpectedText), "Breakpoint hit in GetHWIO_e_RstSrc  function function defination side "); 
  E_DBGR_BreakpointCheckForHalt("GetHWIO_e_RstSrc");
}
testcase To_verify_the_GetHWIO_e_ROM_Flt_Software_interface() 
{
  /***************************************************************************************************************/    
                                              // Test Case Info
  /***************************************************************************************************************/
  setWriteDbgLevel(DebugOff);
  snprintf( chTestTitle, elCount(chTestTitle), "To_verify_the_GetHWIO_e_ROM_Flt_Software_interface" );
  snprintf( chTestDescription, elCount(chTestDescription), "Purpose:To check the GetHWIO_e_ROM_Flt_Software_interface");
  TestCaseAddInfo( chTestTitle, "TC_L30SW_Q-36623750", chTestDescription );
  
  /***************************************************************************************************************/    
                                              // Start of Test Case
  /***************************************************************************************************************/
  
  /***************************************************************************************************************/    
                                              // Test Step 0 PRECONDITIONS
  /***************************************************************************************************************/
  snprintf( chActionText, elCount(chActionText), "Flash the Software and ECU is running "); 
  snprintf( chExpectedText, elCount(chExpectedText), "Ecu is should be in running state"); 
  TestStepAddActionExpected( chActionText, chExpectedText );
  A_DBGR_BreakpointDeleteAll();
  A_DBGR_R();

  /***************************************************************************************************************/    
                                              // Test Step 1 Add the break point at function call side 
  /***************************************************************************************************************/
  snprintf( chActionText, elCount(chActionText), "Set Breakpoint in Test_ecc_rom_injection\\7 Function call side  "); 
  snprintf( chExpectedText, elCount(chExpectedText), "verify is Breakpoint Set Test_ecc_rom_injection\\7 in Function call side"); 
  A_DBGR_BreakpointSet("Test_ecc_rom_injection\\7");  
  A_DBGR_Go();
  
  snprintf( chActionText, elCount(chActionText), "verify Breakpoint should hit in Test_ecc_rom_injection\\7"); 
  snprintf( chExpectedText, elCount(chExpectedText), "Breakpoint hit in Test_ecc_rom_injection\\7 function"); 
  E_DBGR_BreakpointCheckForHalt("Test_ecc_rom_injection\\7");
  /***************************************************************************************************************/    
                                              // Test Step2 add break point at function defination side 
  /***************************************************************************************************************/
  snprintf( chActionText, elCount(chActionText), "Set Breakpoint in GetHWIO_e_ROM_Flt Function defination  side  "); 
  snprintf( chExpectedText, elCount(chExpectedText), "verify is Breakpoint Set GetHWIO_e_ROM_Flt in funaction defination side"); 
  TestStepAddActionExpected( chActionText, chExpectedText );
  A_DBGR_BreakpointSet("GetHWIO_e_ROM_Flt"); 

  A_DBGR_Go();
  snprintf( chActionText, elCount(chActionText), "verify Breakpoint should hit in GetHWIO_e_ROM_Flt function defination side  "); 
  snprintf( chExpectedText, elCount(chExpectedText), "Breakpoint hit in GetHWIO_e_ROM_Flt function function defination side "); 
  E_DBGR_BreakpointCheckForHalt("GetHWIO_e_ROM_Flt");
}
testcase To_verify_the_GetSDLAdaptor_e_ROM_Flt_Software_interface() 
{
  /***************************************************************************************************************/    
                                              // Test Case Info
  /***************************************************************************************************************/
  setWriteDbgLevel(DebugOff);
  snprintf( chTestTitle, elCount(chTestTitle), "To_verify_the_GetSDLAdaptor_e_ROM_Flt_Software_interface" );
  snprintf( chTestDescription, elCount(chTestDescription), "Purpose:To check the GetSDLAdaptor_e_ROM_Flt_Software_interface");
  TestCaseAddInfo( chTestTitle, "TC_L30SW_Q-36623750", chTestDescription );
  
  /***************************************************************************************************************/    
                                              // Start of Test Case
  /***************************************************************************************************************/
  
  /***************************************************************************************************************/    
                                              // Test Step 0 PRECONDITIONS
  /***************************************************************************************************************/
  snprintf( chActionText, elCount(chActionText), "Flash the Software and ECU is running "); 
  snprintf( chExpectedText, elCount(chExpectedText), "Ecu is should be in running state"); 
  TestStepAddActionExpected( chActionText, chExpectedText );
  A_DBGR_BreakpointDeleteAll();
  A_DBGR_R();

  /***************************************************************************************************************/    
                                              // Test Step 1 Add the break point at function call side 
  /***************************************************************************************************************/
  snprintf( chActionText, elCount(chActionText), "Set Breakpoint in GetHWIO_e_ROM_Flt Function call side  "); 
  snprintf( chExpectedText, elCount(chExpectedText), "verify is Breakpoint Set GetHWIO_e_ROM_Flt in Function call side"); 
  A_DBGR_BreakpointSet("GetHWIO_e_ROM_Flt");  
  A_DBGR_Go();
  
  snprintf( chActionText, elCount(chActionText), "verify Breakpoint should hit in GetHWIO_e_ROM_Flt"); 
  snprintf( chExpectedText, elCount(chExpectedText), "Breakpoint hit in GetHWIO_e_ROM_Flt function"); 
  E_DBGR_BreakpointCheckForHalt("GetHWIO_e_ROM_Flt");
  /***************************************************************************************************************/    
                                              // Test Step2 add break point at function defination side 
  /***************************************************************************************************************/
  snprintf( chActionText, elCount(chActionText), "Set Breakpoint in GetSDLAdaptor_e_ROM_Flt  Function defination  side  "); 
  snprintf( chExpectedText, elCount(chExpectedText), "verify is Breakpoint Set GetSDLAdaptor_e_ROM_Flt in funaction defination side"); 
  TestStepAddActionExpected( chActionText, chExpectedText );
  A_DBGR_BreakpointSet("GetSDLAdaptor_e_ROM_Flt"); 

  A_DBGR_Go();
  snprintf( chActionText, elCount(chActionText), "verify Breakpoint should hit in GetSDLAdaptor_e_ROM_Flt function defination side  "); 
  snprintf( chExpectedText, elCount(chExpectedText), "Breakpoint hit in GetSDLAdaptor_e_ROM_Flt function function defination side ");
  E_DBGR_BreakpointCheckForHalt("GetSDLAdaptor_e_ROM_Flt");
}
testcase To_verify_the_GetHWIO_y_ROM_AddressFailed_Software_interface() 
{
  /***************************************************************************************************************/    
                                              // Test Case Info
  /***************************************************************************************************************/
  setWriteDbgLevel(DebugOff);
  snprintf( chTestTitle, elCount(chTestTitle), "To_verify_the_GetHWIO_y_ROM_AddressFailed_Software_interface" );
  snprintf( chTestDescription, elCount(chTestDescription), "Purpose:To check the GetHWIO_y_ROM_AddressFailed_Software_interface");
  TestCaseAddInfo( chTestTitle, "TC_L30SW_Q-36623750", chTestDescription );
  
  /***************************************************************************************************************/    
                                              // Start of Test Case
  /***************************************************************************************************************/
  
  /***************************************************************************************************************/    
                                              // Test Step 0 PRECONDITIONS
  /***************************************************************************************************************/
  snprintf( chActionText, elCount(chActionText), "Flash the Software and ECU is running "); 
  snprintf( chExpectedText, elCount(chExpectedText), "Ecu is should be in running state"); 
  TestStepAddActionExpected( chActionText, chExpectedText );
  A_DBGR_BreakpointDeleteAll();
  A_DBGR_R();

  /***************************************************************************************************************/    
                                              // Test Step 1 Add the break point at function call side 
  /***************************************************************************************************************/
  snprintf( chActionText, elCount(chActionText), "Set Breakpoint in  Test_ecc_rom_injection\\9 Function call side  "); 
  snprintf( chExpectedText, elCount(chExpectedText), "verify is Breakpoint Set Test_ecc_rom_injection\\9 in Function call side"); 
  A_DBGR_BreakpointSet("Test_ecc_rom_injection\\9");  
  A_DBGR_Go();
  
  snprintf( chActionText, elCount(chActionText), "verify Breakpoint should hit in core0_main\\20 "); 
  snprintf( chExpectedText, elCount(chExpectedText), "Breakpoint hit in Test_ecc_rom_injection\\9 function"); ;
  E_DBGR_BreakpointCheckForHalt("Test_ecc_rom_injection\\9");
  /***************************************************************************************************************/    
                                              // Test Step2 add break point at function defination side 
  /***************************************************************************************************************/
  snprintf( chActionText, elCount(chActionText), "Set Breakpoint in GetHWIO_y_ROM_AddressFailed  Function defination  side  "); 
  snprintf( chExpectedText, elCount(chExpectedText), "verify is Breakpoint Set GetHWIO_y_ROM_AddressFailed in funaction defination side"); 
  TestStepAddActionExpected( chActionText, chExpectedText );
  A_DBGR_BreakpointSet("GetHWIO_y_ROM_AddressFailed"); 

  A_DBGR_Go();
  snprintf( chActionText, elCount(chActionText), "verify Breakpoint should hit in GetHWIO_y_ROM_AddressFailed function defination side  "); 
  snprintf( chExpectedText, elCount(chExpectedText), "Breakpoint hit in GetHWIO_y_ROM_AddressFailed function function defination side "); 
  E_DBGR_BreakpointCheckForHalt("GetHWIO_y_ROM_AddressFailed");
}
testcase To_verify_the_GetSDLAdaptor_y_ROM_AddressFailed_Software_interface() 
{
  /***************************************************************************************************************/    
                                              // Test Case Info
  /***************************************************************************************************************/
  setWriteDbgLevel(DebugOff);
  snprintf( chTestTitle, elCount(chTestTitle), "To_verify_the_Os_Entry_OS_SMUSafety_ISR1_Software_interface" );
  snprintf( chTestDescription, elCount(chTestDescription), "Purpose:To check the Os_Entry_OS_SMUSafety_ISR1_Software_interface");
  TestCaseAddInfo( chTestTitle, "TC_L30SW_Q-36623750", chTestDescription );
  
  /***************************************************************************************************************/    
                                              // Start of Test Case
  /***************************************************************************************************************/
  
  /***************************************************************************************************************/    
                                              // Test Step 0 PRECONDITIONS
  /***************************************************************************************************************/
  snprintf( chActionText, elCount(chActionText), "Flash the Software and ECU is running "); 
  snprintf( chExpectedText, elCount(chExpectedText), "Ecu is should be in running state"); 
  TestStepAddActionExpected( chActionText, chExpectedText );
  A_DBGR_BreakpointDeleteAll();
  A_DBGR_R();

  /***************************************************************************************************************/    
                                              // Test Step 1 Add the break point at function call side 
  /***************************************************************************************************************/
  snprintf( chActionText, elCount(chActionText), "Set Breakpoint in GetHWIO_y_ROM_AddressFailed Function call side  "); 
  snprintf( chExpectedText, elCount(chExpectedText), "verify is Breakpoint Set GetHWIO_y_ROM_AddressFailed in Function call side"); 
  A_DBGR_BreakpointSet("GetHWIO_y_ROM_AddressFailed");  
  A_DBGR_Go();
  
  snprintf( chActionText, elCount(chActionText), "verify Breakpoint should hit in GetHWIO_y_ROM_AddressFailed"); 
  snprintf( chExpectedText, elCount(chExpectedText), "Breakpoint hit in GetHWIO_y_ROM_AddressFailed function"); 
  E_DBGR_BreakpointCheckForHalt("GetHWIO_y_ROM_AddressFailed");
  /***************************************************************************************************************/    
                                              // Test Step2 add break point at function defination side 
  /***************************************************************************************************************/
  snprintf( chActionText, elCount(chActionText), "Set Breakpoint in GetSDLAdaptor_y_ROM_AddressFailed  Function defination  side  "); 
  snprintf( chExpectedText, elCount(chExpectedText), "verify is Breakpoint Set GetSDLAdaptor_y_ROM_AddressFailed in funaction defination side"); 
  TestStepAddActionExpected( chActionText, chExpectedText );
  A_DBGR_BreakpointSet("GetSDLAdaptor_y_ROM_AddressFailed"); 

  A_DBGR_Go();
  snprintf( chActionText, elCount(chActionText), "verify Breakpoint should hit in GetSDLAdaptor_y_ROM_AddressFailed function defination side  "); 
  snprintf( chExpectedText, elCount(chExpectedText), "Breakpoint hit in GetSDLAdaptor_y_ROM_AddressFailed function function defination side "); 
  E_DBGR_BreakpointCheckForHalt("GetSDLAdaptor_y_ROM_AddressFailed");
}
testcase To_verify_the_GetHWIO_y_ROM_InstAddressFailed_Software_interface() 
{
  /***************************************************************************************************************/    
                                              // Test Case Info
  /***************************************************************************************************************/
  setWriteDbgLevel(DebugOff);
  snprintf( chTestTitle, elCount(chTestTitle), "To_verify_the_GetHWIO_y_ROM_InstAddressFailed_Software_interface" );
  snprintf( chTestDescription, elCount(chTestDescription), "Purpose:To check the GetHWIO_y_ROM_InstAddressFailed_Software_interface");
  TestCaseAddInfo( chTestTitle, "TC_L30SW_Q-36623750", chTestDescription );
  
  /***************************************************************************************************************/    
                                              // Start of Test Case
  /***************************************************************************************************************/
  
  /***************************************************************************************************************/    
                                              // Test Step 0 PRECONDITIONS
  /***************************************************************************************************************/
  snprintf( chActionText, elCount(chActionText), "Flash the Software and ECU is running "); 
  snprintf( chExpectedText, elCount(chExpectedText), "Ecu is should be in running state"); 
  TestStepAddActionExpected( chActionText, chExpectedText );
  A_DBGR_BreakpointDeleteAll();
  A_DBGR_R();

  /***************************************************************************************************************/    
                                              // Test Step 1 Add the break point at function call side 
  /***************************************************************************************************************/
  snprintf( chActionText, elCount(chActionText), "Set Breakpoint in  Test_ecc_rom_injection\\8 Function call side  "); 
  snprintf( chExpectedText, elCount(chExpectedText), "verify is Breakpoint Set Test_ecc_rom_injection\\8 in Function call side"); 
  A_DBGR_BreakpointSet("Test_ecc_rom_injection\\8");  
  A_DBGR_Go();
  
  snprintf( chActionText, elCount(chActionText), "verify Breakpoint should hit in Test_ecc_rom_injection\\8 "); 
  snprintf( chExpectedText, elCount(chExpectedText), "Breakpoint hit in Test_ecc_rom_injection\\8 function"); 
  E_DBGR_BreakpointCheckForHalt("Test_ecc_rom_injection\\8");
  /***************************************************************************************************************/    
                                              // Test Step2 add break point at function defination side 
  /***************************************************************************************************************/
  snprintf( chActionText, elCount(chActionText), "Set Breakpoint in GetHWIO_y_ROM_InstAddressFailed  Function defination  side  "); 
  snprintf( chExpectedText, elCount(chExpectedText), "verify is Breakpoint Set GetHWIO_y_ROM_InstAddressFailed in funaction defination side"); 
  TestStepAddActionExpected( chActionText, chExpectedText );
  A_DBGR_BreakpointSet("GetHWIO_y_ROM_InstAddressFailed"); 

  A_DBGR_Go();
  snprintf( chActionText, elCount(chActionText), "verify Breakpoint should hit in GetHWIO_y_ROM_InstAddressFailed function defination side  "); 
  snprintf( chExpectedText, elCount(chExpectedText), "Breakpoint hit in GetHWIO_y_ROM_InstAddressFailed function function defination side "); 
  E_DBGR_BreakpointCheckForHalt("GetHWIO_y_ROM_InstAddressFailed");
}
testcase To_verify_the_GetSDLAdaptor_y_ROM_InstAddressFailed_Software_interface() 
{
  /***************************************************************************************************************/    
                                              // Test Case Info
  /***************************************************************************************************************/
  setWriteDbgLevel(DebugOff);
  snprintf( chTestTitle, elCount(chTestTitle), "To_verify_the_GetSDLAdaptor_y_ROM_InstAddressFailed_Software_interface" );
  snprintf( chTestDescription, elCount(chTestDescription), "Purpose:To check the GetSDLAdaptor_y_ROM_InstAddressFailed_Software_interface");
  TestCaseAddInfo( chTestTitle, "TC_L30SW_Q-36623750", chTestDescription );
  
  /***************************************************************************************************************/    
                                              // Start of Test Case
  /***************************************************************************************************************/
  
  /***************************************************************************************************************/    
                                              // Test Step 0 PRECONDITIONS
  /***************************************************************************************************************/
  snprintf( chActionText, elCount(chActionText), "Flash the Software and ECU is running "); 
  snprintf( chExpectedText, elCount(chExpectedText), "Ecu is should be in running state"); 
  TestStepAddActionExpected( chActionText, chExpectedText );
  A_DBGR_BreakpointDeleteAll();
  A_DBGR_R();

  /***************************************************************************************************************/    
                                              // Test Step 1 Add the break point at function call side 
  /***************************************************************************************************************/
  snprintf( chActionText, elCount(chActionText), "Set Breakpoint in  GetHWIO_y_ROM_InstAddressFailed Function call side  "); 
  snprintf( chExpectedText, elCount(chExpectedText), "verify is Breakpoint Set GetHWIO_y_ROM_InstAddressFailed  in Function call side"); 
  A_DBGR_BreakpointSet("GetHWIO_y_ROM_InstAddressFailed");  
  A_DBGR_Go();
  
  snprintf( chActionText, elCount(chActionText), "verify Breakpoint should hit in GetHWIO_y_ROM_InstAddressFailed"); 
  snprintf( chExpectedText, elCount(chExpectedText), "Breakpoint hit in GetHWIO_y_ROM_InstAddressFailed function"); 
  E_DBGR_BreakpointCheckForHalt("GetHWIO_y_ROM_InstAddressFailed");
  /***************************************************************************************************************/    
                                              // Test Step2 add break point at function defination side 
  /***************************************************************************************************************/
  snprintf( chActionText, elCount(chActionText), "Set Breakpoint in GetSDLAdaptor_y_ROM_InstAddressFailed  Function defination  side  "); 
  snprintf( chExpectedText, elCount(chExpectedText), "verify is Breakpoint Set GetSDLAdaptor_y_ROM_InstAddressFailed in funaction defination side"); 
  TestStepAddActionExpected( chActionText, chExpectedText );
  A_DBGR_BreakpointSet("GetSDLAdaptor_y_ROM_InstAddressFailed"); 

  A_DBGR_Go();
  snprintf( chActionText, elCount(chActionText), "verify Breakpoint should hit in GetSDLAdaptor_y_ROM_InstAddressFailed function defination side  "); 
  snprintf( chExpectedText, elCount(chExpectedText), "Breakpoint hit in GetSDLAdaptor_y_ROM_InstAddressFailed function function defination side "); 
  E_DBGR_BreakpointCheckForHalt("GetSDLAdaptor_y_ROM_InstAddressFailed");
}
testcase To_verify_the_Minimum_value_GetHWIO_y_ROM_FailedCPU_Specific_Software_interface() 
{
  /***************************************************************************************************************/    
                                              // Test Case Info
  /***************************************************************************************************************/
  setWriteDbgLevel(DebugOff);
  snprintf( chTestTitle, elCount(chTestTitle), "To_verify_the_GetHWIO_y_ROM_FailedCPU_Specific_Software_interface" );
  snprintf( chTestDescription, elCount(chTestDescription), "Purpose:To check the GetHWIO_y_ROM_FailedCPU_Specific_Software_interface");
  TestCaseAddInfo( chTestTitle, "TC_L30SW_Q-36623750", chTestDescription );
  
  /***************************************************************************************************************/    
                                              // Start of Test Case
  /***************************************************************************************************************/
  
  /***************************************************************************************************************/    
                                              // Test Step 0 PRECONDITIONS
  /***************************************************************************************************************/
  snprintf( chActionText, elCount(chActionText), "Flash the Software and ECU is running "); 
  snprintf( chExpectedText, elCount(chExpectedText), "Ecu is should be in running state"); 
  TestStepAddActionExpected( chActionText, chExpectedText );
  A_DBGR_BreakpointDeleteAll();
  A_DBGR_R();
  /***************************************************************************************************************/    
                                              // Test Step 1 updateing  counter value to 0
  /***************************************************************************************************************/
  snprintf( chActionText, elCount(chActionText), "Set Breakpoint in Test_ecc_ram_injection  Function call side  "); 
  snprintf( chExpectedText, elCount(chExpectedText), "verify is Breakpoint Set Test_ecc_ram_injection in Function call side"); 
  A_DBGR_BreakpointSet("Test_ecc_rom_injection");  
  A_DBGR_Go();
  
  
  E_DBGR_BreakpointCheckForHalt("Test_ecc_rom_injection");
  snprintf( chActionText, elCount(chActionText), "Set the Conter variable value to 0"); 
  snprintf( chExpectedText, elCount(chExpectedText), "verify Conter variable value to 0");
  TestStepAddActionExpected( chActionText, chExpectedText );
  A_DBGR_VariableSet("count","0");
  E_DBGR_VariableCheck("count",0,Equal);
  snprintf( chActionText, elCount(chActionText), "Check the break points are deleted"); 
  snprintf( chExpectedText, elCount(chExpectedText), "verify is Breakpoints are  deleted ");
  TestStepAddActionExpected( chActionText, chExpectedText );
  A_DBGR_BreakpointDeleteAll();

  /***************************************************************************************************************/    
                                              // Test Step 1 Add the break point at function call side 
  /***************************************************************************************************************/
  snprintf( chActionText, elCount(chActionText), "Set Breakpoint in  Test_ecc_rom_injection\\10  Function call side  "); 
  snprintf( chExpectedText, elCount(chExpectedText), "verify is Breakpoint Set  Test_ecc_rom_injection\\10  in Function call side"); 
  A_DBGR_BreakpointSet("Test_ecc_rom_injection\\10");  
  A_DBGR_Go();
  
  snprintf( chActionText, elCount(chActionText), "verify Breakpoint should hit in Test_ecc_rom_injection\\10"); 
  snprintf( chExpectedText, elCount(chExpectedText), "Breakpoint hit in  Test_ecc_rom_injection\\10 function"); 
  E_DBGR_BreakpointCheckForHalt("Test_ecc_rom_injection\\10");
  /***************************************************************************************************************/    
                                              // Test Step2 Update the rom_payload variable to minimum value 
  /***************************************************************************************************************/
  snprintf( chActionText, elCount(chActionText), "Set the ecc_rom_payload variable  to minimum value"); 
  snprintf( chExpectedText, elCount(chExpectedText), "verify ecc_rom_payload variable to minimum value");
  TestStepAddActionExpected( chActionText, chExpectedText );
  A_DBGR_VariableSet("test_ecc_rom_payload[0]","0");
  E_DBGR_VariableCheck("test_ecc_rom_payload[0]",0,Equal);
  
  /***************************************************************************************************************/    
                                              // Test Step3 add break point at function defination side 
  /***************************************************************************************************************/
  snprintf( chActionText, elCount(chActionText), "Set Breakpoint in GetHWIO_y_ROM_FailedCPU_Specific Function defination  side  "); 
  snprintf( chExpectedText, elCount(chExpectedText), "verify is Breakpoint Set GetHWIO_y_ROM_FailedCPU_Specific in funaction defination side"); 
  TestStepAddActionExpected( chActionText, chExpectedText );
  A_DBGR_BreakpointSet("GetHWIO_y_ROM_FailedCPU_Specific");

  A_DBGR_Go();
  snprintf( chActionText, elCount(chActionText), "verify Breakpoint should hit in GetHWIO_y_ROM_FailedCPU_Specific function defination side  "); 
  snprintf( chExpectedText, elCount(chExpectedText), "Breakpoint hit in GetHWIO_y_ROM_FailedCPU_Specific function function defination side "); 
  E_DBGR_BreakpointCheckForHalt("GetHWIO_y_ROM_FailedCPU_Specific");
  
  snprintf( chActionText, elCount(chActionText), "verify Breakpoint should hit in GetHWIO_y_ROM_FailedCPU_Specific function defination side  "); 
  snprintf( chExpectedText, elCount(chExpectedText), "Breakpoint hit in GetHWIO_y_ROM_FailedCPU_Specific function function defination side "); 
  TestStepAddActionExpected( chActionText, chExpectedText );
  E_DBGR_RegisterCheck("D:0x30001F5C","0");
  
}
testcase To_verify_the_MID_value_GetHWIO_y_ROM_FailedCPU_Specific_Software_interface() 
{
  /***************************************************************************************************************/    
                                              // Test Case Info
  /***************************************************************************************************************/
  setWriteDbgLevel(DebugOff);
  snprintf( chTestTitle, elCount(chTestTitle), "To_verify_the_GetHWIO_y_ROM_FailedCPU_Specific_Software_interface" );
  snprintf( chTestDescription, elCount(chTestDescription), "Purpose:To check the GetHWIO_y_ROM_FailedCPU_Specific_Software_interface");
  TestCaseAddInfo( chTestTitle, "TC_L30SW_Q-36623750", chTestDescription );
  
  /***************************************************************************************************************/    
                                              // Start of Test Case
  /***************************************************************************************************************/
  
  /***************************************************************************************************************/    
                                              // Test Step 0 PRECONDITIONS
  /***************************************************************************************************************/
  snprintf( chActionText, elCount(chActionText), "Flash the Software and ECU is running "); 
  snprintf( chExpectedText, elCount(chExpectedText), "Ecu is should be in running state"); 
  TestStepAddActionExpected( chActionText, chExpectedText );
  A_DBGR_BreakpointDeleteAll();
  A_DBGR_R();
  /***************************************************************************************************************/    
                                              // Test Step 1 updateing  counter value to 0
  /***************************************************************************************************************/
  snprintf( chActionText, elCount(chActionText), "Set Breakpoint in Test_ecc_ram_injection  Function call side  "); 
  snprintf( chExpectedText, elCount(chExpectedText), "verify is Breakpoint Set Test_ecc_ram_injection in Function call side"); 
  A_DBGR_BreakpointSet("Test_ecc_rom_injection");  
  A_DBGR_Go();
  
  
  E_DBGR_BreakpointCheckForHalt("Test_ecc_rom_injection");
  snprintf( chActionText, elCount(chActionText), "Set the Conter variable value to 0"); 
  snprintf( chExpectedText, elCount(chExpectedText), "verify Conter variable value to 0");
  TestStepAddActionExpected( chActionText, chExpectedText );
  A_DBGR_VariableSet("count","0");
  E_DBGR_VariableCheck("count",0,Equal);
  snprintf( chActionText, elCount(chActionText), "Check the break points are deleted"); 
  snprintf( chExpectedText, elCount(chExpectedText), "verify is Breakpoints are  deleted ");
  TestStepAddActionExpected( chActionText, chExpectedText );
  A_DBGR_BreakpointDeleteAll();

  /***************************************************************************************************************/    
                                              // Test Step 1 Add the break point at function call side 
  /***************************************************************************************************************/
  snprintf( chActionText, elCount(chActionText), "Set Breakpoint in  Test_ecc_rom_injection\\10  Function call side  "); 
  snprintf( chExpectedText, elCount(chExpectedText), "verify is Breakpoint Set  Test_ecc_rom_injection\\10  in Function call side"); 
  A_DBGR_BreakpointSet("Test_ecc_rom_injection\\10");  
  A_DBGR_Go();
  
  snprintf( chActionText, elCount(chActionText), "verify Breakpoint should hit in Test_ecc_rom_injection\\10"); 
  snprintf( chExpectedText, elCount(chExpectedText), "Breakpoint hit in  Test_ecc_rom_injection\\10 function"); 
  E_DBGR_BreakpointCheckForHalt("Test_ecc_rom_injection\\10");
  /***************************************************************************************************************/    
                                              // Test Step2 Update the rom_payload variable to minimum value 
  /***************************************************************************************************************/
  snprintf( chActionText, elCount(chActionText), "Set the ecc_rom_payload variable  to minimum value"); 
  snprintf( chExpectedText, elCount(chExpectedText), "verify ecc_rom_payload variable to minimum value");
  TestStepAddActionExpected( chActionText, chExpectedText );
  A_DBGR_VariableSet("test_ecc_rom_payload[0]","127");
  E_DBGR_VariableCheck("test_ecc_rom_payload[0]",127,Equal);
  
  /***************************************************************************************************************/    
                                              // Test Step3 add break point at function defination side 
  /***************************************************************************************************************/
  snprintf( chActionText, elCount(chActionText), "Set Breakpoint in GetHWIO_y_ROM_FailedCPU_Specific Function defination  side  "); 
  snprintf( chExpectedText, elCount(chExpectedText), "verify is Breakpoint Set GetHWIO_y_ROM_FailedCPU_Specific in funaction defination side"); 
  TestStepAddActionExpected( chActionText, chExpectedText );
  A_DBGR_BreakpointSet("GetHWIO_y_ROM_FailedCPU_Specific");

  A_DBGR_Go();
  snprintf( chActionText, elCount(chActionText), "verify Breakpoint should hit in GetHWIO_y_ROM_FailedCPU_Specific function defination side  "); 
  snprintf( chExpectedText, elCount(chExpectedText), "Breakpoint hit in GetHWIO_y_ROM_FailedCPU_Specific function function defination side "); 
  E_DBGR_BreakpointCheckForHalt("GetHWIO_y_ROM_FailedCPU_Specific");
  
  snprintf( chActionText, elCount(chActionText), "verify Breakpoint should hit in GetHWIO_y_ROM_FailedCPU_Specific function defination side  "); 
  snprintf( chExpectedText, elCount(chExpectedText), "Breakpoint hit in GetHWIO_y_ROM_FailedCPU_Specific function function defination side "); 
  TestStepAddActionExpected( chActionText, chExpectedText );
  E_DBGR_RegisterCheck("D:0x30001F5C","7F");
  
}
testcase To_verify_the_Max_value_GetHWIO_y_ROM_FailedCPU_Specific_Software_interface() 
{
  /***************************************************************************************************************/    
                                              // Test Case Info
  /***************************************************************************************************************/
  setWriteDbgLevel(DebugOff);
  snprintf( chTestTitle, elCount(chTestTitle), "To_verify_the_GetHWIO_y_ROM_FailedCPU_Specific_Software_interface" );
  snprintf( chTestDescription, elCount(chTestDescription), "Purpose:To check the GetHWIO_y_ROM_FailedCPU_Specific_Software_interface");
  TestCaseAddInfo( chTestTitle, "TC_L30SW_Q-36623750", chTestDescription );
  
  /***************************************************************************************************************/    
                                              // Start of Test Case
  /***************************************************************************************************************/
  
  /***************************************************************************************************************/    
                                              // Test Step 0 PRECONDITIONS
  /***************************************************************************************************************/
  snprintf( chActionText, elCount(chActionText), "Flash the Software and ECU is running "); 
  snprintf( chExpectedText, elCount(chExpectedText), "Ecu is should be in running state"); 
  TestStepAddActionExpected( chActionText, chExpectedText );
  A_DBGR_BreakpointDeleteAll();
  A_DBGR_R();
  /***************************************************************************************************************/    
                                              // Test Step 1 updateing  counter value to 0
  /***************************************************************************************************************/
  snprintf( chActionText, elCount(chActionText), "Set Breakpoint in Test_ecc_ram_injection  Function call side  "); 
  snprintf( chExpectedText, elCount(chExpectedText), "verify is Breakpoint Set Test_ecc_ram_injection in Function call side"); 
  A_DBGR_BreakpointSet("Test_ecc_rom_injection");  
  A_DBGR_Go();
  
  
  E_DBGR_BreakpointCheckForHalt("Test_ecc_rom_injection");
  snprintf( chActionText, elCount(chActionText), "Set the Conter variable value to 0"); 
  snprintf( chExpectedText, elCount(chExpectedText), "verify Conter variable value to 0");
  TestStepAddActionExpected( chActionText, chExpectedText );
  A_DBGR_VariableSet("count","0");
  E_DBGR_VariableCheck("count",0,Equal);
  snprintf( chActionText, elCount(chActionText), "Check the break points are deleted"); 
  snprintf( chExpectedText, elCount(chExpectedText), "verify is Breakpoints are  deleted ");
  TestStepAddActionExpected( chActionText, chExpectedText );
  A_DBGR_BreakpointDeleteAll();

  /***************************************************************************************************************/    
                                              // Test Step 1 Add the break point at function call side 
  /***************************************************************************************************************/
  snprintf( chActionText, elCount(chActionText), "Set Breakpoint in  Test_ecc_rom_injection\\10  Function call side  "); 
  snprintf( chExpectedText, elCount(chExpectedText), "verify is Breakpoint Set  Test_ecc_rom_injection\\10  in Function call side"); 
  A_DBGR_BreakpointSet("Test_ecc_rom_injection\\10");  
  A_DBGR_Go();
  
  snprintf( chActionText, elCount(chActionText), "verify Breakpoint should hit in Test_ecc_rom_injection\\10"); 
  snprintf( chExpectedText, elCount(chExpectedText), "Breakpoint hit in  Test_ecc_rom_injection\\10 function"); 
  E_DBGR_BreakpointCheckForHalt("Test_ecc_rom_injection\\10");
  /***************************************************************************************************************/    
                                              // Test Step2 Update the rom_payload variable to maximum value 
  /***************************************************************************************************************/
  snprintf( chActionText, elCount(chActionText), "Set the ecc_rom_payload variable  to maximum value"); 
  snprintf( chExpectedText, elCount(chExpectedText), "verify ecc_rom_payload variable to maximum value");
  TestStepAddActionExpected( chActionText, chExpectedText );
  A_DBGR_VariableSet("test_ecc_rom_payload[0]","255");
  E_DBGR_VariableCheck("test_ecc_rom_payload[0]",255,Equal);
  
  /***************************************************************************************************************/    
                                              // Test Step3 add break point at function defination side 
  /***************************************************************************************************************/
  snprintf( chActionText, elCount(chActionText), "Set Breakpoint in GetHWIO_y_ROM_FailedCPU_Specific Function defination  side  "); 
  snprintf( chExpectedText, elCount(chExpectedText), "verify is Breakpoint Set GetHWIO_y_ROM_FailedCPU_Specific in funaction defination side"); 
  TestStepAddActionExpected( chActionText, chExpectedText );
  A_DBGR_BreakpointSet("GetHWIO_y_ROM_FailedCPU_Specific");

  A_DBGR_Go();
  snprintf( chActionText, elCount(chActionText), "verify Breakpoint should hit in GetHWIO_y_ROM_FailedCPU_Specific function defination side  "); 
  snprintf( chExpectedText, elCount(chExpectedText), "Breakpoint hit in GetHWIO_y_ROM_FailedCPU_Specific function function defination side "); 
  //E_DBGR_BreakpointCheckForHalt("GetHWIO_y_ROM_FailedCPU_Specific");
  E_DBGR_CheckState(T32_State_Stopped);
  
  snprintf( chActionText, elCount(chActionText), "verify Breakpoint should hit in GetHWIO_y_ROM_FailedCPU_Specific function defination side  "); 
  snprintf( chExpectedText, elCount(chExpectedText), "Breakpoint hit in GetHWIO_y_ROM_FailedCPU_Specific function function defination side "); 
  TestStepAddActionExpected( chActionText, chExpectedText );
  E_DBGR_RegisterCheck("D:0x30001F5C","FF");
  
}
testcase To_verify_the_GetSDLAdaptor_y_ROM_FailedCPU_Specific_Software_interface() 
{
  /***************************************************************************************************************/    
                                              // Test Case Info
  /***************************************************************************************************************/
  setWriteDbgLevel(DebugOff);
  snprintf( chTestTitle, elCount(chTestTitle), "To_verify_the_GetSDLAdaptor_y_ROM_FailedCPU_Specific_Software_interface" );
  snprintf( chTestDescription, elCount(chTestDescription), "Purpose:To check the GetSDLAdaptor_y_ROM_FailedCPU_Specific_Software_interface");
  TestCaseAddInfo( chTestTitle, "TC_L30SW_Q-36623750", chTestDescription );
  
  /***************************************************************************************************************/    
                                              // Start of Test Case
  /***************************************************************************************************************/
  
  /***************************************************************************************************************/    
                                              // Test Step 0 PRECONDITIONS
  /***************************************************************************************************************/
  snprintf( chActionText, elCount(chActionText), "Flash the Software and ECU is running "); 
  snprintf( chExpectedText, elCount(chExpectedText), "Ecu is should be in running state"); 
  TestStepAddActionExpected( chActionText, chExpectedText );
  A_DBGR_BreakpointDeleteAll();
  A_DBGR_R();

  /***************************************************************************************************************/    
                                              // Test Step 1 Add the break point at function call side 
  /***************************************************************************************************************/
  snprintf( chActionText, elCount(chActionText), "Set Breakpoint in  GetHWIO_y_ROM_FailedCPU_Specific Function call side  "); 
  snprintf( chExpectedText, elCount(chExpectedText), "verify is Breakpoint Set GetHWIO_y_ROM_FailedCPU_Specific  in Function call side"); 
  A_DBGR_BreakpointSet("GetHWIO_y_ROM_FailedCPU_Specific");  
  A_DBGR_Go();
  
  snprintf( chActionText, elCount(chActionText), "verify Breakpoint should hit in GetHWIO_y_ROM_FailedCPU_Specific"); 
  snprintf( chExpectedText, elCount(chExpectedText), "Breakpoint hit in GetHWIO_y_ROM_FailedCPU_Specific function"); 
  E_DBGR_BreakpointCheckForHalt("GetHWIO_y_ROM_FailedCPU_Specific");
  /***************************************************************************************************************/    
                                              // Test Step2 add break point at function defination side 
  /***************************************************************************************************************/
  snprintf( chActionText, elCount(chActionText), "Set Breakpoint in GetSDLAdaptor_y_ROM_FailedCPU_Specific  Function defination  side  "); 
  snprintf( chExpectedText, elCount(chExpectedText), "verify is Breakpoint Set GetSDLAdaptor_y_ROM_FailedCPU_Specific in funaction defination side"); 
  TestStepAddActionExpected( chActionText, chExpectedText );
  A_DBGR_BreakpointSet("GetSDLAdaptor_y_ROM_FailedCPU_Specific"); 

  A_DBGR_Go();
  snprintf( chActionText, elCount(chActionText), "verify Breakpoint should hit in GetSDLAdaptor_y_ROM_FailedCPU_Specific function defination side  "); 
  snprintf( chExpectedText, elCount(chExpectedText), "Breakpoint hit in GetSDLAdaptor_y_ROM_FailedCPU_Specific function function defination side "); 
  E_DBGR_BreakpointCheckForHalt("GetSDLAdaptor_y_ROM_FailedCPU_Specific");
}
testcase To_verify_the_ClrHWIO_ROM_Flt_Software_interface() 
{
  /***************************************************************************************************************/    
                                              // Test Case Info
  /***************************************************************************************************************/
  setWriteDbgLevel(DebugOff);
  snprintf( chTestTitle, elCount(chTestTitle), "To_verify_the_ClrHWIO_ROM_Flt_Software_interface" );
  snprintf( chTestDescription, elCount(chTestDescription), "Purpose:To check the ClrHWIO_ROM_Flt_Software_interface");
  TestCaseAddInfo( chTestTitle, "TC_L30SW_Q-36623750", chTestDescription );
  
  /***************************************************************************************************************/    
                                              // Start of Test Case
  /***************************************************************************************************************/
  
  /***************************************************************************************************************/    
                                              // Test Step 0 PRECONDITIONS
  /***************************************************************************************************************/
  snprintf( chActionText, elCount(chActionText), "Flash the Software and ECU is running "); 
  snprintf( chExpectedText, elCount(chExpectedText), "Ecu is should be in running state"); 
  TestStepAddActionExpected( chActionText, chExpectedText );
  A_DBGR_BreakpointDeleteAll();
  A_DBGR_R();

  /***************************************************************************************************************/    
                                              // Test Step 1 Add the break point at function call side 
  /***************************************************************************************************************/
  snprintf( chActionText, elCount(chActionText), "Set Breakpoint in Test_ecc_rom_injection\\11 Function call side  "); 
  snprintf( chExpectedText, elCount(chExpectedText), "verify is Breakpoint Set Test_ecc_rom_injection\\11 in Function call side"); 
  A_DBGR_BreakpointSet("Test_ecc_rom_injection\\11");  
  A_DBGR_Go();
  
  snprintf( chActionText, elCount(chActionText), "verify Breakpoint should hit in Test_ecc_rom_injection\\11 "); 
  snprintf( chExpectedText, elCount(chExpectedText), "Breakpoint hit in Test_ecc_rom_injection\\11 function"); 
  E_DBGR_BreakpointCheckForHalt("Test_ecc_rom_injection\\11");
  /***************************************************************************************************************/    
                                              // Test Step2 add break point at function defination side 
  /***************************************************************************************************************/
  snprintf( chActionText, elCount(chActionText), "Set Breakpoint in ClrHWIO_ROM_Flt Function defination  side  "); 
  snprintf( chExpectedText, elCount(chExpectedText), "verify is Breakpoint Set ClrHWIO_ROM_Flt in funaction defination side"); 
  TestStepAddActionExpected( chActionText, chExpectedText );
  A_DBGR_BreakpointSet("ClrHWIO_ROM_Flt"); 

  A_DBGR_Go();
  snprintf( chActionText, elCount(chActionText), "verify Breakpoint should hit in ClrHWIO_ROM_Flt function defination side  "); 
  snprintf( chExpectedText, elCount(chExpectedText), "Breakpoint hit in ClrHWIO_ROM_Flt function function defination side "); 
  E_DBGR_BreakpointCheckForHalt("ClrHWIO_ROM_Flt");
}
testcase To_verify_the_ClrSDLAdaptor_ROM_Flt_Software_interface() 
{
  /***************************************************************************************************************/    
                                              // Test Case Info
  /***************************************************************************************************************/
  setWriteDbgLevel(DebugOff);
  snprintf( chTestTitle, elCount(chTestTitle), "To_verify_the_ClrSDLAdaptor_ROM_Flt_Software_interface" );
  snprintf( chTestDescription, elCount(chTestDescription), "Purpose:To check the ClrSDLAdaptor_ROM_Flt_Software_interface");
  TestCaseAddInfo( chTestTitle, "TC_L30SW_Q-36623750", chTestDescription );
  
  /***************************************************************************************************************/    
                                              // Start of Test Case
  /***************************************************************************************************************/
  
  /***************************************************************************************************************/    
                                              // Test Step 0 PRECONDITIONS
  /***************************************************************************************************************/
  snprintf( chActionText, elCount(chActionText), "Flash the Software and ECU is running "); 
  snprintf( chExpectedText, elCount(chExpectedText), "Ecu is should be in running state"); 
  TestStepAddActionExpected( chActionText, chExpectedText );
  A_DBGR_BreakpointDeleteAll();
  A_DBGR_R();

  /***************************************************************************************************************/    
                                              // Test Step 1 Add the break point at function call side 
  /***************************************************************************************************************/
  snprintf( chActionText, elCount(chActionText), "Set Breakpoint in ClrHWIO_ROM_Flt Function call side  "); 
  snprintf( chExpectedText, elCount(chExpectedText), "verify is Breakpoint Set ClrHWIO_ROM_Flt in Function call side"); 
  A_DBGR_BreakpointSet("ClrHWIO_ROM_Flt");  
  A_DBGR_Go();
  
  snprintf( chActionText, elCount(chActionText), "verify Breakpoint should hit in ClrHWIO_ROM_Flt"); 
  snprintf( chExpectedText, elCount(chExpectedText), "Breakpoint hit in ClrHWIO_ROM_Flt function"); 
  E_DBGR_BreakpointCheckForHalt("ClrHWIO_ROM_Flt");
  /***************************************************************************************************************/    
                                              // Test Step2 add break point at function defination side 
  /***************************************************************************************************************/
  snprintf( chActionText, elCount(chActionText), "Set Breakpoint in ClrSDLAdaptor_ROM_Flt  Function defination  side  "); 
  snprintf( chExpectedText, elCount(chExpectedText), "verify is Breakpoint Set ClrSDLAdaptor_ROM_Flt in funaction defination side"); 
  TestStepAddActionExpected( chActionText, chExpectedText );
  A_DBGR_BreakpointSet("ClrSDLAdaptor_ROM_Flt"); 


  A_DBGR_Go();
  //TestStepAddActionExpected( chActionText, chExpectedText );
  snprintf( chActionText, elCount(chActionText), "verify Breakpoint should hit in ClrSDLAdaptor_ROM_Flt function defination side  "); 
  snprintf( chExpectedText, elCount(chExpectedText), "Breakpoint hit in ClrSDLAdaptor_ROM_Flt function function defination side "); 
  E_DBGR_BreakpointCheckForHalt("ClrSDLAdaptor_ROM_Flt");
}

/***************************************************************************************************************/    
                                              // RAM_SWIT_Testcases
/***************************************************************************************************************/
testcase To_verify_the_SDLAdaptor_init_RAM_Software_interface() 
{
  /***************************************************************************************************************/    
                                              // Test Case Info
  /***************************************************************************************************************/
  setWriteDbgLevel(DebugOff);
  snprintf( chTestTitle, elCount(chTestTitle), "To_verify_the_SDLAdaptor_init_Software_interface" );
  snprintf( chTestDescription, elCount(chTestDescription), "Purpose:To check the To_verify_the_SDLAdaptor_init_Software_interface_interface");
  TestCaseAddInfo( chTestTitle, "TC_L30SW_Q-36623750", chTestDescription);
  
  /***************************************************************************************************************/    
                                              // Start of Test Case
  /***************************************************************************************************************/
  
  /***************************************************************************************************************/    
                                              // Test Step 0 PRECONDITIONS
  /***************************************************************************************************************/
  snprintf( chActionText, elCount(chActionText), "Flash the Software and ECU is running"); 
  snprintf( chExpectedText, elCount(chExpectedText), "Ecu is should be in running state"); 
  TestStepAddActionExpected(chActionText, chExpectedText);
  A_DBGR_BreakpointDeleteAll();
  A_DBGR_R();

  /***************************************************************************************************************/    
                                              // Test Step 1 Add the break point at function call side 
  /***************************************************************************************************************/
  snprintf( chActionText, elCount(chActionText), "Set Breakpoint in App_MCALInit\\52 Function call side"); 
  snprintf( chExpectedText, elCount(chExpectedText), "verify is Breakpoint Set App_MCALInit\\52 in Function call side"); 
  A_DBGR_BreakpointSet("App_MCALInit\\52");  
  A_DBGR_Go();
  
  snprintf( chExpectedText, elCount(chExpectedText), "Breakpoint hit in App_MCALInit\\52 function"); 
  E_DBGR_BreakpointCheckForHalt("App_MCALInit\\52");
  /***************************************************************************************************************/    
                                              // Test Step2 add break point at function defination side 
  /***************************************************************************************************************/
  snprintf( chActionText, elCount(chActionText), "Set Breakpoint in SDLAdaptor_init  Function defination  side "); 
  snprintf( chExpectedText, elCount(chExpectedText), "verify is Breakpoint Set SDLAdaptor_init in funaction defination side"); 
  TestStepAddActionExpected( chActionText, chExpectedText);
  A_DBGR_BreakpointSet("SDLAdaptor_init");

  A_DBGR_Go();
  
  snprintf( chActionText, elCount(chActionText), "verify Breakpoint should hit in SDLAdaptor_init function defination side"); 
  snprintf( chExpectedText, elCount(chExpectedText), "Breakpoint hit in SDLAdaptor_init function function defination side ");
  E_DBGR_BreakpointCheckForHalt("SDLAdaptor_init");
}
testcase To_verify_the_SDLAdaptor_run_RAM_Software_interface() 
{
  /***************************************************************************************************************/    
                                              // Test Case Info
  /***************************************************************************************************************/
  setWriteDbgLevel(DebugOff);
  snprintf( chTestTitle, elCount(chTestTitle), "To_verify_the_Os_Entry_OS_SMUSafety_ISR1_Software_interface" );
  snprintf( chTestDescription, elCount(chTestDescription), "Purpose:To check the Os_Entry_OS_SMUSafety_ISR1_Software_interface");
  TestCaseAddInfo( chTestTitle, "TC_L30SW_Q-36623750", chTestDescription );
  
  /***************************************************************************************************************/    
                                              // Start of Test Case
  /***************************************************************************************************************/
  
  /***************************************************************************************************************/    
                                              // Test Step 0 PRECONDITIONS
  /***************************************************************************************************************/
  snprintf( chActionText, elCount(chActionText), "Flash the Software and ECU is running "); 
  snprintf( chExpectedText, elCount(chExpectedText), "Ecu is should be in running state"); 
  TestStepAddActionExpected( chActionText, chExpectedText );
  A_DBGR_BreakpointDeleteAll();
  A_DBGR_R();

  /***************************************************************************************************************/    
                                              // Test Step 1 Add the break point at function call side 
  /***************************************************************************************************************/
  snprintf( chActionText, elCount(chActionText), "Set Breakpoint in  Os_Entry_Task_Core0_10ms\\10 Function call side  "); 
  snprintf( chExpectedText, elCount(chExpectedText), "verify is Breakpoint Set  Os_Entry_Task_Core0_10ms\\10 in Function call side"); 
  A_DBGR_BreakpointSet("Os_Entry_Task_Core0_10ms\\10");  
  A_DBGR_Go();
  
  snprintf( chActionText, elCount(chActionText), "Set Breakpoint in  Os_Entry_Task_Core0_10ms\\10 Function call side  ");
  snprintf( chExpectedText, elCount(chExpectedText), "Breakpoint hit in  Os_Entry_Task_Core0_10ms\\10 function"); 
  E_DBGR_BreakpointCheckForHalt("Os_Entry_Task_Core0_10ms\\10");
  /***************************************************************************************************************/    
                                              // Test Step2 add break point at function defination side 
  /***************************************************************************************************************/
  snprintf( chActionText, elCount(chActionText), "Set Breakpoint in SDLAdaptor_run  Function defination  side  "); 
  snprintf( chExpectedText, elCount(chExpectedText), "verify is Breakpoint Set SDLAdaptor_run in funaction defination side"); 
  TestStepAddActionExpected( chActionText, chExpectedText );
  A_DBGR_BreakpointSet("SDLAdaptor_run"); 

  A_DBGR_Go();
  snprintf( chActionText, elCount(chActionText), "verify Breakpoint should hit in SDLAdaptor_run function defination side  "); 
  snprintf( chExpectedText, elCount(chExpectedText), "Breakpoint hit in SDLAdaptor_run function function defination side "); 
  E_DBGR_BreakpointCheckForHalt("SDLAdaptor_run");
}
testcase To_verify_the_GetHWIO_e_RAM_Flt_Software_interface() 
{
  /***************************************************************************************************************/    
                                              // Test Case Info
  /***************************************************************************************************************/
  setWriteDbgLevel(DebugOff);
  snprintf( chTestTitle, elCount(chTestTitle), "To_verify_the_GetHWIO_e_RAM_Flt_Software_interface" );
  snprintf( chTestDescription, elCount(chTestDescription), "Purpose:To check the GetHWIO_e_RAM_Flt_Software_interface");
  TestCaseAddInfo( chTestTitle, "TC_L30SW_Q-36623750", chTestDescription );
  
  /***************************************************************************************************************/    
                                              // Start of Test Case
  /***************************************************************************************************************/
  
  /***************************************************************************************************************/    
                                              // Test Step 0 PRECONDITIONS
  /***************************************************************************************************************/
  snprintf( chActionText, elCount(chActionText), "Flash the Software and ECU is running "); 
  snprintf( chExpectedText, elCount(chExpectedText), "Ecu is should be in running state"); 
  TestStepAddActionExpected( chActionText, chExpectedText );
  A_DBGR_BreakpointDeleteAll();
  A_DBGR_R();
  /***************************************************************************************************************/    
                                              // Test Step 1 updateing  counter value to 0
  /***************************************************************************************************************/
  snprintf( chActionText, elCount(chActionText), "Set Breakpoint in Test_ecc_ram_injection  Function call side  "); 
  snprintf( chExpectedText, elCount(chExpectedText), "verify is Breakpoint Set Test_ecc_ram_injection in Function call side"); 
  A_DBGR_BreakpointSet("Test_ecc_ram_injection");  
  A_DBGR_Go();
  
  
  E_DBGR_BreakpointCheckForHalt("Test_ecc_ram_injection");
  snprintf( chActionText, elCount(chActionText), "Set the Conter variable value to 0"); 
  snprintf( chExpectedText, elCount(chExpectedText), "verify Conter variable value to 0");
  TestStepAddActionExpected( chActionText, chExpectedText );
  A_DBGR_VariableSet("count","0");
  E_DBGR_VariableCheck("count",0,Equal);
  snprintf( chActionText, elCount(chActionText), "Check the break points are deleted"); 
  snprintf( chExpectedText, elCount(chExpectedText), "verify is Breakpoints are  deleted ");
  TestStepAddActionExpected( chActionText, chExpectedText );
  A_DBGR_BreakpointDeleteAll();

  /***************************************************************************************************************/    
                                              // Test Step 2 Add the break point at function call side 
  /***************************************************************************************************************/
  snprintf( chActionText, elCount(chActionText), "Set Breakpoint in Test_ecc_ram_injection\\6  Function call side  "); 
  snprintf( chExpectedText, elCount(chExpectedText), "verify is Breakpoint Set Test_ecc_ram_injection\\6 in Function call side"); 
  A_DBGR_BreakpointSet("Test_ecc_ram_injection\\6");  
  A_DBGR_Go();
  
  snprintf( chActionText, elCount(chActionText), "Set Breakpoint in Test_ecc_ram_injection\\6  Function call side  ");
  snprintf( chExpectedText, elCount(chExpectedText), "Breakpoint hit in Test_ecc_ram_injection\\6 function"); 
  E_DBGR_BreakpointCheckForHalt("Test_ecc_ram_injection\\6");
  /***************************************************************************************************************/    
                                              // Test Step3 add break point at function defination side 
  /***************************************************************************************************************/
  snprintf( chActionText, elCount(chActionText), "Set Breakpoint in GetHWIO_e_RAM_Flt Function defination  side  "); 
  snprintf( chExpectedText, elCount(chExpectedText), "verify is Breakpoint Set GetHWIO_e_RAM_Flt in funaction defination side"); 
  TestStepAddActionExpected( chActionText, chExpectedText );
  A_DBGR_BreakpointSet("GetHWIO_e_RAM_Flt"); 

  A_DBGR_Go();
  snprintf( chActionText, elCount(chActionText), "verify Breakpoint should hit in GetHWIO_e_RAM_Flt function defination side  "); 
  snprintf( chExpectedText, elCount(chExpectedText), "Breakpoint hit in GetHWIO_e_RAM_Flt function function defination side "); 
  E_DBGR_BreakpointCheckForHalt("GetHWIO_e_RAM_Flt");
}
testcase To_verify_the_GetSDLAdaptor_e_RAM_Flt_Software_interface() 
{
  /***************************************************************************************************************/    
                                              // Test Case Info
  /***************************************************************************************************************/
  setWriteDbgLevel(DebugOff);
  snprintf( chTestTitle, elCount(chTestTitle), "To_verify_the_GetSDLAdaptor_e_RAM_Flt_Software_interface" );
  snprintf( chTestDescription, elCount(chTestDescription), "Purpose:To check the_GetSDLAdaptor_e_RAM_Flt_Software_interface");
  TestCaseAddInfo( chTestTitle, "TC_L30SW_Q-36623750", chTestDescription );
  
  /***************************************************************************************************************/    
                                              // Start of Test Case
  /***************************************************************************************************************/
  
  /***************************************************************************************************************/    
                                              // Test Step 0 PRECONDITIONS
  /***************************************************************************************************************/
  snprintf( chActionText, elCount(chActionText), "Flash the Software and ECU is running "); 
  snprintf( chExpectedText, elCount(chExpectedText), "Ecu is should be in running state"); 
  TestStepAddActionExpected( chActionText, chExpectedText );
  A_DBGR_BreakpointDeleteAll();
  A_DBGR_R();
  /***************************************************************************************************************/    
                                              // Test Step 1 updateing  counter value to 0
  /***************************************************************************************************************/
  snprintf( chActionText, elCount(chActionText), "Set Breakpoint in Test_ecc_ram_injection  Function call side  "); 
  snprintf( chExpectedText, elCount(chExpectedText), "verify is Breakpoint Set Test_ecc_ram_injection in Function call side"); 
  A_DBGR_BreakpointSet("Test_ecc_ram_injection");  
  A_DBGR_Go();
  
  
  E_DBGR_BreakpointCheckForHalt("Test_ecc_ram_injection");
  snprintf( chActionText, elCount(chActionText), "Set the Conter variable value to 0"); 
  snprintf( chExpectedText, elCount(chExpectedText), "verify Conter variable value to 0");
  TestStepAddActionExpected( chActionText, chExpectedText );
  A_DBGR_VariableSet("count","0");
  E_DBGR_VariableCheck("count",0,Equal);
  snprintf( chActionText, elCount(chActionText), "Check the break points are deleted"); 
  snprintf( chExpectedText, elCount(chExpectedText), "verify is Breakpoints are  deleted ");
  TestStepAddActionExpected( chActionText, chExpectedText );
  A_DBGR_BreakpointDeleteAll();
  
  /***************************************************************************************************************/    
                                              // Test Step 2 Add the break point at function call side 
  /***************************************************************************************************************/
  snprintf( chActionText, elCount(chActionText), "Set Breakpoint in Test_ecc_ram_injection\\6  Function call side  "); 
  snprintf( chExpectedText, elCount(chExpectedText), "verify is Breakpoint Set Test_ecc_ram_injection\\6 in Function call side"); 
  A_DBGR_BreakpointSet("Test_ecc_ram_injection\\6");  
  A_DBGR_Go();
  
  
  snprintf( chActionText, elCount(chActionText), "Set Breakpoint in Test_ecc_ram_injection\\6 Function call side  ");
  snprintf( chExpectedText, elCount(chExpectedText), "Breakpoint hit in Test_ecc_ram_injection\\6 function"); 
  E_DBGR_BreakpointCheckForHalt("Test_ecc_ram_injection\\6");
  /***************************************************************************************************************/    
                                              // Test Step3 add break point at function defination side 
  /***************************************************************************************************************/
  snprintf( chActionText, elCount(chActionText), "Set Breakpoint in GetSDLAdaptor_e_RAM_Flt  Function defination  side  "); 
  snprintf( chExpectedText, elCount(chExpectedText), "verify is Breakpoint Set GetSDLAdaptor_e_RAM_Flt in funaction defination side"); 
  TestStepAddActionExpected( chActionText, chExpectedText );
  A_DBGR_BreakpointSet("GetSDLAdaptor_e_RAM_Flt"); 

  A_DBGR_Go();
  snprintf( chActionText, elCount(chActionText), "verify Breakpoint should hit in GetSDLAdaptor_e_RAM_Flt function defination side  "); 
  snprintf( chExpectedText, elCount(chExpectedText), "Breakpoint hit in GetSDLAdaptor_e_RAM_Flt function function defination side "); 
  E_DBGR_BreakpointCheckForHalt("GetSDLAdaptor_e_RAM_Flt");
}
testcase To_verify_the_GetHWIO_y_RAM_AddressFailed_Software_interface() 
{
  /***************************************************************************************************************/    
                                              // Test Case Info
  /***************************************************************************************************************/
  setWriteDbgLevel(DebugOff);
  snprintf( chTestTitle, elCount(chTestTitle), "To_verify_the_GetHWIO_y_RAM_AddressFailed_Software_interface" );
  snprintf( chTestDescription, elCount(chTestDescription), "Purpose:To check the GetHWIO_y_RAM_AddressFailed_Software_interface");
  TestCaseAddInfo( chTestTitle, "TC_L30SW_Q-36623750", chTestDescription );
  
  /***************************************************************************************************************/    
                                              // Start of Test Case
  /***************************************************************************************************************/
  
  /***************************************************************************************************************/    
                                              // Test Step 0 PRECONDITIONS
  /***************************************************************************************************************/
  snprintf( chActionText, elCount(chActionText), "Flash the Software and ECU is running "); 
  snprintf( chExpectedText, elCount(chExpectedText), "Ecu is should be in running state"); 
  TestStepAddActionExpected( chActionText, chExpectedText );
  A_DBGR_BreakpointDeleteAll();
  A_DBGR_R();
 /***************************************************************************************************************/    
                                              // Test Step 1 updateing  counter value to 0
  /***************************************************************************************************************/
  snprintf( chActionText, elCount(chActionText), "Set Breakpoint in Test_ecc_ram_injection  Function call side  "); 
  snprintf( chExpectedText, elCount(chExpectedText), "verify is Breakpoint Set Test_ecc_ram_injection in Function call side"); 
  A_DBGR_BreakpointSet("Test_ecc_ram_injection");  
  A_DBGR_Go();
  
  
  E_DBGR_BreakpointCheckForHalt("Test_ecc_ram_injection");
  snprintf( chActionText, elCount(chActionText), "Set the Conter variable value to 0"); 
  snprintf( chExpectedText, elCount(chExpectedText), "verify Conter variable value to 0");
  TestStepAddActionExpected( chActionText, chExpectedText );
  A_DBGR_VariableSet("count","0");
  E_DBGR_VariableCheck("count",0,Equal);
  snprintf( chActionText, elCount(chActionText), "Check the break points are deleted"); 
  snprintf( chExpectedText, elCount(chExpectedText), "verify is Breakpoints are  deleted ");
  TestStepAddActionExpected( chActionText, chExpectedText );
  A_DBGR_BreakpointDeleteAll();
  /***************************************************************************************************************/    
                                              // Test Step 2 Add the break point at function call side 
  /***************************************************************************************************************/
  snprintf( chActionText, elCount(chActionText), "Set Breakpoint in Test_ecc_ram_injection\\7  Function call side  "); 
  snprintf( chExpectedText, elCount(chExpectedText), "verify is Breakpoint Set Test_ecc_ram_injection\\7 in Function call side"); 
  A_DBGR_BreakpointSet("Test_ecc_ram_injection\\7");  
  A_DBGR_Go();
  
  snprintf( chActionText, elCount(chActionText), "Set Breakpoint in Test_ecc_ram_injection\\7  Function call side  "); 
  snprintf( chExpectedText, elCount(chExpectedText), "Breakpoint hit in Test_ecc_ram_injection\\7 function"); 
  E_DBGR_BreakpointCheckForHalt("Test_ecc_ram_injection\\7");
  /***************************************************************************************************************/    
                                              // Test Step3 add break point at function defination side 
  /***************************************************************************************************************/
  snprintf( chActionText, elCount(chActionText), "Set Breakpoint in GetHWIO_y_RAM_AddressFailed Function defination  side  "); 
  snprintf( chExpectedText, elCount(chExpectedText), "verify is Breakpoint Set GetHWIO_y_RAM_AddressFailed in funaction defination side"); 
  TestStepAddActionExpected( chActionText, chExpectedText );
  A_DBGR_BreakpointSet("GetHWIO_y_RAM_AddressFailed"); 

  A_DBGR_Go();
  snprintf( chActionText, elCount(chActionText), "verify Breakpoint should hit in GetHWIO_y_RAM_AddressFailed function defination side  "); 
  snprintf( chExpectedText, elCount(chExpectedText), "Breakpoint hit in GetHWIO_y_RAM_AddressFailed function function defination side "); 
  E_DBGR_BreakpointCheckForHalt("GetHWIO_y_RAM_AddressFailed");
}
testcase To_verify_the_GetSDLAdaptor_y_RAM_AddressFailed_Software_interface() 
{
  /***************************************************************************************************************/    
                                              // Test Case Info
  /***************************************************************************************************************/
  setWriteDbgLevel(DebugOff);
  snprintf( chTestTitle, elCount(chTestTitle), "To_verify_the_GetSDLAdaptor_y_RAM_AddressFailed_Software_interface" );
  snprintf( chTestDescription, elCount(chTestDescription), "Purpose:To check the_GetSDLAdaptor_y_RAM_AddressFailed_Software_interface");
  TestCaseAddInfo( chTestTitle, "TC_L30SW_Q-36623750", chTestDescription );
  
  /***************************************************************************************************************/    
                                              // Start of Test Case
  /***************************************************************************************************************/
  
  /***************************************************************************************************************/    
                                              // Test Step 0 PRECONDITIONS
  /***************************************************************************************************************/
  snprintf( chActionText, elCount(chActionText), "Flash the Software and ECU is running "); 
  snprintf( chExpectedText, elCount(chExpectedText), "Ecu is should be in running state"); 
  TestStepAddActionExpected( chActionText, chExpectedText );
  A_DBGR_BreakpointDeleteAll();
  A_DBGR_R();
  /***************************************************************************************************************/    
                                              // Test Step 1 updateing  counter value to 0
  /***************************************************************************************************************/
  snprintf( chActionText, elCount(chActionText), "Set Breakpoint in Test_ecc_ram_injection  Function call side  "); 
  snprintf( chExpectedText, elCount(chExpectedText), "verify is Breakpoint Set Test_ecc_ram_injection in Function call side"); 
  A_DBGR_BreakpointSet("Test_ecc_ram_injection");  
  A_DBGR_Go();
  
  
  E_DBGR_BreakpointCheckForHalt("Test_ecc_ram_injection");
  snprintf( chActionText, elCount(chActionText), "Set the Conter variable value to 0"); 
  snprintf( chExpectedText, elCount(chExpectedText), "verify Conter variable value to 0");
  TestStepAddActionExpected( chActionText, chExpectedText );
  A_DBGR_VariableSet("count","0");
  E_DBGR_VariableCheck("count",0,Equal);
  snprintf( chActionText, elCount(chActionText), "Check the break points are deleted"); 
  snprintf( chExpectedText, elCount(chExpectedText), "verify is Breakpoints are  deleted ");
  TestStepAddActionExpected( chActionText, chExpectedText );
  A_DBGR_BreakpointDeleteAll();

  /***************************************************************************************************************/    
                                              // Test Step 2 Add the break point at function call side 
  /***************************************************************************************************************/
  snprintf( chActionText, elCount(chActionText), "Set Breakpoint in Test_ecc_ram_injection\\7 Function call side  "); 
  snprintf( chExpectedText, elCount(chExpectedText), "verify is Breakpoint Set Test_ecc_ram_injection\\7 in Function call side"); 
  A_DBGR_BreakpointSet("Test_ecc_ram_injection\\7");  
  A_DBGR_Go();
   
  snprintf( chExpectedText, elCount(chExpectedText), "Breakpoint hit in Test_ecc_ram_injection\\7 function"); 
  E_DBGR_BreakpointCheckForHalt("Test_ecc_ram_injection\\7");
  /***************************************************************************************************************/    
                                              // Test Step3 add break point at function defination side 
  /***************************************************************************************************************/
  snprintf( chActionText, elCount(chActionText), "Set Breakpoint in GetHWIO_y_RAM_AddressFailed  Function defination  side  "); 
  snprintf( chExpectedText, elCount(chExpectedText), "verify is Breakpoint Set GetHWIO_y_RAM_AddressFailed in funaction defination side"); 
  TestStepAddActionExpected( chActionText, chExpectedText );
  A_DBGR_BreakpointSet("GetHWIO_y_RAM_AddressFailed"); 

  A_DBGR_Go();
  snprintf( chActionText, elCount(chActionText), "verify Breakpoint should hit in GetHWIO_y_RAM_AddressFailed function defination side  "); 
  snprintf( chExpectedText, elCount(chExpectedText), "Breakpoint hit in GetHWIO_y_RAM_AddressFailed function function defination side "); 
  E_DBGR_BreakpointCheckForHalt("GetHWIO_y_RAM_AddressFailed");
}
testcase To_verify_the_GetHWIO_y_RAM_InstAddressFailed_Software_interface() 
{
  /***************************************************************************************************************/    
                                              // Test Case Info
  /***************************************************************************************************************/
  setWriteDbgLevel(DebugOff);
  snprintf( chTestTitle, elCount(chTestTitle), "To_verify_the_GetHWIO_y_RAM_InstAddressFailed_Software_interface" );
  snprintf( chTestDescription, elCount(chTestDescription), "Purpose:To check the GetHWIO_y_RAM_InstAddressFailed_interface");
  TestCaseAddInfo( chTestTitle, "TC_L30SW_Q-36623750", chTestDescription );
  
  /***************************************************************************************************************/    
                                              // Start of Test Case
  /***************************************************************************************************************/
  
  /***************************************************************************************************************/    
                                              // Test Step 0 PRECONDITIONS
  /***************************************************************************************************************/
  snprintf( chActionText, elCount(chActionText), "Flash the Software and ECU is running "); 
  snprintf( chExpectedText, elCount(chExpectedText), "Ecu is should be in running state"); 
  TestStepAddActionExpected( chActionText, chExpectedText );
  A_DBGR_BreakpointDeleteAll();
  A_DBGR_R();
  /***************************************************************************************************************/    
                                              // Test Step 1 updateing  counter value to 0
  /***************************************************************************************************************/
  snprintf( chActionText, elCount(chActionText), "Set Breakpoint in Test_ecc_ram_injection  Function call side  "); 
  snprintf( chExpectedText, elCount(chExpectedText), "verify is Breakpoint Set Test_ecc_ram_injection in Function call side"); 
  A_DBGR_BreakpointSet("Test_ecc_ram_injection");  
  A_DBGR_Go();
  
  
  E_DBGR_BreakpointCheckForHalt("Test_ecc_ram_injection");
  snprintf( chActionText, elCount(chActionText), "Set the Conter variable value to 0"); 
  snprintf( chExpectedText, elCount(chExpectedText), "verify Conter variable value to 0");
  TestStepAddActionExpected( chActionText, chExpectedText );
  A_DBGR_VariableSet("count","0");
  E_DBGR_VariableCheck("count",0,Equal);
  snprintf( chActionText, elCount(chActionText), "Check the break points are deleted"); 
  snprintf( chExpectedText, elCount(chExpectedText), "verify is Breakpoints are  deleted ");
  TestStepAddActionExpected( chActionText, chExpectedText );
  A_DBGR_BreakpointDeleteAll();

  /***************************************************************************************************************/    
                                              // Test Step 2 Add the break point at function call side 
  /***************************************************************************************************************/
  snprintf( chActionText, elCount(chActionText), "Set Breakpoint in Test_ecc_ram_injection\\8  Function call side  "); 
  snprintf( chExpectedText, elCount(chExpectedText), "verify is Breakpoint Set Test_ecc_ram_injection\\8 in Function call side"); 
  A_DBGR_BreakpointSet("Test_ecc_ram_injection\\8");  
  A_DBGR_Go();
  
  snprintf( chActionText, elCount(chActionText), "verify Breakpoint should hit in Test_ecc_ram_injection\\8 "); 
  snprintf( chExpectedText, elCount(chExpectedText), "Breakpoint hit in Test_ecc_ram_injection\\8 function"); 
  E_DBGR_BreakpointCheckForHalt("Test_ecc_ram_injection\\8");
  /***************************************************************************************************************/    
                                              // Test Step2 add break point at function defination side 
  /***************************************************************************************************************/
  snprintf( chActionText, elCount(chActionText), "Set Breakpoint in GetHWIO_y_RAM_InstAddressFailed Function defination  side  "); 
  snprintf( chExpectedText, elCount(chExpectedText), "verify is Breakpoint Set GetHWIO_y_RAM_InstAddressFailed in funaction defination side"); 
  TestStepAddActionExpected( chActionText, chExpectedText );
  A_DBGR_BreakpointSet("GetHWIO_y_RAM_InstAddressFailed"); 

  A_DBGR_Go();
  snprintf( chActionText, elCount(chActionText), "verify Breakpoint should hit in GetHWIO_y_RAM_InstAddressFailed function defination side  "); 
  snprintf( chExpectedText, elCount(chExpectedText), "Breakpoint hit in GetHWIO_y_RAM_InstAddressFailed function function defination side "); 
  E_DBGR_BreakpointCheckForHalt("GetHWIO_y_RAM_InstAddressFailed");
}
testcase To_verify_the_GetSDLAdaptor_y_RAM_InstAddressFailed_Software_interface() 
{
  /***************************************************************************************************************/    
                                              // Test Case Info
  /***************************************************************************************************************/
  setWriteDbgLevel(DebugOff);
  snprintf( chTestTitle, elCount(chTestTitle), "To_verify_the_GetSDLAdaptor_y_RAM_InstAddressFailed_Software_interface" );
  snprintf( chTestDescription, elCount(chTestDescription), "Purpose:To check the_GetSDLAdaptor_y_RAM_InstAddressFailed_Software_interface");
  TestCaseAddInfo( chTestTitle, "TC_L30SW_Q-36623750", chTestDescription );
  
  /***************************************************************************************************************/    
                                              // Start of Test Case
  /***************************************************************************************************************/
  
  /***************************************************************************************************************/    
                                              // Test Step 0 PRECONDITIONS
  /***************************************************************************************************************/
  snprintf( chActionText, elCount(chActionText), "Flash the Software and ECU is running "); 
  snprintf( chExpectedText, elCount(chExpectedText), "Ecu is should be in running state"); 
  TestStepAddActionExpected( chActionText, chExpectedText );
  A_DBGR_BreakpointDeleteAll();
  A_DBGR_R();
  /***************************************************************************************************************/    
                                              // Test Step 1 updateing  counter value to 0
  /***************************************************************************************************************/
  snprintf( chActionText, elCount(chActionText), "Set Breakpoint in Test_ecc_ram_injection  Function call side  "); 
  snprintf( chExpectedText, elCount(chExpectedText), "verify is Breakpoint Set Test_ecc_ram_injection in Function call side"); 
  A_DBGR_BreakpointSet("Test_ecc_ram_injection");  
  A_DBGR_Go();
  
  
  E_DBGR_BreakpointCheckForHalt("Test_ecc_ram_injection");
  snprintf( chActionText, elCount(chActionText), "Set the Conter variable value to 0"); 
  snprintf( chExpectedText, elCount(chExpectedText), "verify Conter variable value to 0");
  TestStepAddActionExpected( chActionText, chExpectedText );
  A_DBGR_VariableSet("count","0");
  E_DBGR_VariableCheck("count",0,Equal);
  snprintf( chActionText, elCount(chActionText), "Check the break points are deleted"); 
  snprintf( chExpectedText, elCount(chExpectedText), "verify is Breakpoints are  deleted ");
  TestStepAddActionExpected( chActionText, chExpectedText );
  A_DBGR_BreakpointDeleteAll();

  /***************************************************************************************************************/    
                                              // Test Step 2 Add the break point at function call side 
  /***************************************************************************************************************/
  snprintf( chActionText, elCount(chActionText), "Set Breakpoint in Test_ecc_ram_injection\\8 Function call side  "); 
  snprintf( chExpectedText, elCount(chExpectedText), "verify is Breakpoint Set Test_ecc_ram_injection\\8 in Function call side"); 
  A_DBGR_BreakpointSet("Test_ecc_ram_injection\\8");  
  A_DBGR_Go();
  
  snprintf( chExpectedText, elCount(chExpectedText), "Breakpoint hit in Test_ecc_ram_injection\\8 function"); 
  E_DBGR_BreakpointCheckForHalt("Test_ecc_ram_injection\\8");
  /***************************************************************************************************************/    
                                              // Test Step3 add break point at function defination side 
  /***************************************************************************************************************/
  snprintf( chActionText, elCount(chActionText), "Set Breakpoint in GetHWIO_y_RAM_InstAddressFailed  Function defination  side  "); 
  snprintf( chExpectedText, elCount(chExpectedText), "verify is Breakpoint Set GetHWIO_y_RAM_InstAddressFailed in funaction defination side"); 
  TestStepAddActionExpected( chActionText, chExpectedText );
  A_DBGR_BreakpointSet("GetHWIO_y_RAM_InstAddressFailed");

  A_DBGR_Go();
  snprintf( chActionText, elCount(chActionText), "verify Breakpoint should hit in GetHWIO_y_RAM_InstAddressFailed function defination side  "); 
  snprintf( chExpectedText, elCount(chExpectedText), "Breakpoint hit in GetHWIO_y_RAM_InstAddressFailed function function defination side "); 
  E_DBGR_BreakpointCheckForHalt("GetHWIO_y_RAM_InstAddressFailed");
}
testcase To_verify_the_ClrHWIO_RAM_Flt_Software_interface() 
{
  /***************************************************************************************************************/    
                                              // Test Case Info
  /***************************************************************************************************************/
  setWriteDbgLevel(DebugOff);
  snprintf( chTestTitle, elCount(chTestTitle), "To_verify_the_ClrHWIO_RAM_Flt_Software_interface" );
  snprintf( chTestDescription, elCount(chTestDescription), "Purpose:To check the ClrHWIO_RAM_Flt_Software_interface");
  TestCaseAddInfo( chTestTitle, "TC_L30SW_Q-36623750", chTestDescription );
  
  /***************************************************************************************************************/    
                                              // Start of Test Case
  /***************************************************************************************************************/
  
  /***************************************************************************************************************/    
                                              // Test Step 0 PRECONDITIONS
  /***************************************************************************************************************/
  snprintf( chActionText, elCount(chActionText), "Flash the Software and ECU is running "); 
  snprintf( chExpectedText, elCount(chExpectedText), "Ecu is should be in running state"); 
  TestStepAddActionExpected( chActionText, chExpectedText );
  A_DBGR_BreakpointDeleteAll();
  A_DBGR_R();
 /***************************************************************************************************************/    
                                              // Test Step 1 updateing  counter value to 0
  /***************************************************************************************************************/
  snprintf( chActionText, elCount(chActionText), "Set Breakpoint in Test_ecc_ram_injection  Function call side  "); 
  snprintf( chExpectedText, elCount(chExpectedText), "verify is Breakpoint Set Test_ecc_ram_injection in Function call side"); 
  A_DBGR_BreakpointSet("Test_ecc_ram_injection");  
  A_DBGR_Go();
  
  
  E_DBGR_BreakpointCheckForHalt("Test_ecc_ram_injection");
  snprintf( chActionText, elCount(chActionText), "Set the Conter variable value to 0"); 
  snprintf( chExpectedText, elCount(chExpectedText), "verify Conter variable value to 0");
  TestStepAddActionExpected( chActionText, chExpectedText );
  A_DBGR_VariableSet("count","0");
  E_DBGR_VariableCheck("count",0,Equal);
  snprintf( chActionText, elCount(chActionText), "Check the break points are deleted"); 
  snprintf( chExpectedText, elCount(chExpectedText), "verify is Breakpoints are  deleted ");
  TestStepAddActionExpected( chActionText, chExpectedText );
  A_DBGR_BreakpointDeleteAll();
  /***************************************************************************************************************/    
                                              // Test Step 2 Add the break point at function call side 
  /***************************************************************************************************************/
  snprintf( chActionText, elCount(chActionText), "Set Breakpoint in Test_ecc_ram_injection\\10  Function call side  "); 
  snprintf( chExpectedText, elCount(chExpectedText), "verify is Breakpoint Set Test_ecc_ram_injection\\10 in Function call side"); 
  A_DBGR_BreakpointSet("Test_ecc_ram_injection\\10");  
  A_DBGR_Go();
  
  snprintf( chActionText, elCount(chActionText), "verify Breakpoint should hit in core0_main\\20 "); 
  snprintf( chExpectedText, elCount(chExpectedText), "Breakpoint hit in Test_ecc_ram_injection\\10 function"); 
  E_DBGR_BreakpointCheckForHalt("Test_ecc_ram_injection\\10");
  /***************************************************************************************************************/    
                                              // Test Step3 add break point at function defination side 
  /***************************************************************************************************************/
  snprintf( chActionText, elCount(chActionText), "Set Breakpoint in ClrHWIO_RAM_Flt Function defination  side  "); 
  snprintf( chExpectedText, elCount(chExpectedText), "verify is Breakpoint Set ClrHWIO_RAM_Flt in funaction defination side"); 
  TestStepAddActionExpected( chActionText, chExpectedText );
  A_DBGR_BreakpointSet("ClrHWIO_RAM_Flt"); 


  A_DBGR_Go();
  snprintf( chActionText, elCount(chActionText), "verify Breakpoint should hit in ClrHWIO_RAM_Flt function defination side  "); 
  snprintf( chExpectedText, elCount(chExpectedText), "Breakpoint hit in ClrHWIO_RAM_Flt function function defination side "); 
  E_DBGR_BreakpointCheckForHalt("ClrHWIO_RAM_Flt");
}
testcase To_verify_the_ClrSDLAdaptor_RAM_Flt_Software_interface() 
{
  /***************************************************************************************************************/    
                                              // Test Case Info
  /***************************************************************************************************************/
  setWriteDbgLevel(DebugOff);
  snprintf( chTestTitle, elCount(chTestTitle), "To_verify_the_ClrSDLAdaptor_RAM_Flt_Software_interface" );
  snprintf( chTestDescription, elCount(chTestDescription), "Purpose:To check the_ClrSDLAdaptor_RAM_Flt_Software_interface");
  TestCaseAddInfo( chTestTitle, "TC_L30SW_Q-36623750", chTestDescription );
  
  /***************************************************************************************************************/    
                                              // Start of Test Case
  /***************************************************************************************************************/
  
  /***************************************************************************************************************/    
                                              // Test Step 0 PRECONDITIONS
  /***************************************************************************************************************/
  snprintf( chActionText, elCount(chActionText), "Flash the Software and ECU is running "); 
  snprintf( chExpectedText, elCount(chExpectedText), "Ecu is should be in running state"); 
  TestStepAddActionExpected( chActionText, chExpectedText );
  A_DBGR_BreakpointDeleteAll();
  A_DBGR_R();
  /***************************************************************************************************************/    
                                              // Test Step 1 updateing  counter value to 0
  /***************************************************************************************************************/
  snprintf( chActionText, elCount(chActionText), "Set Breakpoint in Test_ecc_ram_injection  Function call side  "); 
  snprintf( chExpectedText, elCount(chExpectedText), "verify is Breakpoint Set Test_ecc_ram_injection in Function call side"); 
  A_DBGR_BreakpointSet("Test_ecc_ram_injection");  
  A_DBGR_Go();
  
  
  E_DBGR_BreakpointCheckForHalt("Test_ecc_ram_injection");
  snprintf( chActionText, elCount(chActionText), "Set the Conter variable value to 0"); 
  snprintf( chExpectedText, elCount(chExpectedText), "verify Conter variable value to 0");
  TestStepAddActionExpected( chActionText, chExpectedText );
  A_DBGR_VariableSet("count","0");
  E_DBGR_VariableCheck("count",0,Equal);
  snprintf( chActionText, elCount(chActionText), "Check the break points are deleted"); 
  snprintf( chExpectedText, elCount(chExpectedText), "verify is Breakpoints are  deleted ");
  TestStepAddActionExpected( chActionText, chExpectedText );
  A_DBGR_BreakpointDeleteAll();

  /***************************************************************************************************************/    
                                              // Test Step 2 Add the break point at function call side 
  /***************************************************************************************************************/
  snprintf( chActionText, elCount(chActionText), "Set Breakpoint in ClrHWIO_RAM_Flt Function call side  "); 
  snprintf( chExpectedText, elCount(chExpectedText), "verify is Breakpoint Set ClrHWIO_RAM_Flt in Function call side"); 
  A_DBGR_BreakpointSet("ClrHWIO_RAM_Flt");  
  A_DBGR_Go();
  
  snprintf( chExpectedText, elCount(chExpectedText), "Breakpoint hit in ClrHWIO_RAM_Flt function"); 
  E_DBGR_BreakpointCheckForHalt("ClrHWIO_RAM_Flt");
  /***************************************************************************************************************/    
                                              // Test Step3 add break point at function defination side 
  /***************************************************************************************************************/
  snprintf( chActionText, elCount(chActionText), "Set Breakpoint in ClrSDLAdaptor_RAM_Flt  Function defination  side  "); 
  snprintf( chExpectedText, elCount(chExpectedText), "verify is Breakpoint Set ClrSDLAdaptor_RAM_Flt in funaction defination side"); 
  TestStepAddActionExpected( chActionText, chExpectedText );
  A_DBGR_BreakpointSet("ClrSDLAdaptor_RAM_Flt"); 

  A_DBGR_Go();
  snprintf( chActionText, elCount(chActionText), "verify Breakpoint should hit in ClrSDLAdaptor_RAM_Flt function defination side  "); 
  snprintf( chExpectedText, elCount(chExpectedText), "Breakpoint hit in ClrSDLAdaptor_RAM_Flt function function defination side "); 
  E_DBGR_BreakpointCheckForHalt("ClrSDLAdaptor_RAM_Flt");
}
testcase To_verify_the_Minimum_value_SetHWIO_h_RAM_ECC_Init_Software_interface() 
{
  /***************************************************************************************************************/    
                                              // Test Case Info
  /***************************************************************************************************************/
  setWriteDbgLevel(DebugOff);
  snprintf( chTestTitle, elCount(chTestTitle), "To_verify_the_SetHWIO_h_RAM_ECC_Init_Software_interface" );
  snprintf( chTestDescription, elCount(chTestDescription), "Purpose:To check the SetHWIO_h_RAM_ECC_Init_Software_interface");
  TestCaseAddInfo( chTestTitle, "TC_L30SW_Q-36623750", chTestDescription );
  
  /***************************************************************************************************************/    
                                              // Start of Test Case
  /***************************************************************************************************************/
  
  /***************************************************************************************************************/    
                                              // Test Step 0 PRECONDITIONS
  /***************************************************************************************************************/
  snprintf( chActionText, elCount(chActionText), "Flash the Software and ECU is running "); 
  snprintf( chExpectedText, elCount(chExpectedText), "Ecu is should be in running state"); 
  TestStepAddActionExpected( chActionText, chExpectedText );
  A_DBGR_BreakpointDeleteAll();
  A_DBGR_R();

  /***************************************************************************************************************/    
                                              // Test Step 1 Add the break point at function call side 
  /***************************************************************************************************************/
  snprintf( chActionText, elCount(chActionText), "Set Breakpoint in  App_MCALInit\\83  Function call side  "); 
  snprintf( chExpectedText, elCount(chExpectedText), "verify is Breakpoint Set  App_MCALInit\\83  in Function call side"); 
  A_DBGR_BreakpointSet("App_MCALInit\\83");  
  A_DBGR_Go();
  
  snprintf( chActionText, elCount(chActionText), "verify Breakpoint should hit in App_MCALInit\\83"); 
  snprintf( chExpectedText, elCount(chExpectedText), "Breakpoint hit in  App_MCALInit\\83 function");
  //TestStepAddActionExpected( chActionText, chExpectedText );
  //E_DBGR_BreakpointCheckForHalt(" App_MCALInit\\51");
   E_DBGR_CheckState(T32_State_Stopped);
  /***************************************************************************************************************/    
                                              // Test Step2 Update the rom_payload variable to minimum value 
  /***************************************************************************************************************/
  snprintf( chActionText, elCount(chActionText), "Set the Test_start variable  to minimum value"); 
  snprintf( chExpectedText, elCount(chExpectedText), "verify Test_start variable to minimum value");
  TestStepAddActionExpected( chActionText, chExpectedText );
  A_DBGR_VariableSet("Test_start","0");
  E_DBGR_VariableCheck("Test_start",0,Equal);
  snprintf( chActionText, elCount(chActionText), "Set the Test_length variable  to minimum value"); 
  snprintf( chExpectedText, elCount(chExpectedText), "verify Test_length variable to minimum value");
  TestStepAddActionExpected( chActionText, chExpectedText );
  A_DBGR_VariableSet("Test_length","0");
  E_DBGR_VariableCheck("Test_length",0,Equal);
  snprintf( chActionText, elCount(chActionText), "Set the Test_fill variable  to minimum value"); 
  snprintf( chExpectedText, elCount(chExpectedText), "verify Test_fill variable to minimum value");
  TestStepAddActionExpected( chActionText, chExpectedText );
  A_DBGR_VariableSet("Test_fill","0");
  E_DBGR_VariableCheck("Test_fill",0,Equal);
  /***************************************************************************************************************/    
                                              // Test Step3 add break point at function defination side 
  /***************************************************************************************************************/
  snprintf( chActionText, elCount(chActionText), "Set Breakpoint in SetHWIO_h_RAM_ECC_Init Function defination  side  "); 
  snprintf( chExpectedText, elCount(chExpectedText), "verify is Breakpoint Set SetHWIO_h_RAM_ECC_Init in funaction defination side"); 
  TestStepAddActionExpected( chActionText, chExpectedText );
  A_DBGR_BreakpointSet("SetHWIO_h_RAM_ECC_Init");

  A_DBGR_Go();
  snprintf( chActionText, elCount(chActionText), "verify Breakpoint should hit in SetHWIO_h_RAM_ECC_Init function defination side  "); 
  snprintf( chExpectedText, elCount(chExpectedText), "Breakpoint hit in SetHWIO_h_RAM_ECC_Init function function defination side "); 
  E_DBGR_BreakpointCheckForHalt("SetHWIO_h_RAM_ECC_Init");
  
  snprintf( chActionText, elCount(chActionText), "verify Breakpoint should hit in start function defination side  "); 
  snprintf( chExpectedText, elCount(chExpectedText), "Breakpoint hit in start function function defination side "); 
  TestStepAddActionExpected( chActionText, chExpectedText );
  //E_DBGR_RegisterCheck("D:0x2000008C","0");
  E_DBGR_VariableCheck("start",0,Equal);
  snprintf( chActionText, elCount(chActionText), "Set the length variable  to minimum value"); 
  snprintf( chExpectedText, elCount(chExpectedText), "verify length variable to minimum value");
  TestStepAddActionExpected( chActionText, chExpectedText );
  E_DBGR_VariableCheck("length",0,Equal);
  snprintf( chActionText, elCount(chActionText), "Set the Test_fill variable  to minimum value"); 
  snprintf( chExpectedText, elCount(chExpectedText), "verify fill variable to minimum value");
  TestStepAddActionExpected( chActionText, chExpectedText );
  E_DBGR_VariableCheck("fill ",0,Equal);
  
  
}
testcase To_verify_the_Mid_value_SetHWIO_h_RAM_ECC_Init_Software_interface() 
{
  /***************************************************************************************************************/    
                                              // Test Case Info
  /***************************************************************************************************************/
  setWriteDbgLevel(DebugOff);
  snprintf( chTestTitle, elCount(chTestTitle), "To_verify_the_SetHWIO_h_RAM_ECC_Init_Software_interface" );
  snprintf( chTestDescription, elCount(chTestDescription), "Purpose:To check the SetHWIO_h_RAM_ECC_Init_Software_interface");
  TestCaseAddInfo( chTestTitle, "TC_L30SW_Q-36623750", chTestDescription );
  
  /***************************************************************************************************************/    
                                              // Start of Test Case
  /***************************************************************************************************************/
  
  /***************************************************************************************************************/    
                                              // Test Step 0 PRECONDITIONS
  /***************************************************************************************************************/
  snprintf( chActionText, elCount(chActionText), "Flash the Software and ECU is running "); 
  snprintf( chExpectedText, elCount(chExpectedText), "Ecu is should be in running state"); 
  TestStepAddActionExpected( chActionText, chExpectedText );
  A_DBGR_BreakpointDeleteAll();
  A_DBGR_R();

  /***************************************************************************************************************/    
                                              // Test Step 1 Add the break point at function call side 
  /***************************************************************************************************************/
  snprintf( chActionText, elCount(chActionText), "Set Breakpoint in  App_MCALInit\\83  Function call side  "); 
  snprintf( chExpectedText, elCount(chExpectedText), "verify is Breakpoint Set  App_MCALInit\\83 in Function call side"); 
  A_DBGR_BreakpointSet("App_MCALInit\\83");  
  A_DBGR_Go();
  
  snprintf( chActionText, elCount(chActionText), "verify Breakpoint should hit in App_MCALInit\\83"); 
  snprintf( chExpectedText, elCount(chExpectedText), "Breakpoint hit in  App_MCALInit\\83 function"); 
  //E_DBGR_BreakpointCheckForHalt(" App_MCALInit\\51");
  E_DBGR_CheckState(T32_State_Stopped);
  /***************************************************************************************************************/    
                                              // Test Step2 Update the rom_payload variable to minimum value 
  /***************************************************************************************************************/
  snprintf( chActionText, elCount(chActionText), "Set the Test_start variable  to mid value"); 
  snprintf( chExpectedText, elCount(chExpectedText), "verify Test_start variable to mid value");
  TestStepAddActionExpected( chActionText, chExpectedText );
  A_DBGR_VariableSet("Test_start","0x7FFFFFFF");
  E_DBGR_VariableCheck("Test_start",2147483647,Equal);
  snprintf( chActionText, elCount(chActionText), "Set the Test_length variable  to mid value"); 
  snprintf( chExpectedText, elCount(chExpectedText), "verify Test_length variable to mid value");
  TestStepAddActionExpected( chActionText, chExpectedText );
  A_DBGR_VariableSet("Test_length","2147483647");
  E_DBGR_VariableCheck("Test_length",2147483647,Equal);
  snprintf( chActionText, elCount(chActionText), "Set the Test_fill variable  to mid value"); 
  snprintf( chExpectedText, elCount(chExpectedText), "verify Test_fill variable to mid value");
  TestStepAddActionExpected( chActionText, chExpectedText );
  A_DBGR_VariableSet("Test_fill","2147483647");
  E_DBGR_VariableCheck("Test_fill",2147483647,Equal);
  /***************************************************************************************************************/    
                                              // Test Step3 add break point at function defination side 
  /***************************************************************************************************************/
  snprintf( chActionText, elCount(chActionText), "Set Breakpoint in SetHWIO_h_RAM_ECC_Init Function defination  side  "); 
  snprintf( chExpectedText, elCount(chExpectedText), "verify is Breakpoint Set SetHWIO_h_RAM_ECC_Init in funaction defination side"); 
  TestStepAddActionExpected( chActionText, chExpectedText );
  A_DBGR_BreakpointSet("SetHWIO_h_RAM_ECC_Init");

  A_DBGR_Go();
  snprintf( chActionText, elCount(chActionText), "verify Breakpoint should hit in SetHWIO_h_RAM_ECC_Init function defination side  "); 
  snprintf( chExpectedText, elCount(chExpectedText), "Breakpoint hit in SetHWIO_h_RAM_ECC_Init function function defination side "); 
  E_DBGR_BreakpointCheckForHalt("SetHWIO_h_RAM_ECC_Init");
  
  snprintf( chActionText, elCount(chActionText), "verify Breakpoint should hit in start function defination side  "); 
  snprintf( chExpectedText, elCount(chExpectedText), "Breakpoint hit in start function function defination side "); 
  TestStepAddActionExpected( chActionText, chExpectedText );
  //E_DBGR_RegisterCheck("D:0x2000008C","0");
  E_DBGR_VariableCheck("start ",0x7FFFFFFF,Equal);
  snprintf( chActionText, elCount(chActionText), "Set the length variable  to mid value"); 
  snprintf( chExpectedText, elCount(chExpectedText), "verify length variable to mid value");
  TestStepAddActionExpected( chActionText, chExpectedText );
  E_DBGR_VariableCheck("length",2147483647,Equal);
  snprintf( chActionText, elCount(chActionText), "Set the Test_fill variable  to mid value"); 
  snprintf( chExpectedText, elCount(chExpectedText), "verify fill variable to mid value");
  TestStepAddActionExpected( chActionText, chExpectedText );
  E_DBGR_VariableCheck("fill ",2147483647,Equal);
  
  
}
testcase To_verify_the_Maximum_value_SetHWIO_h_RAM_ECC_Init_Software_interface() 
{
  /***************************************************************************************************************/    
                                              // Test Case Info
  /***************************************************************************************************************/
  setWriteDbgLevel(DebugOff);
  snprintf( chTestTitle, elCount(chTestTitle), "To_verify_the_SetHWIO_h_RAM_ECC_Init_Software_interface" );
  snprintf( chTestDescription, elCount(chTestDescription), "Purpose:To check the SetHWIO_h_RAM_ECC_Init_Software_interface");
  TestCaseAddInfo( chTestTitle, "TC_L30SW_Q-36623750", chTestDescription );
  
  /***************************************************************************************************************/    
                                              // Start of Test Case
  /***************************************************************************************************************/
  
  /***************************************************************************************************************/    
                                              // Test Step 0 PRECONDITIONS
  /***************************************************************************************************************/
  snprintf( chActionText, elCount(chActionText), "Flash the Software and ECU is running "); 
  snprintf( chExpectedText, elCount(chExpectedText), "Ecu is should be in running state"); 
  TestStepAddActionExpected( chActionText, chExpectedText );
  A_DBGR_BreakpointDeleteAll();
  A_DBGR_R();

  /***************************************************************************************************************/    
                                              // Test Step 1 Add the break point at function call side 
  /***************************************************************************************************************/
  snprintf( chActionText, elCount(chActionText), "Set Breakpoint in  App_MCALInit\\83  Function call side  "); 
  snprintf( chExpectedText, elCount(chExpectedText), "verify is Breakpoint Set  App_MCALInit\\83  in Function call side"); 
  A_DBGR_BreakpointSet("App_MCALInit\\83");  
  A_DBGR_Go();
  
  snprintf( chActionText, elCount(chActionText), "verify Breakpoint should hit in App_MCALInit\\83"); 
  snprintf( chExpectedText, elCount(chExpectedText), "Breakpoint hit in  App_MCALInit\\83 function"); 
  //E_DBGR_BreakpointCheckForHalt(" App_MCALInit\\51");
  E_DBGR_CheckState(T32_State_Stopped);
  /***************************************************************************************************************/    
                                              // Test Step2 Update the rom_payload variable to minimum value 
  /***************************************************************************************************************/
  snprintf( chActionText, elCount(chActionText), "Set the Test_start variable  to maximum value"); 
  snprintf( chExpectedText, elCount(chExpectedText), "verify Test_start variable to maximum value");
  TestStepAddActionExpected( chActionText, chExpectedText );
  A_DBGR_VariableSet("Test_start","0xFFFFFFFF");
  E_DBGR_VariableCheck("Test_start",4294967295,Equal);
  //A_DBGR_VariableRead("0x80826988",0x80826988);
  snprintf( chActionText, elCount(chActionText), "Set the Test_length variable  to maximum value"); 
  snprintf( chExpectedText, elCount(chExpectedText), "verify Test_length variable to maximum value");
  TestStepAddActionExpected( chActionText, chExpectedText );
  A_DBGR_VariableSet("Test_length","4294967295");
  E_DBGR_VariableCheck("Test_length",4294967295,Equal);
  snprintf( chActionText, elCount(chActionText), "Set the Test_fill variable  to maximum value"); 
  snprintf( chExpectedText, elCount(chExpectedText), "verify Test_fill variable to maximum value");
  TestStepAddActionExpected( chActionText, chExpectedText );
  A_DBGR_VariableSet("Test_fill","4294967295");
  E_DBGR_VariableCheck("Test_fill",4294967295,Equal);
  /***************************************************************************************************************/    
                                              // Test Step3 add break point at function defination side 
  /***************************************************************************************************************/
  snprintf( chActionText, elCount(chActionText), "Set Breakpoint in SetHWIO_h_RAM_ECC_Init Function defination  side  "); 
  snprintf( chExpectedText, elCount(chExpectedText), "verify is Breakpoint Set SetHWIO_h_RAM_ECC_Init in funaction defination side"); 
  TestStepAddActionExpected( chActionText, chExpectedText );
  A_DBGR_BreakpointSet("SetHWIO_h_RAM_ECC_Init");

  A_DBGR_Go();
  snprintf( chActionText, elCount(chActionText), "verify Breakpoint should hit in SetHWIO_h_RAM_ECC_Init function defination side  "); 
  snprintf( chExpectedText, elCount(chExpectedText), "Breakpoint hit in SetHWIO_h_RAM_ECC_Init function function defination side "); 
  E_DBGR_BreakpointCheckForHalt("SetHWIO_h_RAM_ECC_Init");
  
  snprintf( chActionText, elCount(chActionText), "verify Breakpoint should hit in start function defination side  "); 
  snprintf( chExpectedText, elCount(chExpectedText), "Breakpoint hit in start function function defination side "); 
  TestStepAddActionExpected( chActionText, chExpectedText );
  //E_DBGR_RegisterCheck("D:0x2000008C","0");
  E_DBGR_VariableCheck("start ",0xFFFFFFFF,Equal);
  snprintf( chActionText, elCount(chActionText), "Set the length variable  to maximum value"); 
  snprintf( chExpectedText, elCount(chExpectedText), "verify length variable to maximum value");
  TestStepAddActionExpected( chActionText, chExpectedText );
  E_DBGR_VariableCheck("length",4294967295,Equal);
  snprintf( chActionText, elCount(chActionText), "Set the Test_fill variable  to maximum value"); 
  snprintf( chExpectedText, elCount(chExpectedText), "verify fill variable to maximum value");
  TestStepAddActionExpected( chActionText, chExpectedText );
  E_DBGR_VariableCheck("fill ",4294967295,Equal);
  
  
}
testcase To_verify_the_SetSDLAdaptor_h_RAM_ECC_Init_Software_interface() 
{
  /***************************************************************************************************************/    
                                              // Test Case Info
  /***************************************************************************************************************/
  setWriteDbgLevel(DebugOff);
  snprintf( chTestTitle, elCount(chTestTitle), "To_verify_the_SetSDLAdaptor_h_RAM_ECC_Init_Software_interface" );
  snprintf( chTestDescription, elCount(chTestDescription), "Purpose:To check the_SetSDLAdaptor_h_RAM_ECC_Init_Software_interface");
  TestCaseAddInfo( chTestTitle, "TC_L30SW_Q-36623750", chTestDescription );
  
  /***************************************************************************************************************/    
                                              // Start of Test Case
  /***************************************************************************************************************/
  
  /***************************************************************************************************************/    
                                              // Test Step 0 PRECONDITIONS
  /***************************************************************************************************************/
  snprintf( chActionText, elCount(chActionText), "Flash the Software and ECU is running "); 
  snprintf( chExpectedText, elCount(chExpectedText), "Ecu is should be in running state"); 
  TestStepAddActionExpected( chActionText, chExpectedText );
  A_DBGR_BreakpointDeleteAll();
  A_DBGR_R();

  /***************************************************************************************************************/    
                                              // Test Step 1 Add the break point at function call side 
  /***************************************************************************************************************/
  snprintf( chActionText, elCount(chActionText), "Set Breakpoint in  App_MCALInit\\51 Function call side  "); 
  snprintf( chExpectedText, elCount(chExpectedText), "verify is Breakpoint Set App_MCALInit\\51 in Function call side"); 
  A_DBGR_BreakpointSet("App_MCALInit\\51");  
  A_DBGR_Go();
  
  snprintf( chActionText, elCount(chActionText), "Set Breakpoint in SetSDLAdaptor_h_RAM_ECC_Init Function call side  "); 
  snprintf( chExpectedText, elCount(chExpectedText), "Breakpoint hit in SetSDLAdaptor_h_RAM_ECC_Init function"); 
  E_DBGR_BreakpointCheckForHalt("App_MCALInit\\51");
  /***************************************************************************************************************/    
                                              // Test Step2 add break point at function defination side 
  /***************************************************************************************************************/
  snprintf( chActionText, elCount(chActionText), "Set Breakpoint in SetHWIO_h_RAM_ECC_Init  Function defination  side  "); 
  snprintf( chExpectedText, elCount(chExpectedText), "verify is Breakpoint Set SetHWIO_h_RAM_ECC_Init in funaction defination side"); 
  TestStepAddActionExpected( chActionText, chExpectedText );
  A_DBGR_BreakpointSet("SetHWIO_h_RAM_ECC_Init");

  A_DBGR_Go();
  snprintf( chActionText, elCount(chActionText), "verify Breakpoint should hit in SetSDLAdaptor_h_RAM_ECC_Init function defination side  "); 
  snprintf( chExpectedText, elCount(chExpectedText), "Breakpoint hit in SetSDLAdaptor_h_RAM_ECC_Init function function defination side "); 
  //TestStepAddActionExpected( chActionText, chExpectedText );
  E_DBGR_BreakpointCheckForHalt("SetHWIO_h_RAM_ECC_Init");
}
testcase To_verify_the_GetHWIO_e_CacheRAM_Flt_Software_interface() 
{
  /***************************************************************************************************************/    
                                              // Test Case Info
  /***************************************************************************************************************/
  setWriteDbgLevel(DebugOff);
  snprintf( chTestTitle, elCount(chTestTitle), "To_verify_the_GetHWIO_b_WrtProtRAM_Flt_Software_interface" );
  snprintf( chTestDescription, elCount(chTestDescription), "Purpose:To check the GetHWIO_b_WrtProtRAM_Flt_interface");
  TestCaseAddInfo( chTestTitle, "TC_L30SW_Q-36623750", chTestDescription );
  
  /***************************************************************************************************************/    
                                              // Start of Test Case
  /***************************************************************************************************************/
  
  /***************************************************************************************************************/    
                                              // Test Step 0 PRECONDITIONS
  /***************************************************************************************************************/
  snprintf( chActionText, elCount(chActionText), "Flash the Software and ECU is running "); 
  snprintf( chExpectedText, elCount(chExpectedText), "Ecu is should be in running state"); 
  TestStepAddActionExpected( chActionText, chExpectedText );
  A_DBGR_BreakpointDeleteAll();
  A_DBGR_R();

  /***************************************************************************************************************/    
                                              // Test Step 1 Add the break point at function call side 
  /***************************************************************************************************************/
  snprintf( chActionText, elCount(chActionText), "Set Breakpoint in MEMPROT_HWIO_ExecuteWriteTest_ProtectedAddress_WPArea\\11  Function call side  "); 
  snprintf( chExpectedText, elCount(chExpectedText), "verify is Breakpoint Set MEMPROT_HWIO_ExecuteWriteTest_ProtectedAddress_WPArea\\11 in Function call side"); 
 // TestStepAddActionExpected( chActionText, chExpectedText );
  A_DBGR_BreakpointSet("MEMPROT_HWIO_ExecuteWriteTest_ProtectedAddress_WPArea\\11");  
  A_DBGR_Go();
  
  //snprintf( chActionText, elCount(chActionText), "verify Breakpoint should hit in core0_main\\20 "); 
  snprintf( chExpectedText, elCount(chExpectedText), "Breakpoint hit in MEMPROT_HWIO_ExecuteWriteTest_ProtectedAddress_WPArea\\11 function"); 
  //TestStepAddActionExpected( chActionText, chExpectedText );
  E_DBGR_BreakpointCheckForHalt("MEMPROT_HWIO_ExecuteWriteTest_ProtectedAddress_WPArea\\11");
  /***************************************************************************************************************/    
                                              // Test Step2 add break point at function defination side 
  /***************************************************************************************************************/
  snprintf( chActionText, elCount(chActionText), "Set Breakpoint in GetHWIO_b_WrtProtRAM_Flt Function defination  side  "); 
  snprintf( chExpectedText, elCount(chExpectedText), "verify is Breakpoint Set GetHWIO_b_WrtProtRAM_Flt in funaction defination side"); 
  TestStepAddActionExpected( chActionText, chExpectedText );
  A_DBGR_BreakpointSet("GetHWIO_b_WrtProtRAM_Flt"); 
  //snprintf( chActionText, elCount(chActionText), "Set Breakpoint in ECU running   "); 
  //snprintf( chExpectedText, elCount(chExpectedText), "verify is ECU is running ");  
  //TestStepAddActionExpected( chActionText, chExpectedText );

  A_DBGR_Go();
  //TestStepAddActionExpected( chActionText, chExpectedText );
  snprintf( chActionText, elCount(chActionText), "verify Breakpoint should hit in GetHWIO_b_WrtProtRAM_Flt function defination side  "); 
  snprintf( chExpectedText, elCount(chExpectedText), "Breakpoint hit in GetHWIO_b_WrtProtRAM_Flt function function defination side "); 
  TestStepAddActionExpected( chActionText, chExpectedText );
  E_DBGR_BreakpointCheckForHalt("GetHWIO_b_WrtProtRAM_Flt");
}
testcase To_verify_the_GetSDLAdaptor_e_CacheRAM_Flt_Software_interface() 
{
  /***************************************************************************************************************/    
                                              // Test Case Info
  /***************************************************************************************************************/
  setWriteDbgLevel(DebugOff);
  snprintf( chTestTitle, elCount(chTestTitle), "To_verify_the_GetSDLAdaptor_e_CacheRAM_Flt_Software_interface" );
  snprintf( chTestDescription, elCount(chTestDescription), "Purpose:To check the_GetSDLAdaptor_e_CacheRAM_Flt_Software_interface");
  TestCaseAddInfo( chTestTitle, "TC_L30SW_Q-36623750", chTestDescription );
  
  /***************************************************************************************************************/    
                                              // Start of Test Case
  /***************************************************************************************************************/
  
  /***************************************************************************************************************/    
                                              // Test Step 0 PRECONDITIONS
  /***************************************************************************************************************/
  snprintf( chActionText, elCount(chActionText), "Flash the Software and ECU is running "); 
  snprintf( chExpectedText, elCount(chExpectedText), "Ecu is should be in running state"); 
  TestStepAddActionExpected( chActionText, chExpectedText );
  A_DBGR_BreakpointDeleteAll();
  A_DBGR_R();

  /***************************************************************************************************************/    
                                              // Test Step 1 Add the break point at function call side 
  /***************************************************************************************************************/
  snprintf( chActionText, elCount(chActionText), "Set Breakpoint in GetHWIO_e_CacheRAM_Flt\\3 Function call side  "); 
  snprintf( chExpectedText, elCount(chExpectedText), "verify is Breakpoint Set GetHWIO_e_CacheRAM_Flt\\3 in Function call side"); 
  A_DBGR_BreakpointSet("GetHWIO_e_CacheRAM_Flt\\3");  
  A_DBGR_Go();
  
  snprintf( chExpectedText, elCount(chExpectedText), "Breakpoint hit in GetHWIO_e_CacheRAM_Flt\\3 function"); 
  E_DBGR_BreakpointCheckForHalt("GetHWIO_e_CacheRAM_Flt\\3");
  /***************************************************************************************************************/    
                                              // Test Step2 add break point at function defination side 
  /***************************************************************************************************************/
  snprintf( chActionText, elCount(chActionText), "Set Breakpoint in GetSDLAdaptor_e_CacheRAM_Flt  Function defination  side  "); 
  snprintf( chExpectedText, elCount(chExpectedText), "verify is Breakpoint Set GetSDLAdaptor_e_CacheRAM_Flt in funaction defination side"); 
  TestStepAddActionExpected( chActionText, chExpectedText );
  A_DBGR_BreakpointSet("GetSDLAdaptor_e_CacheRAM_Flt"); 

  A_DBGR_Go();
  snprintf( chActionText, elCount(chActionText), "verify Breakpoint should hit in GetSDLAdaptor_e_CacheRAM_Flt function defination side  "); 
  snprintf( chExpectedText, elCount(chExpectedText), "Breakpoint hit in GetSDLAdaptor_e_CacheRAM_Flt function function defination side "); 
  E_DBGR_BreakpointCheckForHalt("GetSDLAdaptor_e_CacheRAM_Flt");
}
testcase To_verify_the_GetHWIO_y_CacheRAM_AddressFailed_Software_interface() 
{
  /***************************************************************************************************************/    
                                              // Test Case Info
  /***************************************************************************************************************/
  setWriteDbgLevel(DebugOff);
  snprintf( chTestTitle, elCount(chTestTitle), "To_verify_the_GetHWIO_y_CacheRAM_AddressFailed_Software_interface" );
  snprintf( chTestDescription, elCount(chTestDescription), "Purpose:To check the GetHWIO_y_CacheRAM_AddressFailed_Software_interface");
  TestCaseAddInfo( chTestTitle, "TC_L30SW_Q-36623750", chTestDescription );
  
  /***************************************************************************************************************/    
                                              // Start of Test Case
  /***************************************************************************************************************/
  
  /***************************************************************************************************************/    
                                              // Test Step 0 PRECONDITIONS
  /***************************************************************************************************************/
  snprintf( chActionText, elCount(chActionText), "Flash the Software and ECU is running "); 
  snprintf( chExpectedText, elCount(chExpectedText), "Ecu is should be in running state"); 
  TestStepAddActionExpected( chActionText, chExpectedText );
  A_DBGR_BreakpointDeleteAll();
  A_DBGR_R();

  /***************************************************************************************************************/    
                                              // Test Step 1 Add the break point at function call side 
  /***************************************************************************************************************/
  snprintf( chActionText, elCount(chActionText), "Set Breakpoint in Test_ecc_ram_injection\\12  Function call side  "); 
  snprintf( chExpectedText, elCount(chExpectedText), "verify is Breakpoint Set Test_ecc_ram_injection\\12 in Function call side"); 
 // TestStepAddActionExpected( chActionText, chExpectedText );
  A_DBGR_BreakpointSet("Test_ecc_ram_injection\\12");  
  A_DBGR_Go();
  
  //snprintf( chActionText, elCount(chActionText), "verify Breakpoint should hit in core0_main\\20 "); 
  snprintf( chExpectedText, elCount(chExpectedText), "Breakpoint hit in Test_ecc_ram_injection\\12 function"); 
  //TestStepAddActionExpected( chActionText, chExpectedText );
  E_DBGR_BreakpointCheckForHalt("Test_ecc_ram_injection\\12");
  /***************************************************************************************************************/    
                                              // Test Step2 add break point at function defination side 
  /***************************************************************************************************************/
  snprintf( chActionText, elCount(chActionText), "Set Breakpoint in GetHWIO_y_CacheRAM_AddressFailed Function defination  side  "); 
  snprintf( chExpectedText, elCount(chExpectedText), "verify is Breakpoint Set GetHWIO_y_CacheRAM_AddressFailed in funaction defination side"); 
  TestStepAddActionExpected( chActionText, chExpectedText );
  A_DBGR_BreakpointSet("GetHWIO_y_CacheRAM_AddressFailed"); 
  //snprintf( chActionText, elCount(chActionText), "Set Breakpoint in ECU running   "); 
  //snprintf( chExpectedText, elCount(chExpectedText), "verify is ECU is running ");  
  //TestStepAddActionExpected( chActionText, chExpectedText );

  A_DBGR_Go();
  //TestStepAddActionExpected( chActionText, chExpectedText );
  snprintf( chActionText, elCount(chActionText), "verify Breakpoint should hit in GetHWIO_y_CacheRAM_AddressFailed function defination side  "); 
  snprintf( chExpectedText, elCount(chExpectedText), "Breakpoint hit in GetHWIO_y_CacheRAM_AddressFailed function function defination side "); 
  TestStepAddActionExpected( chActionText, chExpectedText );
  E_DBGR_BreakpointCheckForHalt("GetHWIO_y_CacheRAM_AddressFailed");
}
testcase To_verify_the_GetSDLAdaptor_y_CacheRAM_AddressFailed_Software_interface() 
{
  /***************************************************************************************************************/    
                                              // Test Case Info
  /***************************************************************************************************************/
  setWriteDbgLevel(DebugOff);
  snprintf( chTestTitle, elCount(chTestTitle), "To_verify_the_GetSDLAdaptor_y_CacheRAM_AddressFailed_Software_interface" );
  snprintf( chTestDescription, elCount(chTestDescription), "Purpose:To check the  GetSDLAdaptor_y_CacheRAM_AddressFailed_Software_interface");
  TestCaseAddInfo( chTestTitle, "TC_L30SW_Q-36623750", chTestDescription );
  
  /***************************************************************************************************************/    
                                              // Start of Test Case
  /***************************************************************************************************************/
  
  /***************************************************************************************************************/    
                                              // Test Step 0 PRECONDITIONS
  /***************************************************************************************************************/
  snprintf( chActionText, elCount(chActionText), "Flash the Software and ECU is running "); 
  snprintf( chExpectedText, elCount(chExpectedText), "Ecu is should be in running state"); 
  TestStepAddActionExpected( chActionText, chExpectedText );
  A_DBGR_BreakpointDeleteAll();
  A_DBGR_R();

  /***************************************************************************************************************/    
                                              // Test Step 1 Add the break point at function call side 
  /***************************************************************************************************************/
  snprintf( chActionText, elCount(chActionText), "Set Breakpoint in GetHWIO_y_CacheRAM_AddressFailed\\3 Function call side  "); 
  snprintf( chExpectedText, elCount(chExpectedText), "verify is Breakpoint Set GetHWIO_y_CacheRAM_AddressFailed\\3 in Function call side"); 
  A_DBGR_BreakpointSet("GetHWIO_y_CacheRAM_AddressFailed\\3");  
  A_DBGR_Go();
   
  snprintf( chExpectedText, elCount(chExpectedText), "Breakpoint hit in GetHWIO_y_CacheRAM_AddressFailed\\3 function"); 
  E_DBGR_BreakpointCheckForHalt("GetHWIO_y_CacheRAM_AddressFailed\\3");
  /***************************************************************************************************************/    
                                              // Test Step2 add break point at function defination side 
  /***************************************************************************************************************/
  snprintf( chActionText, elCount(chActionText), "Set Breakpoint in GetSDLAdaptor_y_CacheRAM_AddressFailed  Function defination  side  "); 
  snprintf( chExpectedText, elCount(chExpectedText), "verify is Breakpoint Set GetSDLAdaptor_y_CacheRAM_AddressFailed in funaction defination side"); 
  TestStepAddActionExpected( chActionText, chExpectedText );
  A_DBGR_BreakpointSet("GetSDLAdaptor_y_CacheRAM_AddressFailed"); 

  A_DBGR_Go();
  snprintf( chActionText, elCount(chActionText), "verify Breakpoint should hit in GetSDLAdaptor_y_CacheRAM_AddressFailed function defination side  "); 
  snprintf( chExpectedText, elCount(chExpectedText), "Breakpoint hit in GetSDLAdaptor_y_CacheRAM_AddressFailed function function defination side "); 
  E_DBGR_BreakpointCheckForHalt("GetSDLAdaptor_y_CacheRAM_AddressFailed");
}
testcase To_verify_the_ClrHWIO_CacheRAM_Flt_Software_interface() 
{
  /***************************************************************************************************************/    
                                              // Test Case Info
  /***************************************************************************************************************/
  setWriteDbgLevel(DebugOff);
  snprintf( chTestTitle, elCount(chTestTitle), "To_verify_the_ClrHWIO_CacheRAM_Flt_Software_interface" );
  snprintf( chTestDescription, elCount(chTestDescription), "Purpose:To check the ClrHWIO_CacheRAM_Flt_Software_interface");
  TestCaseAddInfo( chTestTitle, "TC_L30SW_Q-36623750", chTestDescription );
  
  /***************************************************************************************************************/    
                                              // Start of Test Case
  /***************************************************************************************************************/
  
  /***************************************************************************************************************/    
                                              // Test Step 0 PRECONDITIONS
  /***************************************************************************************************************/
  snprintf( chActionText, elCount(chActionText), "Flash the Software and ECU is running "); 
  snprintf( chExpectedText, elCount(chExpectedText), "Ecu is should be in running state"); 
  TestStepAddActionExpected( chActionText, chExpectedText );
  A_DBGR_BreakpointDeleteAll();
  A_DBGR_R();

  /***************************************************************************************************************/    
                                              // Test Step 1 Add the break point at function call side 
  /***************************************************************************************************************/
  snprintf( chActionText, elCount(chActionText), "Set Breakpoint in Test_ecc_ram_injection\\11  Function call side  "); 
  snprintf( chExpectedText, elCount(chExpectedText), "verify is Breakpoint Set Test_ecc_ram_injection\\11 in Function call side"); 
 // TestStepAddActionExpected( chActionText, chExpectedText );
  A_DBGR_BreakpointSet("Test_ecc_ram_injection\\11");  
  A_DBGR_Go();
  
  //snprintf( chActionText, elCount(chActionText), "verify Breakpoint should hit in core0_main\\20 "); 
  snprintf( chExpectedText, elCount(chExpectedText), "Breakpoint hit in Test_ecc_ram_injection\\11 function"); 
  //TestStepAddActionExpected( chActionText, chExpectedText );
  E_DBGR_BreakpointCheckForHalt("Test_ecc_ram_injection\\11");
  /***************************************************************************************************************/    
                                              // Test Step2 add break point at function defination side 
  /***************************************************************************************************************/
  snprintf( chActionText, elCount(chActionText), "Set Breakpoint in ClrHWIO_CacheRAM_Flt Function defination  side  "); 
  snprintf( chExpectedText, elCount(chExpectedText), "verify is Breakpoint Set ClrHWIO_CacheRAM_Flt in funaction defination side"); 
  TestStepAddActionExpected( chActionText, chExpectedText );
  A_DBGR_BreakpointSet("ClrHWIO_CacheRAM_Flt"); 
  //snprintf( chActionText, elCount(chActionText), "Set Breakpoint in ECU running   "); 
  //snprintf( chExpectedText, elCount(chExpectedText), "verify is ECU is running ");  
  //TestStepAddActionExpected( chActionText, chExpectedText );

  A_DBGR_Go();
  //TestStepAddActionExpected( chActionText, chExpectedText );
  snprintf( chActionText, elCount(chActionText), "verify Breakpoint should hit in ClrHWIO_CacheRAM_Flt function defination side  "); 
  snprintf( chExpectedText, elCount(chExpectedText), "Breakpoint hit in ClrHWIO_CacheRAM_Flt function function defination side "); 
  TestStepAddActionExpected( chActionText, chExpectedText );
  E_DBGR_BreakpointCheckForHalt("ClrHWIO_CacheRAM_Flt");
}
testcase To_verify_the_ClrSDLAdaptor_CacheRAM_Flt_Software_interface() 
{
  /***************************************************************************************************************/    
                                              // Test Case Info
  /***************************************************************************************************************/
  setWriteDbgLevel(DebugOff);
  snprintf( chTestTitle, elCount(chTestTitle), "To_verify_the_ClrSDLAdaptor_CacheRAM_Flt_Software_interface" );
  snprintf( chTestDescription, elCount(chTestDescription), "Purpose:To check the_ClrSDLAdaptor_CacheRAM_Flt_Software_interface");
  TestCaseAddInfo( chTestTitle, "TC_L30SW_Q-36623750", chTestDescription );
  
  /***************************************************************************************************************/    
                                              // Start of Test Case
  /***************************************************************************************************************/
  
  /***************************************************************************************************************/    
                                              // Test Step 0 PRECONDITIONS
  /***************************************************************************************************************/
  snprintf( chActionText, elCount(chActionText), "Flash the Software and ECU is running "); 
  snprintf( chExpectedText, elCount(chExpectedText), "Ecu is should be in running state"); 
  TestStepAddActionExpected( chActionText, chExpectedText );
  A_DBGR_BreakpointDeleteAll();
  A_DBGR_R();

  /***************************************************************************************************************/    
                                              // Test Step 1 Add the break point at function call side 
  /***************************************************************************************************************/
  snprintf( chActionText, elCount(chActionText), "Set Breakpoint in ClrHWIO_CacheRAM_Flt\\2 Function call side  "); 
  snprintf( chExpectedText, elCount(chExpectedText), "verify is Breakpoint Set ClrHWIO_CacheRAM_Flt\\2 in Function call side"); 
  A_DBGR_BreakpointSet("ClrHWIO_CacheRAM_Flt\\2");  
  A_DBGR_Go();
  
  snprintf( chExpectedText, elCount(chExpectedText), "Breakpoint hit in ClrHWIO_CacheRAM_Flt\\2 function"); 
  E_DBGR_BreakpointCheckForHalt("ClrHWIO_CacheRAM_Flt\\2");
  /***************************************************************************************************************/    
                                              // Test Step2 add break point at function defination side 
  /***************************************************************************************************************/
  snprintf( chActionText, elCount(chActionText), "Set Breakpoint in ClrSDLAdaptor_CacheRAM_Flt  Function defination  side  "); 
  snprintf( chExpectedText, elCount(chExpectedText), "verify is Breakpoint Set ClrSDLAdaptor_CacheRAM_Flt in funaction defination side"); 
  TestStepAddActionExpected( chActionText, chExpectedText );
  A_DBGR_BreakpointSet("ClrSDLAdaptor_CacheRAM_Flt"); 

  A_DBGR_Go();
  snprintf( chActionText, elCount(chActionText), "verify Breakpoint should hit in ClrSDLAdaptor_CacheRAM_Flt function defination side  "); 
  snprintf( chExpectedText, elCount(chExpectedText), "Breakpoint hit in ClrSDLAdaptor_CacheRAM_Flt function function defination side "); 
  E_DBGR_BreakpointCheckForHalt("ClrSDLAdaptor_CacheRAM_Flt");
}
testcase To_verify_the_GetHWIO_y_RAM_FailedCPU_Specific_Software_interface() 
{
  /***************************************************************************************************************/    
                                              // Test Case Info
  /***************************************************************************************************************/
  setWriteDbgLevel(DebugOff);
  snprintf( chTestTitle, elCount(chTestTitle), "To_verify_the_GetHWIO_y_RAM_FailedCPU_Specific_Software_interface" );
  snprintf( chTestDescription, elCount(chTestDescription), "Purpose:To check the GetHWIO_y_RAM_FailedCPU_Specific_interface");
  TestCaseAddInfo( chTestTitle, "TC_L30SW_Q-36623750", chTestDescription );
  
  /***************************************************************************************************************/    
                                              // Start of Test Case
  /***************************************************************************************************************/
  
  /***************************************************************************************************************/    
                                              // Test Step 0 PRECONDITIONS
  /***************************************************************************************************************/
  snprintf( chActionText, elCount(chActionText), "Flash the Software and ECU is running "); 
  snprintf( chExpectedText, elCount(chExpectedText), "Ecu is should be in running state"); 
  TestStepAddActionExpected( chActionText, chExpectedText );
  A_DBGR_BreakpointDeleteAll();
  A_DBGR_R();
  /***************************************************************************************************************/    
                                              // Test Step 1 updateing  counter value to 0
  /***************************************************************************************************************/
  snprintf( chActionText, elCount(chActionText), "Set Breakpoint in Test_ecc_ram_injection  Function call side  "); 
  snprintf( chExpectedText, elCount(chExpectedText), "verify is Breakpoint Set Test_ecc_ram_injection in Function call side"); 
  A_DBGR_BreakpointSet("Test_ecc_ram_injection");  
  A_DBGR_Go();
  
  
  E_DBGR_BreakpointCheckForHalt("Test_ecc_ram_injection");
  snprintf( chActionText, elCount(chActionText), "Set the Conter variable value to 0"); 
  snprintf( chExpectedText, elCount(chExpectedText), "verify Conter variable value to 0");
  TestStepAddActionExpected( chActionText, chExpectedText );
  A_DBGR_VariableSet("count","0");
  E_DBGR_VariableCheck("count",0,Equal);
  snprintf( chActionText, elCount(chActionText), "Check the break points are deleted"); 
  snprintf( chExpectedText, elCount(chExpectedText), "verify is Breakpoints are  deleted ");
  TestStepAddActionExpected( chActionText, chExpectedText );
  A_DBGR_BreakpointDeleteAll();

  /***************************************************************************************************************/    
                                              // Test Step 2 Add the break point at function call side 
  /***************************************************************************************************************/
  snprintf( chActionText, elCount(chActionText), "Set Breakpoint in Test_ecc_ram_injection\\9 Function call side  "); 
  snprintf( chExpectedText, elCount(chExpectedText), "verify is Breakpoint Set Test_ecc_ram_injection\\9 in Function call side"); 
  A_DBGR_BreakpointSet("Test_ecc_ram_injection\\9");  
  A_DBGR_Go();
  
  snprintf( chActionText, elCount(chActionText), "verify Breakpoint should hit in Test_ecc_ram_injection\\9"); 
  snprintf( chExpectedText, elCount(chExpectedText), "Breakpoint hit in Test_ecc_ram_injection\\9 function"); 
  E_DBGR_BreakpointCheckForHalt("Test_ecc_ram_injection\\9");
  /***************************************************************************************************************/    
                                              // Test Step2 add break point at function defination side 
  /***************************************************************************************************************/
  snprintf( chActionText, elCount(chActionText), "Set Breakpoint in GetHWIO_y_RAM_FailedCPU_Specific Function defination  side  "); 
  snprintf( chExpectedText, elCount(chExpectedText), "verify is Breakpoint Set GetHWIO_y_RAM_FailedCPU_Specific in funaction defination side"); 
  TestStepAddActionExpected( chActionText, chExpectedText );
  A_DBGR_BreakpointSet("GetHWIO_y_RAM_FailedCPU_Specific"); 

  A_DBGR_Go();
  snprintf( chActionText, elCount(chActionText), "verify Breakpoint should hit in GetHWIO_y_RAM_FailedCPU_Specific function defination side  "); 
  snprintf( chExpectedText, elCount(chExpectedText), "Breakpoint hit in GetHWIO_y_RAM_FailedCPU_Specific function function defination side "); 
  E_DBGR_BreakpointCheckForHalt("GetHWIO_y_RAM_FailedCPU_Specific");
}
testcase To_verify_the_GetSDLAdaptor_y_RAM_FailedCPU_Specific_Software_interface() 
{
  /***************************************************************************************************************/    
                                              // Test Case Info
  /***************************************************************************************************************/
  setWriteDbgLevel(DebugOff);
  snprintf( chTestTitle, elCount(chTestTitle), "To_verify_the_GetSDLAdaptor_y_RAM_FailedCPU_Specific_Software_interface" );
  snprintf( chTestDescription, elCount(chTestDescription), "Purpose:To check the_GetSDLAdaptor_y_RAM_FailedCPU_Specific_Software_interface");
  TestCaseAddInfo( chTestTitle, "TC_L30SW_Q-36623750", chTestDescription );
  
  /***************************************************************************************************************/    
                                              // Start of Test Case
  /***************************************************************************************************************/
  
  /***************************************************************************************************************/    
                                              // Test Step 0 PRECONDITIONS
  /***************************************************************************************************************/
  snprintf( chActionText, elCount(chActionText), "Flash the Software and ECU is running "); 
  snprintf( chExpectedText, elCount(chExpectedText), "Ecu is should be in running state"); 
  TestStepAddActionExpected( chActionText, chExpectedText );
  A_DBGR_BreakpointDeleteAll();
  A_DBGR_R();
  /***************************************************************************************************************/    
                                              // Test Step 1 updateing  counter value to 0
  /***************************************************************************************************************/
  snprintf( chActionText, elCount(chActionText), "Set Breakpoint in Test_ecc_ram_injection  Function call side  "); 
  snprintf( chExpectedText, elCount(chExpectedText), "verify is Breakpoint Set Test_ecc_ram_injection in Function call side"); 
  A_DBGR_BreakpointSet("Test_ecc_ram_injection");  
  A_DBGR_Go();
  
  
  E_DBGR_BreakpointCheckForHalt("Test_ecc_ram_injection");
  snprintf( chActionText, elCount(chActionText), "Set the Conter variable value to 0"); 
  snprintf( chExpectedText, elCount(chExpectedText), "verify Conter variable value to 0");
  TestStepAddActionExpected( chActionText, chExpectedText );
  A_DBGR_VariableSet("count","0");
  E_DBGR_VariableCheck("count",0,Equal);
  snprintf( chActionText, elCount(chActionText), "Check the break points are deleted"); 
  snprintf( chExpectedText, elCount(chExpectedText), "verify is Breakpoints are  deleted ");
  TestStepAddActionExpected( chActionText, chExpectedText );
  A_DBGR_BreakpointDeleteAll();

  /***************************************************************************************************************/    
                                              // Test Step 2 Add the break point at function call side 
  /***************************************************************************************************************/
  snprintf( chActionText, elCount(chActionText), "Set Breakpoint in Test_ecc_ram_injection\\8 Function call side  "); 
  snprintf( chExpectedText, elCount(chExpectedText), "verify is Breakpoint Set Test_ecc_ram_injection\\8 in Function call side"); 
  A_DBGR_BreakpointSet("Test_ecc_ram_injection\\9");  
  A_DBGR_Go();
  
  snprintf( chExpectedText, elCount(chExpectedText), "Breakpoint hit in Test_ecc_ram_injection\\8 function"); 
  E_DBGR_BreakpointCheckForHalt("Test_ecc_ram_injection\\9");
  /***************************************************************************************************************/    
                                              // Test Step3 add break point at function defination side 
  /***************************************************************************************************************/
  snprintf( chActionText, elCount(chActionText), "Set Breakpoint in GetSDLAdaptor_y_RAM_FailedCPU_Specific  Function defination  side  "); 
  snprintf( chExpectedText, elCount(chExpectedText), "verify is Breakpoint Set GetSDLAdaptor_y_RAM_FailedCPU_Specific in funaction defination side"); 
  TestStepAddActionExpected( chActionText, chExpectedText );
  A_DBGR_BreakpointSet("GetSDLAdaptor_y_RAM_FailedCPU_Specific");

  A_DBGR_Go();
  snprintf( chActionText, elCount(chActionText), "verify Breakpoint should hit in GetSDLAdaptor_y_RAM_FailedCPU_Specific function defination side  "); 
  snprintf( chExpectedText, elCount(chExpectedText), "Breakpoint hit in GetSDLAdaptor_y_RAM_FailedCPU_Specific function function defination side "); 
  E_DBGR_BreakpointCheckForHalt("GetSDLAdaptor_y_RAM_FailedCPU_Specific");
}
testcase To_verify_the_Minimum_value_GetHWIO_y_RAM_FailedCPU_Specific_Software_interface() 
{
  /***************************************************************************************************************/    
                                              // Test Case Info
  /***************************************************************************************************************/
  setWriteDbgLevel(DebugOff);
  snprintf( chTestTitle, elCount(chTestTitle), "To_verify_the_GetHWIO_y_RAM_FailedCPU_Specific_Software_interface" );
  snprintf( chTestDescription, elCount(chTestDescription), "Purpose:To check the GetHWIO_y_RAM_FailedCPU_Specific_Software_interface");
  TestCaseAddInfo( chTestTitle, "TC_L30SW_Q-36623750", chTestDescription );
  
  /***************************************************************************************************************/    
                                              // Start of Test Case
  /***************************************************************************************************************/
  
  /***************************************************************************************************************/    
                                              // Test Step 0 PRECONDITIONS
  /***************************************************************************************************************/
  snprintf( chActionText, elCount(chActionText), "Flash the Software and ECU is running "); 
  snprintf( chExpectedText, elCount(chExpectedText), "Ecu is should be in running state"); 
  TestStepAddActionExpected( chActionText, chExpectedText );
  A_DBGR_BreakpointDeleteAll();
  A_DBGR_R();
  

  /***************************************************************************************************************/    
                                              // Test Step 1 Add the break point at function call side 
  /***************************************************************************************************************/
  snprintf( chActionText, elCount(chActionText), "Set Breakpoint in  Test_ecc_ram_injection  Function call side  "); 
  snprintf( chExpectedText, elCount(chExpectedText), "verify is Breakpoint Set  Test_ecc_ram_injection  in Function call side"); 
  A_DBGR_BreakpointSet("Test_ecc_ram_injection");  
  A_DBGR_Go();
  
  snprintf( chActionText, elCount(chActionText), "verify Breakpoint should hit in Test_ecc_ram_injection"); 
  snprintf( chExpectedText, elCount(chExpectedText), "Breakpoint hit in  Test_ecc_ram_injection function"); 
  E_DBGR_CheckState(T32_State_Stopped);
  /***************************************************************************************************************/    
                                              // Test Step2 Update the rom_payload variable to minimum value 
  /***************************************************************************************************************/
  snprintf( chActionText, elCount(chActionText), "Set the ecc_rom_payload variable  to minimum value"); 
  snprintf( chExpectedText, elCount(chExpectedText), "verify ecc_rom_payload variable to minimum value");
  TestStepAddActionExpected( chActionText, chExpectedText );
  A_DBGR_VariableSet("test_ecc_ram_payload[0]","0");
  E_DBGR_VariableCheck("test_ecc_ram_payload[0]",0,Equal);
  
  snprintf( chActionText, elCount(chActionText), "Set the Conter variable value to 0"); 
  snprintf( chExpectedText, elCount(chExpectedText), "verify Conter variable value to 0");
  TestStepAddActionExpected( chActionText, chExpectedText );
  A_DBGR_VariableSet("count","0");
  E_DBGR_VariableCheck("count",0,Equal);
//  snprintf( chActionText, elCount(chActionText), "Check the break points are deleted"); 
//  snprintf( chExpectedText, elCount(chExpectedText), "verify is Breakpoints are  deleted ");
//  TestStepAddActionExpected( chActionText, chExpectedText );
//  A_DBGR_BreakpointDeleteAll();
  
  
  /***************************************************************************************************************/    
                                              // Test Step 3 Add the break point at function call side 
  /***************************************************************************************************************/
  snprintf( chActionText, elCount(chActionText), "Set Breakpoint in  Test_ecc_ram_injection\\9  Function call side  "); 
  snprintf( chExpectedText, elCount(chExpectedText), "verify is Breakpoint Set  Test_ecc_ram_injection\\9  in Function call side"); 
  TestStepAddActionExpected( chActionText, chExpectedText );
  A_DBGR_BreakpointSet("Test_ecc_ram_injection\\9");  
  A_DBGR_Go();
  
  snprintf( chActionText, elCount(chActionText), "verify Breakpoint should hit in Test_ecc_ram_injection\\9"); 
  snprintf( chExpectedText, elCount(chExpectedText), "Breakpoint hit in  Test_ecc_ram_injection\\9 function"); 
  //E_DBGR_BreakpointCheckForHalt(" Test_ecc_ram_injection\\9");
    //TestStepAddActionExpected( chActionText, chExpectedText );
    E_DBGR_CheckState(T32_State_Stopped);
  // E_DBGR_BreakpointCheckForHalt(" Test_ecc_ram_injection\\9");
  /***************************************************************************************************************/    
                                              // Test Step4 add break point at function defination side 
  /***************************************************************************************************************/
  snprintf( chActionText, elCount(chActionText), "Set Breakpoint in GetHWIO_y_RAM_FailedCPU_Specific Function defination  side  "); 
  snprintf( chExpectedText, elCount(chExpectedText), "verify is Breakpoint Set GetHWIO_y_RAM_FailedCPU_Specific in funaction defination side"); 
  TestStepAddActionExpected( chActionText, chExpectedText );
  A_DBGR_BreakpointSet("GetHWIO_y_RAM_FailedCPU_Specific");

  A_DBGR_Go();
  snprintf( chActionText, elCount(chActionText), "verify Breakpoint should hit in GetHWIO_y_RAM_FailedCPU_Specific function defination side  "); 
  snprintf( chExpectedText, elCount(chExpectedText), "Breakpoint hit in GetHWIO_y_RAM_FailedCPU_Specific function function defination side "); 
  E_DBGR_BreakpointCheckForHalt("GetHWIO_y_RAM_FailedCPU_Specific");
  
  snprintf( chActionText, elCount(chActionText), "verify Breakpoint should hit in GetHWIO_y_RAM_FailedCPU_Specific function defination side  "); 
  snprintf( chExpectedText, elCount(chExpectedText), "Breakpoint hit in GetHWIO_y_RAM_FailedCPU_Specific function function defination side "); 
  TestStepAddActionExpected( chActionText, chExpectedText );
  E_DBGR_RegisterCheck("D:0x30001F5C","0");
  
}
testcase To_verify_the_Mid_value_GetHWIO_y_RAM_FailedCPU_Specific_Software_interface() 
{
  /***************************************************************************************************************/    
                                              // Test Case Info
  /***************************************************************************************************************/
  setWriteDbgLevel(DebugOff);
  snprintf( chTestTitle, elCount(chTestTitle), "To_verify_the_Mid_value_GetHWIO_y_RAM_FailedCPU_Specific_Software_interface" );
  snprintf( chTestDescription, elCount(chTestDescription), "Purpose:To check the GetHWIO_y_RAM_FailedCPU_Specific_Software_interface");
  TestCaseAddInfo( chTestTitle, "TC_L30SW_Q-36623750", chTestDescription );
  
  /***************************************************************************************************************/    
                                              // Start of Test Case
  /***************************************************************************************************************/
  
  /***************************************************************************************************************/    
                                              // Test Step 0 PRECONDITIONS
  /***************************************************************************************************************/
  snprintf( chActionText, elCount(chActionText), "Flash the Software and ECU is running "); 
  snprintf( chExpectedText, elCount(chExpectedText), "Ecu is should be in running state"); 
  TestStepAddActionExpected( chActionText, chExpectedText );
  A_DBGR_BreakpointDeleteAll();
  A_DBGR_R();
  

  /***************************************************************************************************************/    
                                              // Test Step 1 Add the break point at function call side 
  /***************************************************************************************************************/
  snprintf( chActionText, elCount(chActionText), "Set Breakpoint in  Test_ecc_ram_injection  Function call side  "); 
  snprintf( chExpectedText, elCount(chExpectedText), "verify is Breakpoint Set  Test_ecc_ram_injection  in Function call side"); 
  A_DBGR_BreakpointSet("Test_ecc_ram_injection");  
  A_DBGR_Go();
  
  snprintf( chActionText, elCount(chActionText), "verify Breakpoint should hit in Test_ecc_ram_injection"); 
  snprintf( chExpectedText, elCount(chExpectedText), "Breakpoint hit in  Test_ecc_ram_injection function"); 
  E_DBGR_CheckState(T32_State_Stopped);
  /***************************************************************************************************************/    
                                              // Test Step2 Update the rom_payload variable to minimum value 
  /***************************************************************************************************************/
  snprintf( chActionText, elCount(chActionText), "Set the ecc_rom_payload variable  to minimum value"); 
  snprintf( chExpectedText, elCount(chExpectedText), "verify ecc_rom_payload variable to minimum value");
  TestStepAddActionExpected( chActionText, chExpectedText );
  A_DBGR_VariableSet("test_ecc_ram_payload[0]","127");
  E_DBGR_VariableCheck("test_ecc_ram_payload[0]",127,Equal);
  
  snprintf( chActionText, elCount(chActionText), "Set the Conter variable value to 0"); 
  snprintf( chExpectedText, elCount(chExpectedText), "verify Conter variable value to 0");
  TestStepAddActionExpected( chActionText, chExpectedText );
  A_DBGR_VariableSet("count","0");
  E_DBGR_VariableCheck("count",0,Equal);
//  snprintf( chActionText, elCount(chActionText), "Check the break points are deleted"); 
//  snprintf( chExpectedText, elCount(chExpectedText), "verify is Breakpoints are  deleted ");
//  TestStepAddActionExpected( chActionText, chExpectedText );
//  A_DBGR_BreakpointDeleteAll();
  
  
  /***************************************************************************************************************/    
                                              // Test Step 3 Add the break point at function call side 
  /***************************************************************************************************************/
  snprintf( chActionText, elCount(chActionText), "Set Breakpoint in  Test_ecc_ram_injection\\9  Function call side  "); 
  snprintf( chExpectedText, elCount(chExpectedText), "verify is Breakpoint Set  Test_ecc_ram_injection\\9  in Function call side"); 
  TestStepAddActionExpected( chActionText, chExpectedText );
  A_DBGR_BreakpointSet("Test_ecc_ram_injection\\9");  
  A_DBGR_Go();
  
  snprintf( chActionText, elCount(chActionText), "verify Breakpoint should hit in Test_ecc_ram_injection\\9"); 
  snprintf( chExpectedText, elCount(chExpectedText), "Breakpoint hit in  Test_ecc_ram_injection\\9 function"); 
  //E_DBGR_BreakpointCheckForHalt(" Test_ecc_ram_injection\\9");
    //TestStepAddActionExpected( chActionText, chExpectedText );
    E_DBGR_CheckState(T32_State_Stopped);
  // E_DBGR_BreakpointCheckForHalt(" Test_ecc_ram_injection\\9");
  /***************************************************************************************************************/    
                                              // Test Step4 add break point at function defination side 
  /***************************************************************************************************************/
  snprintf( chActionText, elCount(chActionText), "Set Breakpoint in GetHWIO_y_RAM_FailedCPU_Specific Function defination  side  "); 
  snprintf( chExpectedText, elCount(chExpectedText), "verify is Breakpoint Set GetHWIO_y_RAM_FailedCPU_Specific in funaction defination side"); 
  TestStepAddActionExpected( chActionText, chExpectedText );
  A_DBGR_BreakpointSet("GetHWIO_y_RAM_FailedCPU_Specific");

  A_DBGR_Go();
  snprintf( chActionText, elCount(chActionText), "verify Breakpoint should hit in GetHWIO_y_RAM_FailedCPU_Specific function defination side  "); 
  snprintf( chExpectedText, elCount(chExpectedText), "Breakpoint hit in GetHWIO_y_RAM_FailedCPU_Specific function function defination side "); 
  E_DBGR_BreakpointCheckForHalt("GetHWIO_y_RAM_FailedCPU_Specific");
  
  snprintf( chActionText, elCount(chActionText), "verify Breakpoint should hit in GetHWIO_y_RAM_FailedCPU_Specific function defination side  "); 
  snprintf( chExpectedText, elCount(chExpectedText), "Breakpoint hit in GetHWIO_y_RAM_FailedCPU_Specific function function defination side "); 
  TestStepAddActionExpected( chActionText, chExpectedText );
  E_DBGR_RegisterCheck("D:0x30001F5C","7F");
  
}
testcase To_verify_the_Maximum_value_GetHWIO_y_RAM_FailedCPU_Specific_Software_interface() 
{
  /***************************************************************************************************************/    
                                              // Test Case Info
  /***************************************************************************************************************/
  setWriteDbgLevel(DebugOff);
  snprintf( chTestTitle, elCount(chTestTitle), "To_verify_the_Maximum_value_GetHWIO_y_RAM_FailedCPU_Specific_Software_interface" );
  snprintf( chTestDescription, elCount(chTestDescription), "Purpose:To check the GetHWIO_y_RAM_FailedCPU_Specific_Software_interface");
  TestCaseAddInfo( chTestTitle, "TC_L30SW_Q-36623750", chTestDescription );
  
  /***************************************************************************************************************/    
                                              // Start of Test Case
  /***************************************************************************************************************/
  
  /***************************************************************************************************************/    
                                              // Test Step 0 PRECONDITIONS
  /***************************************************************************************************************/
  snprintf( chActionText, elCount(chActionText), "Flash the Software and ECU is running "); 
  snprintf( chExpectedText, elCount(chExpectedText), "Ecu is should be in running state"); 
  TestStepAddActionExpected( chActionText, chExpectedText );
  A_DBGR_BreakpointDeleteAll();
  A_DBGR_R();
  

  /***************************************************************************************************************/    
                                              // Test Step 1 Add the break point at function call side 
  /***************************************************************************************************************/
  snprintf( chActionText, elCount(chActionText), "Set Breakpoint in  Test_ecc_ram_injection  Function call side  "); 
  snprintf( chExpectedText, elCount(chExpectedText), "verify is Breakpoint Set  Test_ecc_ram_injection  in Function call side"); 
  A_DBGR_BreakpointSet("Test_ecc_ram_injection");  
  A_DBGR_Go();
  
  snprintf( chActionText, elCount(chActionText), "verify Breakpoint should hit in Test_ecc_ram_injection"); 
  snprintf( chExpectedText, elCount(chExpectedText), "Breakpoint hit in  Test_ecc_ram_injection function"); 
  E_DBGR_CheckState(T32_State_Stopped);
  /***************************************************************************************************************/    
                                              // Test Step2 Update the rom_payload variable to maximum value 
  /***************************************************************************************************************/
  snprintf( chActionText, elCount(chActionText), "Set the ecc_rom_payload variable  to maximum value"); 
  snprintf( chExpectedText, elCount(chExpectedText), "verify ecc_rom_payload variable to maximum value");
  TestStepAddActionExpected( chActionText, chExpectedText );
  A_DBGR_VariableSet("test_ecc_ram_payload[0]","255");
  E_DBGR_VariableCheck("test_ecc_ram_payload[0]",255,Equal);
  
  snprintf( chActionText, elCount(chActionText), "Set the Conter variable value to 0"); 
  snprintf( chExpectedText, elCount(chExpectedText), "verify Conter variable value to 0");
  TestStepAddActionExpected( chActionText, chExpectedText );
  A_DBGR_VariableSet("count","0");
  E_DBGR_VariableCheck("count",0,Equal);
//  snprintf( chActionText, elCount(chActionText), "Check the break points are deleted"); 
//  snprintf( chExpectedText, elCount(chExpectedText), "verify is Breakpoints are  deleted ");
//  TestStepAddActionExpected( chActionText, chExpectedText );
//  A_DBGR_BreakpointDeleteAll();
  
  
  /***************************************************************************************************************/    
                                              // Test Step 3 Add the break point at function call side 
  /***************************************************************************************************************/
  snprintf( chActionText, elCount(chActionText), "Set Breakpoint in  Test_ecc_ram_injection\\9  Function call side  "); 
  snprintf( chExpectedText, elCount(chExpectedText), "verify is Breakpoint Set  Test_ecc_ram_injection\\9  in Function call side"); 
  TestStepAddActionExpected( chActionText, chExpectedText );
  A_DBGR_BreakpointSet("Test_ecc_ram_injection\\9");  
  A_DBGR_Go();
  
  snprintf( chActionText, elCount(chActionText), "verify Breakpoint should hit in Test_ecc_ram_injection\\9"); 
  snprintf( chExpectedText, elCount(chExpectedText), "Breakpoint hit in  Test_ecc_ram_injection\\9 function"); 
  //E_DBGR_BreakpointCheckForHalt(" Test_ecc_ram_injection\\9");
    //TestStepAddActionExpected( chActionText, chExpectedText );
    E_DBGR_CheckState(T32_State_Stopped);
  // E_DBGR_BreakpointCheckForHalt(" Test_ecc_ram_injection\\9");
  /***************************************************************************************************************/    
                                              // Test Step4 add break point at function defination side 
  /***************************************************************************************************************/
  snprintf( chActionText, elCount(chActionText), "Set Breakpoint in GetHWIO_y_RAM_FailedCPU_Specific Function defination  side  "); 
  snprintf( chExpectedText, elCount(chExpectedText), "verify is Breakpoint Set GetHWIO_y_RAM_FailedCPU_Specific in funaction defination side"); 
  TestStepAddActionExpected( chActionText, chExpectedText );
  A_DBGR_BreakpointSet("GetHWIO_y_RAM_FailedCPU_Specific");

  A_DBGR_Go();
  snprintf( chActionText, elCount(chActionText), "verify Breakpoint should hit in GetHWIO_y_RAM_FailedCPU_Specific function defination side  "); 
  snprintf( chExpectedText, elCount(chExpectedText), "Breakpoint hit in GetHWIO_y_RAM_FailedCPU_Specific function function defination side "); 
  //TestStepAddActionExpected( chActionText, chExpectedText );
  //E_DBGR_BreakpointCheckForHalt("GetHWIO_y_RAM_FailedCPU_Specific");
  E_DBGR_CheckState(T32_State_Stopped);
  
  snprintf( chActionText, elCount(chActionText), "verify Breakpoint should hit in GetHWIO_y_RAM_FailedCPU_Specific function defination side  "); 
  snprintf( chExpectedText, elCount(chExpectedText), "Breakpoint hit in GetHWIO_y_RAM_FailedCPU_Specific function function defination side "); 
  TestStepAddActionExpected( chActionText, chExpectedText );
  E_DBGR_RegisterCheck("D:0x30001F5C","FF");
}
testcase To_verify_the_GetHWIO_Cnt_StackSize_RAM_Software_interface() 
{
  /***************************************************************************************************************/    
                                              // Test Case Info
  /***************************************************************************************************************/
  setWriteDbgLevel(DebugOff);
  snprintf( chTestTitle, elCount(chTestTitle), "To_verify_the_GetHWIO_Cnt_StackSize_RAM_Software_interface" );
  snprintf( chTestDescription, elCount(chTestDescription), "Purpose:To check the To_verify_the_GetHWIO_Cnt_StackSize_Software_interface_interface");
  TestCaseAddInfo( chTestTitle, "TC_L30SW_Q-36623750", chTestDescription);
  
  /***************************************************************************************************************/    
                                              // Start of Test Case
  /***************************************************************************************************************/
  
  /***************************************************************************************************************/    
                                              // Test Step 0 PRECONDITIONS
  /***************************************************************************************************************/
  snprintf( chActionText, elCount(chActionText), "Flash the Software and ECU is running"); 
  snprintf( chExpectedText, elCount(chExpectedText), "Ecu is should be in running state"); 
  TestStepAddActionExpected(chActionText, chExpectedText);
  A_DBGR_BreakpointDeleteAll();
  A_DBGR_R();

  /***************************************************************************************************************/    
                                              // Test Step 1 Add the break point at function call side 
  /***************************************************************************************************************/
  snprintf( chActionText, elCount(chActionText), "Set Breakpoint in TestApp_Core0_1000ms_MainFunction\\87 Function call side"); 
  snprintf( chExpectedText, elCount(chExpectedText), "verify is Breakpoint Set TestApp_Core0_1000ms_MainFunction\\87 in Function call side"); 
  A_DBGR_BreakpointSet("TestApp_Core0_1000ms_MainFunction\\87");  
  A_DBGR_Go();
  
  snprintf( chActionText, elCount(chActionText), "Set Breakpoint in TestApp_Core0_1000ms_MainFunction\\87 Function call side"); 
  snprintf( chExpectedText, elCount(chExpectedText), "Breakpoint hit in TestApp_Core0_1000ms_MainFunction\\87 function"); 
  E_DBGR_BreakpointCheckForHalt("TestApp_Core0_1000ms_MainFunction\\87");
  /***************************************************************************************************************/    
                                              // Test Step2 add break point at function defination side 
  /***************************************************************************************************************/
  snprintf( chActionText, elCount(chActionText), "Set Breakpoint in GetHWIO_Cnt_StackSize  Function defination  side "); 
  snprintf( chExpectedText, elCount(chExpectedText), "verify is Breakpoint Set GetHWIO_Cnt_StackSize in funaction defination side"); 
  TestStepAddActionExpected( chActionText, chExpectedText);
  A_DBGR_BreakpointSet("GetHWIO_Cnt_StackSize");

  A_DBGR_Go();
  
  snprintf( chActionText, elCount(chActionText), "verify Breakpoint should hit in GetHWIO_Cnt_StackSize function defination side"); 
  snprintf( chExpectedText, elCount(chExpectedText), "Breakpoint hit in GetHWIO_Cnt_StackSize function function defination side ");
  E_DBGR_BreakpointCheckForHalt("GetHWIO_Cnt_StackSize");
}
testcase To_verify_the_GetHWIO_Cnt_StackPeak_RAM_Software_interface() 
{
  /***************************************************************************************************************/    
                                              // Test Case Info
  /***************************************************************************************************************/
  setWriteDbgLevel(DebugOff);
  snprintf( chTestTitle, elCount(chTestTitle), "To_verify_the_GetHWIO_Cnt_StackPeak_RAM_Software_interface" );
  snprintf( chTestDescription, elCount(chTestDescription), "Purpose:To check the To_verify_the_GetHWIO_Cnt_StackPeak_RAM_Software_interface_interface");
  TestCaseAddInfo( chTestTitle, "TC_L30SW_Q-36623750", chTestDescription);
  
  /***************************************************************************************************************/    
                                              // Start of Test Case
  /***************************************************************************************************************/
  
  /***************************************************************************************************************/    
                                              // Test Step 0 PRECONDITIONS
  /***************************************************************************************************************/
  snprintf( chActionText, elCount(chActionText), "Flash the Software and ECU is running"); 
  snprintf( chExpectedText, elCount(chExpectedText), "Ecu is should be in running state"); 
  TestStepAddActionExpected(chActionText, chExpectedText);
  A_DBGR_BreakpointDeleteAll();
  A_DBGR_R();

  /***************************************************************************************************************/    
                                              // Test Step 1 Add the break point at function call side 
  /***************************************************************************************************************/
  snprintf( chActionText, elCount(chActionText), "Set Breakpoint in TestApp_Core0_1000ms_MainFunction\\90 Function call side"); 
  snprintf( chExpectedText, elCount(chExpectedText), "verify is Breakpoint Set TestApp_Core0_1000ms_MainFunction\\90 in Function call side"); 
  A_DBGR_BreakpointSet("TestApp_Core0_1000ms_MainFunction\\90");  
  A_DBGR_Go();
  
  snprintf( chActionText, elCount(chActionText), "Set Breakpoint in TestApp_Core0_1000ms_MainFunction\\90 Function call side"); 
  snprintf( chExpectedText, elCount(chExpectedText), "Breakpoint hit in TestApp_Core0_1000ms_MainFunction\\90 function"); 
  E_DBGR_BreakpointCheckForHalt("TestApp_Core0_1000ms_MainFunction\\90");
  /***************************************************************************************************************/    
                                              // Test Step2 add break point at function defination side 
  /***************************************************************************************************************/
  snprintf( chActionText, elCount(chActionText), "Set Breakpoint in GetHWIO_Cnt_StackPeak  Function defination  side "); 
  snprintf( chExpectedText, elCount(chExpectedText), "verify is Breakpoint Set GetHWIO_Cnt_StackPeak in funaction defination side"); 
  TestStepAddActionExpected( chActionText, chExpectedText);
  A_DBGR_BreakpointSet("GetHWIO_Cnt_StackPeak");

  A_DBGR_Go();
  
  snprintf( chActionText, elCount(chActionText), "verify Breakpoint should hit in GetHWIO_Cnt_StackSize function defination side"); 
  snprintf( chExpectedText, elCount(chExpectedText), "Breakpoint hit in GetHWIO_Cnt_StackSize function function defination side ");
  E_DBGR_BreakpointCheckForHalt("GetHWIO_Cnt_StackPeak");
}




testcase To_verify_the_ClrHWIO_WrtProtRAM_Flt_Software_interface() 
{
  /***************************************************************************************************************/    
                                              // Test Case Info
  /***************************************************************************************************************/
  setWriteDbgLevel(DebugOff);
  snprintf( chTestTitle, elCount(chTestTitle), "To_verify_the_ClrHWIO_WrtProtRAM_Flt_Software_interface" );
  snprintf( chTestDescription, elCount(chTestDescription), "Purpose:To check the ClrHWIO_WrtProtRAM_Flt_Software_interface");
  TestCaseAddInfo( chTestTitle, "TC_L30SW_Q-36623750", chTestDescription );
  
  /***************************************************************************************************************/    
                                              // Start of Test Case
  /***************************************************************************************************************/
  
  /***************************************************************************************************************/    
                                              // Test Step 0 PRECONDITIONS
  /***************************************************************************************************************/
  snprintf( chActionText, elCount(chActionText), "Flash the Software and ECU is running "); 
  snprintf( chExpectedText, elCount(chExpectedText), "Ecu is should be in running state"); 
  TestStepAddActionExpected( chActionText, chExpectedText );
  A_DBGR_BreakpointDeleteAll();
  A_DBGR_R();

  /***************************************************************************************************************/    
                                              // Test Step 1 Add the break point at function call side 
  /***************************************************************************************************************/
  snprintf( chActionText, elCount(chActionText), "Set Breakpoint in MEMPROT_HWIO_ExecuteWriteTest_ProtectedAddress_WPArea\\30 Function call side  "); 
  snprintf( chExpectedText, elCount(chExpectedText), "verify is Breakpoint Set MEMPROT_HWIO_ExecuteWriteTest_ProtectedAddress_WPArea\\30 in Function call side"); 
 // TestStepAddActionExpected( chActionText, chExpectedText );
  A_DBGR_BreakpointSet("MEMPROT_HWIO_ExecuteWriteTest_ProtectedAddress_WPArea\\30");  
  A_DBGR_Go();
  
  //snprintf( chActionText, elCount(chActionText), "verify Breakpoint should hit in core0_main\\20 "); 
  snprintf( chExpectedText, elCount(chExpectedText), "Breakpoint hit in MEMPROT_HWIO_ExecuteWriteTest_ProtectedAddress_WPArea\\30 function"); 
  //TestStepAddActionExpected( chActionText, chExpectedText );
  E_DBGR_BreakpointCheckForHalt("MEMPROT_HWIO_ExecuteWriteTest_ProtectedAddress_WPArea\\30");
  /***************************************************************************************************************/    
                                              // Test Step2 add break point at function defination side 
  /***************************************************************************************************************/
  snprintf( chActionText, elCount(chActionText), "Set Breakpoint in ClrHWIO_WrtProtRAM_Flt Function defination  side  "); 
  snprintf( chExpectedText, elCount(chExpectedText), "verify is Breakpoint Set ClrHWIO_WrtProtRAM_Flt in funaction defination side"); 
  TestStepAddActionExpected( chActionText, chExpectedText );
  A_DBGR_BreakpointSet("ClrHWIO_WrtProtRAM_Flt"); 
  //snprintf( chActionText, elCount(chActionText), "Set Breakpoint in ECU running   "); 
  //snprintf( chExpectedText, elCount(chExpectedText), "verify is ECU is running ");  
  //TestStepAddActionExpected( chActionText, chExpectedText );

  A_DBGR_Go();
  //TestStepAddActionExpected( chActionText, chExpectedText );
  snprintf( chActionText, elCount(chActionText), "verify Breakpoint should hit in ClrHWIO_WrtProtRAM_Flt function defination side  "); 
  snprintf( chExpectedText, elCount(chExpectedText), "Breakpoint hit in ClrHWIO_WrtProtRAM_Flt function function defination side "); 
  TestStepAddActionExpected( chActionText, chExpectedText );
  E_DBGR_BreakpointCheckForHalt("ClrHWIO_WrtProtRAM_Flt");
}
testcase To_verify_the_GetHWIO_b_WrtProtRAM_Flt_Software_interface() 
{
  /***************************************************************************************************************/    
                                              // Test Case Info
  /***************************************************************************************************************/
  setWriteDbgLevel(DebugOff);
  snprintf( chTestTitle, elCount(chTestTitle), "To_verify_the_GetHWIO_b_WrtProtRAM_Flt_Software_interface" );
  snprintf( chTestDescription, elCount(chTestDescription), "Purpose:To check the GetHWIO_b_WrtProtRAM_Flt_interface");
  TestCaseAddInfo( chTestTitle, "TC_L30SW_Q-36623750", chTestDescription );
  
  /***************************************************************************************************************/    
                                              // Start of Test Case
  /***************************************************************************************************************/
  
  /***************************************************************************************************************/    
                                              // Test Step 0 PRECONDITIONS
  /***************************************************************************************************************/
  snprintf( chActionText, elCount(chActionText), "Flash the Software and ECU is running "); 
  snprintf( chExpectedText, elCount(chExpectedText), "Ecu is should be in running state"); 
  TestStepAddActionExpected( chActionText, chExpectedText );
  A_DBGR_BreakpointDeleteAll();
  A_DBGR_R();

  /***************************************************************************************************************/    
                                              // Test Step 1 Add the break point at function call side 
  /***************************************************************************************************************/
  snprintf( chActionText, elCount(chActionText), "Set Breakpoint in MEMPROT_HWIO_ExecuteWriteTest_ProtectedAddress_WPArea\\11  Function call side  "); 
  snprintf( chExpectedText, elCount(chExpectedText), "verify is Breakpoint Set MEMPROT_HWIO_ExecuteWriteTest_ProtectedAddress_WPArea\\11 in Function call side"); 
 // TestStepAddActionExpected( chActionText, chExpectedText );
  A_DBGR_BreakpointSet("MEMPROT_HWIO_ExecuteWriteTest_ProtectedAddress_WPArea\\11");  
  A_DBGR_Go();
  
  //snprintf( chActionText, elCount(chActionText), "verify Breakpoint should hit in core0_main\\20 "); 
  snprintf( chExpectedText, elCount(chExpectedText), "Breakpoint hit in MEMPROT_HWIO_ExecuteWriteTest_ProtectedAddress_WPArea\\11 function"); 
  //TestStepAddActionExpected( chActionText, chExpectedText );
  E_DBGR_BreakpointCheckForHalt("MEMPROT_HWIO_ExecuteWriteTest_ProtectedAddress_WPArea\\11");
  /***************************************************************************************************************/    
                                              // Test Step2 add break point at function defination side 
  /***************************************************************************************************************/
  snprintf( chActionText, elCount(chActionText), "Set Breakpoint in GetHWIO_b_WrtProtRAM_Flt Function defination  side  "); 
  snprintf( chExpectedText, elCount(chExpectedText), "verify is Breakpoint Set GetHWIO_b_WrtProtRAM_Flt in funaction defination side"); 
  TestStepAddActionExpected( chActionText, chExpectedText );
  A_DBGR_BreakpointSet("GetHWIO_b_WrtProtRAM_Flt"); 
  //snprintf( chActionText, elCount(chActionText), "Set Breakpoint in ECU running   "); 
  //snprintf( chExpectedText, elCount(chExpectedText), "verify is ECU is running ");  
  //TestStepAddActionExpected( chActionText, chExpectedText );

  A_DBGR_Go();
  //TestStepAddActionExpected( chActionText, chExpectedText );
  snprintf( chActionText, elCount(chActionText), "verify Breakpoint should hit in GetHWIO_b_WrtProtRAM_Flt function defination side  "); 
  snprintf( chExpectedText, elCount(chExpectedText), "Breakpoint hit in GetHWIO_b_WrtProtRAM_Flt function function defination side "); 
  TestStepAddActionExpected( chActionText, chExpectedText );
  E_DBGR_BreakpointCheckForHalt("GetHWIO_b_WrtProtRAM_Flt");
}
testcase To_verify_the_GetHWIO_ptr_WrtProtRAM_FltAddr_Software_interface() 
{
  /***************************************************************************************************************/    
                                              // Test Case Info
  /***************************************************************************************************************/
  setWriteDbgLevel(DebugOff);
  snprintf( chTestTitle, elCount(chTestTitle), "To_verify_the_GetHWIO_ptr_WrtProtRAM_FltAddr_Software_interface" );
  snprintf( chTestDescription, elCount(chTestDescription), "Purpose:To check the GetHWIO_ptr_WrtProtRAM_FltAddr_interface");
  TestCaseAddInfo( chTestTitle, "TC_L30SW_Q-36623750", chTestDescription );
  
  /***************************************************************************************************************/    
                                              // Start of Test Case
  /***************************************************************************************************************/
  
  /***************************************************************************************************************/    
                                              // Test Step 0 PRECONDITIONS
  /***************************************************************************************************************/
  snprintf( chActionText, elCount(chActionText), "Flash the Software and ECU is running "); 
  snprintf( chExpectedText, elCount(chExpectedText), "Ecu is should be in running state"); 
  TestStepAddActionExpected( chActionText, chExpectedText );
  A_DBGR_BreakpointDeleteAll();
  A_DBGR_R();

  /***************************************************************************************************************/    
                                              // Test Step 1 Add the break point at function call side 
  /***************************************************************************************************************/
  snprintf( chActionText, elCount(chActionText), "Set Breakpoint in MEMPROT_HWIO_ExecuteWriteTest_ProtectedAddress_WPArea\\18  Function call side  "); 
  snprintf( chExpectedText, elCount(chExpectedText), "verify is Breakpoint Set MEMPROT_HWIO_ExecuteWriteTest_ProtectedAddress_WPArea\\18 in Function call side"); 
 // TestStepAddActionExpected( chActionText, chExpectedText );
  A_DBGR_BreakpointSet("MEMPROT_HWIO_ExecuteWriteTest_ProtectedAddress_WPArea\\18");  
  A_DBGR_Go();
  
  //snprintf( chActionText, elCount(chActionText), "verify Breakpoint should hit in core0_main\\20 "); 
  snprintf( chExpectedText, elCount(chExpectedText), "Breakpoint hit in MEMPROT_HWIO_ExecuteWriteTest_ProtectedAddress_WPArea\\18 function"); 
  //TestStepAddActionExpected( chActionText, chExpectedText );
  E_DBGR_BreakpointCheckForHalt("MEMPROT_HWIO_ExecuteWriteTest_ProtectedAddress_WPArea\\18");
  /***************************************************************************************************************/    
                                              // Test Step2 add break point at function defination side 
  /***************************************************************************************************************/
  snprintf( chActionText, elCount(chActionText), "Set Breakpoint in GetHWIO_ptr_WrtProtRAM_FltAddr Function defination  side  "); 
  snprintf( chExpectedText, elCount(chExpectedText), "verify is Breakpoint Set GetHWIO_ptr_WrtProtRAM_FltAddr in funaction defination side"); 
  TestStepAddActionExpected( chActionText, chExpectedText );
  A_DBGR_BreakpointSet("GetHWIO_ptr_WrtProtRAM_FltAddr"); 
  //snprintf( chActionText, elCount(chActionText), "Set Breakpoint in ECU running   "); 
  //snprintf( chExpectedText, elCount(chExpectedText), "verify is ECU is running ");  
  //TestStepAddActionExpected( chActionText, chExpectedText );

  A_DBGR_Go();
  //TestStepAddActionExpected( chActionText, chExpectedText );
  snprintf( chActionText, elCount(chActionText), "verify Breakpoint should hit in GetHWIO_ptr_WrtProtRAM_FltAddr function defination side  "); 
  snprintf( chExpectedText, elCount(chExpectedText), "Breakpoint hit in GetHWIO_ptr_WrtProtRAM_FltAddr function function defination side "); 
  TestStepAddActionExpected( chActionText, chExpectedText );
  E_DBGR_BreakpointCheckForHalt("GetHWIO_ptr_WrtProtRAM_FltAddr");
}
testcase To_verify_the_GetHWIO_ptr_WrtProtRAM_FltInstAddr_Software_interface() 
{
  /***************************************************************************************************************/    
                                              // Test Case Info
  /***************************************************************************************************************/
  setWriteDbgLevel(DebugOff);
  snprintf( chTestTitle, elCount(chTestTitle), "To_verify_the_GetHWIO_ptr_WrtProtRAM_FltInstAddr_Software_interface" );
  snprintf( chTestDescription, elCount(chTestDescription), "Purpose:To check the GetHWIO_ptr_WrtProtRAM_FltInstAddr_interface");
  TestCaseAddInfo( chTestTitle, "TC_L30SW_Q-36623750", chTestDescription );
  
  /***************************************************************************************************************/    
                                              // Start of Test Case
  /***************************************************************************************************************/
  
  /***************************************************************************************************************/    
                                              // Test Step 0 PRECONDITIONS
  /***************************************************************************************************************/
  snprintf( chActionText, elCount(chActionText), "Flash the Software and ECU is running "); 
  snprintf( chExpectedText, elCount(chExpectedText), "Ecu is should be in running state"); 
  TestStepAddActionExpected( chActionText, chExpectedText );
  A_DBGR_BreakpointDeleteAll();
  A_DBGR_R();

  /***************************************************************************************************************/    
                                              // Test Step 1 Add the break point at function call side 
  /***************************************************************************************************************/
  snprintf( chActionText, elCount(chActionText), "Set Breakpoint in MEMPROT_HWIO_ExecuteWriteTest_ProtectedAddress_WPArea\\19  Function call side  "); 
  snprintf( chExpectedText, elCount(chExpectedText), "verify is Breakpoint Set MEMPROT_HWIO_ExecuteWriteTest_ProtectedAddress_WPArea\\19 in Function call side"); 
 // TestStepAddActionExpected( chActionText, chExpectedText );
  A_DBGR_BreakpointSet("MEMPROT_HWIO_ExecuteWriteTest_ProtectedAddress_WPArea\\19");  
  A_DBGR_Go();
  
  //snprintf( chActionText, elCount(chActionText), "verify Breakpoint should hit in core0_main\\20 "); 
  snprintf( chExpectedText, elCount(chExpectedText), "Breakpoint hit in MEMPROT_HWIO_ExecuteWriteTest_ProtectedAddress_WPArea\\19 function"); 
  //TestStepAddActionExpected( chActionText, chExpectedText );
  E_DBGR_BreakpointCheckForHalt("MEMPROT_HWIO_ExecuteWriteTest_ProtectedAddress_WPArea\\19");
  /***************************************************************************************************************/    
                                              // Test Step2 add break point at function defination side 
  /***************************************************************************************************************/
  snprintf( chActionText, elCount(chActionText), "Set Breakpoint in GetHWIO_ptr_WrtProtRAM_FltInstAddr Function defination  side  "); 
  snprintf( chExpectedText, elCount(chExpectedText), "verify is Breakpoint Set GetHWIO_ptr_WrtProtRAM_FltInstAddr in funaction defination side"); 
  TestStepAddActionExpected( chActionText, chExpectedText );
  A_DBGR_BreakpointSet("GetHWIO_ptr_WrtProtRAM_FltInstAddr"); 
  //snprintf( chActionText, elCount(chActionText), "Set Breakpoint in ECU running   "); 
  //snprintf( chExpectedText, elCount(chExpectedText), "verify is ECU is running ");  
  //TestStepAddActionExpected( chActionText, chExpectedText );

  A_DBGR_Go();
  //TestStepAddActionExpected( chActionText, chExpectedText );
  snprintf( chActionText, elCount(chActionText), "verify Breakpoint should hit in GetHWIO_ptr_WrtProtRAM_FltInstAddr function defination side  "); 
  snprintf( chExpectedText, elCount(chExpectedText), "Breakpoint hit in GetHWIO_ptr_WrtProtRAM_FltInstAddr function function defination side "); 
  TestStepAddActionExpected( chActionText, chExpectedText );
  E_DBGR_BreakpointCheckForHalt("GetHWIO_ptr_WrtProtRAM_FltInstAddr");
}
testcase To_verify_the_SetHWIO_b_WrtProtRAM_LckUnlck_True_Software_interface() 
{
  /***************************************************************************************************************/    
                                              // Test Case Info
  /***************************************************************************************************************/
  setWriteDbgLevel(DebugOff);
  snprintf( chTestTitle, elCount(chTestTitle), "To_verify_the_SetHWIO_b_WrtProtRAM_LckUnlck_True_Software_interface" );
  snprintf( chTestDescription, elCount(chTestDescription), "Purpose:To check the SetHWIO_b_WrtProtRAM_LckUnlck_True_interface");
  TestCaseAddInfo( chTestTitle, "TC_L30SW_Q-36623750", chTestDescription );
  
  /***************************************************************************************************************/    
                                              // Start of Test Case
  /***************************************************************************************************************/
  
  /***************************************************************************************************************/    
                                              // Test Step 0 PRECONDITIONS
  /***************************************************************************************************************/
  snprintf( chActionText, elCount(chActionText), "Flash the Software and ECU is running "); 
  snprintf( chExpectedText, elCount(chExpectedText), "Ecu is should be in running state"); 
  TestStepAddActionExpected( chActionText, chExpectedText );
  A_DBGR_BreakpointDeleteAll();
  A_DBGR_R();

  /***************************************************************************************************************/    
                                              // Test Step 1 Add the break point at function call side 
  /***************************************************************************************************************/
  snprintf( chActionText, elCount(chActionText), "Set Breakpoint in MEMPROT_HWIO_Run_WriteProtectedRAM_Tests\\25  Function call side  "); 
  snprintf( chExpectedText, elCount(chExpectedText), "verify is Breakpoint Set MEMPROT_HWIO_Run_WriteProtectedRAM_Tests\\25 in Function call side"); 
 // TestStepAddActionExpected( chActionText, chExpectedText );
  A_DBGR_BreakpointSet("MEMPROT_HWIO_Run_WriteProtectedRAM_Tests\\25");  
  A_DBGR_Go();
  
  //snprintf( chActionText, elCount(chActionText), "verify Breakpoint should hit in core0_main\\20 "); 
  snprintf( chExpectedText, elCount(chExpectedText), "Breakpoint hit in MEMPROT_HWIO_Run_WriteProtectedRAM_Tests\\25 function"); 
  //TestStepAddActionExpected( chActionText, chExpectedText );
  E_DBGR_BreakpointCheckForHalt("MEMPROT_HWIO_Run_WriteProtectedRAM_Tests\\25");
  /***************************************************************************************************************/    
                                              // Test Step2 add break point at function defination side 
  /***************************************************************************************************************/
  snprintf( chActionText, elCount(chActionText), "Set Breakpoint in SetHWIO_b_WrtProtRAM_LckUnlck\\5  Function defination  side  "); 
  snprintf( chExpectedText, elCount(chExpectedText), "verify is Breakpoint Set SetHWIO_b_WrtProtRAM_LckUnlck\\5 in funaction defination side"); 
  TestStepAddActionExpected( chActionText, chExpectedText );
  A_DBGR_BreakpointSet("SetHWIO_b_WrtProtRAM_LckUnlck\\5"); 
  //snprintf( chActionText, elCount(chActionText), "Set Breakpoint in ECU running   "); 
  //snprintf( chExpectedText, elCount(chExpectedText), "verify is ECU is running ");  
  //TestStepAddActionExpected( chActionText, chExpectedText );

  A_DBGR_Go();
  //TestStepAddActionExpected( chActionText, chExpectedText );
  snprintf( chActionText, elCount(chActionText), "verify Breakpoint should hit in SetHWIO_b_WrtProtRAM_LckUnlck\\5 function defination side  "); 
  snprintf( chExpectedText, elCount(chExpectedText), "Breakpoint hit in SetHWIO_b_WrtProtRAM_LckUnlck\\5 function function defination side "); 
  TestStepAddActionExpected( chActionText, chExpectedText );
  E_DBGR_BreakpointCheckForHalt("SetHWIO_b_WrtProtRAM_LckUnlck\\5");
}
testcase To_verify_the_SetHWIO_b_WrtProtRAM_LckUnlck_False_Software_interface() 
{
  /***************************************************************************************************************/    
                                              // Test Case Info
  /***************************************************************************************************************/
  setWriteDbgLevel(DebugOff);
  snprintf( chTestTitle, elCount(chTestTitle), "To_verify_the_SetHWIO_b_WrtProtRAM_LckUnlck_False_Software_interface" );
  snprintf( chTestDescription, elCount(chTestDescription), "Purpose:To check the SetHWIO_b_WrtProtRAM_LckUnlck_False_interface");
  TestCaseAddInfo( chTestTitle, "TC_L30SW_Q-36623750", chTestDescription );
  
  /***************************************************************************************************************/    
                                              // Start of Test Case
  /***************************************************************************************************************/
  
  /***************************************************************************************************************/    
                                              // Test Step 0 PRECONDITIONS
  /***************************************************************************************************************/
  snprintf( chActionText, elCount(chActionText), "Flash the Software and ECU is running "); 
  snprintf( chExpectedText, elCount(chExpectedText), "Ecu is should be in running state"); 
  TestStepAddActionExpected( chActionText, chExpectedText );
  A_DBGR_BreakpointDeleteAll();
  A_DBGR_R();

  /***************************************************************************************************************/    
                                              // Test Step 1 Add the break point at function call side 
  /***************************************************************************************************************/
  snprintf( chActionText, elCount(chActionText), "Set Breakpoint in MEMPROT_HWIO_Run_WriteProtectedRAM_Tests\\25  Function call side  "); 
  snprintf( chExpectedText, elCount(chExpectedText), "verify is Breakpoint Set MEMPROT_HWIO_Run_WriteProtectedRAM_Tests\\25 in Function call side"); 
 // TestStepAddActionExpected( chActionText, chExpectedText );
  A_DBGR_BreakpointSet("MEMPROT_HWIO_Run_WriteProtectedRAM_Tests\\25");  
  A_DBGR_Go();
  
  //snprintf( chActionText, elCount(chActionText), "verify Breakpoint should hit in core0_main\\20 "); 
  snprintf( chExpectedText, elCount(chExpectedText), "Breakpoint hit in MEMPROT_HWIO_Run_WriteProtectedRAM_Tests\\25 function"); 
  //TestStepAddActionExpected( chActionText, chExpectedText );
  E_DBGR_BreakpointCheckForHalt("MEMPROT_HWIO_Run_WriteProtectedRAM_Tests\\25");
  /***************************************************************************************************************/    
                                              // Test Step2 add break point at function defination side 
  /***************************************************************************************************************/
  snprintf( chActionText, elCount(chActionText), "Set Breakpoint in SetHWIO_b_WrtProtRAM_LckUnlck\\10  Function defination  side  "); 
  snprintf( chExpectedText, elCount(chExpectedText), "verify is Breakpoint Set SetHWIO_b_WrtProtRAM_LckUnlck\\10 in funaction defination side"); 
  TestStepAddActionExpected( chActionText, chExpectedText );
  A_DBGR_BreakpointSet("SetHWIO_b_WrtProtRAM_LckUnlck\\10"); 
  //snprintf( chActionText, elCount(chActionText), "Set Breakpoint in ECU running   "); 
  //snprintf( chExpectedText, elCount(chExpectedText), "verify is ECU is running ");  
  //TestStepAddActionExpected( chActionText, chExpectedText );

  A_DBGR_Go();
  //TestStepAddActionExpected( chActionText, chExpectedText );
  snprintf( chActionText, elCount(chActionText), "verify Breakpoint should hit in SetHWIO_b_WrtProtRAM_LckUnlck\\10 function defination side  "); 
  snprintf( chExpectedText, elCount(chExpectedText), "Breakpoint hit in SetHWIO_b_WrtProtRAM_LckUnlck\\10 function function defination side "); 
  TestStepAddActionExpected( chActionText, chExpectedText );
  E_DBGR_BreakpointCheckForHalt("SetHWIO_b_WrtProtRAM_LckUnlck\\10");
}
/***************************************************************************************************************/    
                                              // Timers_SWIT_Testcases
/***************************************************************************************************************/
testcase To_verify_the_MCU_Init_Software_interface() 
{
  /***************************************************************************************************************/    
                                              // Test Case Info
  /***************************************************************************************************************/
  setWriteDbgLevel(DebugOff);
  snprintf( chTestTitle, elCount(chTestTitle), "To_verify_the_MCU_Init_Software_interface" );
  snprintf( chTestDescription, elCount(chTestDescription), "Purpose:To check the MCU_Init_Software_interface");
  TestCaseAddInfo( chTestTitle, "TC_L30SW_Q-36623750", chTestDescription );
  
  /***************************************************************************************************************/    
                                              // Start of Test Case
  /***************************************************************************************************************/
  
  /***************************************************************************************************************/    
                                              // Test Step 0 PRECONDITIONS
  /***************************************************************************************************************/
  snprintf( chActionText, elCount(chActionText), "Flash the Software and ECU is running "); 
  snprintf( chExpectedText, elCount(chExpectedText), "Ecu is should be in running state"); 
  TestStepAddActionExpected( chActionText, chExpectedText );
  A_DBGR_BreakpointDeleteAll();
  A_DBGR_R();

  /***************************************************************************************************************/    
                                              // Test Step 1 Add the break point at function call side 
  /***************************************************************************************************************/
  snprintf( chActionText, elCount(chActionText), "Set Breakpoint in App_MCALInit\\22 Function call side  "); 
  snprintf( chExpectedText, elCount(chExpectedText), "verify is Breakpoint Set App_MCALInit\\22 in Function call side"); 
  A_DBGR_BreakpointSet("App_MCALInit\\22");  
  A_DBGR_Go();
  
  snprintf( chExpectedText, elCount(chExpectedText), "Breakpoint hit in App_MCALInit\\22 function"); 
  E_DBGR_BreakpointCheckForHalt("App_MCALInit\\22");
  /***************************************************************************************************************/    
                                              // Test Step2 add break point at function defination side 
  /***************************************************************************************************************/
  snprintf( chActionText, elCount(chActionText), "Set Breakpoint in Mcu_Init Function defination  side  "); 
  snprintf( chExpectedText, elCount(chExpectedText), "verify is Breakpoint Set Mcu_Init in funaction defination side"); 
  TestStepAddActionExpected( chActionText, chExpectedText );
  A_DBGR_BreakpointSet("Mcu_Init"); 

  A_DBGR_Go();
  snprintf( chActionText, elCount(chActionText), "verify Breakpoint should hit in Mcu_Init function defination side  "); 
  snprintf( chExpectedText, elCount(chExpectedText), "Breakpoint hit in Mcu_Init function function defination side "); 
  E_DBGR_BreakpointCheckForHalt("Mcu_Init");
}
testcase To_verify_the_MCU_InitClock_Software_interface() 
{
  /***************************************************************************************************************/    
                                              // Test Case Info
  /***************************************************************************************************************/
  setWriteDbgLevel(DebugOff);
  snprintf( chTestTitle, elCount(chTestTitle), "To_verify_the_MCU_InitClock_Software_interface" );
  snprintf( chTestDescription, elCount(chTestDescription), "Purpose:To check the MCU_InitClock_Software_interface");
  TestCaseAddInfo( chTestTitle, "TC_L30SW_Q-36623750", chTestDescription );
  
  /***************************************************************************************************************/    
                                              // Start of Test Case
  /***************************************************************************************************************/
  
  /***************************************************************************************************************/    
                                              // Test Step 0 PRECONDITIONS
  /***************************************************************************************************************/
  snprintf( chActionText, elCount(chActionText), "Flash the Software and ECU is running "); 
  snprintf( chExpectedText, elCount(chExpectedText), "Ecu is should be in running state"); 
  TestStepAddActionExpected( chActionText, chExpectedText );
  A_DBGR_BreakpointDeleteAll();
  A_DBGR_R();

  /***************************************************************************************************************/    
                                              // Test Step 1 Add the break point at function call side 
  /***************************************************************************************************************/
  snprintf( chActionText, elCount(chActionText), "Set Breakpoint in App_MCALInit\\24 Function call side  "); 
  snprintf( chExpectedText, elCount(chExpectedText), "verify is Breakpoint Set App_MCALInit\\24 in Function call side"); 
  A_DBGR_BreakpointSet("App_MCALInit\\24");  
  A_DBGR_Go();
  
  snprintf( chExpectedText, elCount(chExpectedText), "Breakpoint hit in App_MCALInit\\24 function"); 
  E_DBGR_BreakpointCheckForHalt("App_MCALInit\\24");
  /***************************************************************************************************************/    
                                              // Test Step2 add break point at function defination side 
  /***************************************************************************************************************/
  snprintf( chActionText, elCount(chActionText), "Set Breakpoint in Mcu_InitClock Function defination  side  "); 
  snprintf( chExpectedText, elCount(chExpectedText), "verify is Breakpoint Set Mcu_InitClock in funaction defination side"); 
  TestStepAddActionExpected( chActionText, chExpectedText );
  A_DBGR_BreakpointSet("Mcu_InitClock"); 

  A_DBGR_Go();
  snprintf( chActionText, elCount(chActionText), "verify Breakpoint should hit in Mcu_InitClock function defination side  "); 
  snprintf( chExpectedText, elCount(chExpectedText), "Breakpoint hit in Mcu_InitClock function function defination side "); 
  E_DBGR_BreakpointCheckForHalt("Mcu_InitClock");
}
testcase To_verify_the_Mcu_DistributePllClock_Software_interface() 
{
  /***************************************************************************************************************/    
                                              // Test Case Info
  /***************************************************************************************************************/
  setWriteDbgLevel(DebugOff);
  snprintf( chTestTitle, elCount(chTestTitle), "To_verify_the_Mcu_DistributePllClock_Software_interface" );
  snprintf( chTestDescription, elCount(chTestDescription), "Purpose:To check the Mcu_DistributePllClock_Software_interface");
  TestCaseAddInfo( chTestTitle, "TC_L30SW_Q-36623750", chTestDescription );
  
  /***************************************************************************************************************/    
                                              // Start of Test Case
  /***************************************************************************************************************/
  
  /***************************************************************************************************************/    
                                              // Test Step 0 PRECONDITIONS
  /***************************************************************************************************************/
  snprintf( chActionText, elCount(chActionText), "Flash the Software and ECU is running "); 
  snprintf( chExpectedText, elCount(chExpectedText), "Ecu is should be in running state"); 
  TestStepAddActionExpected( chActionText, chExpectedText );
  A_DBGR_BreakpointDeleteAll();
  A_DBGR_R();

  /***************************************************************************************************************/    
                                              // Test Step 1 Add the break point at function call side 
  /***************************************************************************************************************/
  snprintf( chActionText, elCount(chActionText), "Set Breakpoint in App_MCALInit\\33 Function call side  "); 
  snprintf( chExpectedText, elCount(chExpectedText), "verify is Breakpoint Set App_MCALInit\\33 in Function call side"); 
  A_DBGR_BreakpointSet("App_MCALInit\\33");  
  A_DBGR_Go();
  
  snprintf( chExpectedText, elCount(chExpectedText), "Breakpoint hit in App_MCALInit\\33 function"); 
  E_DBGR_BreakpointCheckForHalt("App_MCALInit\\33");
  /***************************************************************************************************************/    
                                              // Test Step2 add break point at function defination side 
  /***************************************************************************************************************/
  snprintf( chActionText, elCount(chActionText), "Set Breakpoint in Mcu_DistributePllClock Function defination  side  "); 
  snprintf( chExpectedText, elCount(chExpectedText), "verify is Breakpoint Set Mcu_DistributePllClock in funaction defination side"); 
  TestStepAddActionExpected( chActionText, chExpectedText );
  A_DBGR_BreakpointSet("Mcu_DistributePllClock"); 

  A_DBGR_Go();
  snprintf( chActionText, elCount(chActionText), "verify Breakpoint should hit in Mcu_DistributePllClock function defination side  "); 
  snprintf( chExpectedText, elCount(chExpectedText), "Breakpoint hit in Mcu_DistributePllClock function function defination side "); 
  E_DBGR_BreakpointCheckForHalt("Mcu_DistributePllClock");
}
testcase To_verify_the_os_main_Timers_Software_interface() 
{
  /***************************************************************************************************************/    
                                              // Test Case Info
  /***************************************************************************************************************/
  setWriteDbgLevel(DebugOff);
  snprintf( chTestTitle, elCount(chTestTitle), "To_verify_the_os_main_Timers_Software_interface" );
  snprintf( chTestDescription, elCount(chTestDescription), "Purpose:To check the To_verify_the_os_main_interface_interface");
  TestCaseAddInfo( chTestTitle, "TC_L30SW_Q-36623750", chTestDescription );
  
  /***************************************************************************************************************/    
                                              // Start of Test Case
  /***************************************************************************************************************/
  
  /***************************************************************************************************************/    
                                              // Test Step 0 PRECONDITIONS
  /***************************************************************************************************************/
  snprintf( chActionText, elCount(chActionText), "Flash the Software and ECU is running "); 
  snprintf( chExpectedText, elCount(chExpectedText), "Ecu is should be in running state"); 
  TestStepAddActionExpected( chActionText, chExpectedText );
  A_DBGR_BreakpointDeleteAll();
  A_DBGR_R();

  /***************************************************************************************************************/    
                                              // Test Step 1 Add the break point at function call side 
  /***************************************************************************************************************/
  snprintf( chActionText, elCount(chActionText), "Set Breakpoint in core0_main\\28 Function call side  "); 
  snprintf( chExpectedText, elCount(chExpectedText), "verify is Breakpoint Set core0_main\\28 in Function call side"); 
  A_DBGR_BreakpointSet("core0_main\\28");  
  A_DBGR_Go();
  
  snprintf( chActionText, elCount(chActionText), "verify Breakpoint should hit in core0_main\\28"); 
  snprintf( chExpectedText, elCount(chExpectedText), "Breakpoint hit in core0_main\\28 function"); 
  E_DBGR_BreakpointCheckForHalt("core0_main\\28");
  /***************************************************************************************************************/    
                                              // Test Step2 add break point at function defination side 
  /***************************************************************************************************************/
  snprintf( chActionText, elCount(chActionText), "Set Breakpoint in os_main  Function defination side"); 
  snprintf( chExpectedText, elCount(chExpectedText), "verify is Breakpoint Set os_main in funaction defination side"); 
  TestStepAddActionExpected( chActionText, chExpectedText );
  A_DBGR_BreakpointSet("os_main"); 


  A_DBGR_Go();
  snprintf( chActionText, elCount(chActionText), "verify Breakpoint should hit in os_main function defination side"); 
  snprintf( chExpectedText, elCount(chExpectedText), "Breakpoint hit in os_main function function defination side");
  E_DBGR_BreakpointCheckForHalt("os_main");
}
testcase To_verify_the_Os_Entry_Task_Core0_100ms_Software_interface() 
{
  /***************************************************************************************************************/    
                                              // Test Case Info
  /***************************************************************************************************************/
  setWriteDbgLevel(DebugOff);
  snprintf( chTestTitle, elCount(chTestTitle), "To_verify_the_Os_Entry_Task_Core0_100ms_Software_interface" );
  snprintf( chTestDescription, elCount(chTestDescription), "Purpose:To check the Os_Entry_Task_Core0_100ms_Software_interface");
  TestCaseAddInfo( chTestTitle, "TC_L30SW_Q-36623750", chTestDescription );
  
  /***************************************************************************************************************/    
                                              // Start of Test Case
  /***************************************************************************************************************/
  
  /***************************************************************************************************************/    
                                              // Test Step 0 PRECONDITIONS
  /***************************************************************************************************************/
  snprintf( chActionText, elCount(chActionText), "Flash the Software and ECU is running "); 
  snprintf( chExpectedText, elCount(chExpectedText), "Ecu is should be in running state"); 
  TestStepAddActionExpected( chActionText, chExpectedText );
  A_DBGR_BreakpointDeleteAll();
  A_DBGR_R();

  /***************************************************************************************************************/    
                                              // Test Step 1 Add the break point at function call side 
  /***************************************************************************************************************/
  snprintf( chActionText, elCount(chActionText), "Set Breakpoint in Os_Entry_Task_Core0_100ms\\14 Function call side  "); 
  snprintf( chExpectedText, elCount(chExpectedText), "verify is Breakpoint Set  Os_Entry_Task_Core0_100ms\\14 in Function call side"); 
  A_DBGR_BreakpointSet("Os_Entry_Task_Core0_100ms\\14");  
  A_DBGR_Go();
  
  snprintf( chExpectedText, elCount(chExpectedText), "Breakpoint hit in  Os_Entry_Task_Core0_100ms\\14 function"); 
  E_DBGR_BreakpointCheckForHalt("Os_Entry_Task_Core0_100ms\\14");
  /***************************************************************************************************************/    
                                              // Test Step2 add break point at function defination side 
  /***************************************************************************************************************/
  snprintf( chActionText, elCount(chActionText), "Set Breakpoint in  MngTSKR_100msOS_Task Function defination  side  "); 
  snprintf( chExpectedText, elCount(chExpectedText), "verify is Breakpoint Set MngTSKR_100msOS_Task in funaction defination side"); 
  TestStepAddActionExpected( chActionText, chExpectedText );
  A_DBGR_BreakpointSet("MngTSKR_100msOS_Task"); 

  A_DBGR_Go();
  snprintf( chActionText, elCount(chActionText), "verify Breakpoint should hit in MngTSKR_100msOS_Task function defination side  "); 
  snprintf( chExpectedText, elCount(chExpectedText), "Breakpoint hit in MngTSKR_100msOS_Task function defination side "); 
  E_DBGR_BreakpointCheckForHalt("MngTSKR_100msOS_Task");
}
testcase To_verify_the_GetHWIO_Cnt_SysTick_Software_interface() 
{
  /***************************************************************************************************************/    
                                              // Test Case Info
  /***************************************************************************************************************/
  setWriteDbgLevel(DebugOff);
  snprintf( chTestTitle, elCount(chTestTitle), "To_verify_the_GetHWIO_Cnt_SysTick_Software_interface" );
  snprintf( chTestDescription, elCount(chTestDescription), "Purpose:To check the GetHWIO_Cnt_SysTick_Software_interface");
  TestCaseAddInfo( chTestTitle, "TC_L30SW_Q-36623750", chTestDescription );
  
  /***************************************************************************************************************/    
                                              // Start of Test Case
  /***************************************************************************************************************/
  
  /***************************************************************************************************************/    
                                              // Test Step 0 PRECONDITIONS
  /***************************************************************************************************************/
  snprintf( chActionText, elCount(chActionText), "Flash the Software and ECU is running "); 
  snprintf( chExpectedText, elCount(chExpectedText), "Ecu is should be in running state"); 
  TestStepAddActionExpected( chActionText, chExpectedText );
  A_DBGR_BreakpointDeleteAll();
  A_DBGR_R();

  /***************************************************************************************************************/    
                                              // Test Step 1 Add the break point at function call side 
  /***************************************************************************************************************/
  snprintf( chActionText, elCount(chActionText), "Set Breakpoint in test_ticks\\4 Function call side  "); 
  snprintf( chExpectedText, elCount(chExpectedText), "verify is Breakpoint Set test_ticks\\4 in Function call side"); 
  A_DBGR_BreakpointSet("test_ticks\\4");  
  A_DBGR_Go();
  
  snprintf( chExpectedText, elCount(chExpectedText), "Breakpoint hit in test_ticks\\4 function"); 
  E_DBGR_BreakpointCheckForHalt("test_ticks\\4");
  /***************************************************************************************************************/    
                                              // Test Step2 add break point at function defination side 
  /***************************************************************************************************************/
  snprintf( chActionText, elCount(chActionText), "Set Breakpoint in GetHWIO_Cnt_SysTicks Function defination  side  "); 
  snprintf( chExpectedText, elCount(chExpectedText), "verify is Breakpoint Set GetHWIO_Cnt_SysTicks in funaction defination side"); 
  TestStepAddActionExpected( chActionText, chExpectedText );
  A_DBGR_BreakpointSet("GetHWIO_Cnt_SysTicks"); 

  A_DBGR_Go();
  snprintf( chActionText, elCount(chActionText), "verify Breakpoint should hit in GetHWIO_Cnt_SysTicks function defination side  "); 
  snprintf( chExpectedText, elCount(chExpectedText), "Breakpoint hit in GetHWIO_Cnt_SysTicks function function defination side "); 
  E_DBGR_BreakpointCheckForHalt("GetHWIO_Cnt_SysTicks");
}
testcase To_verify_the_GetHWIO_Cnt_SysTicksPerMicrosec_Software_interface() 
{
  /***************************************************************************************************************/    
                                              // Test Case Info
  /***************************************************************************************************************/
  setWriteDbgLevel(DebugOff);
  snprintf( chTestTitle, elCount(chTestTitle), "To_verify_the_GetHWIO_Cnt_SysTicksPerMicrosec_Software_interface" );
  snprintf( chTestDescription, elCount(chTestDescription), "Purpose:To check the GetHWIO_Cnt_SysTicksPerMicrosec_Software_interface");
  TestCaseAddInfo( chTestTitle, "TC_L30SW_Q-36623750", chTestDescription );
  
  /***************************************************************************************************************/    
                                              // Start of Test Case
  /***************************************************************************************************************/
  
  /***************************************************************************************************************/    
                                              // Test Step 0 PRECONDITIONS
  /***************************************************************************************************************/
  snprintf( chActionText, elCount(chActionText), "Flash the Software and ECU is running "); 
  snprintf( chExpectedText, elCount(chExpectedText), "Ecu is should be in running state"); 
  TestStepAddActionExpected( chActionText, chExpectedText );
  A_DBGR_BreakpointDeleteAll();
  A_DBGR_R();

  /***************************************************************************************************************/    
                                              // Test Step 1 Add the break point at function call side 
  /***************************************************************************************************************/
  snprintf( chActionText, elCount(chActionText), "Set Breakpoint in test_ticks Function call side  "); 
  snprintf( chExpectedText, elCount(chExpectedText), "verify is Breakpoint Set test_ticks in Function call side"); 
  A_DBGR_BreakpointSet("test_ticks");  
  A_DBGR_Go();
  
  snprintf( chExpectedText, elCount(chExpectedText), "Breakpoint hit in test_ticks function"); 
  E_DBGR_BreakpointCheckForHalt("test_ticks");
  /***************************************************************************************************************/    
                                              // Test Step2 add break point at function defination side 
  /***************************************************************************************************************/
  snprintf( chActionText, elCount(chActionText), "Set Breakpoint in  GetHWIO_Cnt_SysTicksPerMicrosec Function defination  side  "); 
  snprintf( chExpectedText, elCount(chExpectedText), "verify is Breakpoint Set  GetHWIO_Cnt_SysTicksPerMicrosec in function  defination side"); 
  TestStepAddActionExpected( chActionText, chExpectedText );
  A_DBGR_BreakpointSet("GetHWIO_Cnt_SysTicksPerMicrosec"); 

  A_DBGR_Go();
  snprintf( chActionText, elCount(chActionText), "verify Breakpoint should hit in  GetHWIO_Cnt_SysTicksPerMicrosec function defination side  "); 
  snprintf( chExpectedText, elCount(chExpectedText), "Breakpoint hit in  GetHWIO_Cnt_SysTicksPerMicrosec function function defination side "); 
  E_DBGR_BreakpointCheckForHalt("GetHWIO_Cnt_SysTicksPerMicrosec");
}
testcase To_verify_the_GetHWIO_t_Current_Software_interface() 
{
  /***************************************************************************************************************/    
                                              // Test Case Info
  /***************************************************************************************************************/
  setWriteDbgLevel(DebugOff);
  snprintf( chTestTitle, elCount(chTestTitle), "To_verify_the_GetHWIO_t_Current_Software_interface" );
  snprintf( chTestDescription, elCount(chTestDescription), "Purpose:To check the GetHWIO_t_Current_Software_interface");
  TestCaseAddInfo( chTestTitle, "TC_L30SW_Q-36623750", chTestDescription );
  
  /***************************************************************************************************************/    
                                              // Start of Test Case
  /***************************************************************************************************************/
  
  /***************************************************************************************************************/    
                                              // Test Step 0 PRECONDITIONS
  /***************************************************************************************************************/
  snprintf( chActionText, elCount(chActionText), "Flash the Software and ECU is running "); 
  snprintf( chExpectedText, elCount(chExpectedText), "Ecu is should be in running state"); 
  TestStepAddActionExpected( chActionText, chExpectedText );
  A_DBGR_BreakpointDeleteAll();
  A_DBGR_R();

  /***************************************************************************************************************/    
                                              // Test Step 1 Add the break point at function call side 
  /***************************************************************************************************************/
  snprintf( chActionText, elCount(chActionText), "Set Breakpoint in test_Current_Time Function call side  "); 
  snprintf( chExpectedText, elCount(chExpectedText), "verify is Breakpoint Set test_Current_Time in Function call side"); 
  A_DBGR_BreakpointSet("test_Current_Time");  
  A_DBGR_Go();
  
  snprintf( chExpectedText, elCount(chExpectedText), "Breakpoint hit in test_Current_Time function"); 
  E_DBGR_BreakpointCheckForHalt("test_Current_Time");
  /***************************************************************************************************************/    
                                              // Test Step2 add break point at function defination side 
  /***************************************************************************************************************/
  snprintf( chActionText, elCount(chActionText), "Set Breakpoint in  GetHWIO_t_Current Function defination  side  "); 
  snprintf( chExpectedText, elCount(chExpectedText), "verify is Breakpoint Set  GetHWIO_t_Current in function  defination side"); 
  TestStepAddActionExpected( chActionText, chExpectedText );
  A_DBGR_BreakpointSet("GetHWIO_t_Current"); 

  A_DBGR_Go();
  snprintf( chActionText, elCount(chActionText), "verify Breakpoint should hit in  GetHWIO_t_Current function defination side  "); 
  snprintf( chExpectedText, elCount(chExpectedText), "Breakpoint hit in  GetHWIO_t_Current function function defination side "); 
  E_DBGR_BreakpointCheckForHalt("GetHWIO_t_Current");
}
testcase To_verify_the_GetHWIO_e_CPU_timers_Software_interface() 
{
  /***************************************************************************************************************/    
                                              // Test Case Info
  /***************************************************************************************************************/
  setWriteDbgLevel(DebugOff);
  snprintf( chTestTitle, elCount(chTestTitle), "To_verify_the_GetHWIO_e_CPU_timers_Software_interface" );
  snprintf( chTestDescription, elCount(chTestDescription), "Purpose:To check the GetHWIO_e_CPU_timers_Software_interface");
  TestCaseAddInfo( chTestTitle, "TC_L30SW_Q-36623750", chTestDescription );
  
  /***************************************************************************************************************/    
                                              // Start of Test Case
  /***************************************************************************************************************/
  
  /***************************************************************************************************************/    
                                              // Test Step 0 PRECONDITIONS
  /***************************************************************************************************************/
  snprintf( chActionText, elCount(chActionText), "Flash the Software and ECU is running "); 
  snprintf( chExpectedText, elCount(chExpectedText), "Ecu is should be in running state"); 
  TestStepAddActionExpected( chActionText, chExpectedText );
  A_DBGR_BreakpointDeleteAll();
  A_DBGR_R();

  /***************************************************************************************************************/    
                                              // Test Step 1 Add the break point at function call side 
  /***************************************************************************************************************/
  snprintf( chActionText, elCount(chActionText), "Set Breakpoint in Get_STM_Tick_Value  Function call side  "); 
  snprintf( chExpectedText, elCount(chExpectedText), "verify is Breakpoint Set Get_STM_Tick_Value  in Function call side"); 
  A_DBGR_BreakpointSet("Get_STM_Tick_Value");  
  A_DBGR_Go();
  
  snprintf( chExpectedText, elCount(chExpectedText), "Breakpoint hit in Get_STM_Tick_Value  function"); 
  E_DBGR_BreakpointCheckForHalt("Get_STM_Tick_Value");
  /***************************************************************************************************************/    
                                              // Test Step2 add break point at function defination side 
  /***************************************************************************************************************/
  snprintf( chActionText, elCount(chActionText), "Set Breakpoint in GetHWIO_e_CPU Function defination  side  "); 
  snprintf( chExpectedText, elCount(chExpectedText), "verify is Breakpoint Set GetHWIO_e_CPU in funaction defination side"); 
  TestStepAddActionExpected( chActionText, chExpectedText );
  A_DBGR_BreakpointSet("GetHWIO_e_CPU"); 

  A_DBGR_Go();
  snprintf( chActionText, elCount(chActionText), "verify Breakpoint should hit in GetHWIO_e_CPU function defination side  "); 
  snprintf( chExpectedText, elCount(chExpectedText), "Breakpoint hit in GetHWIO_e_CPU function defination side "); 
  E_DBGR_BreakpointCheckForHalt("GetHWIO_e_CPU");
}

/***************************************************************************************************************/    
                                              //Mem_Protection_SWIT_Testcases
/***************************************************************************************************************/


testcase To_verify_the_Tc4xMemProt_App_Init_Software_interface() 
{
  /***************************************************************************************************************/    
                                              // Test Case Info
  /***************************************************************************************************************/
  setWriteDbgLevel(DebugOff);
  snprintf( chTestTitle, elCount(chTestTitle), "To_verify_the_Tc4xMemProt_App_Init_Software_interface" );
  snprintf( chTestDescription, elCount(chTestDescription), "Purpose:To check the Tc4xMemProt_App_Init ");
  TestCaseAddInfo( chTestTitle, "TC_L30SW_Q-36623750", chTestDescription );
  
  /***************************************************************************************************************/    
                                              // Start of Test Case
  /***************************************************************************************************************/
  
  /***************************************************************************************************************/    
                                              // Test Step 0 PRECONDITIONS
  /***************************************************************************************************************/
  snprintf( chActionText, elCount(chActionText), "Flash the Software and ECU is running "); 
  snprintf( chExpectedText, elCount(chExpectedText), "Ecu is should be in running state"); 
  TestStepAddActionExpected( chActionText, chExpectedText );
  A_DBGR_BreakpointDeleteAll();
  A_DBGR_R();

  /***************************************************************************************************************/    
                                              // Test Step 1 Add the break point at function call side 
  /***************************************************************************************************************/
  snprintf( chActionText, elCount(chActionText), "Set Breakpoint in core0_main\\20 Function call side  "); 
  snprintf( chExpectedText, elCount(chExpectedText), "verify is Breakpoint Set core0_main\\20 in Function call side"); 
  A_DBGR_BreakpointSet("core0_main\\20");  
  A_DBGR_Go();
  
  snprintf( chActionText, elCount(chActionText), "verify Breakpoint should hit in core0_main\\20 "); 
  snprintf( chExpectedText, elCount(chExpectedText), "Breakpoint hit in core0_main\\20 function"); 
  E_DBGR_BreakpointCheckForHalt("core0_main\\20");
  /***************************************************************************************************************/    
                                              // Test Step2 add break point at function defination side 
  /***************************************************************************************************************/
  snprintf( chActionText, elCount(chActionText), "Set Breakpoint in Tc4xMemProt_App_Init Function defination  side  "); 
  snprintf( chExpectedText, elCount(chExpectedText), "verify is Breakpoint Set Tc4xMemProt_App_Init in funaction defination side"); 
  TestStepAddActionExpected( chActionText, chExpectedText );
  A_DBGR_BreakpointSet("Tc4xMemProt_App_Init"); 

  A_DBGR_Go();
  snprintf( chActionText, elCount(chActionText), "verify Breakpoint should hit in Tc4xMemProt_App_Init function defination side  "); 
  snprintf( chExpectedText, elCount(chExpectedText), "Breakpoint hit in Tc4xMemProt_App_Init function function defination side "); 
  E_DBGR_BreakpointCheckForHalt("Tc4xMemProt_App_Init");
}
testcase To_verify_the_Tc4xMemProt_Init_Software_interface() 
{
  /***************************************************************************************************************/    
                                              // Test Case Info
  /***************************************************************************************************************/
  setWriteDbgLevel(DebugOff);
  snprintf( chTestTitle, elCount(chTestTitle), "To_verify_the_software_shall_report_the_status_of_the_Stack_overflow_condition_for_Core_0" );
  snprintf( chTestDescription, elCount(chTestDescription), "Purpose:To check the Stack_overflow_condition_for_Core_0 ");
  TestCaseAddInfo( chTestTitle, "TC_L30SW_Q-36623750", chTestDescription );
  
  /***************************************************************************************************************/    
                                              // Start of Test Case
  /***************************************************************************************************************/
  
  /***************************************************************************************************************/    
                                              // Test Step 0 PRECONDITIONS
  /***************************************************************************************************************/
  snprintf( chActionText, elCount(chActionText), "Flash the Software and ECU is running "); 
  snprintf( chExpectedText, elCount(chExpectedText), "Ecu is should be in running state"); 
  TestStepAddActionExpected( chActionText, chExpectedText );
  A_DBGR_BreakpointDeleteAll();
  A_DBGR_R();

  /***************************************************************************************************************/    
                                              // Test Step 1 Add the break point at function call side 
  /***************************************************************************************************************/
  snprintf( chActionText, elCount(chActionText), "Set Breakpoint in Tc4xMemProt_App_Init\\98\\1  Function call side  "); 
  snprintf( chExpectedText, elCount(chExpectedText), "verify is Breakpoint Set Tc4xMemProt_App_Init\\98\\1 in Function call side"); 
  A_DBGR_BreakpointSet("Tc4xMemProt_App_Init\\98\\1");  
  A_DBGR_Go();
  
  snprintf( chActionText, elCount(chActionText), "verify Breakpoint should hit in Tc4xMemProt_App_Init\\98\\1 "); 
  snprintf( chExpectedText, elCount(chExpectedText), "Breakpoint hit in Tc4xMemProt_App_Init\\98\\1 function"); 
  E_DBGR_BreakpointCheckForHalt("Tc4xMemProt_App_Init\\98\\1");
  /***************************************************************************************************************/    
                                              // Test Step2 add break point at function defination side 
  /***************************************************************************************************************/
  snprintf( chActionText, elCount(chActionText), "Set Breakpoint in Tc4xMemProt_Init Function defination  side  "); 
  snprintf( chExpectedText, elCount(chExpectedText), "verify is Breakpoint Set Tc4xMemProt_Init in funaction defination side"); 
  TestStepAddActionExpected( chActionText, chExpectedText );
  A_DBGR_BreakpointSet("Tc4xMemProt_Init"); 

  
  snprintf( chActionText, elCount(chActionText), "verify Breakpoint should hit in Tc4xMemProt_Init function defination side  "); 
  snprintf( chExpectedText, elCount(chExpectedText), "Breakpoint hit in Tc4xMemProt_Init function function defination side "); 
 
  A_DBGR_Go();
  
  snprintf( chActionText, elCount(chActionText), "verify Breakpoint should hit in Tc4xMemProt_Init function defination side  "); 
  snprintf( chExpectedText, elCount(chExpectedText), "Breakpoint hit in Tc4xMemProt_Init function function defination side "); 
  E_DBGR_BreakpointCheckForHalt("Tc4xMemProt_Init");
}
testcase To_verify_the_Tc4xMemProt_TrapHandler_Ifx_Software_interface() 
{
  /***************************************************************************************************************/    
                                              // Test Case Info
  /***************************************************************************************************************/
  setWriteDbgLevel(DebugOff);
  snprintf( chTestTitle, elCount(chTestTitle), "To_verify_the_Tc4xMemProt_TrapHandler_Ifx_Software_interface" );
  snprintf( chTestDescription, elCount(chTestDescription), "Purpose:To check the Tc4xMemProt_TrapHandler_Ifx_Software ");
  TestCaseAddInfo( chTestTitle, "TC_L30SW_Q-36623750", chTestDescription );
  
  /***************************************************************************************************************/    
                                              // Start of Test Case
  /***************************************************************************************************************/
  
  /***************************************************************************************************************/    
                                              // Test Step 0 PRECONDITIONS
  /***************************************************************************************************************/
  snprintf( chActionText, elCount(chActionText), "Flash the Software and ECU is running "); 
  snprintf( chExpectedText, elCount(chExpectedText), "Ecu is should be in running state"); 
  TestStepAddActionExpected( chActionText, chExpectedText );
  A_DBGR_BreakpointDeleteAll();
  A_DBGR_R();

  /***************************************************************************************************************/    
                                              // Test Step 1 Add the break point at stackoverflow side
  /***************************************************************************************************************/
  //snprintf( chActionText, elCount(chActionText), "Set Breakpoint in P:0x80833C36 stack overflow address  Function call side"); 
  //snprintf( chExpectedText, elCount(chExpectedText), "verify is Breakpoint Set P:0x80833C36 stack overflow address in Function call side"); 
  //A_DBGR_BreakpointSet("P:0x80833C36");  
 // A_DBGR_Go();
  
 // snprintf( chActionText, elCount(chActionText), "verify Breakpoint should hit in P:0x80833C36 stack overflow address"); 
  //snprintf( chExpectedText, elCount(chExpectedText), "Breakpoint hit in P:0x80833C36 stack overflow address function");
  //TestStepAddActionExpected( chActionText, chExpectedText );
  //E_DBGR_BreakpointCheckForHalt("P:0x80833C36");
  /***************************************************************************************************************/    
                      //Test Step2 add break point at function function call side of Tc4xMemProt_TrapHandler_Ifx 
  /***************************************************************************************************************/
  snprintf( chActionText, elCount(chActionText), "Set Breakpoint in Tc4xMemProt_TrapHandler_Ifx Function call side"); 
  snprintf( chExpectedText, elCount(chExpectedText), "verify is Breakpoint Set Tc4xMemProt_TrapHandler_Ifx in funaction call side"); 
  //TestStepAddActionExpected( chActionText, chExpectedText );
  A_DBGR_BreakpointSet("InternalProtectionError\\32"); 

  A_DBGR_Go();
  snprintf( chActionText, elCount(chActionText), "verify Breakpoint should hit in Tc4xMemProt_TrapHandler_Ifx function call side"); 
  snprintf( chExpectedText, elCount(chExpectedText), "Breakpoint hit in Tc4xMemProt_TrapHandler_Ifx function function call side"); 
  //TestStepAddActionExpected( chActionText, chExpectedText );
  E_DBGR_BreakpointCheckForHalt("InternalProtectionError\\32");
  /***************************************************************************************************************/    
                      //Test Step3 add break point at function function defination  side of Tc4xMemProt_TrapHandler_Ifx 
  /***************************************************************************************************************/
  snprintf( chActionText, elCount(chActionText), "Set Breakpoint in Tc4xMemProt_TrapHandler_Ifx Function defination side"); 
  snprintf( chExpectedText, elCount(chExpectedText), "verify is Breakpoint Set Tc4xMemProt_TrapHandler_Ifx in funaction defination side"); 
  TestStepAddActionExpected( chActionText, chExpectedText );
  A_DBGR_BreakpointSet("Tc4xMemProt_TrapHandler_Ifx"); 

  A_DBGR_Go();
  snprintf( chActionText, elCount(chActionText), "verify Breakpoint should hit in Tc4xMemProt_TrapHandler_Ifx function defination side"); 
  snprintf( chExpectedText, elCount(chExpectedText), "Breakpoint hit in Tc4xMemProt_TrapHandler_Ifx function function defination side"); 
  //TestStepAddActionExpected( chActionText, chExpectedText );
  E_DBGR_BreakpointCheckForHalt("Tc4xMemProt_TrapHandler_Ifx");
  
  
}
testcase To_verify_the_TX4xMemProt_APP_Violation_CallBack_Software_interface() 
{
  /***************************************************************************************************************/    
                                              // Test Case Info
  /***************************************************************************************************************/
  setWriteDbgLevel(DebugOff);
  snprintf( chTestTitle, elCount(chTestTitle), "To_verify_the_TX4xMemProt_APP_Violation_CallBack_Software_interface" );
  snprintf( chTestDescription, elCount(chTestDescription), "Purpose:To check the To_verify_the_TX4xMemProt_APP_Violation_CallBack_Software_interface");
  TestCaseAddInfo( chTestTitle, "TC_L30SW_Q-36623750", chTestDescription );
  
  /***************************************************************************************************************/    
                                              // Start of Test Case
  /***************************************************************************************************************/
  
  /***************************************************************************************************************/    
                                              // Test Step 0 PRECONDITIONS
  /***************************************************************************************************************/
  snprintf( chActionText, elCount(chActionText), "Flash the Software and ECU is running "); 
  snprintf( chExpectedText, elCount(chExpectedText), "Ecu is should be in running state"); 
  TestStepAddActionExpected( chActionText, chExpectedText );
  A_DBGR_BreakpointDeleteAll();
  A_DBGR_R();

  /***************************************************************************************************************/    
                                              // Test Step 1 Add the break point at function call side 
  /***************************************************************************************************************/
  snprintf( chActionText, elCount(chActionText), "Set Breakpoint in Tc4xMemProt_App_Init Function call side  "); 
  snprintf( chExpectedText, elCount(chExpectedText), "verify is Breakpoint Set Tc4xMemProt_App_Init in Function call side"); 
  A_DBGR_BreakpointSet("Tc4xMemProt_App_Init");  
  A_DBGR_Go();
  
  snprintf( chActionText, elCount(chActionText), "Set Breakpoint in Tc4xMemProt_App_Init Function call side  ");
  snprintf( chExpectedText, elCount(chExpectedText), "Breakpoint hit in Tc4xMemProt_App_Init function"); 
  E_DBGR_BreakpointCheckForHalt("Tc4xMemProt_App_Init");
  /***************************************************************************************************************/    
                                              // Test Step2 add break point at function defination side 
  /***************************************************************************************************************/
  snprintf( chActionText, elCount(chActionText), "Set Breakpoint in TX4xMemProt_APP_Violation_CallBack\\2  Function defination  side  "); 
  snprintf( chExpectedText, elCount(chExpectedText), "verify is Breakpoint Set TX4xMemProt_APP_Violation_CallBack\\2 in funaction defination side"); 
  TestStepAddActionExpected( chActionText, chExpectedText );
  A_DBGR_BreakpointSet("TX4xMemProt_APP_Violation_CallBack\\2"); 

  A_DBGR_Go();
  snprintf( chActionText, elCount(chActionText), "verify Breakpoint should hit in TX4xMemProt_APP_Violation_CallBack\\2 function defination side  "); 
  snprintf( chExpectedText, elCount(chExpectedText), "Breakpoint hit in TX4xMemProt_APP_Violation_CallBack\\2 function function defination side "); 
  E_DBGR_BreakpointCheckForHalt("TX4xMemProt_APP_Violation_CallBack\\2");
}
testcase To_verify_the_hwio_reset_stack_request_Software_interface() 
{
  /***************************************************************************************************************/    
                                              // Test Case Info
  /***************************************************************************************************************/
  setWriteDbgLevel(DebugOff);
  snprintf( chTestTitle, elCount(chTestTitle), "To_verify_the_TX4xMemProt_APP_Violation_CallBack_Software_interface" );
  snprintf( chTestDescription, elCount(chTestDescription), "Purpose:To check the To_verify_the_TX4xMemProt_APP_Violation_CallBack_Software_interface");
  TestCaseAddInfo( chTestTitle, "TC_L30SW_Q-36623750", chTestDescription );
  
  /***************************************************************************************************************/    
                                              // Start of Test Case
  /***************************************************************************************************************/
  
  /***************************************************************************************************************/    
                                              // Test Step 0 PRECONDITIONS
  /***************************************************************************************************************/
  snprintf( chActionText, elCount(chActionText), "Flash the Software and ECU is running "); 
  snprintf( chExpectedText, elCount(chExpectedText), "Ecu is should be in running state"); 
  TestStepAddActionExpected( chActionText, chExpectedText );
  A_DBGR_BreakpointDeleteAll();
  A_DBGR_R();

  /***************************************************************************************************************/    
                                              // Test Step 0 Add the break point at stack overflow  side 
  /***************************************************************************************************************/
  snprintf( chActionText, elCount(chActionText), "Set Breakpoint in MEMPROT_HWIO_Run_StackOverflow_Tests\\53+0x2 Function call side  "); 
  snprintf( chExpectedText, elCount(chExpectedText), "verify is Breakpoint Set Tc4xMemProt_App_Init in Function call side"); 
  A_DBGR_BreakpointSet("MEMPROT_HWIO_Run_StackOverflow_Tests\\53+0x2");  
  A_DBGR_Go();
  
  snprintf( chActionText, elCount(chActionText), "Set Breakpoint in Tc4xMemProt_App_Init Function call side  ");
  snprintf( chExpectedText, elCount(chExpectedText), "Breakpoint hit in Tc4xMemProt_App_Init function"); 
  E_DBGR_BreakpointCheckForHalt("MEMPROT_HWIO_Run_StackOverflow_Tests\\53+0x2");
    /***************************************************************************************************************/    
                                              // Test Step 1 Add the break point at function call side 
  /***************************************************************************************************************/
  snprintf( chActionText, elCount(chActionText), "Set Breakpoint in InternalProtectionError\\42 Function call side  "); 
  snprintf( chExpectedText, elCount(chExpectedText), "verify is Breakpoint Set InternalProtectionError\\42 in Function call side"); 
  A_DBGR_BreakpointSet("InternalProtectionError\\42");  
  A_DBGR_Go();
  
  snprintf( chActionText, elCount(chActionText), "Set Breakpoint in InternalProtectionError\\42 Function call side  ");
  snprintf( chExpectedText, elCount(chExpectedText), "Breakpoint hit in InternalProtectionError\\42 function");
  TestStepAddActionExpected( chActionText, chExpectedText );
  E_DBGR_BreakpointCheckForHalt("InternalProtectionError\\42");
  /***************************************************************************************************************/    
                                              // Test Step2 add break point at function defination side 
  /***************************************************************************************************************/
  snprintf( chActionText, elCount(chActionText), "Set Breakpoint in hwio_reset_request\\2  Function defination  side  "); 
  snprintf( chExpectedText, elCount(chExpectedText), "verify is Breakpoint Set hwio_reset_request\\2 in funaction defination side"); 
  TestStepAddActionExpected( chActionText, chExpectedText );
  A_DBGR_BreakpointSet("hwio_reset_request\\2"); 

  A_DBGR_Go();
  snprintf( chActionText, elCount(chActionText), "verify Breakpoint should hit in hwio_reset_request\\2 function defination side  "); 
  snprintf( chExpectedText, elCount(chExpectedText), "Breakpoint hit in hwio_reset_request\\2 function function defination side "); 
  E_DBGR_BreakpointCheckForHalt("hwio_reset_request\\2");
}
testcase To_verify_the_GetHWIO_e_StackProtSt_Software_interface() 
{
  /***************************************************************************************************************/    
                                              // Test Case Info
  /***************************************************************************************************************/
  setWriteDbgLevel(DebugOff);
  snprintf( chTestTitle, elCount(chTestTitle), "To_verify_the_software_shall_report_the_status_of_the_Stack_overflow_condition_for_Core_0" );
  snprintf( chTestDescription, elCount(chTestDescription), "Purpose:To check the Stack_overflow_condition_for_Core_0 ");
  TestCaseAddInfo( chTestTitle, "TC_L30SW_Q-36623750", chTestDescription );
  
  /***************************************************************************************************************/    
                                              // Start of Test Case
  /***************************************************************************************************************/
  
  /***************************************************************************************************************/    
                                              // Test Step 0 PRECONDITIONS
  /***************************************************************************************************************/
  snprintf( chActionText, elCount(chActionText), "Flash the Software and ECU is running "); 
  snprintf( chExpectedText, elCount(chExpectedText), "Ecu is should be in running state"); 
  TestStepAddActionExpected( chActionText, chExpectedText );
  A_DBGR_BreakpointDeleteAll();
  A_DBGR_R();

  /***************************************************************************************************************/    
                                              // Test Step 1 Add the break point at function call side 
  /***************************************************************************************************************/
  snprintf( chActionText, elCount(chActionText), "Set Breakpoint in MEMPROT_HWIO_Run_StackOverflow_Tests\\55  Function call side  "); 
  snprintf( chExpectedText, elCount(chExpectedText), "verify is Breakpoint Set MEMPROT_HWIO_Run_StackOverflow_Tests\\55 in Function call side"); 
  A_DBGR_BreakpointSet("MEMPROT_HWIO_Run_StackOverflow_Tests\\55");  
  A_DBGR_Go();
  
  snprintf( chActionText, elCount(chActionText), "verify Breakpoint should hit in MEMPROT_HWIO_Run_StackOverflow_Tests\\55"); 
  snprintf( chExpectedText, elCount(chExpectedText), "Breakpoint hit in MEMPROT_HWIO_Run_StackOverflow_Tests\\55 function");
  E_DBGR_BreakpointCheckForHalt("MEMPROT_HWIO_Run_StackOverflow_Tests\\55");
  /***************************************************************************************************************/    
                                              // Test Step2 add break point at function defination side 
  /***************************************************************************************************************/
  snprintf( chActionText, elCount(chActionText), "Set Breakpoint in GetHWIO_e_StackProtSt\\2 Function defination  side  "); 
  snprintf( chExpectedText, elCount(chExpectedText), "verify is Breakpoint Set GetHWIO_e_StackProtSt\\2 in funaction defination side"); 
  TestStepAddActionExpected( chActionText, chExpectedText );
  A_DBGR_BreakpointSet("GetHWIO_e_StackProtSt\\2"); 

  A_DBGR_Go();
  snprintf( chActionText, elCount(chActionText), "verify Breakpoint should hit in GetHWIO_e_StackProtSt\\2 function defination side  "); 
  snprintf( chExpectedText, elCount(chExpectedText), "Breakpoint hit in GetHWIO_e_StackProtSt\\2 function function defination side "); 
  E_DBGR_BreakpointCheckForHalt("GetHWIO_e_StackProtSt\\2");
}
testcase To_verify_the_Tc4xMemProt_Get_Error_StackOverflow_Software_interface() 
{
  /***************************************************************************************************************/    
                                              // Test Case Info
  /***************************************************************************************************************/
  setWriteDbgLevel(DebugOff);
  snprintf( chTestTitle, elCount(chTestTitle), "To_verify_the_Tc4xMemProt_Get_Error_StackOverflow_Software_interface" );
  snprintf( chTestDescription, elCount(chTestDescription), "Purpose:To check the Stack_overflow_condition");
  TestCaseAddInfo( chTestTitle, "TC_L30SW_Q-36623750", chTestDescription );
  
  /***************************************************************************************************************/    
                                              // Start of Test Case
  /***************************************************************************************************************/
  
  /***************************************************************************************************************/    
                                              // Test Step 0 PRECONDITIONS
  /***************************************************************************************************************/
  snprintf( chActionText, elCount(chActionText), "Flash the Software and ECU is running "); 
  snprintf( chExpectedText, elCount(chExpectedText), "Ecu is should be in running state"); 
  TestStepAddActionExpected( chActionText, chExpectedText );
  A_DBGR_BreakpointDeleteAll();
  A_DBGR_R();

  /***************************************************************************************************************/    
                                              // Test Step 1 Add the break point at function call side 
  /***************************************************************************************************************/
  snprintf( chActionText, elCount(chActionText), "Set Breakpoint in GetHWIO_e_StackProtSt\\9  Function call side  "); 
  snprintf( chExpectedText, elCount(chExpectedText), "verify is Breakpoint Set GetHWIO_e_StackProtSt\\9 in Function call side"); 
  A_DBGR_BreakpointSet("GetHWIO_e_StackProtSt\\9");  
  A_DBGR_Go();
  
  snprintf( chActionText, elCount(chActionText), "verify Breakpoint should hit in GetHWIO_e_StackProtSt\\9"); 
  snprintf( chExpectedText, elCount(chExpectedText), "Breakpoint hit in GetHWIO_e_StackProtSt\\9 function");
  E_DBGR_BreakpointCheckForHalt("GetHWIO_e_StackProtSt\\9");
  /***************************************************************************************************************/    
                                              // Test Step2 add break point at function defination side 
  /***************************************************************************************************************/
  snprintf( chActionText, elCount(chActionText), "Set Breakpoint in Tc4xMemProt_Get_Error_StackOverflow\\2 Function defination  side  "); 
  snprintf( chExpectedText, elCount(chExpectedText), "verify is Breakpoint Set Tc4xMemProt_Get_Error_StackOverflow\\2 in funaction defination side"); 
  TestStepAddActionExpected( chActionText, chExpectedText );
  A_DBGR_BreakpointSet("Tc4xMemProt_Get_Error_StackOverflow\\2"); 

  A_DBGR_Go();
  snprintf( chActionText, elCount(chActionText), "verify Breakpoint should hit in Tc4xMemProt_Get_Error_StackOverflow\\2 function defination side  "); 
  snprintf( chExpectedText, elCount(chExpectedText), "Breakpoint hit in Tc4xMemProt_Get_Error_StackOverflow\\2 function function defination side "); 
  E_DBGR_BreakpointCheckForHalt("Tc4xMemProt_Get_Error_StackOverflow\\2");
}
testcase To_verify_the_Tc4xMemProt_Get_Error_StackUnderflow_Software_interface() 
{
  /***************************************************************************************************************/    
                                              // Test Case Info
  /***************************************************************************************************************/
  setWriteDbgLevel(DebugOff);
  snprintf( chTestTitle, elCount(chTestTitle), "To_verify_the_Tc4xMemProt_Get_Error_StackUnderflow_Software_interface" );
  snprintf( chTestDescription, elCount(chTestDescription), "Purpose:To check the StackUnderflow_condition");
  TestCaseAddInfo( chTestTitle, "TC_L30SW_Q-36623750", chTestDescription );
  
  /***************************************************************************************************************/    
                                              // Start of Test Case
  /***************************************************************************************************************/
  
  /***************************************************************************************************************/    
                                              // Test Step 0 PRECONDITIONS
  /***************************************************************************************************************/
  snprintf( chActionText, elCount(chActionText), "Flash the Software and ECU is running "); 
  snprintf( chExpectedText, elCount(chExpectedText), "Ecu is should be in running state"); 
  TestStepAddActionExpected( chActionText, chExpectedText );
  A_DBGR_BreakpointDeleteAll();
  A_DBGR_R();

  /***************************************************************************************************************/    
                                              // Test Step 1 Add the break point at function call side 
  /***************************************************************************************************************/
  snprintf( chActionText, elCount(chActionText), "Set Breakpoint in GetHWIO_e_StackProtSt\\17  Function call side  "); 
  snprintf( chExpectedText, elCount(chExpectedText), "verify is Breakpoint Set GetHWIO_e_StackProtSt\\17 in Function call side"); 
  A_DBGR_BreakpointSet("GetHWIO_e_StackProtSt\\17");  
  A_DBGR_Go();
  
  snprintf( chActionText, elCount(chActionText), "verify Breakpoint should hit in GetHWIO_e_StackProtSt\\17"); 
  snprintf( chExpectedText, elCount(chExpectedText), "Breakpoint hit in GetHWIO_e_StackProtSt\\17 function");
  E_DBGR_BreakpointCheckForHalt("GetHWIO_e_StackProtSt\\17");
  /***************************************************************************************************************/    
                                              // Test Step2 add break point at function defination side 
  /***************************************************************************************************************/
  snprintf( chActionText, elCount(chActionText), "Set Breakpoint in Tc4xMemProt_Get_Error_StackUnderflow\\2 Function defination  side  "); 
  snprintf( chExpectedText, elCount(chExpectedText), "verify is Breakpoint Set Tc4xMemProt_Get_Error_StackUnderflow\\2 in funaction defination side"); 
  TestStepAddActionExpected( chActionText, chExpectedText );
  A_DBGR_BreakpointSet("Tc4xMemProt_Get_Error_StackUnderflow\\2"); 

  A_DBGR_Go();
  snprintf( chActionText, elCount(chActionText), "verify Breakpoint should hit in Tc4xMemTc4xMemProt_Get_Error_StackUnderflowrot_Get_Error_StackOverflow\\2 function defination side  "); 
  snprintf( chExpectedText, elCount(chExpectedText), "Breakpoint hit in Tc4xMemProt_Get_Error_StackUnderflow\\2 function function defination side "); 
  E_DBGR_BreakpointCheckForHalt("Tc4xMemProt_Get_Error_StackUnderflow\\2");
}
testcase To_verify_the_SetHWIO_b_WrtProtRAM_LckUnlck_Software_interface() 
{
  /***************************************************************************************************************/    
                                              // Test Case Info
  /***************************************************************************************************************/
  setWriteDbgLevel(DebugOff);
  snprintf( chTestTitle, elCount(chTestTitle), "To_verify_the_SetHWIO_b_WrtProtRAM_LckUnlck_Software_interface" );
  snprintf( chTestDescription, elCount(chTestDescription), "Purpose:To check the SetHWIO_b_WrtProtRAM_LckUnlck");
  TestCaseAddInfo( chTestTitle, "TC_L30SW_Q-36623750", chTestDescription );
  
  /***************************************************************************************************************/    
                                              // Start of Test Case
  /***************************************************************************************************************/
  
  /***************************************************************************************************************/    
                                              // Test Step 0 PRECONDITIONS
  /***************************************************************************************************************/
  snprintf( chActionText, elCount(chActionText), "Flash the Software and ECU is running "); 
  snprintf( chExpectedText, elCount(chExpectedText), "Ecu is should be in running state"); 
  TestStepAddActionExpected( chActionText, chExpectedText );
  A_DBGR_BreakpointDeleteAll();
  A_DBGR_R();

  /***************************************************************************************************************/    
                                              // Test Step 1 Add the break point at function call side 
  /***************************************************************************************************************/
  snprintf( chActionText, elCount(chActionText), "Set Breakpoint in MEMPROT_HWIO_Run_WriteProtectedRAM_Tests\\25  Function call side  "); 
  snprintf( chExpectedText, elCount(chExpectedText), "verify is Breakpoint Set MEMPROT_HWIO_Run_WriteProtectedRAM_Tests\\25 in Function call side"); 
  A_DBGR_BreakpointSet("MEMPROT_HWIO_Run_WriteProtectedRAM_Tests\\25");  
  A_DBGR_Go();
  
  snprintf( chActionText, elCount(chActionText), "verify Breakpoint should hit in MEMPROT_HWIO_Run_WriteProtectedRAM_Tests\\25"); 
  snprintf( chExpectedText, elCount(chExpectedText), "Breakpoint hit in MEMPROT_HWIO_Run_WriteProtectedRAM_Tests\\25 function");
  E_DBGR_BreakpointCheckForHalt("MEMPROT_HWIO_Run_WriteProtectedRAM_Tests\\25");
  /***************************************************************************************************************/    
                                              // Test Step2 add break point at function defination side 
  /***************************************************************************************************************/
  snprintf( chActionText, elCount(chActionText), "Set Breakpoint in SetHWIO_b_WrtProtRAM_LckUnlck\\2 Function defination  side  "); 
  snprintf( chExpectedText, elCount(chExpectedText), "verify is Breakpoint Set SetHWIO_b_WrtProtRAM_LckUnlck\\2 in funaction defination side"); 
  TestStepAddActionExpected( chActionText, chExpectedText );
  A_DBGR_BreakpointSet("SetHWIO_b_WrtProtRAM_LckUnlck\\2"); 

  A_DBGR_Go();
  snprintf( chActionText, elCount(chActionText), "verify Breakpoint should hit in SetHWIO_b_WrtProtRAM_LckUnlck\\2 function defination side  "); 
  snprintf( chExpectedText, elCount(chExpectedText), "Breakpoint hit in SetHWIO_b_WrtProtRAM_LckUnlck\\2 function function defination side "); 
  E_DBGR_BreakpointCheckForHalt("SetHWIO_b_WrtProtRAM_LckUnlck\\2");
}
testcase To_verify_the_Tc4xMemProt_SetWP_Protection_True_condition_Software_interface() 
{
  /***************************************************************************************************************/    
                                              // Test Case Info
  /***************************************************************************************************************/
  setWriteDbgLevel(DebugOff);
  snprintf( chTestTitle, elCount(chTestTitle), "To_verify_the_Tc4xMemProt_SetWP_Protection_True_Software_interface" );
  snprintf( chTestDescription, elCount(chTestDescription), "Purpose:To check the SetWP_Protection_True_Software_interface");
  TestCaseAddInfo( chTestTitle, "TC_L30SW_Q-36623750", chTestDescription );
  
  /***************************************************************************************************************/    
                                              // Start of Test Case
  /***************************************************************************************************************/
  
  /***************************************************************************************************************/    
                                              // Test Step 0 PRECONDITIONS
  /***************************************************************************************************************/
  snprintf( chActionText, elCount(chActionText), "Flash the Software and ECU is running "); 
  snprintf( chExpectedText, elCount(chExpectedText), "Ecu is should be in running state"); 
  TestStepAddActionExpected( chActionText, chExpectedText );
  A_DBGR_BreakpointDeleteAll();
  A_DBGR_R();

  /***************************************************************************************************************/    
                                              // Test Step 1 Add the break point at function call side 
  /***************************************************************************************************************/
  snprintf( chActionText, elCount(chActionText), "Set Breakpoint in SetHWIO_b_WrtProtRAM_LckUnlck\\5  Function call side  "); 
  snprintf( chExpectedText, elCount(chExpectedText), "verify is Breakpoint Set SetHWIO_b_WrtProtRAM_LckUnlck\\5 in Function call side"); 
  A_DBGR_BreakpointSet("SetHWIO_b_WrtProtRAM_LckUnlck\\5");  
  A_DBGR_Go();
  
  snprintf( chActionText, elCount(chActionText), "verify Breakpoint should hit in SetHWIO_b_WrtProtRAM_LckUnlck\\5"); 
  snprintf( chExpectedText, elCount(chExpectedText), "Breakpoint hit in SetHWIO_b_WrtProtRAM_LckUnlck\\5 function");
  E_DBGR_BreakpointCheckForHalt("SetHWIO_b_WrtProtRAM_LckUnlck\\5");
  /***************************************************************************************************************/    
                                              // Test Step2 add break point at function defination side 
  /***************************************************************************************************************/
  snprintf( chActionText, elCount(chActionText), "Set Breakpoint in Tc4xMemProt_SetWP_Protection\\2 Function defination  side  "); 
  snprintf( chExpectedText, elCount(chExpectedText), "verify is Breakpoint Set Tc4xMemProt_SetWP_Protection\\2 in funaction defination side"); 
  TestStepAddActionExpected( chActionText, chExpectedText );
  A_DBGR_BreakpointSet("Tc4xMemProt_SetWP_Protection\\2"); 

  A_DBGR_Go();
  snprintf( chActionText, elCount(chActionText), "verify Breakpoint should hit in Tc4xMemProt_SetWP_Protection\\2 function defination side  "); 
  snprintf( chExpectedText, elCount(chExpectedText), "Breakpoint hit in Tc4xMemProt_SetWP_Protection\\2 function function defination side "); 
  E_DBGR_BreakpointCheckForHalt("Tc4xMemProt_SetWP_Protection\\2");
}
testcase To_verify_the_Tc4xMemProt_SetWP_Protection_False_condition_Software_interface() 
{
  /***************************************************************************************************************/    
                                              // Test Case Info
  /***************************************************************************************************************/
  setWriteDbgLevel(DebugOff);
  snprintf( chTestTitle, elCount(chTestTitle), "To_verify_the_Tc4xMemProt_SetWP_Protection_False_condition_Software_interface" );
  snprintf( chTestDescription, elCount(chTestDescription), "Purpose:To check the SetWP_Protection_False_condition_Software_interface");
  TestCaseAddInfo( chTestTitle, "TC_L30SW_Q-36623750", chTestDescription );
  
  /***************************************************************************************************************/    
                                              // Start of Test Case
  /***************************************************************************************************************/
  
  /***************************************************************************************************************/    
                                              // Test Step 0 PRECONDITIONS
  /***************************************************************************************************************/
  snprintf( chActionText, elCount(chActionText), "Flash the Software and ECU is running "); 
  snprintf( chExpectedText, elCount(chExpectedText), "Ecu is should be in running state"); 
  TestStepAddActionExpected( chActionText, chExpectedText );
  A_DBGR_BreakpointDeleteAll();
  A_DBGR_R();

  /***************************************************************************************************************/    
                                              // Test Step 1 Add the break point at function call side 
  /***************************************************************************************************************/
  snprintf( chActionText, elCount(chActionText), "Set Breakpoint in SetHWIO_b_WrtProtRAM_LckUnlck\\10  Function call side  "); 
  snprintf( chExpectedText, elCount(chExpectedText), "verify is Breakpoint Set SetHWIO_b_WrtProtRAM_LckUnlck\\10 in Function call side"); 
  A_DBGR_BreakpointSet("SetHWIO_b_WrtProtRAM_LckUnlck\\10");  
  A_DBGR_Go();
  
  snprintf( chActionText, elCount(chActionText), "verify Breakpoint should hit in SetHWIO_b_WrtProtRAM_LckUnlck\\10"); 
  snprintf( chExpectedText, elCount(chExpectedText), "Breakpoint hit in SetHWIO_b_WrtProtRAM_LckUnlck\\10 function");
  E_DBGR_BreakpointCheckForHalt("SetHWIO_b_WrtProtRAM_LckUnlck\\10");
  /***************************************************************************************************************/    
                                              // Test Step2 add break point at function defination side 
  /***************************************************************************************************************/
  snprintf( chActionText, elCount(chActionText), "Set Breakpoint in Tc4xMemProt_SetWP_Protection\\2 Function defination  side  "); 
  snprintf( chExpectedText, elCount(chExpectedText), "verify is Breakpoint Set Tc4xMemProt_SetWP_Protection\\2 in funaction defination side"); 
  TestStepAddActionExpected( chActionText, chExpectedText );
  A_DBGR_BreakpointSet("Tc4xMemProt_SetWP_Protection\\2"); 

  A_DBGR_Go();
  snprintf( chActionText, elCount(chActionText), "verify Breakpoint should hit in Tc4xMemProt_SetWP_Protection\\2 function defination side  "); 
  snprintf( chExpectedText, elCount(chExpectedText), "Breakpoint hit in Tc4xMemProt_SetWP_Protection\\2 function function defination side "); 
  E_DBGR_BreakpointCheckForHalt("Tc4xMemProt_SetWP_Protection\\2");
}
testcase To_verify_the_GetHWIO_b_WrtProtRAM_Flt_Stack_Software_interface() 
{
  /***************************************************************************************************************/    
                                              // Test Case Info
  /***************************************************************************************************************/
  setWriteDbgLevel(DebugOff);
  snprintf( chTestTitle, elCount(chTestTitle), "To_verify_the_GetHWIO_b_WrtProtRAM_Flt_Stack_Software_interface" );
  snprintf( chTestDescription, elCount(chTestDescription), "Purpose:To check the GetHWIO_b_WrtProtRAM_Flt_Stack_Software_interface");
  TestCaseAddInfo( chTestTitle, "TC_L30SW_Q-36623750", chTestDescription );
  
  /***************************************************************************************************************/    
                                              // Start of Test Case
  /***************************************************************************************************************/
  
  /***************************************************************************************************************/    
                                              // Test Step 0 PRECONDITIONS
  /***************************************************************************************************************/
  snprintf( chActionText, elCount(chActionText), "Flash the Software and ECU is running "); 
  snprintf( chExpectedText, elCount(chExpectedText), "Ecu is should be in running state"); 
  TestStepAddActionExpected( chActionText, chExpectedText );
  A_DBGR_BreakpointDeleteAll();
  A_DBGR_R();

  /***************************************************************************************************************/    
                                              // Test Step 1 Add the break point at function call side 
  /***************************************************************************************************************/
  snprintf( chActionText, elCount(chActionText), "Set Breakpoint in MEMPROT_HWIO_Run_WriteProtectedRAM_Tests\\18 Function call side  "); 
  snprintf( chExpectedText, elCount(chExpectedText), "verify is Breakpoint MEMPROT_HWIO_Run_WriteProtectedRAM_Tests\\18 in Function call side"); 
  A_DBGR_BreakpointSet("MEMPROT_HWIO_Run_WriteProtectedRAM_Tests\\18");  
  A_DBGR_Go();
  
  snprintf( chActionText, elCount(chActionText), "verify Breakpoint should hit in MEMPROT_HWIO_Run_WriteProtectedRAM_Tests\\18"); 
  snprintf( chExpectedText, elCount(chExpectedText), "Breakpoint hit in MEMPROT_HWIO_Run_WriteProtectedRAM_Tests\\18 function");
  E_DBGR_BreakpointCheckForHalt("MEMPROT_HWIO_Run_WriteProtectedRAM_Tests\\18");
  /***************************************************************************************************************/    
                                              // Test Step2 add break point at function defination side 
  /***************************************************************************************************************/
  snprintf( chActionText, elCount(chActionText), "Set Breakpoint in GetHWIO_b_WrtProtRAM_Flt Function defination  side  "); 
  snprintf( chExpectedText, elCount(chExpectedText), "verify is Breakpoint Set GetHWIO_b_WrtProtRAM_Flt in funaction defination side"); 
  TestStepAddActionExpected( chActionText, chExpectedText );
  A_DBGR_BreakpointSet("GetHWIO_b_WrtProtRAM_Flt"); 

  A_DBGR_Go();
  snprintf( chActionText, elCount(chActionText), "verify Breakpoint should hit in GetHWIO_b_WrtProtRAM_Flt function defination side  "); 
  snprintf( chExpectedText, elCount(chExpectedText), "Breakpoint hit in GetHWIO_b_WrtProtRAM_Flt function function defination side "); 
  E_DBGR_BreakpointCheckForHalt("GetHWIO_b_WrtProtRAM_Flt");
}
testcase To_verify_the_Tc4xMemProt_Get_WriteProtectedAccessError_Software_interface() 
{
  /***************************************************************************************************************/    
                                              // Test Case Info
  /***************************************************************************************************************/
  setWriteDbgLevel(DebugOff);
  snprintf( chTestTitle, elCount(chTestTitle), "To_verify_the_Tc4xMemProt_Get_WriteProtectedAccessError_Software_interface" );
  snprintf( chTestDescription, elCount(chTestDescription), "Purpose:To check the Tc4xMemProt_Get_WriteProtectedAccessError_Software_interface");
  TestCaseAddInfo( chTestTitle, "TC_L30SW_Q-36623750", chTestDescription );
  
  /***************************************************************************************************************/    
                                              // Start of Test Case
  /***************************************************************************************************************/
  
  /***************************************************************************************************************/    
                                              // Test Step 0 PRECONDITIONS
  /***************************************************************************************************************/
  snprintf( chActionText, elCount(chActionText), "Flash the Software and ECU is running "); 
  snprintf( chExpectedText, elCount(chExpectedText), "Ecu is should be in running state"); 
  TestStepAddActionExpected( chActionText, chExpectedText );
  A_DBGR_BreakpointDeleteAll();
  A_DBGR_R();

  /***************************************************************************************************************/    
                                              // Test Step 1 Add the break point at function call side 
  /***************************************************************************************************************/
  snprintf( chActionText, elCount(chActionText), "Set Breakpoint in GetHWIO_b_WrtProtRAM_Flt\\8 Function call side  "); 
  snprintf( chExpectedText, elCount(chExpectedText), "verify is Breakpoint GetHWIO_b_WrtProtRAM_Flt\\8 in Function call side"); 
  A_DBGR_BreakpointSet("GetHWIO_b_WrtProtRAM_Flt\\8");  
  A_DBGR_Go();
  
  snprintf( chActionText, elCount(chActionText), "verify Breakpoint should hit in GetHWIO_b_WrtProtRAM_Flt\\8"); 
  snprintf( chExpectedText, elCount(chExpectedText), "Breakpoint hit in GetHWIO_b_WrtProtRAM_Flt\\8 function");
  E_DBGR_BreakpointCheckForHalt("GetHWIO_b_WrtProtRAM_Flt\\8");
  /***************************************************************************************************************/    
                                              // Test Step2 add break point at function defination side 
  /***************************************************************************************************************/
  snprintf( chActionText, elCount(chActionText), "Set Breakpoint in Tc4xMemProt_Get_WriteProtectedAccessError Function defination  side  "); 
  snprintf( chExpectedText, elCount(chExpectedText), "verify is Breakpoint Set Tc4xMemProt_Get_WriteProtectedAccessError in funaction defination side"); 
  TestStepAddActionExpected( chActionText, chExpectedText );
  A_DBGR_BreakpointSet("Tc4xMemProt_Get_WriteProtectedAccessError");

  A_DBGR_Go();
  snprintf( chActionText, elCount(chActionText), "verify Breakpoint should hit in Tc4xMemProt_Get_WriteProtectedAccessError function defination side  "); 
  snprintf( chExpectedText, elCount(chExpectedText), "Breakpoint hit in Tc4xMemProt_Get_WriteProtectedAccessError function function defination side "); 
  E_DBGR_BreakpointCheckForHalt("Tc4xMemProt_Get_WriteProtectedAccessError");
}
testcase To_verify_the_GetHWIO_ptr_WrtProtRAM_FltAddr_stack_Software_interface() 
{
  /***************************************************************************************************************/    
                                              // Test Case Info
  /***************************************************************************************************************/
  setWriteDbgLevel(DebugOff);
  snprintf( chTestTitle, elCount(chTestTitle), "To_verify_the_GetHWIO_ptr_WrtProtRAM_FltAddr_stack_Software_interface" );
  snprintf( chTestDescription, elCount(chTestDescription), "Purpose:To check the GetHWIO_ptr_WrtProtRAM_FltAddr_Software_interface");
  TestCaseAddInfo( chTestTitle, "TC_L30SW_Q-36623750", chTestDescription );
  
  /***************************************************************************************************************/    
                                              // Start of Test Case
  /***************************************************************************************************************/
  
  /***************************************************************************************************************/    
                                              // Test Step 0 PRECONDITIONS
  /***************************************************************************************************************/
  snprintf( chActionText, elCount(chActionText), "Flash the Software and ECU is running "); 
  snprintf( chExpectedText, elCount(chExpectedText), "Ecu is should be in running state"); 
  TestStepAddActionExpected( chActionText, chExpectedText );
  A_DBGR_BreakpointDeleteAll();
  A_DBGR_R();

  /***************************************************************************************************************/    
                                              // Test Step 1 Add the break point at function call side 
  /***************************************************************************************************************/
  snprintf( chActionText, elCount(chActionText), "Set Breakpoint in MEMPROT_HWIO_ExecuteWriteTest_ProtectedAddress_WPArea\\18 Function call side  "); 
  snprintf( chExpectedText, elCount(chExpectedText), "verify is BreakpointMEMPROT_HWIO_ExecuteWriteTest_ProtectedAddress_WPArea\\18 in Function call side"); 
  A_DBGR_BreakpointSet("MEMPROT_HWIO_ExecuteWriteTest_ProtectedAddress_WPArea\\18");  
  A_DBGR_Go();
  
  snprintf( chActionText, elCount(chActionText), "verify Breakpoint should hit in MEMPROT_HWIO_ExecuteWriteTest_ProtectedAddress_WPArea\\18"); 
  snprintf( chExpectedText, elCount(chExpectedText), "Breakpoint hit in MEMPROT_HWIO_ExecuteWriteTest_ProtectedAddress_WPArea\\18 function");
  E_DBGR_BreakpointCheckForHalt("MEMPROT_HWIO_ExecuteWriteTest_ProtectedAddress_WPArea\\18");
  /***************************************************************************************************************/    
                                              // Test Step2 add break point at function defination side 
  /***************************************************************************************************************/
  snprintf( chActionText, elCount(chActionText), "Set Breakpoint in GetHWIO_ptr_WrtProtRAM_FltAddr Function defination  side  "); 
  snprintf( chExpectedText, elCount(chExpectedText), "verify is Breakpoint Set GetHWIO_ptr_WrtProtRAM_FltAddr in funaction defination side"); 
  TestStepAddActionExpected( chActionText, chExpectedText );
  A_DBGR_BreakpointSet("GetHWIO_ptr_WrtProtRAM_FltAddr");

  A_DBGR_Go();
  snprintf( chActionText, elCount(chActionText), "verify Breakpoint should hit in GetHWIO_ptr_WrtProtRAM_FltAddr function defination side  "); 
  snprintf( chExpectedText, elCount(chExpectedText), "Breakpoint hit in GetHWIO_ptr_WrtProtRAM_FltAddr function function defination side "); 
  E_DBGR_BreakpointCheckForHalt("GetHWIO_ptr_WrtProtRAM_FltAddr");
}
testcase To_verify_the_Tc4xMemProt_Get_WriteProtectedAccessError_FltAddr_Software_interface() 
{
  /***************************************************************************************************************/    
                                              // Test Case Info
  /***************************************************************************************************************/
  setWriteDbgLevel(DebugOff);
  snprintf( chTestTitle, elCount(chTestTitle), "To_verify_the_Tc4xMemProt_Get_WriteProtectedAccessError_FltAddr_Software_interface" );
  snprintf( chTestDescription, elCount(chTestDescription), "Purpose:To check the Tc4xMemProt_Get_WriteProtectedAccessError_Software_interface");
  TestCaseAddInfo( chTestTitle, "TC_L30SW_Q-36623750", chTestDescription );
  
  /***************************************************************************************************************/    
                                              // Start of Test Case
  /***************************************************************************************************************/
  
  /***************************************************************************************************************/    
                                              // Test Step 0 PRECONDITIONS
  /***************************************************************************************************************/
  snprintf( chActionText, elCount(chActionText), "Flash the Software and ECU is running "); 
  snprintf( chExpectedText, elCount(chExpectedText), "Ecu is should be in running state"); 
  TestStepAddActionExpected( chActionText, chExpectedText );
  A_DBGR_BreakpointDeleteAll();
  A_DBGR_R();

  /***************************************************************************************************************/    
                                              // Test Step 1 Add the break point at function call side 
  /***************************************************************************************************************/
  snprintf( chActionText, elCount(chActionText), "Set Breakpoint in GetHWIO_ptr_WrtProtRAM_FltAddr\\8 Function call side  "); 
  snprintf( chExpectedText, elCount(chExpectedText), "verify is Breakpoint GetHWIO_ptr_WrtProtRAM_FltAddr\\8 in Function call side"); 
  A_DBGR_BreakpointSet("GetHWIO_ptr_WrtProtRAM_FltAddr\\8");  
  A_DBGR_Go();
  
  snprintf( chActionText, elCount(chActionText), "verify Breakpoint should hit in GetHWIO_ptr_WrtProtRAM_FltAddr\\8"); 
  snprintf( chExpectedText, elCount(chExpectedText), "Breakpoint hit in GetHWIO_ptr_WrtProtRAM_FltAddr\\8 function");
  E_DBGR_BreakpointCheckForHalt("GetHWIO_ptr_WrtProtRAM_FltAddr\\8");
  /***************************************************************************************************************/    
                                              // Test Step2 add break point at function defination side 
  /***************************************************************************************************************/
  snprintf( chActionText, elCount(chActionText), "Set Breakpoint in Tc4xMemProt_Get_WriteProtectedAccessError Function defination  side  "); 
  snprintf( chExpectedText, elCount(chExpectedText), "verify is Breakpoint Set Tc4xMemProt_Get_WriteProtectedAccessError in funaction defination side"); 
  TestStepAddActionExpected( chActionText, chExpectedText );
  A_DBGR_BreakpointSet("Tc4xMemProt_Get_WriteProtectedAccessError");

  A_DBGR_Go();
  snprintf( chActionText, elCount(chActionText), "verify Breakpoint should hit in Tc4xMemProt_Get_WriteProtectedAccessError function defination side  "); 
  snprintf( chExpectedText, elCount(chExpectedText), "Breakpoint hit in Tc4xMemProt_Get_WriteProtectedAccessError function function defination side "); 
  E_DBGR_BreakpointCheckForHalt("Tc4xMemProt_Get_WriteProtectedAccessError");
}
testcase To_verify_the_GetHWIO_ptr_WrtProtRAM_FltInstAddr_stack_Software_interface() 
{
  /***************************************************************************************************************/    
                                              // Test Case Info
  /***************************************************************************************************************/
  setWriteDbgLevel(DebugOff);
  snprintf( chTestTitle, elCount(chTestTitle), "To_verify_the_GetHWIO_ptr_WrtProtRAM_FltInstAddr_stack_Software_interface" );
  snprintf( chTestDescription, elCount(chTestDescription), "Purpose:To check the GetHWIO_ptr_WrtProtRAM_FltInstAddr_Software_interface");
  TestCaseAddInfo( chTestTitle, "TC_L30SW_Q-36623750", chTestDescription );
  
  /***************************************************************************************************************/    
                                              // Start of Test Case
  /***************************************************************************************************************/
  
  /***************************************************************************************************************/    
                                              // Test Step 0 PRECONDITIONS
  /***************************************************************************************************************/
  snprintf( chActionText, elCount(chActionText), "Flash the Software and ECU is running "); 
  snprintf( chExpectedText, elCount(chExpectedText), "Ecu is should be in running state"); 
  TestStepAddActionExpected( chActionText, chExpectedText );
  A_DBGR_BreakpointDeleteAll();
  A_DBGR_R();

  /***************************************************************************************************************/    
                                              // Test Step 1 Add the break point at function call side 
  /***************************************************************************************************************/
  snprintf( chActionText, elCount(chActionText), "Set Breakpoint in MEMPROT_HWIO_ExecuteWriteTest_ProtectedAddress_WPArea\\19 Function call side  "); 
  snprintf( chExpectedText, elCount(chExpectedText), "verify is BreakpointMEMPROT_HWIO_ExecuteWriteTest_ProtectedAddress_WPArea\\19 in Function call side"); 
  A_DBGR_BreakpointSet("MEMPROT_HWIO_ExecuteWriteTest_ProtectedAddress_WPArea\\19");  
  A_DBGR_Go();
  
  snprintf( chActionText, elCount(chActionText), "verify Breakpoint should hit in MEMPROT_HWIO_ExecuteWriteTest_ProtectedAddress_WPArea\\19"); 
  snprintf( chExpectedText, elCount(chExpectedText), "Breakpoint hit in MEMPROT_HWIO_ExecuteWriteTest_ProtectedAddress_WPArea\\19 function");
  E_DBGR_BreakpointCheckForHalt("MEMPROT_HWIO_ExecuteWriteTest_ProtectedAddress_WPArea\\19");
  /***************************************************************************************************************/    
                                              // Test Step2 add break point at function defination side 
  /***************************************************************************************************************/
  snprintf( chActionText, elCount(chActionText), "Set Breakpoint in GetHWIO_ptr_WrtProtRAM_FltInstAddr Function defination  side  "); 
  snprintf( chExpectedText, elCount(chExpectedText), "verify is Breakpoint Set GetHWIO_ptr_WrtProtRAM_FltInstAddr in funaction defination side"); 
  TestStepAddActionExpected( chActionText, chExpectedText );
  A_DBGR_BreakpointSet("GetHWIO_ptr_WrtProtRAM_FltInstAddr");

  A_DBGR_Go();
  snprintf( chActionText, elCount(chActionText), "verify Breakpoint should hit in GetHWIO_ptr_WrtProtRAM_FltInstAddr function defination side  "); 
  snprintf( chExpectedText, elCount(chExpectedText), "Breakpoint hit in GetHWIO_ptr_WrtProtRAM_FltInstAddr function function defination side "); 
  E_DBGR_BreakpointCheckForHalt("GetHWIO_ptr_WrtProtRAM_FltInstAddr");
}
testcase To_verify_the_Tc4xMemProt_Get_WriteProtectedAccessError_FltInstAddr_Software_interface() 
{
  /***************************************************************************************************************/    
                                              // Test Case Info
  /***************************************************************************************************************/
  setWriteDbgLevel(DebugOff);
  snprintf( chTestTitle, elCount(chTestTitle), "To_verify_the_Tc4xMemProt_Get_WriteProtectedAccessError_FltInstAddr_Software_interface" );
  snprintf( chTestDescription, elCount(chTestDescription), "Purpose:To check the Get_WriteProtectedAccessError_Software_interface");
  TestCaseAddInfo( chTestTitle, "TC_L30SW_Q-36623750", chTestDescription );
  
  /***************************************************************************************************************/    
                                              // Start of Test Case
  /***************************************************************************************************************/
  
  /***************************************************************************************************************/    
                                              // Test Step 0 PRECONDITIONS
  /***************************************************************************************************************/
  snprintf( chActionText, elCount(chActionText), "Flash the Software and ECU is running "); 
  snprintf( chExpectedText, elCount(chExpectedText), "Ecu is should be in running state"); 
  TestStepAddActionExpected( chActionText, chExpectedText );
  A_DBGR_BreakpointDeleteAll();
  A_DBGR_R();

  /***************************************************************************************************************/    
                                              // Test Step 1 Add the break point at function call side 
  /***************************************************************************************************************/
  snprintf( chActionText, elCount(chActionText), "Set Breakpoint in GetHWIO_ptr_WrtProtRAM_FltInstAddr\\8 Function call side  "); 
  snprintf( chExpectedText, elCount(chExpectedText), "verify is Breakpoint GetHWIO_ptr_WrtProtRAM_FltInstAddr\\8 in Function call side"); 
  A_DBGR_BreakpointSet("GetHWIO_ptr_WrtProtRAM_FltInstAddr\\8");  
  A_DBGR_Go();
  
  snprintf( chActionText, elCount(chActionText), "verify Breakpoint should hit in GetHWIO_ptr_WrtProtRAM_FltInstAddr\\8"); 
  snprintf( chExpectedText, elCount(chExpectedText), "Breakpoint hit in GetHWIO_ptr_WrtProtRAM_FltInstAddr\\8 function");
  E_DBGR_BreakpointCheckForHalt("GetHWIO_ptr_WrtProtRAM_FltInstAddr\\8");
  /***************************************************************************************************************/    
                                              // Test Step2 add break point at function defination side 
  /***************************************************************************************************************/
  snprintf( chActionText, elCount(chActionText), "Set Breakpoint in Tc4xMemProt_Get_WriteProtectedAccessError Function defination  side  "); 
  snprintf( chExpectedText, elCount(chExpectedText), "verify is Breakpoint Set Tc4xMemProt_Get_WriteProtectedAccessError in funaction defination side"); 
  TestStepAddActionExpected( chActionText, chExpectedText );
  A_DBGR_BreakpointSet("Tc4xMemProt_Get_WriteProtectedAccessError");

  A_DBGR_Go();
  snprintf( chActionText, elCount(chActionText), "verify Breakpoint should hit in Tc4xMemProt_Get_WriteProtectedAccessError function defination side  "); 
  snprintf( chExpectedText, elCount(chExpectedText), "Breakpoint hit in Tc4xMemProt_Get_WriteProtectedAccessError function function defination side "); 
  E_DBGR_BreakpointCheckForHalt("Tc4xMemProt_Get_WriteProtectedAccessError");
}
testcase To_verify_the_SetHWIO_y_WrtProtRAM_Update_Software_interface() 
{
  /***************************************************************************************************************/    
                                              // Test Case Info
  /***************************************************************************************************************/
  setWriteDbgLevel(DebugOff);
  snprintf( chTestTitle, elCount(chTestTitle), "To_verify_the_SetHWIO_y_WrtProtRAM_Update_Software_interface" );
  snprintf( chTestDescription, elCount(chTestDescription), "Purpose:To check the SetHWIO_y_WrtProtRAM_Update_Software_interface");
  TestCaseAddInfo( chTestTitle, "TC_L30SW_Q-36623750", chTestDescription );
  
  /***************************************************************************************************************/    
                                              // Start of Test Case
  /***************************************************************************************************************/
  
  /***************************************************************************************************************/    
                                              // Test Step 0 PRECONDITIONS
  /***************************************************************************************************************/
  snprintf( chActionText, elCount(chActionText), "Flash the Software and ECU is running "); 
  snprintf( chExpectedText, elCount(chExpectedText), "Ecu is should be in running state"); 
  TestStepAddActionExpected( chActionText, chExpectedText );
  A_DBGR_BreakpointDeleteAll();
  A_DBGR_R();

  /***************************************************************************************************************/    
                                              // Test Step 1 Add the break point at function call side 
  /***************************************************************************************************************/
  snprintf( chActionText, elCount(chActionText), "Set Breakpoint in MEMPROT_HWIO_ExecuteWriteTest_ProtectedAddress_ProtectedUpdate\\5 Function call side  "); 
  snprintf( chExpectedText, elCount(chExpectedText), "verify is Breakpoint MEMPROT_HWIO_ExecuteWriteTest_ProtectedAddress_ProtectedUpdate\\5 in Function call side"); 
  A_DBGR_BreakpointSet("MEMPROT_HWIO_ExecuteWriteTest_ProtectedAddress_ProtectedUpdate\\5");  
  A_DBGR_Go();
  
  snprintf( chActionText, elCount(chActionText), "verify Breakpoint should hit in MEMPROT_HWIO_ExecuteWriteTest_ProtectedAddress_ProtectedUpdate\\5"); 
  snprintf( chExpectedText, elCount(chExpectedText), "Breakpoint hit in MEMPROT_HWIO_ExecuteWriteTest_ProtectedAddress_ProtectedUpdate\\5 function");
  E_DBGR_BreakpointCheckForHalt("MEMPROT_HWIO_ExecuteWriteTest_ProtectedAddress_ProtectedUpdate\\5");
  /***************************************************************************************************************/    
                                              // Test Step2 add break point at function defination side 
  /***************************************************************************************************************/
  snprintf( chActionText, elCount(chActionText), "Set Breakpoint in SetHWIO_y_WrtProtRAM_Update Function defination  side  "); 
  snprintf( chExpectedText, elCount(chExpectedText), "verify is Breakpoint Set SetHWIO_y_WrtProtRAM_Update in funaction defination side"); 
  TestStepAddActionExpected( chActionText, chExpectedText );
  A_DBGR_BreakpointSet("SetHWIO_y_WrtProtRAM_Update");

  A_DBGR_Go();
  snprintf( chActionText, elCount(chActionText), "verify Breakpoint should hit in SetHWIO_y_WrtProtRAM_Update function defination side  "); 
  snprintf( chExpectedText, elCount(chExpectedText), "Breakpoint hit in SetHWIO_y_WrtProtRAM_Update function function defination side "); 
  E_DBGR_BreakpointCheckForHalt("SetHWIO_y_WrtProtRAM_Update");
}
testcase To_verify_the_Tc4xMemProt_APP_SetProtectionContext_Unprotected_Software_interface() 
{
  /***************************************************************************************************************/    
                                              // Test Case Info
  /***************************************************************************************************************/
  setWriteDbgLevel(DebugOff);
  snprintf( chTestTitle, elCount(chTestTitle), "To_verify_the_Tc4xMemProt_APP_SetProtectionContext_Unprotected_Software_interface" );
  snprintf( chTestDescription, elCount(chTestDescription), "Purpose:To check the Tc4xMemProt_APP_SetProtectionContext_Unprotected_Software_interface");
  TestCaseAddInfo( chTestTitle, "TC_L30SW_Q-36623750", chTestDescription );
  
  /***************************************************************************************************************/    
                                              // Start of Test Case
  /***************************************************************************************************************/
  
  /***************************************************************************************************************/    
                                              // Test Step 0 PRECONDITIONS
  /***************************************************************************************************************/
  snprintf( chActionText, elCount(chActionText), "Flash the Software and ECU is running "); 
  snprintf( chExpectedText, elCount(chExpectedText), "Ecu is should be in running state"); 
  TestStepAddActionExpected( chActionText, chExpectedText );
  A_DBGR_BreakpointDeleteAll();
  A_DBGR_R();

  /***************************************************************************************************************/    
                                              // Test Step 1 Add the break point at function call side 
  /***************************************************************************************************************/
  snprintf( chActionText, elCount(chActionText), "Set Breakpoint in SetHWIO_y_WrtProtRAM_Update\\5 Function call side  "); 
  snprintf( chExpectedText, elCount(chExpectedText), "verify is Breakpoint SetHWIO_y_WrtProtRAM_Update\\5 in Function call side"); 
  A_DBGR_BreakpointSet("SetHWIO_y_WrtProtRAM_Update\\5");  
  A_DBGR_Go();
  
  snprintf( chActionText, elCount(chActionText), "verify Breakpoint should hit in SetHWIO_y_WrtProtRAM_Update\\5"); 
  snprintf( chExpectedText, elCount(chExpectedText), "Breakpoint hit in SetHWIO_y_WrtProtRAM_Update\\5 function");
  E_DBGR_BreakpointCheckForHalt("SetHWIO_y_WrtProtRAM_Update\\5");
  /***************************************************************************************************************/    
                                              // Test Step2 add break point at function defination side 
  /***************************************************************************************************************/
  snprintf( chActionText, elCount(chActionText), "Set Breakpoint in Tc4xMemProt_APP_SetProtectionContext Function defination  side  "); 
  snprintf( chExpectedText, elCount(chExpectedText), "verify is Breakpoint Set Tc4xMemProt_APP_SetProtectionContext in funaction defination side"); 
  TestStepAddActionExpected( chActionText, chExpectedText );
  A_DBGR_BreakpointSet("Tc4xMemProt_APP_SetProtectionContext");

  A_DBGR_Go();
  snprintf( chActionText, elCount(chActionText), "verify Breakpoint should hit in Tc4xMemProt_APP_SetProtectionContext function defination side  "); 
  snprintf( chExpectedText, elCount(chExpectedText), "Breakpoint hit in Tc4xMemProt_APP_SetProtectionContext function function defination side "); 
  E_DBGR_BreakpointCheckForHalt("Tc4xMemProt_APP_SetProtectionContext");
}
testcase To_verify_the_Tc4xMemProt_APP_SetProtectionContext_Protected_Software_interface() 
{
  /***************************************************************************************************************/    
                                              // Test Case Info
  /***************************************************************************************************************/
  setWriteDbgLevel(DebugOff);
  snprintf( chTestTitle, elCount(chTestTitle), "To_verify_the_Tc4xMemProt_APP_SetProtectionContext_Protected_Software_interface" );
  snprintf( chTestDescription, elCount(chTestDescription), "Purpose:To check the Tc4xMemProt_APP_SetProtectionContext_Protected_Software_interface");
  TestCaseAddInfo( chTestTitle, "TC_L30SW_Q-36623750", chTestDescription );
  
  /***************************************************************************************************************/    
                                              // Start of Test Case
  /***************************************************************************************************************/
  
  /***************************************************************************************************************/    
                                              // Test Step 0 PRECONDITIONS
  /***************************************************************************************************************/
  snprintf( chActionText, elCount(chActionText), "Flash the Software and ECU is running "); 
  snprintf( chExpectedText, elCount(chExpectedText), "Ecu is should be in running itate");
  TestStepAddActionExpected( chActionText, chExpectedText );
  A_DBGR_BreakpointDeleteAll();
  A_DBGR_R();

  /***************************************************************************************************************/    
                                              // Test Step 1 Add the break point at function call side 
  /***************************************************************************************************************/
  snprintf( chActionText, elCount(chActionText), "Set Breakpoint in SetHWIO_y_WrtProtRAM_Update\\9 inction call side  "); 
  snprintf( chExpectedText, elCount(chExpectedText), "verify is Breakpoint SetHWIO_y_WrtProtRAM_Update\\9  Function call side"); 
  A_DBGR_BreakpointSet("SetHWIO_y_WrtProtRAM_Update\\9");  
  A_DBGR_Go();
  
  snprintf( chActionText, elCount(chActionText), "verify Breakpoint should hit in SetHWIO_y_WrtProtRAM_Update\\9"); 
  snprintf( chExpectedText, elCount(chExpectedText), "Breakpoint hit in SetHWIO_y_WrtProtRAM_Update\\9 function");
  E_DBGR_BreakpointCheckForHalt("SetHWIO_y_WrtProtRAM_Update\\9");
  /***************************************************************************************************************/    
                                              // Test Step2 add break point at function defination side 
  /***************************************************************************************************************/
  snprintf( chActionText, elCount(chActionText), "Set Breakpoint in Tc4xMemProt_APP_SetProtectionContext Function defination  side  "); 
  snprintf( chExpectedText, elCount(chExpectedText), "verify is Breakpoint Set Tc4xMemProt_APP_SetProtectionContext in funaction defination side"); 
  TestStepAddActionExpected( chActionText, chExpectedText );
  A_DBGR_BreakpointSet("Tc4xMemProt_APP_SetProtectionContext");

  A_DBGR_Go();
  snprintf( chActionText, elCount(chActionText), "verify Breakpoint should hit in Tc4xMemProt_APP_SetProtectionContext function defination side  "); 
  snprintf( chExpectedText, elCount(chExpectedText), "Breakpoint hit in Tc4xMemProt_APP_SetProtectionContext function function defination side "); 
  E_DBGR_BreakpointCheckForHalt("Tc4xMemProt_APP_SetProtectionContext");
}
testcase To_verify_the_ClrHWIO_WrtProtRAM_Flt_Stack_Software_interface() 
{
  /***************************************************************************************************************/    
                                              // Test Case Info
  /***************************************************************************************************************/
  setWriteDbgLevel(DebugOff);
  snprintf( chTestTitle, elCount(chTestTitle), "To_verify_the_ClrHWIO_WrtProtRAM_Flt_Stack_Software_interface" );
  snprintf( chTestDescription, elCount(chTestDescription), "Purpose:To check the ClrHWIO_WrtProtRAM_Flt_Software_interface");
  TestCaseAddInfo( chTestTitle, "TC_L30SW_Q-36623750", chTestDescription );
  
  /***************************************************************************************************************/    
                                              // Start of Test Case
  /***************************************************************************************************************/
  
  /***************************************************************************************************************/    
                                              // Test Step 0 PRECONDITIONS
  /***************************************************************************************************************/
  snprintf( chActionText, elCount(chActionText), "Flash the Software and ECU is running "); 
  snprintf( chExpectedText, elCount(chExpectedText), "Ecu is should be in running itate");
  TestStepAddActionExpected( chActionText, chExpectedText );
  A_DBGR_BreakpointDeleteAll();
  A_DBGR_R();

  /***************************************************************************************************************/    
                                              // Test Step 1 Add the break point at function call side 
  /***************************************************************************************************************/
  snprintf( chActionText, elCount(chActionText), "Set Breakpoint in MEMPROT_HWIO_ExecuteWriteTest_ProtectedAddress_WPArea\\30 inction call side  "); 
  snprintf( chExpectedText, elCount(chExpectedText), "verify is Breakpoint MEMPROT_HWIO_ExecuteWriteTest_ProtectedAddress_WPArea\\30 Function call side"); 
  A_DBGR_BreakpointSet("MEMPROT_HWIO_ExecuteWriteTest_ProtectedAddress_WPArea\\30");  
  A_DBGR_Go();
  
  snprintf( chActionText, elCount(chActionText), "verify Breakpoint should hit in MEMPROT_HWIO_ExecuteWriteTest_ProtectedAddress_WPArea\\30"); 
  snprintf( chExpectedText, elCount(chExpectedText), "Breakpoint hit in MEMPROT_HWIO_ExecuteWriteTest_ProtectedAddress_WPArea\\30 function");
  E_DBGR_BreakpointCheckForHalt("MEMPROT_HWIO_ExecuteWriteTest_ProtectedAddress_WPArea\\30");
  /***************************************************************************************************************/    
                                              // Test Step2 add break point at function defination side 
  /***************************************************************************************************************/
  snprintf( chActionText, elCount(chActionText), "Set Breakpoint in ClrHWIO_WrtProtRAM_Flt Function defination  side  "); 
  snprintf( chExpectedText, elCount(chExpectedText), "verify is Breakpoint Set ClrHWIO_WrtProtRAM_Flt in funaction defination side"); 
  TestStepAddActionExpected( chActionText, chExpectedText );
  A_DBGR_BreakpointSet("ClrHWIO_WrtProtRAM_Flt");

  A_DBGR_Go();
  snprintf( chActionText, elCount(chActionText), "verify Breakpoint should hit in ClrHWIO_WrtProtRAM_Flt function defination side  "); 
  snprintf( chExpectedText, elCount(chExpectedText), "Breakpoint hit in ClrHWIO_WrtProtRAM_Flt function function defination side "); 
  E_DBGR_BreakpointCheckForHalt("ClrHWIO_WrtProtRAM_Flt");
}
testcase To_verify_the_Minimum_value_SetHWIO_y_WrtProtRAM_Update_Software_interface() 
{
  /***************************************************************************************************************/    
                                              // Test Case Info
  /***************************************************************************************************************/
  setWriteDbgLevel(DebugOff);
  snprintf( chTestTitle, elCount(chTestTitle), "To_verify_the_Minimum_value_SetHWIO_y_WrtProtRAM_Update_Software_interface" );
  snprintf( chTestDescription, elCount(chTestDescription), "Purpose:To check the SetHWIO_y_WrtProtRAM_Update_Software_interface");
  TestCaseAddInfo( chTestTitle, "TC_L30SW_Q-36623750", chTestDescription );
  
  /***************************************************************************************************************/    
                                              // Start of Test Case
  /***************************************************************************************************************/
  
  /***************************************************************************************************************/    
                                              // Test Step 0 PRECONDITIONS
  /***************************************************************************************************************/
  snprintf( chActionText, elCount(chActionText), "Flash the Software and ECU is running "); 
  snprintf( chExpectedText, elCount(chExpectedText), "Ecu is should be in running state"); 
  TestStepAddActionExpected( chActionText, chExpectedText );
  A_DBGR_BreakpointDeleteAll();
  A_DBGR_R();

  /***************************************************************************************************************/    
                                              // Test Step 1 Add the break point at function call side 
  /***************************************************************************************************************/
  snprintf( chActionText, elCount(chActionText), "Set Breakpoint in  MEMPROT_HWIO_ExecuteWriteTest_ProtectedAddress_ProtectedUpdate  Function call side  "); 
  snprintf( chExpectedText, elCount(chExpectedText), "verify is Breakpoint Set  MEMPROT_HWIO_ExecuteWriteTest_ProtectedAddress_ProtectedUpdate  in Function call side"); 
  A_DBGR_BreakpointSet("MEMPROT_HWIO_ExecuteWriteTest_ProtectedAddress_ProtectedUpdate");
  
  snprintf( chActionText, elCount(chActionText), "Set Breakpoint in  MEMPROT_HWIO_ExecuteWriteTest_ProtectedAddress_ProtectedUpdate  Function call side  "); 
  snprintf( chExpectedText, elCount(chExpectedText), "verify is Breakpoint Set  MEMPROT_HWIO_ExecuteWriteTest_ProtectedAddress_ProtectedUpdate  in Function call side"); 
  
  A_DBGR_Go();
  
  snprintf( chActionText, elCount(chActionText), "verify Breakpoint should hit in MEMPROT_HWIO_ExecuteWriteTest_ProtectedAddress_ProtectedUpdate"); 
  snprintf( chExpectedText, elCount(chExpectedText), "Breakpoint hit in  MEMPROT_HWIO_ExecuteWriteTest_ProtectedAddress_ProtectedUpdate function"); 
  E_DBGR_BreakpointCheckForHalt("MEMPROT_HWIO_ExecuteWriteTest_ProtectedAddress_ProtectedUpdate");
  /***************************************************************************************************************/    
                                              // Test Step2 Update the  variables  to minimum value 
  /***************************************************************************************************************/
  snprintf( chActionText, elCount(chActionText), "Set the (*(pLoc)) variable  to minimum value"); 
  snprintf( chExpectedText, elCount(chExpectedText), "verify (*(pLoc)) variable to minimum value");
  TestStepAddActionExpected( chActionText, chExpectedText );
  A_DBGR_VariableSet("(*(pLoc))","0");
  E_DBGR_VariableCheck("(*(pLoc))",0,Equal);
  snprintf( chActionText, elCount(chActionText), "Set the (*(NewData)) variable  to minimum value"); 
  snprintf( chExpectedText, elCount(chExpectedText), "verify (*(NewData)) variable to minimum value");
  TestStepAddActionExpected( chActionText, chExpectedText );
  A_DBGR_VariableSet("(*(NewData))","0");
  E_DBGR_VariableCheck("(*(NewData))",0,Equal);
  snprintf( chActionText, elCount(chActionText), "Set the size  variable  to minimum value"); 
  snprintf( chExpectedText, elCount(chExpectedText), "verify size  variable to minimum value");
  TestStepAddActionExpected( chActionText, chExpectedText );
  A_DBGR_VariableSet("size","0");
  E_DBGR_VariableCheck("size",0,Equal);

  /***************************************************************************************************************/    
                                              // Test Step3 Add the break point at function defination  side 
  /***************************************************************************************************************/
  snprintf( chActionText, elCount(chActionText), "Set Breakpoint in  SetHWIO_y_WrtProtRAM_Update function defination side  "); 
  snprintf( chExpectedText, elCount(chExpectedText), "verify is Breakpoint Set  SetHWIO_y_WrtProtRAM_Update  in Function call side"); 
  TestStepAddActionExpected( chActionText, chExpectedText );
  A_DBGR_BreakpointSet("SetHWIO_y_WrtProtRAM_Update");
  
  snprintf( chActionText, elCount(chActionText), "Set Breakpoint in  SetHWIO_y_WrtProtRAM_Update Function defination  side  "); 
  snprintf( chExpectedText, elCount(chExpectedText), "verify is Breakpoint Set  SetHWIO_y_WrtProtRAM_Update  in Function Defination side"); 
  
  A_DBGR_Go();
  
  snprintf( chActionText, elCount(chActionText), "verify Breakpoint should hit in SetHWIO_y_WrtProtRAM_Update"); 
  snprintf( chExpectedText, elCount(chExpectedText), "Breakpoint hit in  SetHWIO_y_WrtProtRAM_Update"); 
  E_DBGR_BreakpointCheckForHalt("SetHWIO_y_WrtProtRAM_Update");
  
  snprintf( chActionText, elCount(chActionText), "Set the (*(Dest)) variable  to minimum value"); 
  snprintf( chExpectedText, elCount(chExpectedText), "verify (*(Dest)) variable to minimum value");
  TestStepAddActionExpected( chActionText, chExpectedText );
  E_DBGR_VariableCheck("(*(Dest))",0,Equal);
  snprintf( chActionText, elCount(chActionText), "Set the (*(Src)) variable  to minimum value"); 
  snprintf( chExpectedText, elCount(chExpectedText), "verify (*(Src)) variable to minimum value");
  TestStepAddActionExpected( chActionText, chExpectedText );
  E_DBGR_VariableCheck("(*(Src))",0,Equal);
  snprintf( chActionText, elCount(chActionText), "Set the size  variable  to minimum value"); 
  snprintf( chExpectedText, elCount(chExpectedText), "verify size  variable to minimum value");
  TestStepAddActionExpected( chActionText, chExpectedText );
  E_DBGR_VariableCheck("Size",0,Equal);
  
}
testcase To_verify_the_Mid_value_SetHWIO_y_WrtProtRAM_Update_Software_interface() 
{
  /***************************************************************************************************************/    
                                              // Test Case Info
  /***************************************************************************************************************/
  setWriteDbgLevel(DebugOff);
  snprintf( chTestTitle, elCount(chTestTitle), "To_verify_the_Mid_value_SetHWIO_y_WrtProtRAM_Update_Software_interface" );
  snprintf( chTestDescription, elCount(chTestDescription), "Purpose:To check the SetHWIO_y_WrtProtRAM_Update_Software_interface");
  TestCaseAddInfo( chTestTitle, "TC_L30SW_Q-36623750", chTestDescription );
  
  /***************************************************************************************************************/    
                                              // Start of Test Case
  /***************************************************************************************************************/
  
  /***************************************************************************************************************/    
                                              // Test Step 0 PRECONDITIONS
  /***************************************************************************************************************/
  snprintf( chActionText, elCount(chActionText), "Flash the Software and ECU is running "); 
  snprintf( chExpectedText, elCount(chExpectedText), "Ecu is should be in running state"); 
  TestStepAddActionExpected( chActionText, chExpectedText );
  A_DBGR_BreakpointDeleteAll();
  A_DBGR_R();

  /***************************************************************************************************************/    
                                              // Test Step 1 Add the break point at function call side 
  /***************************************************************************************************************/
  snprintf( chActionText, elCount(chActionText), "Set Breakpoint in  MEMPROT_HWIO_ExecuteWriteTest_ProtectedAddress_ProtectedUpdate  Function call side  "); 
  snprintf( chExpectedText, elCount(chExpectedText), "verify is Breakpoint Set  MEMPROT_HWIO_ExecuteWriteTest_ProtectedAddress_ProtectedUpdate  in Function call side"); 
  A_DBGR_BreakpointSet("MEMPROT_HWIO_ExecuteWriteTest_ProtectedAddress_ProtectedUpdate");
  
  snprintf( chActionText, elCount(chActionText), "Set Breakpoint in  MEMPROT_HWIO_ExecuteWriteTest_ProtectedAddress_ProtectedUpdate  Function call side  "); 
  snprintf( chExpectedText, elCount(chExpectedText), "verify is Breakpoint Set  MEMPROT_HWIO_ExecuteWriteTest_ProtectedAddress_ProtectedUpdate  in Function call side"); 
  
  A_DBGR_Go();
  
  snprintf( chActionText, elCount(chActionText), "verify Breakpoint should hit in MEMPROT_HWIO_ExecuteWriteTest_ProtectedAddress_ProtectedUpdate"); 
  snprintf( chExpectedText, elCount(chExpectedText), "Breakpoint hit in  MEMPROT_HWIO_ExecuteWriteTest_ProtectedAddress_ProtectedUpdate function"); 
  E_DBGR_BreakpointCheckForHalt("MEMPROT_HWIO_ExecuteWriteTest_ProtectedAddress_ProtectedUpdate");
  /***************************************************************************************************************/    
                                              // Test Step2 Update the  variables  to Mid value 
  /***************************************************************************************************************/
  snprintf( chActionText, elCount(chActionText), "Set the (*(pLoc)) variable  to Mid value"); 
  snprintf( chExpectedText, elCount(chExpectedText), "verify (*(pLoc)) variable to Mid value");
  TestStepAddActionExpected( chActionText, chExpectedText );
  A_DBGR_VariableSet("(*(pLoc))","127");
  E_DBGR_VariableCheck("(*(pLoc))",127,Equal);
  snprintf( chActionText, elCount(chActionText), "Set the (*(NewData)) variable  to Mid value"); 
  snprintf( chExpectedText, elCount(chExpectedText), "verify (*(NewData)) variable to Mid value");
  TestStepAddActionExpected( chActionText, chExpectedText );
  A_DBGR_VariableSet("(*(NewData))","127");
  E_DBGR_VariableCheck("(*(NewData))",127,Equal);
  snprintf( chActionText, elCount(chActionText), "Set the size  variable  to Mid value"); 
  snprintf( chExpectedText, elCount(chExpectedText), "verify size  variable to Mid value");
  TestStepAddActionExpected( chActionText, chExpectedText );
  A_DBGR_VariableSet("size","127");
  E_DBGR_VariableCheck("size",127,Equal);

  /***************************************************************************************************************/    
                                              // Test Step3 Add the break point at function defination  side 
  /***************************************************************************************************************/
  snprintf( chActionText, elCount(chActionText), "Set Breakpoint in  SetHWIO_y_WrtProtRAM_Update function defination side  "); 
  snprintf( chExpectedText, elCount(chExpectedText), "verify is Breakpoint Set  SetHWIO_y_WrtProtRAM_Update  in Function call side"); 
  TestStepAddActionExpected( chActionText, chExpectedText );
  A_DBGR_BreakpointSet("SetHWIO_y_WrtProtRAM_Update");
  
  snprintf( chActionText, elCount(chActionText), "Set Breakpoint in  SetHWIO_y_WrtProtRAM_Update Function defination  side  "); 
  snprintf( chExpectedText, elCount(chExpectedText), "verify is Breakpoint Set  SetHWIO_y_WrtProtRAM_Update  in Function Defination side"); 
  
  A_DBGR_Go();
  
  snprintf( chActionText, elCount(chActionText), "verify Breakpoint should hit in SetHWIO_y_WrtProtRAM_Update"); 
  snprintf( chExpectedText, elCount(chExpectedText), "Breakpoint hit in  SetHWIO_y_WrtProtRAM_Update"); 
  E_DBGR_BreakpointCheckForHalt("SetHWIO_y_WrtProtRAM_Update");
  
 snprintf( chActionText, elCount(chActionText), "Set the (*(Dest)) variable  to Mid value"); 
  snprintf( chExpectedText, elCount(chExpectedText), "verify (*(Dest)) variable to Mid value");
  TestStepAddActionExpected( chActionText, chExpectedText );
  E_DBGR_VariableCheck("(*(Dest))",127,Equal);
  snprintf( chActionText, elCount(chActionText), "Set the (*(Src)) variable  to Mid value"); 
  snprintf( chExpectedText, elCount(chExpectedText), "verify (*(Src)) variable to Mid value");
  TestStepAddActionExpected( chActionText, chExpectedText );
  E_DBGR_VariableCheck("(*(Src))",127,Equal);
  snprintf( chActionText, elCount(chActionText), "Set the size  variable  to Mid value"); 
  snprintf( chExpectedText, elCount(chExpectedText), "verify size  variable to Mid value");
  TestStepAddActionExpected( chActionText, chExpectedText );
  E_DBGR_VariableCheck("Size",127,Equal);
  
}
testcase To_verify_the_Max_value_SetHWIO_y_WrtProtRAM_Update_Software_interface() 
{
  /***************************************************************************************************************/    
                                              // Test Case Info
  /***************************************************************************************************************/
  setWriteDbgLevel(DebugOff);
  snprintf( chTestTitle, elCount(chTestTitle), "To_verify_the_Mid_value_SetHWIO_y_WrtProtRAM_Update_Software_interface" );
  snprintf( chTestDescription, elCount(chTestDescription), "Purpose:To check the SetHWIO_y_WrtProtRAM_Update_Software_interface");
  TestCaseAddInfo( chTestTitle, "TC_L30SW_Q-36623750", chTestDescription );
  
  /***************************************************************************************************************/    
                                              // Start of Test Case
  /***************************************************************************************************************/
  
  /***************************************************************************************************************/    
                                              // Test Step 0 PRECONDITIONS
  /***************************************************************************************************************/
  snprintf( chActionText, elCount(chActionText), "Flash the Software and ECU is running "); 
  snprintf( chExpectedText, elCount(chExpectedText), "Ecu is should be in running state"); 
  TestStepAddActionExpected( chActionText, chExpectedText );
  A_DBGR_BreakpointDeleteAll();
  A_DBGR_R();

  /***************************************************************************************************************/    
                                              // Test Step 1 Add the break point at function call side 
  /***************************************************************************************************************/
  snprintf( chActionText, elCount(chActionText), "Set Breakpoint in  MEMPROT_HWIO_ExecuteWriteTest_ProtectedAddress_ProtectedUpdate  Function call side  "); 
  snprintf( chExpectedText, elCount(chExpectedText), "verify is Breakpoint Set  MEMPROT_HWIO_ExecuteWriteTest_ProtectedAddress_ProtectedUpdate  in Function call side"); 
  A_DBGR_BreakpointSet("MEMPROT_HWIO_ExecuteWriteTest_ProtectedAddress_ProtectedUpdate");
  
  snprintf( chActionText, elCount(chActionText), "Set Breakpoint in  MEMPROT_HWIO_ExecuteWriteTest_ProtectedAddress_ProtectedUpdate  Function call side  "); 
  snprintf( chExpectedText, elCount(chExpectedText), "verify is Breakpoint Set  MEMPROT_HWIO_ExecuteWriteTest_ProtectedAddress_ProtectedUpdate  in Function call side"); 
  
  A_DBGR_Go();
  
  snprintf( chActionText, elCount(chActionText), "verify Breakpoint should hit in MEMPROT_HWIO_ExecuteWriteTest_ProtectedAddress_ProtectedUpdate"); 
  snprintf( chExpectedText, elCount(chExpectedText), "Breakpoint hit in  MEMPROT_HWIO_ExecuteWriteTest_ProtectedAddress_ProtectedUpdate function"); 
  E_DBGR_BreakpointCheckForHalt("MEMPROT_HWIO_ExecuteWriteTest_ProtectedAddress_ProtectedUpdate");
  /***************************************************************************************************************/    
                                              // Test Step2 Update the  variables  to Maximum value 
  /***************************************************************************************************************/
  snprintf( chActionText, elCount(chActionText), "Set the (*(pLoc)) variable  to Maximum value"); 
  snprintf( chExpectedText, elCount(chExpectedText), "verify (*(pLoc)) variable to Maximum value");
  TestStepAddActionExpected( chActionText, chExpectedText );
  A_DBGR_VariableSet("(*(pLoc))","255");
  E_DBGR_VariableCheck("(*(pLoc))",255,Equal);
  snprintf( chActionText, elCount(chActionText), "Set the (*(NewData)) variable  to Maximum value"); 
  snprintf( chExpectedText, elCount(chExpectedText), "verify (*(NewData)) variable to Maximum value");
  TestStepAddActionExpected( chActionText, chExpectedText );
  A_DBGR_VariableSet("(*(NewData))","255");
  E_DBGR_VariableCheck("(*(NewData))",255,Equal);
  snprintf( chActionText, elCount(chActionText), "Set the size  variable  to Maximum value"); 
  snprintf( chExpectedText, elCount(chExpectedText), "verify size  variable to Maximum value");
  TestStepAddActionExpected( chActionText, chExpectedText );
  A_DBGR_VariableSet("size","255");
  E_DBGR_VariableCheck("size",255,Equal);

  /***************************************************************************************************************/    
                                              // Test Step3 Add the break point at function defination  side 
  /***************************************************************************************************************/
  snprintf( chActionText, elCount(chActionText), "Set Breakpoint in  SetHWIO_y_WrtProtRAM_Update function defination side  "); 
  snprintf( chExpectedText, elCount(chExpectedText), "verify is Breakpoint Set  SetHWIO_y_WrtProtRAM_Update  in Function call side"); 
  TestStepAddActionExpected( chActionText, chExpectedText );
  A_DBGR_BreakpointSet("SetHWIO_y_WrtProtRAM_Update");
  
  snprintf( chActionText, elCount(chActionText), "Set Breakpoint in  SetHWIO_y_WrtProtRAM_Update Function defination  side  "); 
  snprintf( chExpectedText, elCount(chExpectedText), "verify is Breakpoint Set  SetHWIO_y_WrtProtRAM_Update  in Function Defination side"); 
  
  A_DBGR_Go();
  
  snprintf( chActionText, elCount(chActionText), "verify Breakpoint should hit in SetHWIO_y_WrtProtRAM_Update"); 
  snprintf( chExpectedText, elCount(chExpectedText), "Breakpoint hit in  SetHWIO_y_WrtProtRAM_Update"); 
  E_DBGR_BreakpointCheckForHalt("SetHWIO_y_WrtProtRAM_Update");
  
 snprintf( chActionText, elCount(chActionText), "Set the (*(Dest)) variable  to Maximum value"); 
  snprintf( chExpectedText, elCount(chExpectedText), "verify (*(Dest)) variable to Maximum value");
  TestStepAddActionExpected( chActionText, chExpectedText );
  E_DBGR_VariableCheck("(*(Dest))",255,Equal);
  snprintf( chActionText, elCount(chActionText), "Set the (*(Src)) variable  to Maximum value"); 
  snprintf( chExpectedText, elCount(chExpectedText), "verify (*(Src)) variable to Maximum value");
  TestStepAddActionExpected( chActionText, chExpectedText );
  E_DBGR_VariableCheck("(*(Src))",255,Equal);
  snprintf( chActionText, elCount(chActionText), "Set the size  variable  to Maximum value"); 
  snprintf( chExpectedText, elCount(chExpectedText), "verify size  variable to Maximum value");
  TestStepAddActionExpected( chActionText, chExpectedText );
  E_DBGR_VariableCheck("Size",255,Equal);
  
}


/***************************************************************************************************************/    
                                              //Stack_SWQT
/***************************************************************************************************************/


testcase To_verify_the_software_shall_report_the_status_of_the_Stack_overflow_condition_for_Core_0() 
{
  /***************************************************************************************************************/    
                                              // Test Case Info
  /***************************************************************************************************************/
  setWriteDbgLevel(DebugOff);
  snprintf( chTestTitle, elCount(chTestTitle), "To_verify_the_software_shall_report_the_status_of_the_Stack_overflow_condition_for_Core_0" );
  snprintf( chTestDescription, elCount(chTestDescription), "Purpose:To_verify_the_software_shall_report_the_status_of_the_Stack_overflow_condition_for_Core_0");
  TestCaseAddInfo( chTestTitle, "TC_L30SW_Q-36623750", chTestDescription );
  
  /***************************************************************************************************************/    
                                              // Start of Test Case
  /***************************************************************************************************************/
  
  /***************************************************************************************************************/    
                                              // Test Step 0 PRECONDITIONS
  /***************************************************************************************************************/
  snprintf( chActionText, elCount(chActionText), "Flash the Software and ECU is running "); 
  snprintf( chExpectedText, elCount(chExpectedText), "Ecu is should be in running state"); 
  TestStepAddActionExpected( chActionText, chExpectedText );
  A_DBGR_BreakpointDeleteAll();
  A_DBGR_R();

  /***************************************************************************************************************/    
                                              // Test Step 1 Add the break point_1 at core_ID 
  /***************************************************************************************************************/
  snprintf( chActionText, elCount(chActionText), "Set Breakpoint in MEMPROT_HWIO_Run_StackOverflow_Tests\\6 Function call side"); 
  snprintf( chExpectedText, elCount(chExpectedText), "verify is Breakpoint Set MEMPROT_HWIO_Run_StackOverflow_Tests\\6 in Function call side"); 
  A_DBGR_BreakpointSet("MEMPROT_HWIO_Run_StackOverflow_Tests\\6");  
  A_DBGR_Go();
  
  snprintf( chActionText, elCount(chActionText), "verify Breakpoint should hit in MEMPROT_HWIO_Run_StackOverflow_Tests\\6"); 
  snprintf( chExpectedText, elCount(chExpectedText), "Breakpoint hit in MEMPROT_HWIO_Run_StackOverflow_Tests\\6 function"); 
  E_DBGR_BreakpointCheckForHalt("MEMPROT_HWIO_Run_StackOverflow_Tests\\6");
  /***************************************************************************************************************/    
                                              // Test Step2 Read the coreID value 
  /***************************************************************************************************************/
  snprintf( chActionText, elCount(chActionText), "Set the Coreid variable value to 0"); 
  snprintf( chExpectedText, elCount(chExpectedText), "verify Coreid variable value to 0");
  TestStepAddActionExpected( chActionText, chExpectedText );
  E_DBGR_VariableCheck("Coreid",0,Equal);
  /***************************************************************************************************************/    
                                              // Test Step3 Keeping break point at stack overflow condition 
  /***************************************************************************************************************/
  
  snprintf( chActionText, elCount(chActionText), "Set Breakpoint in MEMPROT_HWIO_Run_StackOverflow_Tests\\57+0x2 stack overflow condition"); 
  snprintf( chExpectedText, elCount(chExpectedText), "verify is Breakpoint Set MEMPROT_HWIO_Run_StackOverflow_Tests\\57+0x2  stack overflow condition"); 
  TestStepAddActionExpected( chActionText, chExpectedText );
  A_DBGR_BreakpointSet("MEMPROT_HWIO_Run_StackOverflow_Tests\\57+0x2");
  A_DBGR_Go();
  snprintf( chActionText, elCount(chActionText), "setting the Breakpoint at MEMPROT_HWIO_Run_StackOverflow_Tests\\57+0x2"); 
  snprintf( chExpectedText, elCount(chExpectedText), "Verify Breakpoint hit in MEMPROT_HWIO_Run_StackOverflow_Tests\\57+0x2"); 
  E_DBGR_BreakpointCheckForHalt("MEMPROT_HWIO_Run_StackOverflow_Tests\\57+0x2");
  snprintf( chActionText, elCount(chActionText), "Verify breakpoint reached at MEMPROT_HWIO_Run_StackOverflow_Tests\\57+0x2"); 
  snprintf( chExpectedText, elCount(chExpectedText), "Breakpoint reached at MEMPROT_HWIO_Run_StackOverflow_Tests\\57+0x2");
  TestStepAddActionExpected( chActionText, chExpectedText );
  A_DBGR_Go();
  E_DBGR_CheckState(T32_State_Stopped);
  /***************************************************************************************************************/    
                                              // Test Step4 Reading  the fault information data
  /***************************************************************************************************************/
  snprintf( chActionText, elCount(chActionText), "Read the bWPAccessError_Happened variable value equal to 1"); 
  snprintf( chExpectedText, elCount(chExpectedText), "verify bWPAccessError_Happened variable value equal to 1");
  TestStepAddActionExpected( chActionText, chExpectedText );
  E_DBGR_VariableCheck("ME_App_Tc4xMemProt_ContxRam_Core0.TC4XMEMPROT_APP_StackOverflow_ACCESS_ERROR_data.bWPAccessError_Happened",1,Equal);
  snprintf( chActionText, elCount(chActionText), "Read the u32WPAccessError_Address variable address equal to 1879257599"); 
  snprintf( chExpectedText, elCount(chExpectedText), "verify u32WPAccessError_Address variable address equal to 1879257599");
  TestStepAddActionExpected( chActionText, chExpectedText );
  E_DBGR_VariableCheck("ME_App_Tc4xMemProt_ContxRam_Core0.TC4XMEMPROT_APP_StackOverflow_ACCESS_ERROR_data.u32WPAccessError_Address",1879257599,Equal);
  snprintf( chActionText, elCount(chActionText), "Read the u32WPAccessError_InstructionAddress variable value is equal to  to 2156150008"); 
  snprintf( chExpectedText, elCount(chExpectedText), "verify u32WPAccessError_InstructionAddress variable value is equal to 2156150008");
  TestStepAddActionExpected( chActionText, chExpectedText );
  E_DBGR_VariableCheck("ME_App_Tc4xMemProt_ContxRam_Core0.TC4XMEMPROT_APP_StackOverflow_ACCESS_ERROR_data.u32WPAccessError_InstructionAddress",2156150008,Equal);
  
}
testcase To_verify_the_software_shall_report_the_status_of_the_Stack_Overflow_Underflow_condition_for_Core_0() 
{
  /***************************************************************************************************************/    
                                              // Test Case Info
  /***************************************************************************************************************/
  setWriteDbgLevel(DebugOff);
  snprintf( chTestTitle, elCount(chTestTitle), "To_verify_the_software_shall_report_the_status_of_the_Stack_Overflow_Underflow_condition_for_Core_0" );
  snprintf( chTestDescription, elCount(chTestDescription), "Purpose:To_verify_the_software_shall_report_the_status_of_the_Stack_Overflow_Underflow_condition_for_Core_0");
  TestCaseAddInfo( chTestTitle, "TC_L30SW_Q-36623750", chTestDescription );
  
  /***************************************************************************************************************/    
                                              // Start of Test Case
  /***************************************************************************************************************/
  
  /***************************************************************************************************************/    
                                              // Test Step 0 PRECONDITIONS
  /***************************************************************************************************************/
  snprintf( chActionText, elCount(chActionText), "Flash the Software and ECU is running "); 
  snprintf( chExpectedText, elCount(chExpectedText), "Ecu is should be in running state"); 
  TestStepAddActionExpected( chActionText, chExpectedText );
  A_DBGR_BreakpointDeleteAll();
  A_DBGR_R();

  /***************************************************************************************************************/    
                                              // Test Step 1 Add the break point_1 at core_ID 
  /***************************************************************************************************************/
  snprintf( chActionText, elCount(chActionText), "Set Breakpoint in MEMPROT_HWIO_Run_StackOverflow_Tests\\6 Function call side"); 
  snprintf( chExpectedText, elCount(chExpectedText), "verify is Breakpoint Set MEMPROT_HWIO_Run_StackOverflow_Tests\\6 in Function call side"); 
  A_DBGR_BreakpointSet("MEMPROT_HWIO_Run_StackOverflow_Tests\\6");  
  A_DBGR_Go();
  
  snprintf( chActionText, elCount(chActionText), "verify Breakpoint should hit in MEMPROT_HWIO_Run_StackOverflow_Tests\\6"); 
  snprintf( chExpectedText, elCount(chExpectedText), "Breakpoint hit in MEMPROT_HWIO_Run_StackOverflow_Tests\\6 function"); 
  E_DBGR_BreakpointCheckForHalt("MEMPROT_HWIO_Run_StackOverflow_Tests\\6");
  /***************************************************************************************************************/    
                                              // Test Step2 Read the coreID value 
  /***************************************************************************************************************/
  snprintf( chActionText, elCount(chActionText), "Set the Coreid variable value to 0"); 
  snprintf( chExpectedText, elCount(chExpectedText), "verify Coreid variable value to 0");
  TestStepAddActionExpected( chActionText, chExpectedText );
  E_DBGR_VariableCheck("Coreid",0,Equal);
  /***************************************************************************************************************/    
  // Test Step3 Keeping break point at before stack overflow condition and reading the status of the stack by GetHWIO_e_StackProtSt Hwio
  /***************************************************************************************************************/
  
  snprintf( chActionText, elCount(chActionText), "Set Breakpoint in MEMPROT_HWIO_Run_StackOverflow_Tests\\52 before stack overflow condition"); 
  snprintf( chExpectedText, elCount(chExpectedText), "verify is Breakpoint Set MEMPROT_HWIO_Run_StackOverflow_Tests\\52  before stack overflow condition"); 
  TestStepAddActionExpected( chActionText, chExpectedText );
  A_DBGR_BreakpointSet("MEMPROT_HWIO_Run_StackOverflow_Tests\\52");
  /***************************************************************************************************************/    
                                              // Test Step4 Reading  the fault information variable(Before_fault)
  /***************************************************************************************************************/
  snprintf( chActionText, elCount(chActionText), "Read the Before_fault variable value equal to 0"); 
  snprintf( chExpectedText, elCount(chExpectedText), "verify Before_fault variable value equal to 0");
  TestStepAddActionExpected( chActionText, chExpectedText );
  E_DBGR_VariableCheck("Before_fault",0,Equal);
  }
testcase To_verify_the_STACK_PROTECTION_STATUS_should_reset_0_STACK_NO_ERROR_whenever_stack_underflow_condition_gets_detected_for_Core_0() 
{
  /***************************************************************************************************************/    
                                              // Test Case Info
  /***************************************************************************************************************/
  setWriteDbgLevel(DebugOff);
  snprintf( chTestTitle, elCount(chTestTitle), "To_verify_the_software_shall_report_the_status_of_the_Stack_overflow_condition_for_Core_0" );
  snprintf( chTestDescription, elCount(chTestDescription), "Purpose:To_verify_the_software_shall_report_the_status_of_the_Stack_overflow_condition_for_Core_0");
  TestCaseAddInfo( chTestTitle, "TC_L30SW_Q-36623750", chTestDescription );
  
  /***************************************************************************************************************/    
                                              // Start of Test Case
  /***************************************************************************************************************/
  
  /***************************************************************************************************************/    
                                              // Test Step 0 PRECONDITIONS
  /***************************************************************************************************************/
  snprintf( chActionText, elCount(chActionText), "Flash the Software and ECU is running "); 
  snprintf( chExpectedText, elCount(chExpectedText), "Ecu is should be in running state"); 
  TestStepAddActionExpected( chActionText, chExpectedText );
  A_DBGR_BreakpointDeleteAll();
  A_DBGR_R();

  /***************************************************************************************************************/    
                                              // Test Step 1 Add the break point_1 at core_ID 
  /***************************************************************************************************************/
  snprintf( chActionText, elCount(chActionText), "Set Breakpoint in  MEMPROT_HWIO_Run_StackUnderflow_Tests\\6 Function call side"); 
  snprintf( chExpectedText, elCount(chExpectedText), "verify is Breakpoint Set  MEMPROT_HWIO_Run_StackUnderflow_Tests\\6 in Function call side"); 
  A_DBGR_BreakpointSet(" MEMPROT_HWIO_Run_StackUnderflow_Tests\\6");  
  A_DBGR_Go();
  
  snprintf( chActionText, elCount(chActionText), "verify Breakpoint should hit in  MEMPROT_HWIO_Run_StackUnderflow_Tests\\6"); 
  snprintf( chExpectedText, elCount(chExpectedText), "Breakpoint hit in  MEMPROT_HWIO_Run_StackUnderflow_Tests\\6 function"); 
  E_DBGR_BreakpointCheckForHalt(" MEMPROT_HWIO_Run_StackUnderflow_Tests\\6");
  /***************************************************************************************************************/    
                                              // Test Step2 Read the coreID value 
  /***************************************************************************************************************/
  snprintf( chActionText, elCount(chActionText), "Set the Coreid variable value to 0"); 
  snprintf( chExpectedText, elCount(chExpectedText), "verify Coreid variable value to 0");
  TestStepAddActionExpected( chActionText, chExpectedText );
  E_DBGR_VariableCheck("Coreid",0,Equal);
  /***************************************************************************************************************/    
                                              // Test Step3 Keeping break point at stack overflow condition 
  /***************************************************************************************************************/
  
  snprintf( chActionText, elCount(chActionText), "Set Breakpoint in  MEMPROT_HWIO_Run_StackUnderflow_Tests\\57+0x2 stack overflow condition"); 
  snprintf( chExpectedText, elCount(chExpectedText), "verify is Breakpoint Set  MEMPROT_HWIO_Run_StackUnderflow_Tests\\57+0x2  stack overflow condition"); 
  TestStepAddActionExpected( chActionText, chExpectedText );
  A_DBGR_BreakpointSet(" MEMPROT_HWIO_Run_StackUnderflow_Tests\\57+0x2");
  A_DBGR_Go();
  snprintf( chActionText, elCount(chActionText), "setting the Breakpoint at  MEMPROT_HWIO_Run_StackUnderflow_Tests\\57+0x2"); 
  snprintf( chExpectedText, elCount(chExpectedText), "Verify Breakpoint hit in  MEMPROT_HWIO_Run_StackUnderflow_Tests\\57+0x2"); 
  E_DBGR_BreakpointCheckForHalt(" MEMPROT_HWIO_Run_StackUnderflow_Tests\\57+0x2");
  snprintf( chActionText, elCount(chActionText), "Verify breakpoint reached at  MEMPROT_HWIO_Run_StackUnderflow_Tests\\57+0x2"); 
  snprintf( chExpectedText, elCount(chExpectedText), "Breakpoint reached at  MEMPROT_HWIO_Run_StackUnderflow_Tests\\57+0x2");
  TestStepAddActionExpected( chActionText, chExpectedText );
  A_DBGR_Go();
  E_DBGR_CheckState(T32_State_Stopped);
  /***************************************************************************************************************/    
                                              // Test Step4 Reading  the fault information data
  /***************************************************************************************************************/
  snprintf( chActionText, elCount(chActionText), "Read the bWPAccessError_Happened variable value equal to 1"); 
  snprintf( chExpectedText, elCount(chExpectedText), "verify bWPAccessError_Happened variable value equal to 1");
  TestStepAddActionExpected( chActionText, chExpectedText );
  E_DBGR_VariableCheck("ME_App_Tc4xMemProt_ContxRam_Core0.TC4XMEMPROT_APP_StackOverflow_ACCESS_ERROR_data.bWPAccessError_Happened",1,Equal);
  snprintf( chActionText, elCount(chActionText), "Read the u32WPAccessError_Address variable address equal to 1879257599"); 
  snprintf( chExpectedText, elCount(chExpectedText), "verify u32WPAccessError_Address variable address equal to 1879257599");
  TestStepAddActionExpected( chActionText, chExpectedText );
  E_DBGR_VariableCheck("ME_App_Tc4xMemProt_ContxRam_Core0.TC4XMEMPROT_APP_StackOverflow_ACCESS_ERROR_data.u32WPAccessError_Address",1879257599,Equal);
  snprintf( chActionText, elCount(chActionText), "Read the u32WPAccessError_InstructionAddress variable value is equal to  to 2156150008"); 
  snprintf( chExpectedText, elCount(chExpectedText), "verify u32WPAccessError_InstructionAddress variable value is equal to 2156150008");
  TestStepAddActionExpected( chActionText, chExpectedText );
  E_DBGR_VariableCheck("ME_App_Tc4xMemProt_ContxRam_Core0.TC4XMEMPROT_APP_StackOverflow_ACCESS_ERROR_data.u32WPAccessError_InstructionAddress",2156150008,Equal);
   /***************************************************************************************************************/    
                                              // Test Step5 Reading the STACK_PROTECTION_STATUS After reset
  /***************************************************************************************************************/
 
  snprintf( chActionText, elCount(chActionText), "Set Breakpoint in MEMPROT_HWIO_Run_StackOverflow_Tests\\52 Reading the STACK_PROTECTION_STATUS After reset condition"); 
  snprintf( chExpectedText, elCount(chExpectedText), "verify is Breakpoint Set MEMPROT_HWIO_Run_StackOverflow_Tests\\52  Reading the STACK_PROTECTION_STATUS After reset condition"); 
  TestStepAddActionExpected( chActionText, chExpectedText );
  A_DBGR_BreakpointSet("MEMPROT_HWIO_Run_StackOverflow_Tests\\52");
  A_DBGR_Go();
  A_DBGR_Go();
  snprintf( chActionText, elCount(chActionText), "Set the Before_clear_fault_status  variable value to 1"); 
  snprintf( chExpectedText, elCount(chExpectedText), "verify Before_clear_fault_status variable value to 1");
  E_DBGR_VariableCheck("Before_clear_fault_status",1,Equal);
  snprintf( chActionText, elCount(chActionText), "Set Breakpoint in MEMPROT_HWIO_Run_StackOverflow_Tests\\53 Reading the STACK_PROTECTION_STATUS After reset condition"); 
  snprintf( chExpectedText, elCount(chExpectedText), "verify is Breakpoint Set MEMPROT_HWIO_Run_StackOverflow_Tests\\53  Reading the STACK_PROTECTION_STATUS After reset condition"); 
  TestStepAddActionExpected( chActionText, chExpectedText );
  A_DBGR_BreakpointSet("MEMPROT_HWIO_Run_StackOverflow_Tests\\53");
  A_DBGR_Go();
  snprintf( chActionText, elCount(chActionText), "Set the After_clear_fault_status  variable value to 0"); 
  snprintf( chExpectedText, elCount(chExpectedText), "verify After_clear_fault_status variable value to 0");
  E_DBGR_VariableCheck("After_clear_fault_status",0,Equal);
  
}
testcase To_verify_the_STACK_PROTECTION_STATUS_should_reset_0_STACK_NO_ERROR_whenever_stack_overflow_condition_gets_detected_for_Core_0() 
{
  /***************************************************************************************************************/    
                                              // Test Case Info
  /***************************************************************************************************************/
  setWriteDbgLevel(DebugOff);
  snprintf( chTestTitle, elCount(chTestTitle), "To_verify_the_software_shall_report_the_status_of_the_Stack_overflow_condition_for_Core_0" );
  snprintf( chTestDescription, elCount(chTestDescription), "Purpose:To_verify_the_software_shall_report_the_status_of_the_Stack_overflow_condition_for_Core_0");
  TestCaseAddInfo( chTestTitle, "TC_L30SW_Q-36623750", chTestDescription );
  
  /***************************************************************************************************************/    
                                              // Start of Test Case
  /***************************************************************************************************************/
  
  /***************************************************************************************************************/    
                                              // Test Step 0 PRECONDITIONS
  /***************************************************************************************************************/
  snprintf( chActionText, elCount(chActionText), "Flash the Software and ECU is running "); 
  snprintf( chExpectedText, elCount(chExpectedText), "Ecu is should be in running state"); 
  TestStepAddActionExpected( chActionText, chExpectedText );
  A_DBGR_BreakpointDeleteAll();
  A_DBGR_R();

  /***************************************************************************************************************/    
                                              // Test Step 1 Add the break point_1 at core_ID 
  /***************************************************************************************************************/
  snprintf( chActionText, elCount(chActionText), "Set Breakpoint in MEMPROT_HWIO_Run_StackOverflow_Tests\\6 Function call side"); 
  snprintf( chExpectedText, elCount(chExpectedText), "verify is Breakpoint Set MEMPROT_HWIO_Run_StackOverflow_Tests\\6 in Function call side"); 
  A_DBGR_BreakpointSet("MEMPROT_HWIO_Run_StackOverflow_Tests\\6");  
  A_DBGR_Go();
  
  snprintf( chActionText, elCount(chActionText), "verify Breakpoint should hit in MEMPROT_HWIO_Run_StackOverflow_Tests\\6"); 
  snprintf( chExpectedText, elCount(chExpectedText), "Breakpoint hit in MEMPROT_HWIO_Run_StackOverflow_Tests\\6 function"); 
  E_DBGR_BreakpointCheckForHalt("MEMPROT_HWIO_Run_StackOverflow_Tests\\6");
  /***************************************************************************************************************/    
                                              // Test Step2 Read the coreID value 
  /***************************************************************************************************************/
  snprintf( chActionText, elCount(chActionText), "Set the Coreid variable value to 0"); 
  snprintf( chExpectedText, elCount(chExpectedText), "verify Coreid variable value to 0");
  TestStepAddActionExpected( chActionText, chExpectedText );
  E_DBGR_VariableCheck("Coreid",0,Equal);
  /***************************************************************************************************************/    
                                              // Test Step3 Keeping break point at stack overflow condition 
  /***************************************************************************************************************/
  
  snprintf( chActionText, elCount(chActionText), "Set Breakpoint in MEMPROT_HWIO_Run_StackOverflow_Tests\\57+0x2 stack overflow condition"); 
  snprintf( chExpectedText, elCount(chExpectedText), "verify is Breakpoint Set MEMPROT_HWIO_Run_StackOverflow_Tests\\57+0x2  stack overflow condition"); 
  TestStepAddActionExpected( chActionText, chExpectedText );
  A_DBGR_BreakpointSet("MEMPROT_HWIO_Run_StackOverflow_Tests\\57+0x2");
  A_DBGR_Go();
  snprintf( chActionText, elCount(chActionText), "setting the Breakpoint at MEMPROT_HWIO_Run_StackOverflow_Tests\\57+0x2"); 
  snprintf( chExpectedText, elCount(chExpectedText), "Verify Breakpoint hit in MEMPROT_HWIO_Run_StackOverflow_Tests\\57+0x2"); 
  E_DBGR_BreakpointCheckForHalt("MEMPROT_HWIO_Run_StackOverflow_Tests\\57+0x2");
  snprintf( chActionText, elCount(chActionText), "Verify breakpoint reached at MEMPROT_HWIO_Run_StackOverflow_Tests\\57+0x2"); 
  snprintf( chExpectedText, elCount(chExpectedText), "Breakpoint reached at MEMPROT_HWIO_Run_StackOverflow_Tests\\57+0x2");
  TestStepAddActionExpected( chActionText, chExpectedText );
  A_DBGR_Go();
  E_DBGR_CheckState(T32_State_Stopped);
  /***************************************************************************************************************/    
                                              // Test Step4 Reading  the fault information data
  /***************************************************************************************************************/
  snprintf( chActionText, elCount(chActionText), "Read the bWPAccessError_Happened variable value equal to 1"); 
  snprintf( chExpectedText, elCount(chExpectedText), "verify bWPAccessError_Happened variable value equal to 1");
  TestStepAddActionExpected( chActionText, chExpectedText );
  E_DBGR_VariableCheck("ME_App_Tc4xMemProt_ContxRam_Core0.TC4XMEMPROT_APP_StackOverflow_ACCESS_ERROR_data.bWPAccessError_Happened",1,Equal);
  snprintf( chActionText, elCount(chActionText), "Read the u32WPAccessError_Address variable address equal to 1879257599"); 
  snprintf( chExpectedText, elCount(chExpectedText), "verify u32WPAccessError_Address variable address equal to 1879257599");
  TestStepAddActionExpected( chActionText, chExpectedText );
  E_DBGR_VariableCheck("ME_App_Tc4xMemProt_ContxRam_Core0.TC4XMEMPROT_APP_StackOverflow_ACCESS_ERROR_data.u32WPAccessError_Address",1879257599,Equal);
  snprintf( chActionText, elCount(chActionText), "Read the u32WPAccessError_InstructionAddress variable value is equal to  to 2156150008"); 
  snprintf( chExpectedText, elCount(chExpectedText), "verify u32WPAccessError_InstructionAddress variable value is equal to 2156150008");
  TestStepAddActionExpected( chActionText, chExpectedText );
  E_DBGR_VariableCheck("ME_App_Tc4xMemProt_ContxRam_Core0.TC4XMEMPROT_APP_StackOverflow_ACCESS_ERROR_data.u32WPAccessError_InstructionAddress",2156150008,Equal);
   /***************************************************************************************************************/    
                                              // Test Step5 Reading the STACK_PROTECTION_STATUS After reset
  /***************************************************************************************************************/
 
  snprintf( chActionText, elCount(chActionText), "Set Breakpoint in MEMPROT_HWIO_Run_StackOverflow_Tests\\52 Reading the STACK_PROTECTION_STATUS After reset condition"); 
  snprintf( chExpectedText, elCount(chExpectedText), "verify is Breakpoint Set MEMPROT_HWIO_Run_StackOverflow_Tests\\52  Reading the STACK_PROTECTION_STATUS After reset condition"); 
  TestStepAddActionExpected( chActionText, chExpectedText );
  A_DBGR_BreakpointSet("MEMPROT_HWIO_Run_StackOverflow_Tests\\52");
  A_DBGR_Go();
  A_DBGR_Go();
  snprintf( chActionText, elCount(chActionText), "Set the Before_clear_fault_status  variable value to 1"); 
  snprintf( chExpectedText, elCount(chExpectedText), "verify Before_clear_fault_status variable value to 1");
  E_DBGR_VariableCheck("Before_clear_fault_status",1,Equal);
  snprintf( chActionText, elCount(chActionText), "Set Breakpoint in MEMPROT_HWIO_Run_StackOverflow_Tests\\53 Reading the STACK_PROTECTION_STATUS After reset condition"); 
  snprintf( chExpectedText, elCount(chExpectedText), "verify is Breakpoint Set MEMPROT_HWIO_Run_StackOverflow_Tests\\53  Reading the STACK_PROTECTION_STATUS After reset condition"); 
  TestStepAddActionExpected( chActionText, chExpectedText );
  A_DBGR_BreakpointSet("MEMPROT_HWIO_Run_StackOverflow_Tests\\53");
  A_DBGR_Go();
  snprintf( chActionText, elCount(chActionText), "Set the After_clear_fault_status  variable value to 0"); 
  snprintf( chExpectedText, elCount(chExpectedText), "verify After_clear_fault_status variable value to 0");
  E_DBGR_VariableCheck("After_clear_fault_status",0,Equal);
  
}
testcase To_verify_the_STACK_PROTECTION_STATUS_should_reset_0_STACK_NO_ERROR_whenever_stack_overflow_condition_gets_detected_for_Core_1() 
{
  /***************************************************************************************************************/    
                                              // Test Case Info
  /***************************************************************************************************************/
  setWriteDbgLevel(DebugOff);
  snprintf( chTestTitle, elCount(chTestTitle), "To_verify_the_software_shall_report_the_status_of_the_Stack_overflow_condition_for_Core_0" );
  snprintf( chTestDescription, elCount(chTestDescription), "Purpose:To_verify_the_software_shall_report_the_status_of_the_Stack_overflow_condition_for_Core_0");
  TestCaseAddInfo( chTestTitle, "TC_L30SW_Q-36623750", chTestDescription );
  
  /***************************************************************************************************************/    
                                              // Start of Test Case
  /***************************************************************************************************************/
  
  /***************************************************************************************************************/    
                                              // Test Step 0 PRECONDITIONS
  /***************************************************************************************************************/
  snprintf( chActionText, elCount(chActionText), "Flash the Software and ECU is running "); 
  snprintf( chExpectedText, elCount(chExpectedText), "Ecu is should be in running state"); 
  TestStepAddActionExpected( chActionText, chExpectedText );
  A_DBGR_BreakpointDeleteAll();
  A_DBGR_R();

  /***************************************************************************************************************/    
                                              // Test Step 1 Add the break point_1 at core_ID 
  /***************************************************************************************************************/
  snprintf( chActionText, elCount(chActionText), "Set Breakpoint in MEMPROT_HWIO_Run_StackOverflow_Tests\\6 Function call side"); 
  snprintf( chExpectedText, elCount(chExpectedText), "verify is Breakpoint Set MEMPROT_HWIO_Run_StackOverflow_Tests\\6 in Function call side"); 
  A_DBGR_BreakpointSet("MEMPROT_HWIO_Run_StackOverflow_Tests\\6");  
  A_DBGR_Go();
  
  snprintf( chActionText, elCount(chActionText), "verify Breakpoint should hit in MEMPROT_HWIO_Run_StackOverflow_Tests\\6"); 
  snprintf( chExpectedText, elCount(chExpectedText), "Breakpoint hit in MEMPROT_HWIO_Run_StackOverflow_Tests\\6 function"); 
  E_DBGR_BreakpointCheckForHalt("MEMPROT_HWIO_Run_StackOverflow_Tests\\6");
  /***************************************************************************************************************/    
                                              // Test Step2 Read the coreID value 
  /***************************************************************************************************************/
  snprintf( chActionText, elCount(chActionText), "Set the Coreid variable value to 1"); 
  snprintf( chExpectedText, elCount(chExpectedText), "verify Coreid variable value to 1");
  TestStepAddActionExpected( chActionText, chExpectedText );
  E_DBGR_VariableCheck("Coreid",1,Equal);
  /***************************************************************************************************************/    
                                              // Test Step3 Keeping break point at stack overflow condition 
  /***************************************************************************************************************/
  
  snprintf( chActionText, elCount(chActionText), "Set Breakpoint in MEMPROT_HWIO_Run_StackOverflow_Tests\\57+0x2 stack overflow condition"); 
  snprintf( chExpectedText, elCount(chExpectedText), "verify is Breakpoint Set MEMPROT_HWIO_Run_StackOverflow_Tests\\57+0x2  stack overflow condition"); 
  TestStepAddActionExpected( chActionText, chExpectedText );
  A_DBGR_BreakpointSet("MEMPROT_HWIO_Run_StackOverflow_Tests\\57+0x2");
  A_DBGR_Go();
  snprintf( chActionText, elCount(chActionText), "setting the Breakpoint at MEMPROT_HWIO_Run_StackOverflow_Tests\\57+0x2"); 
  snprintf( chExpectedText, elCount(chExpectedText), "Verify Breakpoint hit in MEMPROT_HWIO_Run_StackOverflow_Tests\\57+0x2"); 
  E_DBGR_BreakpointCheckForHalt("MEMPROT_HWIO_Run_StackOverflow_Tests\\57+0x2");
  snprintf( chActionText, elCount(chActionText), "Verify breakpoint reached at MEMPROT_HWIO_Run_StackOverflow_Tests\\57+0x2"); 
  snprintf( chExpectedText, elCount(chExpectedText), "Breakpoint reached at MEMPROT_HWIO_Run_StackOverflow_Tests\\57+0x2");
  TestStepAddActionExpected( chActionText, chExpectedText );
  A_DBGR_Go();
  E_DBGR_CheckState(T32_State_Stopped);
  /***************************************************************************************************************/    
                                              // Test Step4 Reading  the fault information data
  /***************************************************************************************************************/
  snprintf( chActionText, elCount(chActionText), "Read the bWPAccessError_Happened variable value equal to 1"); 
  snprintf( chExpectedText, elCount(chExpectedText), "verify bWPAccessError_Happened variable value equal to 1");
  TestStepAddActionExpected( chActionText, chExpectedText );
  E_DBGR_VariableCheck("ME_App_Tc4xMemProt_ContxRam_Core0.TC4XMEMPROT_APP_StackOverflow_ACCESS_ERROR_data.bWPAccessError_Happened",1,Equal);
  snprintf( chActionText, elCount(chActionText), "Read the u32WPAccessError_Address variable address equal to 1879257599"); 
  snprintf( chExpectedText, elCount(chExpectedText), "verify u32WPAccessError_Address variable address equal to 1879257599");
  TestStepAddActionExpected( chActionText, chExpectedText );
  E_DBGR_VariableCheck("ME_App_Tc4xMemProt_ContxRam_Core0.TC4XMEMPROT_APP_StackOverflow_ACCESS_ERROR_data.u32WPAccessError_Address",1879257599,Equal);
  snprintf( chActionText, elCount(chActionText), "Read the u32WPAccessError_InstructionAddress variable value is equal to  to 2156150008"); 
  snprintf( chExpectedText, elCount(chExpectedText), "verify u32WPAccessError_InstructionAddress variable value is equal to 2156150008");
  TestStepAddActionExpected( chActionText, chExpectedText );
  E_DBGR_VariableCheck("ME_App_Tc4xMemProt_ContxRam_Core0.TC4XMEMPROT_APP_StackOverflow_ACCESS_ERROR_data.u32WPAccessError_InstructionAddress",2156150008,Equal);
   /***************************************************************************************************************/    
                                              // Test Step5 Reading the STACK_PROTECTION_STATUS After reset
  /***************************************************************************************************************/
 
  snprintf( chActionText, elCount(chActionText), "Set Breakpoint in MEMPROT_HWIO_Run_StackOverflow_Tests\\52 Reading the STACK_PROTECTION_STATUS After reset condition"); 
  snprintf( chExpectedText, elCount(chExpectedText), "verify is Breakpoint Set MEMPROT_HWIO_Run_StackOverflow_Tests\\52  Reading the STACK_PROTECTION_STATUS After reset condition"); 
  TestStepAddActionExpected( chActionText, chExpectedText );
  A_DBGR_BreakpointSet("MEMPROT_HWIO_Run_StackOverflow_Tests\\52");
  A_DBGR_Go();
  A_DBGR_Go();
  snprintf( chActionText, elCount(chActionText), "Set the Before_clear_fault_status  variable value to 1"); 
  snprintf( chExpectedText, elCount(chExpectedText), "verify Before_clear_fault_status variable value to 1");
  E_DBGR_VariableCheck("Before_clear_fault_status",1,Equal);
  snprintf( chActionText, elCount(chActionText), "Set Breakpoint in MEMPROT_HWIO_Run_StackOverflow_Tests\\53 Reading the STACK_PROTECTION_STATUS After reset condition"); 
  snprintf( chExpectedText, elCount(chExpectedText), "verify is Breakpoint Set MEMPROT_HWIO_Run_StackOverflow_Tests\\53  Reading the STACK_PROTECTION_STATUS After reset condition"); 
  TestStepAddActionExpected( chActionText, chExpectedText );
  A_DBGR_BreakpointSet("MEMPROT_HWIO_Run_StackOverflow_Tests\\53");
  A_DBGR_Go();
  snprintf( chActionText, elCount(chActionText), "Set the After_clear_fault_status  variable value to 0"); 
  snprintf( chExpectedText, elCount(chExpectedText), "verify After_clear_fault_status variable value to 0");
  E_DBGR_VariableCheck("After_clear_fault_status",0,Equal);
  
}
testcase To_verify_the_STACK_PROTECTION_STATUS_should_reset_0_STACK_NO_ERROR_whenever_stack_overflow_condition_gets_detected_for_Core_2() 
{
  /***************************************************************************************************************/    
                                              // Test Case Info
  /***************************************************************************************************************/
  setWriteDbgLevel(DebugOff);
  snprintf( chTestTitle, elCount(chTestTitle), "To_verify_the_software_shall_report_the_status_of_the_Stack_overflow_condition_for_Core_0" );
  snprintf( chTestDescription, elCount(chTestDescription), "Purpose:To_verify_the_software_shall_report_the_status_of_the_Stack_overflow_condition_for_Core_0");
  TestCaseAddInfo( chTestTitle, "TC_L30SW_Q-36623750", chTestDescription );
  
  /***************************************************************************************************************/    
                                              // Start of Test Case
  /***************************************************************************************************************/
  
  /***************************************************************************************************************/    
                                              // Test Step 0 PRECONDITIONS
  /***************************************************************************************************************/
  snprintf( chActionText, elCount(chActionText), "Flash the Software and ECU is running "); 
  snprintf( chExpectedText, elCount(chExpectedText), "Ecu is should be in running state"); 
  TestStepAddActionExpected( chActionText, chExpectedText );
  A_DBGR_BreakpointDeleteAll();
  A_DBGR_R();

  /***************************************************************************************************************/    
                                              // Test Step 1 Add the break point_1 at core_ID 
  /***************************************************************************************************************/
  snprintf( chActionText, elCount(chActionText), "Set Breakpoint in MEMPROT_HWIO_Run_StackOverflow_Tests\\6 Function call side"); 
  snprintf( chExpectedText, elCount(chExpectedText), "verify is Breakpoint Set MEMPROT_HWIO_Run_StackOverflow_Tests\\6 in Function call side"); 
  A_DBGR_BreakpointSet("MEMPROT_HWIO_Run_StackOverflow_Tests\\6");  
  A_DBGR_Go();
  
  snprintf( chActionText, elCount(chActionText), "verify Breakpoint should hit in MEMPROT_HWIO_Run_StackOverflow_Tests\\6"); 
  snprintf( chExpectedText, elCount(chExpectedText), "Breakpoint hit in MEMPROT_HWIO_Run_StackOverflow_Tests\\6 function"); 
  E_DBGR_BreakpointCheckForHalt("MEMPROT_HWIO_Run_StackOverflow_Tests\\6");
  /***************************************************************************************************************/    
                                              // Test Step2 Read the coreID value 
  /***************************************************************************************************************/
  snprintf( chActionText, elCount(chActionText), "Set the Coreid variable value to 1"); 
  snprintf( chExpectedText, elCount(chExpectedText), "verify Coreid variable value to 1");
  TestStepAddActionExpected( chActionText, chExpectedText );
  E_DBGR_VariableCheck("Coreid",1,Equal);
  /***************************************************************************************************************/    
                                              // Test Step3 Keeping break point at stack overflow condition 
  /***************************************************************************************************************/
  
  snprintf( chActionText, elCount(chActionText), "Set Breakpoint in MEMPROT_HWIO_Run_StackOverflow_Tests\\57+0x2 stack overflow condition"); 
  snprintf( chExpectedText, elCount(chExpectedText), "verify is Breakpoint Set MEMPROT_HWIO_Run_StackOverflow_Tests\\57+0x2  stack overflow condition"); 
  TestStepAddActionExpected( chActionText, chExpectedText );
  A_DBGR_BreakpointSet("MEMPROT_HWIO_Run_StackOverflow_Tests\\57+0x2");
  A_DBGR_Go();
  snprintf( chActionText, elCount(chActionText), "setting the Breakpoint at MEMPROT_HWIO_Run_StackOverflow_Tests\\57+0x2"); 
  snprintf( chExpectedText, elCount(chExpectedText), "Verify Breakpoint hit in MEMPROT_HWIO_Run_StackOverflow_Tests\\57+0x2"); 
  E_DBGR_BreakpointCheckForHalt("MEMPROT_HWIO_Run_StackOverflow_Tests\\57+0x2");
  snprintf( chActionText, elCount(chActionText), "Verify breakpoint reached at MEMPROT_HWIO_Run_StackOverflow_Tests\\57+0x2"); 
  snprintf( chExpectedText, elCount(chExpectedText), "Breakpoint reached at MEMPROT_HWIO_Run_StackOverflow_Tests\\57+0x2");
  TestStepAddActionExpected( chActionText, chExpectedText );
  A_DBGR_Go();
  E_DBGR_CheckState(T32_State_Stopped);
  /***************************************************************************************************************/    
                                              // Test Step4 Reading  the fault information data
  /***************************************************************************************************************/
  snprintf( chActionText, elCount(chActionText), "Read the bWPAccessError_Happened variable value equal to 1"); 
  snprintf( chExpectedText, elCount(chExpectedText), "verify bWPAccessError_Happened variable value equal to 1");
  TestStepAddActionExpected( chActionText, chExpectedText );
  E_DBGR_VariableCheck("ME_App_Tc4xMemProt_ContxRam_Core0.TC4XMEMPROT_APP_StackOverflow_ACCESS_ERROR_data.bWPAccessError_Happened",1,Equal);
  snprintf( chActionText, elCount(chActionText), "Read the u32WPAccessError_Address variable address equal to 1879257599"); 
  snprintf( chExpectedText, elCount(chExpectedText), "verify u32WPAccessError_Address variable address equal to 1879257599");
  TestStepAddActionExpected( chActionText, chExpectedText );
  E_DBGR_VariableCheck("ME_App_Tc4xMemProt_ContxRam_Core0.TC4XMEMPROT_APP_StackOverflow_ACCESS_ERROR_data.u32WPAccessError_Address",1879257599,Equal);
  snprintf( chActionText, elCount(chActionText), "Read the u32WPAccessError_InstructionAddress variable value is equal to  to 2156150008"); 
  snprintf( chExpectedText, elCount(chExpectedText), "verify u32WPAccessError_InstructionAddress variable value is equal to 2156150008");
  TestStepAddActionExpected( chActionText, chExpectedText );
  E_DBGR_VariableCheck("ME_App_Tc4xMemProt_ContxRam_Core0.TC4XMEMPROT_APP_StackOverflow_ACCESS_ERROR_data.u32WPAccessError_InstructionAddress",2156150008,Equal);
   /***************************************************************************************************************/    
                                              // Test Step5 Reading the STACK_PROTECTION_STATUS After reset
  /***************************************************************************************************************/
 
  snprintf( chActionText, elCount(chActionText), "Set Breakpoint in MEMPROT_HWIO_Run_StackOverflow_Tests\\52 Reading the STACK_PROTECTION_STATUS After reset condition"); 
  snprintf( chExpectedText, elCount(chExpectedText), "verify is Breakpoint Set MEMPROT_HWIO_Run_StackOverflow_Tests\\52  Reading the STACK_PROTECTION_STATUS After reset condition"); 
  TestStepAddActionExpected( chActionText, chExpectedText );
  A_DBGR_BreakpointSet("MEMPROT_HWIO_Run_StackOverflow_Tests\\52");
  A_DBGR_Go();
  A_DBGR_Go();
  snprintf( chActionText, elCount(chActionText), "Set the Before_clear_fault_status  variable value to 1"); 
  snprintf( chExpectedText, elCount(chExpectedText), "verify Before_clear_fault_status variable value to 1");
  E_DBGR_VariableCheck("Before_clear_fault_status",1,Equal);
  snprintf( chActionText, elCount(chActionText), "Set Breakpoint in MEMPROT_HWIO_Run_StackOverflow_Tests\\53 Reading the STACK_PROTECTION_STATUS After reset condition"); 
  snprintf( chExpectedText, elCount(chExpectedText), "verify is Breakpoint Set MEMPROT_HWIO_Run_StackOverflow_Tests\\53  Reading the STACK_PROTECTION_STATUS After reset condition"); 
  TestStepAddActionExpected( chActionText, chExpectedText );
  A_DBGR_BreakpointSet("MEMPROT_HWIO_Run_StackOverflow_Tests\\53");
  A_DBGR_Go();
  snprintf( chActionText, elCount(chActionText), "Set the After_clear_fault_status  variable value to 0"); 
  snprintf( chExpectedText, elCount(chExpectedText), "verify After_clear_fault_status variable value to 0");
  E_DBGR_VariableCheck("After_clear_fault_status",0,Equal);
  
}
testcase To_verify_the_STACK_PROTECTION_STATUS_should_reset_0_STACK_NO_ERROR_whenever_stack_overflow_condition_gets_detected_for_Core_3() 
{
  /***************************************************************************************************************/    
                                              // Test Case Info
  /***************************************************************************************************************/
  setWriteDbgLevel(DebugOff);
  snprintf( chTestTitle, elCount(chTestTitle), "To_verify_the_software_shall_report_the_status_of_the_Stack_overflow_condition_for_Core_0" );
  snprintf( chTestDescription, elCount(chTestDescription), "Purpose:To_verify_the_software_shall_report_the_status_of_the_Stack_overflow_condition_for_Core_0");
  TestCaseAddInfo( chTestTitle, "TC_L30SW_Q-36623750", chTestDescription );
  
  /***************************************************************************************************************/    
                                              // Start of Test Case
  /***************************************************************************************************************/
  
  /***************************************************************************************************************/    
                                              // Test Step 0 PRECONDITIONS
  /***************************************************************************************************************/
  snprintf( chActionText, elCount(chActionText), "Flash the Software and ECU is running "); 
  snprintf( chExpectedText, elCount(chExpectedText), "Ecu is should be in running state"); 
  TestStepAddActionExpected( chActionText, chExpectedText );
  A_DBGR_BreakpointDeleteAll();
  A_DBGR_R();

  /***************************************************************************************************************/    
                                              // Test Step 1 Add the break point_1 at core_ID 
  /***************************************************************************************************************/
  snprintf( chActionText, elCount(chActionText), "Set Breakpoint in MEMPROT_HWIO_Run_StackOverflow_Tests\\6 Function call side"); 
  snprintf( chExpectedText, elCount(chExpectedText), "verify is Breakpoint Set MEMPROT_HWIO_Run_StackOverflow_Tests\\6 in Function call side"); 
  A_DBGR_BreakpointSet("MEMPROT_HWIO_Run_StackOverflow_Tests\\6");  
  A_DBGR_Go();
  
  snprintf( chActionText, elCount(chActionText), "verify Breakpoint should hit in MEMPROT_HWIO_Run_StackOverflow_Tests\\6"); 
  snprintf( chExpectedText, elCount(chExpectedText), "Breakpoint hit in MEMPROT_HWIO_Run_StackOverflow_Tests\\6 function"); 
  E_DBGR_BreakpointCheckForHalt("MEMPROT_HWIO_Run_StackOverflow_Tests\\6");
  /***************************************************************************************************************/    
                                              // Test Step2 Read the coreID value 
  /***************************************************************************************************************/
  snprintf( chActionText, elCount(chActionText), "Set the Coreid variable value to 1"); 
  snprintf( chExpectedText, elCount(chExpectedText), "verify Coreid variable value to 1");
  TestStepAddActionExpected( chActionText, chExpectedText );
  E_DBGR_VariableCheck("Coreid",1,Equal);
  /***************************************************************************************************************/    
                                              // Test Step3 Keeping break point at stack overflow condition 
  /***************************************************************************************************************/
  
  snprintf( chActionText, elCount(chActionText), "Set Breakpoint in MEMPROT_HWIO_Run_StackOverflow_Tests\\57+0x2 stack overflow condition"); 
  snprintf( chExpectedText, elCount(chExpectedText), "verify is Breakpoint Set MEMPROT_HWIO_Run_StackOverflow_Tests\\57+0x2  stack overflow condition"); 
  TestStepAddActionExpected( chActionText, chExpectedText );
  A_DBGR_BreakpointSet("MEMPROT_HWIO_Run_StackOverflow_Tests\\57+0x2");
  A_DBGR_Go();
  snprintf( chActionText, elCount(chActionText), "setting the Breakpoint at MEMPROT_HWIO_Run_StackOverflow_Tests\\57+0x2"); 
  snprintf( chExpectedText, elCount(chExpectedText), "Verify Breakpoint hit in MEMPROT_HWIO_Run_StackOverflow_Tests\\57+0x2"); 
  E_DBGR_BreakpointCheckForHalt("MEMPROT_HWIO_Run_StackOverflow_Tests\\57+0x2");
  snprintf( chActionText, elCount(chActionText), "Verify breakpoint reached at MEMPROT_HWIO_Run_StackOverflow_Tests\\57+0x2"); 
  snprintf( chExpectedText, elCount(chExpectedText), "Breakpoint reached at MEMPROT_HWIO_Run_StackOverflow_Tests\\57+0x2");
  TestStepAddActionExpected( chActionText, chExpectedText );
  A_DBGR_Go();
  E_DBGR_CheckState(T32_State_Stopped);
  /***************************************************************************************************************/    
                                              // Test Step4 Reading  the fault information data
  /***************************************************************************************************************/
  snprintf( chActionText, elCount(chActionText), "Read the bWPAccessError_Happened variable value equal to 1"); 
  snprintf( chExpectedText, elCount(chExpectedText), "verify bWPAccessError_Happened variable value equal to 1");
  TestStepAddActionExpected( chActionText, chExpectedText );
  E_DBGR_VariableCheck("ME_App_Tc4xMemProt_ContxRam_Core0.TC4XMEMPROT_APP_StackOverflow_ACCESS_ERROR_data.bWPAccessError_Happened",1,Equal);
  snprintf( chActionText, elCount(chActionText), "Read the u32WPAccessError_Address variable address equal to 1879257599"); 
  snprintf( chExpectedText, elCount(chExpectedText), "verify u32WPAccessError_Address variable address equal to 1879257599");
  TestStepAddActionExpected( chActionText, chExpectedText );
  E_DBGR_VariableCheck("ME_App_Tc4xMemProt_ContxRam_Core0.TC4XMEMPROT_APP_StackOverflow_ACCESS_ERROR_data.u32WPAccessError_Address",1879257599,Equal);
  snprintf( chActionText, elCount(chActionText), "Read the u32WPAccessError_InstructionAddress variable value is equal to  to 2156150008"); 
  snprintf( chExpectedText, elCount(chExpectedText), "verify u32WPAccessError_InstructionAddress variable value is equal to 2156150008");
  TestStepAddActionExpected( chActionText, chExpectedText );
  E_DBGR_VariableCheck("ME_App_Tc4xMemProt_ContxRam_Core0.TC4XMEMPROT_APP_StackOverflow_ACCESS_ERROR_data.u32WPAccessError_InstructionAddress",2156150008,Equal);
   /***************************************************************************************************************/    
                                              // Test Step5 Reading the STACK_PROTECTION_STATUS After reset
  /***************************************************************************************************************/
 
  snprintf( chActionText, elCount(chActionText), "Set Breakpoint in MEMPROT_HWIO_Run_StackOverflow_Tests\\52 Reading the STACK_PROTECTION_STATUS After reset condition"); 
  snprintf( chExpectedText, elCount(chExpectedText), "verify is Breakpoint Set MEMPROT_HWIO_Run_StackOverflow_Tests\\52  Reading the STACK_PROTECTION_STATUS After reset condition"); 
  TestStepAddActionExpected( chActionText, chExpectedText );
  A_DBGR_BreakpointSet("MEMPROT_HWIO_Run_StackOverflow_Tests\\52");
  A_DBGR_Go();
  A_DBGR_Go();
  snprintf( chActionText, elCount(chActionText), "Set the Before_clear_fault_status  variable value to 1"); 
  snprintf( chExpectedText, elCount(chExpectedText), "verify Before_clear_fault_status variable value to 1");
  E_DBGR_VariableCheck("Before_clear_fault_status",1,Equal);
  snprintf( chActionText, elCount(chActionText), "Set Breakpoint in MEMPROT_HWIO_Run_StackOverflow_Tests\\53 Reading the STACK_PROTECTION_STATUS After reset condition"); 
  snprintf( chExpectedText, elCount(chExpectedText), "verify is Breakpoint Set MEMPROT_HWIO_Run_StackOverflow_Tests\\53  Reading the STACK_PROTECTION_STATUS After reset condition"); 
  TestStepAddActionExpected( chActionText, chExpectedText );
  A_DBGR_BreakpointSet("MEMPROT_HWIO_Run_StackOverflow_Tests\\53");
  A_DBGR_Go();
  snprintf( chActionText, elCount(chActionText), "Set the After_clear_fault_status  variable value to 0"); 
  snprintf( chExpectedText, elCount(chExpectedText), "verify After_clear_fault_status variable value to 0");
  E_DBGR_VariableCheck("After_clear_fault_status",0,Equal);
  
}
testcase To_verify_the_STACK_PROTECTION_STATUS_should_reset_0_STACK_NO_ERROR_whenever_stack_overflow_condition_gets_detected_for_Core_4() 
{
  /***************************************************************************************************************/    
                                              // Test Case Info
  /***************************************************************************************************************/
  setWriteDbgLevel(DebugOff);
  snprintf( chTestTitle, elCount(chTestTitle), "To_verify_the_software_shall_report_the_status_of_the_Stack_overflow_condition_for_Core_0" );
  snprintf( chTestDescription, elCount(chTestDescription), "Purpose:To_verify_the_software_shall_report_the_status_of_the_Stack_overflow_condition_for_Core_0");
  TestCaseAddInfo( chTestTitle, "TC_L30SW_Q-36623750", chTestDescription );
  
  /***************************************************************************************************************/    
                                              // Start of Test Case
  /***************************************************************************************************************/
  
  /***************************************************************************************************************/    
                                              // Test Step 0 PRECONDITIONS
  /***************************************************************************************************************/
  snprintf( chActionText, elCount(chActionText), "Flash the Software and ECU is running "); 
  snprintf( chExpectedText, elCount(chExpectedText), "Ecu is should be in running state"); 
  TestStepAddActionExpected( chActionText, chExpectedText );
  A_DBGR_BreakpointDeleteAll();
  A_DBGR_R();

  /***************************************************************************************************************/    
                                              // Test Step 1 Add the break point_1 at core_ID 
  /***************************************************************************************************************/
  snprintf( chActionText, elCount(chActionText), "Set Breakpoint in MEMPROT_HWIO_Run_StackOverflow_Tests\\6 Function call side"); 
  snprintf( chExpectedText, elCount(chExpectedText), "verify is Breakpoint Set MEMPROT_HWIO_Run_StackOverflow_Tests\\6 in Function call side"); 
  A_DBGR_BreakpointSet("MEMPROT_HWIO_Run_StackOverflow_Tests\\6");  
  A_DBGR_Go();
  
  snprintf( chActionText, elCount(chActionText), "verify Breakpoint should hit in MEMPROT_HWIO_Run_StackOverflow_Tests\\6"); 
  snprintf( chExpectedText, elCount(chExpectedText), "Breakpoint hit in MEMPROT_HWIO_Run_StackOverflow_Tests\\6 function"); 
  E_DBGR_BreakpointCheckForHalt("MEMPROT_HWIO_Run_StackOverflow_Tests\\6");
  /***************************************************************************************************************/    
                                              // Test Step2 Read the coreID value 
  /***************************************************************************************************************/
  snprintf( chActionText, elCount(chActionText), "Set the Coreid variable value to 1"); 
  snprintf( chExpectedText, elCount(chExpectedText), "verify Coreid variable value to 1");
  TestStepAddActionExpected( chActionText, chExpectedText );
  E_DBGR_VariableCheck("Coreid",1,Equal);
  /***************************************************************************************************************/    
                                              // Test Step3 Keeping break point at stack overflow condition 
  /***************************************************************************************************************/
  
  snprintf( chActionText, elCount(chActionText), "Set Breakpoint in MEMPROT_HWIO_Run_StackOverflow_Tests\\57+0x2 stack overflow condition"); 
  snprintf( chExpectedText, elCount(chExpectedText), "verify is Breakpoint Set MEMPROT_HWIO_Run_StackOverflow_Tests\\57+0x2  stack overflow condition"); 
  TestStepAddActionExpected( chActionText, chExpectedText );
  A_DBGR_BreakpointSet("MEMPROT_HWIO_Run_StackOverflow_Tests\\57+0x2");
  A_DBGR_Go();
  snprintf( chActionText, elCount(chActionText), "setting the Breakpoint at MEMPROT_HWIO_Run_StackOverflow_Tests\\57+0x2"); 
  snprintf( chExpectedText, elCount(chExpectedText), "Verify Breakpoint hit in MEMPROT_HWIO_Run_StackOverflow_Tests\\57+0x2"); 
  E_DBGR_BreakpointCheckForHalt("MEMPROT_HWIO_Run_StackOverflow_Tests\\57+0x2");
  snprintf( chActionText, elCount(chActionText), "Verify breakpoint reached at MEMPROT_HWIO_Run_StackOverflow_Tests\\57+0x2"); 
  snprintf( chExpectedText, elCount(chExpectedText), "Breakpoint reached at MEMPROT_HWIO_Run_StackOverflow_Tests\\57+0x2");
  TestStepAddActionExpected( chActionText, chExpectedText );
  A_DBGR_Go();
  E_DBGR_CheckState(T32_State_Stopped);
  /***************************************************************************************************************/    
                                              // Test Step4 Reading  the fault information data
  /***************************************************************************************************************/
  snprintf( chActionText, elCount(chActionText), "Read the bWPAccessError_Happened variable value equal to 1"); 
  snprintf( chExpectedText, elCount(chExpectedText), "verify bWPAccessError_Happened variable value equal to 1");
  TestStepAddActionExpected( chActionText, chExpectedText );
  E_DBGR_VariableCheck("ME_App_Tc4xMemProt_ContxRam_Core0.TC4XMEMPROT_APP_StackOverflow_ACCESS_ERROR_data.bWPAccessError_Happened",1,Equal);
  snprintf( chActionText, elCount(chActionText), "Read the u32WPAccessError_Address variable address equal to 1879257599"); 
  snprintf( chExpectedText, elCount(chExpectedText), "verify u32WPAccessError_Address variable address equal to 1879257599");
  TestStepAddActionExpected( chActionText, chExpectedText );
  E_DBGR_VariableCheck("ME_App_Tc4xMemProt_ContxRam_Core0.TC4XMEMPROT_APP_StackOverflow_ACCESS_ERROR_data.u32WPAccessError_Address",1879257599,Equal);
  snprintf( chActionText, elCount(chActionText), "Read the u32WPAccessError_InstructionAddress variable value is equal to  to 2156150008"); 
  snprintf( chExpectedText, elCount(chExpectedText), "verify u32WPAccessError_InstructionAddress variable value is equal to 2156150008");
  TestStepAddActionExpected( chActionText, chExpectedText );
  E_DBGR_VariableCheck("ME_App_Tc4xMemProt_ContxRam_Core0.TC4XMEMPROT_APP_StackOverflow_ACCESS_ERROR_data.u32WPAccessError_InstructionAddress",2156150008,Equal);
   /***************************************************************************************************************/    
                                              // Test Step5 Reading the STACK_PROTECTION_STATUS After reset
  /***************************************************************************************************************/
 
  snprintf( chActionText, elCount(chActionText), "Set Breakpoint in MEMPROT_HWIO_Run_StackOverflow_Tests\\52 Reading the STACK_PROTECTION_STATUS After reset condition"); 
  snprintf( chExpectedText, elCount(chExpectedText), "verify is Breakpoint Set MEMPROT_HWIO_Run_StackOverflow_Tests\\52  Reading the STACK_PROTECTION_STATUS After reset condition"); 
  TestStepAddActionExpected( chActionText, chExpectedText );
  A_DBGR_BreakpointSet("MEMPROT_HWIO_Run_StackOverflow_Tests\\52");
  A_DBGR_Go();
  A_DBGR_Go();
  snprintf( chActionText, elCount(chActionText), "Set the Before_clear_fault_status  variable value to 1"); 
  snprintf( chExpectedText, elCount(chExpectedText), "verify Before_clear_fault_status variable value to 1");
  E_DBGR_VariableCheck("Before_clear_fault_status",1,Equal);
  snprintf( chActionText, elCount(chActionText), "Set Breakpoint in MEMPROT_HWIO_Run_StackOverflow_Tests\\53 Reading the STACK_PROTECTION_STATUS After reset condition"); 
  snprintf( chExpectedText, elCount(chExpectedText), "verify is Breakpoint Set MEMPROT_HWIO_Run_StackOverflow_Tests\\53  Reading the STACK_PROTECTION_STATUS After reset condition"); 
  TestStepAddActionExpected( chActionText, chExpectedText );
  A_DBGR_BreakpointSet("MEMPROT_HWIO_Run_StackOverflow_Tests\\53");
  A_DBGR_Go();
  snprintf( chActionText, elCount(chActionText), "Set the After_clear_fault_status  variable value to 0"); 
  snprintf( chExpectedText, elCount(chExpectedText), "verify After_clear_fault_status variable value to 0");
  E_DBGR_VariableCheck("After_clear_fault_status",0,Equal);
  
}
testcase To_verify_the_STACK_PROTECTION_STATUS_should_reset_0_STACK_NO_ERROR_whenever_stack_overflow_condition_gets_detected_for_Core_5() 
{
  /***************************************************************************************************************/    
                                              // Test Case Info
  /***************************************************************************************************************/
  setWriteDbgLevel(DebugOff);
  snprintf( chTestTitle, elCount(chTestTitle), "To_verify_the_software_shall_report_the_status_of_the_Stack_overflow_condition_for_Core_0" );
  snprintf( chTestDescription, elCount(chTestDescription), "Purpose:To_verify_the_software_shall_report_the_status_of_the_Stack_overflow_condition_for_Core_0");
  TestCaseAddInfo( chTestTitle, "TC_L30SW_Q-36623750", chTestDescription );
  
  /***************************************************************************************************************/    
                                              // Start of Test Case
  /***************************************************************************************************************/
  
  /***************************************************************************************************************/    
                                              // Test Step 0 PRECONDITIONS
  /***************************************************************************************************************/
  snprintf( chActionText, elCount(chActionText), "Flash the Software and ECU is running "); 
  snprintf( chExpectedText, elCount(chExpectedText), "Ecu is should be in running state"); 
  TestStepAddActionExpected( chActionText, chExpectedText );
  A_DBGR_BreakpointDeleteAll();
  A_DBGR_R();

  /***************************************************************************************************************/    
                                              // Test Step 1 Add the break point_1 at core_ID 
  /***************************************************************************************************************/
  snprintf( chActionText, elCount(chActionText), "Set Breakpoint in MEMPROT_HWIO_Run_StackOverflow_Tests\\6 Function call side"); 
  snprintf( chExpectedText, elCount(chExpectedText), "verify is Breakpoint Set MEMPROT_HWIO_Run_StackOverflow_Tests\\6 in Function call side"); 
  A_DBGR_BreakpointSet("MEMPROT_HWIO_Run_StackOverflow_Tests\\6");  
  A_DBGR_Go();
  
  snprintf( chActionText, elCount(chActionText), "verify Breakpoint should hit in MEMPROT_HWIO_Run_StackOverflow_Tests\\6"); 
  snprintf( chExpectedText, elCount(chExpectedText), "Breakpoint hit in MEMPROT_HWIO_Run_StackOverflow_Tests\\6 function"); 
  E_DBGR_BreakpointCheckForHalt("MEMPROT_HWIO_Run_StackOverflow_Tests\\6");
  /***************************************************************************************************************/    
                                              // Test Step2 Read the coreID value 
  /***************************************************************************************************************/
  snprintf( chActionText, elCount(chActionText), "Set the Coreid variable value to 1"); 
  snprintf( chExpectedText, elCount(chExpectedText), "verify Coreid variable value to 1");
  TestStepAddActionExpected( chActionText, chExpectedText );
  E_DBGR_VariableCheck("Coreid",1,Equal);
  /***************************************************************************************************************/    
                                              // Test Step3 Keeping break point at stack overflow condition 
  /***************************************************************************************************************/
  
  snprintf( chActionText, elCount(chActionText), "Set Breakpoint in MEMPROT_HWIO_Run_StackOverflow_Tests\\57+0x2 stack overflow condition"); 
  snprintf( chExpectedText, elCount(chExpectedText), "verify is Breakpoint Set MEMPROT_HWIO_Run_StackOverflow_Tests\\57+0x2  stack overflow condition"); 
  TestStepAddActionExpected( chActionText, chExpectedText );
  A_DBGR_BreakpointSet("MEMPROT_HWIO_Run_StackOverflow_Tests\\57+0x2");
  A_DBGR_Go();
  snprintf( chActionText, elCount(chActionText), "setting the Breakpoint at MEMPROT_HWIO_Run_StackOverflow_Tests\\57+0x2"); 
  snprintf( chExpectedText, elCount(chExpectedText), "Verify Breakpoint hit in MEMPROT_HWIO_Run_StackOverflow_Tests\\57+0x2"); 
  E_DBGR_BreakpointCheckForHalt("MEMPROT_HWIO_Run_StackOverflow_Tests\\57+0x2");
  snprintf( chActionText, elCount(chActionText), "Verify breakpoint reached at MEMPROT_HWIO_Run_StackOverflow_Tests\\57+0x2"); 
  snprintf( chExpectedText, elCount(chExpectedText), "Breakpoint reached at MEMPROT_HWIO_Run_StackOverflow_Tests\\57+0x2");
  TestStepAddActionExpected( chActionText, chExpectedText );
  A_DBGR_Go();
  E_DBGR_CheckState(T32_State_Stopped);
  /***************************************************************************************************************/    
                                              // Test Step4 Reading  the fault information data
  /***************************************************************************************************************/
  snprintf( chActionText, elCount(chActionText), "Read the bWPAccessError_Happened variable value equal to 1"); 
  snprintf( chExpectedText, elCount(chExpectedText), "verify bWPAccessError_Happened variable value equal to 1");
  TestStepAddActionExpected( chActionText, chExpectedText );
  E_DBGR_VariableCheck("ME_App_Tc4xMemProt_ContxRam_Core0.TC4XMEMPROT_APP_StackOverflow_ACCESS_ERROR_data.bWPAccessError_Happened",1,Equal);
  snprintf( chActionText, elCount(chActionText), "Read the u32WPAccessError_Address variable address equal to 1879257599"); 
  snprintf( chExpectedText, elCount(chExpectedText), "verify u32WPAccessError_Address variable address equal to 1879257599");
  TestStepAddActionExpected( chActionText, chExpectedText );
  E_DBGR_VariableCheck("ME_App_Tc4xMemProt_ContxRam_Core0.TC4XMEMPROT_APP_StackOverflow_ACCESS_ERROR_data.u32WPAccessError_Address",1879257599,Equal);
  snprintf( chActionText, elCount(chActionText), "Read the u32WPAccessError_InstructionAddress variable value is equal to  to 2156150008"); 
  snprintf( chExpectedText, elCount(chExpectedText), "verify u32WPAccessError_InstructionAddress variable value is equal to 2156150008");
  TestStepAddActionExpected( chActionText, chExpectedText );
  E_DBGR_VariableCheck("ME_App_Tc4xMemProt_ContxRam_Core0.TC4XMEMPROT_APP_StackOverflow_ACCESS_ERROR_data.u32WPAccessError_InstructionAddress",2156150008,Equal);
   /***************************************************************************************************************/    
                                              // Test Step5 Reading the STACK_PROTECTION_STATUS After reset
  /***************************************************************************************************************/
 
  snprintf( chActionText, elCount(chActionText), "Set Breakpoint in MEMPROT_HWIO_Run_StackOverflow_Tests\\52 Reading the STACK_PROTECTION_STATUS After reset condition"); 
  snprintf( chExpectedText, elCount(chExpectedText), "verify is Breakpoint Set MEMPROT_HWIO_Run_StackOverflow_Tests\\52  Reading the STACK_PROTECTION_STATUS After reset condition"); 
  TestStepAddActionExpected( chActionText, chExpectedText );
  A_DBGR_BreakpointSet("MEMPROT_HWIO_Run_StackOverflow_Tests\\52");
  A_DBGR_Go();
  A_DBGR_Go();
  snprintf( chActionText, elCount(chActionText), "Set the Before_clear_fault_status  variable value to 1"); 
  snprintf( chExpectedText, elCount(chExpectedText), "verify Before_clear_fault_status variable value to 1");
  E_DBGR_VariableCheck("Before_clear_fault_status",1,Equal);
  snprintf( chActionText, elCount(chActionText), "Set Breakpoint in MEMPROT_HWIO_Run_StackOverflow_Tests\\53 Reading the STACK_PROTECTION_STATUS After reset condition"); 
  snprintf( chExpectedText, elCount(chExpectedText), "verify is Breakpoint Set MEMPROT_HWIO_Run_StackOverflow_Tests\\53  Reading the STACK_PROTECTION_STATUS After reset condition"); 
  TestStepAddActionExpected( chActionText, chExpectedText );
  A_DBGR_BreakpointSet("MEMPROT_HWIO_Run_StackOverflow_Tests\\53");
  A_DBGR_Go();
  snprintf( chActionText, elCount(chActionText), "Set the After_clear_fault_status  variable value to 0"); 
  snprintf( chExpectedText, elCount(chExpectedText), "verify After_clear_fault_status variable value to 0");
  E_DBGR_VariableCheck("After_clear_fault_status",0,Equal);
  
}
testcase To_verify_the_software_shall_report_the_status_of_the_Stack_overflow_condition_for_Core_1() 
{
  /***************************************************************************************************************/    
                                              // Test Case Info
  /***************************************************************************************************************/
  setWriteDbgLevel(DebugOff);
  snprintf( chTestTitle, elCount(chTestTitle), "To_verify_the_software_shall_report_the_status_of_the_Stack_overflow_condition_for_Core_0" );
  snprintf( chTestDescription, elCount(chTestDescription), "Purpose:To_verify_the_software_shall_report_the_status_of_the_Stack_overflow_condition_for_Core_0");
  TestCaseAddInfo( chTestTitle, "TC_L30SW_Q-36623750", chTestDescription );
  
  /***************************************************************************************************************/    
                                              // Start of Test Case
  /***************************************************************************************************************/
  
  /***************************************************************************************************************/    
                                              // Test Step 0 PRECONDITIONS
  /***************************************************************************************************************/
  snprintf( chActionText, elCount(chActionText), "Flash the Software and ECU is running "); 
  snprintf( chExpectedText, elCount(chExpectedText), "Ecu is should be in running state"); 
  TestStepAddActionExpected( chActionText, chExpectedText );
  A_DBGR_BreakpointDeleteAll();
  A_DBGR_R();

  /***************************************************************************************************************/    
                                              // Test Step 1 Add the break point_1 at core_ID 
  /***************************************************************************************************************/
  snprintf( chActionText, elCount(chActionText), "Set Breakpoint in MEMPROT_HWIO_Run_StackOverflow_Tests\\6 Function call side"); 
  snprintf( chExpectedText, elCount(chExpectedText), "verify is Breakpoint Set MEMPROT_HWIO_Run_StackOverflow_Tests\\6 in Function call side"); 
  A_DBGR_BreakpointSet("MEMPROT_HWIO_Run_StackOverflow_Tests\\6");  
  A_DBGR_Go();
  
  snprintf( chActionText, elCount(chActionText), "verify Breakpoint should hit in MEMPROT_HWIO_Run_StackOverflow_Tests\\6"); 
  snprintf( chExpectedText, elCount(chExpectedText), "Breakpoint hit in MEMPROT_HWIO_Run_StackOverflow_Tests\\6 function"); 
  E_DBGR_BreakpointCheckForHalt("MEMPROT_HWIO_Run_StackOverflow_Tests\\6");
  /***************************************************************************************************************/    
                                              // Test Step2 Read the coreID value 
  /***************************************************************************************************************/
  snprintf( chActionText, elCount(chActionText), "Set the Coreid variable value to 1"); 
  snprintf( chExpectedText, elCount(chExpectedText), "verify Coreid variable value to 1");
  TestStepAddActionExpected( chActionText, chExpectedText );
  E_DBGR_VariableCheck("Coreid",1,Equal);
  /***************************************************************************************************************/    
                                              // Test Step3 Keeping break point at stack overflow condition 
  /***************************************************************************************************************/
  
  snprintf( chActionText, elCount(chActionText), "Set Breakpoint in MEMPROT_HWIO_Run_StackOverflow_Tests\\57+0x2 stack overflow condition"); 
  snprintf( chExpectedText, elCount(chExpectedText), "verify is Breakpoint Set MEMPROT_HWIO_Run_StackOverflow_Tests\\57+0x2  stack overflow condition"); 
  TestStepAddActionExpected( chActionText, chExpectedText );
  A_DBGR_BreakpointSet("MEMPROT_HWIO_Run_StackOverflow_Tests\\57+0x2");
  A_DBGR_Go();
  snprintf( chActionText, elCount(chActionText), "setting the Breakpoint at MEMPROT_HWIO_Run_StackOverflow_Tests\\57+0x2"); 
  snprintf( chExpectedText, elCount(chExpectedText), "Verify Breakpoint hit in MEMPROT_HWIO_Run_StackOverflow_Tests\\57+0x2"); 
  E_DBGR_BreakpointCheckForHalt("MEMPROT_HWIO_Run_StackOverflow_Tests\\57+0x2");
  snprintf( chActionText, elCount(chActionText), "Verify breakpoint reached at MEMPROT_HWIO_Run_StackOverflow_Tests\\57+0x2"); 
  snprintf( chExpectedText, elCount(chExpectedText), "Breakpoint reached at MEMPROT_HWIO_Run_StackOverflow_Tests\\57+0x2");
  TestStepAddActionExpected( chActionText, chExpectedText );
  A_DBGR_Go();
  E_DBGR_CheckState(T32_State_Stopped);
  /***************************************************************************************************************/    
                                              // Test Step4 Reading  the fault information data
  /***************************************************************************************************************/
  snprintf( chActionText, elCount(chActionText), "Read the bWPAccessError_Happened variable value equal to 1"); 
  snprintf( chExpectedText, elCount(chExpectedText), "verify bWPAccessError_Happened variable value equal to 1");
  TestStepAddActionExpected( chActionText, chExpectedText );
  E_DBGR_VariableCheck("ME_App_Tc4xMemProt_ContxRam_Core1.TC4XMEMPROT_APP_StackOverflow_ACCESS_ERROR_data.bWPAccessError_Happened",1,Equal);
  snprintf( chActionText, elCount(chActionText), "Read the u32WPAccessError_Address variable address equal to 1879257599"); 
  snprintf( chExpectedText, elCount(chExpectedText), "verify u32WPAccessError_Address variable address equal to 1879257599");
  TestStepAddActionExpected( chActionText, chExpectedText );
  E_DBGR_VariableCheck("ME_App_Tc4xMemProt_ContxRam_Core1.TC4XMEMPROT_APP_StackOverflow_ACCESS_ERROR_data.u32WPAccessError_Address",1879257599,Equal);
  snprintf( chActionText, elCount(chActionText), "Read the u32WPAccessError_InstructionAddress variable value is equal to  to 2156150008"); 
  snprintf( chExpectedText, elCount(chExpectedText), "verify u32WPAccessError_InstructionAddress variable value is equal to 2156150008");
  TestStepAddActionExpected( chActionText, chExpectedText );
  E_DBGR_VariableCheck("ME_App_Tc4xMemProt_ContxRam_Core1.TC4XMEMPROT_APP_StackOverflow_ACCESS_ERROR_data.u32WPAccessError_InstructionAddress",2156150008,Equal);
  
}
testcase To_verify_the_software_shall_report_the_status_of_the_Stack_overflow_condition_for_Core_2() 
{
  /***************************************************************************************************************/    
                                              // Test Case Info
  /***************************************************************************************************************/
  setWriteDbgLevel(DebugOff);
  snprintf( chTestTitle, elCount(chTestTitle), "To_verify_the_software_shall_report_the_status_of_the_Stack_overflow_condition_for_Core_0" );
  snprintf( chTestDescription, elCount(chTestDescription), "Purpose:To_verify_the_software_shall_report_the_status_of_the_Stack_overflow_condition_for_Core_0");
  TestCaseAddInfo( chTestTitle, "TC_L30SW_Q-36623750", chTestDescription );
  
  /***************************************************************************************************************/    
                                              // Start of Test Case
  /***************************************************************************************************************/
  
  /***************************************************************************************************************/    
                                              // Test Step 0 PRECONDITIONS
  /***************************************************************************************************************/
  snprintf( chActionText, elCount(chActionText), "Flash the Software and ECU is running"); 
  snprintf( chExpectedText, elCount(chExpectedText), "Ecu is should be in running state"); 
  TestStepAddActionExpected( chActionText, chExpectedText );
  A_DBGR_BreakpointDeleteAll();
  A_DBGR_R();

  /***************************************************************************************************************/    
                                              // Test Step 1 Add the break point_1 at core_ID 
  /***************************************************************************************************************/
  snprintf( chActionText, elCount(chActionText), "Set Breakpoint in MEMPROT_HWIO_Run_StackOverflow_Tests\\6 Function call side"); 
  snprintf( chExpectedText, elCount(chExpectedText), "verify is Breakpoint Set MEMPROT_HWIO_Run_StackOverflow_Tests\\6 in Function call side"); 
  A_DBGR_BreakpointSet("MEMPROT_HWIO_Run_StackOverflow_Tests\\6");  
  A_DBGR_Go();
  
  snprintf( chActionText, elCount(chActionText), "verify Breakpoint should hit in MEMPROT_HWIO_Run_StackOverflow_Tests\\6"); 
  snprintf( chExpectedText, elCount(chExpectedText), "Breakpoint hit in MEMPROT_HWIO_Run_StackOverflow_Tests\\6 function"); 
  E_DBGR_BreakpointCheckForHalt("MEMPROT_HWIO_Run_StackOverflow_Tests\\6");
  /***************************************************************************************************************/    
                                              // Test Step2 Read the coreID value 
  /***************************************************************************************************************/
  snprintf( chActionText, elCount(chActionText), "Set the Coreid variable value to 2"); 
  snprintf( chExpectedText, elCount(chExpectedText), "verify Coreid variable value to 2");
  TestStepAddActionExpected( chActionText, chExpectedText );
  E_DBGR_VariableCheck("Coreid",2,Equal);
  /***************************************************************************************************************/    
                                              // Test Step3 Keeping break point at stack overflow condition 
  /***************************************************************************************************************/
  
  snprintf( chActionText, elCount(chActionText), "Set Breakpoint in MEMPROT_HWIO_Run_StackOverflow_Tests\\57+0x2 stack overflow condition"); 
  snprintf( chExpectedText, elCount(chExpectedText), "verify is Breakpoint Set MEMPROT_HWIO_Run_StackOverflow_Tests\\57+0x2  stack overflow condition"); 
  TestStepAddActionExpected( chActionText, chExpectedText );
  A_DBGR_BreakpointSet("MEMPROT_HWIO_Run_StackOverflow_Tests\\57+0x2");
  A_DBGR_Go();
  snprintf( chActionText, elCount(chActionText), "setting the Breakpoint at MEMPROT_HWIO_Run_StackOverflow_Tests\\57+0x2"); 
  snprintf( chExpectedText, elCount(chExpectedText), "Verify Breakpoint hit in MEMPROT_HWIO_Run_StackOverflow_Tests\\57+0x2"); 
  E_DBGR_BreakpointCheckForHalt("MEMPROT_HWIO_Run_StackOverflow_Tests\\57+0x2");
  snprintf( chActionText, elCount(chActionText), "Verify breakpoint reached at MEMPROT_HWIO_Run_StackOverflow_Tests\\57+0x2"); 
  snprintf( chExpectedText, elCount(chExpectedText), "Breakpoint reached at MEMPROT_HWIO_Run_StackOverflow_Tests\\57+0x2");
  TestStepAddActionExpected( chActionText, chExpectedText );
  A_DBGR_Go();
  E_DBGR_CheckState(T32_State_Stopped);
  /***************************************************************************************************************/    
                                              // Test Step4 Reading  the fault information data
  /***************************************************************************************************************/
  snprintf( chActionText, elCount(chActionText), "Read the bWPAccessError_Happened variable value equal to 1"); 
  snprintf( chExpectedText, elCount(chExpectedText), "verify bWPAccessError_Happened variable value equal to 1");
  TestStepAddActionExpected( chActionText, chExpectedText );
  E_DBGR_VariableCheck("ME_App_Tc4xMemProt_ContxRam_Core2.TC4XMEMPROT_APP_StackOverflow_ACCESS_ERROR_data.bWPAccessError_Happened",1,Equal);
  snprintf( chActionText, elCount(chActionText), "Read the u32WPAccessError_Address variable address equal to 1879257599"); 
  snprintf( chExpectedText, elCount(chExpectedText), "verify u32WPAccessError_Address variable address equal to 1879257599");
  TestStepAddActionExpected( chActionText, chExpectedText );
  E_DBGR_VariableCheck("ME_App_Tc4xMemProt_ContxRam_Core2.TC4XMEMPROT_APP_StackOverflow_ACCESS_ERROR_data.u32WPAccessError_Address",1879257599,Equal);
  snprintf( chActionText, elCount(chActionText), "Read the u32WPAccessError_InstructionAddress variable value is equal to  to 2156150008"); 
  snprintf( chExpectedText, elCount(chExpectedText), "verify u32WPAccessError_InstructionAddress variable value is equal to 2156150008");
  TestStepAddActionExpected( chActionText, chExpectedText );
  E_DBGR_VariableCheck("ME_App_Tc4xMemProt_ContxRam_Core2.TC4XMEMPROT_APP_StackOverflow_ACCESS_ERROR_data.u32WPAccessError_InstructionAddress",2156150008,Equal);
  
}
testcase To_verify_the_software_shall_report_the_status_of_the_Stack_overflow_condition_for_Core_3() 
{
  /***************************************************************************************************************/    
                                              // Test Case Info
  /***************************************************************************************************************/
  setWriteDbgLevel(DebugOff);
  snprintf( chTestTitle, elCount(chTestTitle), "To_verify_the_software_shall_report_the_status_of_the_Stack_overflow_condition_for_Core_0" );
  snprintf( chTestDescription, elCount(chTestDescription), "Purpose:To_verify_the_software_shall_report_the_status_of_the_Stack_overflow_condition_for_Core_0");
  TestCaseAddInfo( chTestTitle, "TC_L30SW_Q-36623750", chTestDescription );
  
  /***************************************************************************************************************/    
                                              // Start of Test Case
  /***************************************************************************************************************/
  
  /***************************************************************************************************************/    
                                              // Test Step 0 PRECONDITIONS
  /***************************************************************************************************************/
  snprintf( chActionText, elCount(chActionText), "Flash the Software and ECU is running"); 
  snprintf( chExpectedText, elCount(chExpectedText), "Ecu is should be in running state"); 
  TestStepAddActionExpected( chActionText, chExpectedText );
  A_DBGR_BreakpointDeleteAll();
  A_DBGR_R();

  /***************************************************************************************************************/    
                                              // Test Step 1 Add the break point_1 at core_ID 
  /***************************************************************************************************************/
  snprintf( chActionText, elCount(chActionText), "Set Breakpoint in MEMPROT_HWIO_Run_StackOverflow_Tests\\6 Function call side"); 
  snprintf( chExpectedText, elCount(chExpectedText), "verify is Breakpoint Set MEMPROT_HWIO_Run_StackOverflow_Tests\\6 in Function call side"); 
  A_DBGR_BreakpointSet("MEMPROT_HWIO_Run_StackOverflow_Tests\\6");  
  A_DBGR_Go();
  
  snprintf( chActionText, elCount(chActionText), "verify Breakpoint should hit in MEMPROT_HWIO_Run_StackOverflow_Tests\\6"); 
  snprintf( chExpectedText, elCount(chExpectedText), "Breakpoint hit in MEMPROT_HWIO_Run_StackOverflow_Tests\\6 function"); 
  E_DBGR_BreakpointCheckForHalt("MEMPROT_HWIO_Run_StackOverflow_Tests\\6");
  /***************************************************************************************************************/    
                                              // Test Step2 Read the coreID value 
  /***************************************************************************************************************/
  snprintf( chActionText, elCount(chActionText), "Set the Coreid variable value to 3"); 
  snprintf( chExpectedText, elCount(chExpectedText), "verify Coreid variable value to 3");
  TestStepAddActionExpected( chActionText, chExpectedText );
  E_DBGR_VariableCheck("Coreid",3,Equal);
  /***************************************************************************************************************/    
                                              // Test Step3 Keeping break point at stack overflow condition 
  /***************************************************************************************************************/
  
  snprintf( chActionText, elCount(chActionText), "Set Breakpoint in MEMPROT_HWIO_Run_StackOverflow_Tests\\57+0x2 stack overflow condition"); 
  snprintf( chExpectedText, elCount(chExpectedText), "verify is Breakpoint Set MEMPROT_HWIO_Run_StackOverflow_Tests\\57+0x2  stack overflow condition"); 
  TestStepAddActionExpected( chActionText, chExpectedText );
  A_DBGR_BreakpointSet("MEMPROT_HWIO_Run_StackOverflow_Tests\\57+0x2");
  A_DBGR_Go();
  snprintf( chActionText, elCount(chActionText), "setting the Breakpoint at MEMPROT_HWIO_Run_StackOverflow_Tests\\57+0x2"); 
  snprintf( chExpectedText, elCount(chExpectedText), "Verify Breakpoint hit in MEMPROT_HWIO_Run_StackOverflow_Tests\\57+0x2"); 
  E_DBGR_BreakpointCheckForHalt("MEMPROT_HWIO_Run_StackOverflow_Tests\\57+0x2");
  snprintf( chActionText, elCount(chActionText), "Verify breakpoint reached at MEMPROT_HWIO_Run_StackOverflow_Tests\\57+0x2"); 
  snprintf( chExpectedText, elCount(chExpectedText), "Breakpoint reached at MEMPROT_HWIO_Run_StackOverflow_Tests\\57+0x2");
  TestStepAddActionExpected( chActionText, chExpectedText );
  A_DBGR_Go();
  E_DBGR_CheckState(T32_State_Stopped);
  /***************************************************************************************************************/    
                                              // Test Step4 Reading  the fault information data
  /***************************************************************************************************************/
  snprintf( chActionText, elCount(chActionText), "Read the bWPAccessError_Happened variable value equal to 1"); 
  snprintf( chExpectedText, elCount(chExpectedText), "verify bWPAccessError_Happened variable value equal to 1");
  TestStepAddActionExpected( chActionText, chExpectedText );
  E_DBGR_VariableCheck("ME_App_Tc4xMemProt_ContxRam_Core3.TC4XMEMPROT_APP_StackOverflow_ACCESS_ERROR_data.bWPAccessError_Happened",1,Equal);
  snprintf( chActionText, elCount(chActionText), "Read the u32WPAccessError_Address variable address equal to 1879257599"); 
  snprintf( chExpectedText, elCount(chExpectedText), "verify u32WPAccessError_Address variable address equal to 1879257599");
  TestStepAddActionExpected( chActionText, chExpectedText );
  E_DBGR_VariableCheck("ME_App_Tc4xMemProt_ContxRam_Core3.TC4XMEMPROT_APP_StackOverflow_ACCESS_ERROR_data.u32WPAccessError_Address",1879257599,Equal);
  snprintf( chActionText, elCount(chActionText), "Read the u32WPAccessError_InstructionAddress variable value is equal to  to 2156150008"); 
  snprintf( chExpectedText, elCount(chExpectedText), "verify u32WPAccessError_InstructionAddress variable value is equal to 2156150008");
  TestStepAddActionExpected( chActionText, chExpectedText );
  E_DBGR_VariableCheck("ME_App_Tc4xMemProt_ContxRam_Core3.TC4XMEMPROT_APP_StackOverflow_ACCESS_ERROR_data.u32WPAccessError_InstructionAddress",2156150008,Equal);
  
}
testcase To_verify_the_software_shall_report_the_status_of_the_Stack_overflow_condition_for_Core_4() 
{
  /***************************************************************************************************************/    
                                              // Test Case Info
  /***************************************************************************************************************/
  setWriteDbgLevel(DebugOff);
  snprintf( chTestTitle, elCount(chTestTitle), "To_verify_the_software_shall_report_the_status_of_the_Stack_overflow_condition_for_Core_0" );
  snprintf( chTestDescription, elCount(chTestDescription), "Purpose:To_verify_the_software_shall_report_the_status_of_the_Stack_overflow_condition_for_Core_0");
  TestCaseAddInfo( chTestTitle, "TC_L30SW_Q-36623750", chTestDescription );
  
  /***************************************************************************************************************/    
                                              // Start of Test Case
  /***************************************************************************************************************/
  
  /***************************************************************************************************************/    
                                              // Test Step 0 PRECONDITIONS
  /***************************************************************************************************************/
  snprintf( chActionText, elCount(chActionText), "Flash the Software and ECU is running"); 
  snprintf( chExpectedText, elCount(chExpectedText), "Ecu is should be in running state"); 
  TestStepAddActionExpected( chActionText, chExpectedText );
  A_DBGR_BreakpointDeleteAll();
  A_DBGR_R();

  /***************************************************************************************************************/    
                                              // Test Step 1 Add the break point_1 at core_ID 
  /***************************************************************************************************************/
  snprintf( chActionText, elCount(chActionText), "Set Breakpoint in MEMPROT_HWIO_Run_StackOverflow_Tests\\6 Function call side"); 
  snprintf( chExpectedText, elCount(chExpectedText), "verify is Breakpoint Set MEMPROT_HWIO_Run_StackOverflow_Tests\\6 in Function call side"); 
  A_DBGR_BreakpointSet("MEMPROT_HWIO_Run_StackOverflow_Tests\\6");  
  A_DBGR_Go();
  
  snprintf( chActionText, elCount(chActionText), "verify Breakpoint should hit in MEMPROT_HWIO_Run_StackOverflow_Tests\\6"); 
  snprintf( chExpectedText, elCount(chExpectedText), "Breakpoint hit in MEMPROT_HWIO_Run_StackOverflow_Tests\\6 function"); 
  E_DBGR_BreakpointCheckForHalt("MEMPROT_HWIO_Run_StackOverflow_Tests\\6");
  /***************************************************************************************************************/    
                                              // Test Step2 Read the coreID value 
  /***************************************************************************************************************/
  snprintf( chActionText, elCount(chActionText), "Set the Coreid variable value to 4"); 
  snprintf( chExpectedText, elCount(chExpectedText), "verify Coreid variable value to 4");
  TestStepAddActionExpected( chActionText, chExpectedText );
  E_DBGR_VariableCheck("Coreid",4,Equal);
  /***************************************************************************************************************/    
                                              // Test Step3 Keeping break point at stack overflow condition 
  /***************************************************************************************************************/
  
  snprintf( chActionText, elCount(chActionText), "Set Breakpoint in MEMPROT_HWIO_Run_StackOverflow_Tests\\57+0x2 stack overflow condition"); 
  snprintf( chExpectedText, elCount(chExpectedText), "verify is Breakpoint Set MEMPROT_HWIO_Run_StackOverflow_Tests\\57+0x2  stack overflow condition"); 
  TestStepAddActionExpected( chActionText, chExpectedText );
  A_DBGR_BreakpointSet("MEMPROT_HWIO_Run_StackOverflow_Tests\\57+0x2");
  A_DBGR_Go();
  snprintf( chActionText, elCount(chActionText), "setting the Breakpoint at MEMPROT_HWIO_Run_StackOverflow_Tests\\57+0x2"); 
  snprintf( chExpectedText, elCount(chExpectedText), "Verify Breakpoint hit in MEMPROT_HWIO_Run_StackOverflow_Tests\\57+0x2"); 
  E_DBGR_BreakpointCheckForHalt("MEMPROT_HWIO_Run_StackOverflow_Tests\\57+0x2");
  snprintf( chActionText, elCount(chActionText), "Verify breakpoint reached at MEMPROT_HWIO_Run_StackOverflow_Tests\\57+0x2"); 
  snprintf( chExpectedText, elCount(chExpectedText), "Breakpoint reached at MEMPROT_HWIO_Run_StackOverflow_Tests\\57+0x2");
  TestStepAddActionExpected( chActionText, chExpectedText );
  A_DBGR_Go();
  E_DBGR_CheckState(T32_State_Stopped);
  /***************************************************************************************************************/    
                                              // Test Step4 Reading  the fault information data
  /***************************************************************************************************************/
  snprintf( chActionText, elCount(chActionText), "Read the bWPAccessError_Happened variable value equal to 1"); 
  snprintf( chExpectedText, elCount(chExpectedText), "verify bWPAccessError_Happened variable value equal to 1");
  TestStepAddActionExpected( chActionText, chExpectedText );
  E_DBGR_VariableCheck("ME_App_Tc4xMemProt_ContxRam_Core4.TC4XMEMPROT_APP_StackOverflow_ACCESS_ERROR_data.bWPAccessError_Happened",1,Equal);
  snprintf( chActionText, elCount(chActionText), "Read the u32WPAccessError_Address variable address equal to 1879257599"); 
  snprintf( chExpectedText, elCount(chExpectedText), "verify u32WPAccessError_Address variable address equal to 1879257599");
  TestStepAddActionExpected( chActionText, chExpectedText );
  E_DBGR_VariableCheck("ME_App_Tc4xMemProt_ContxRam_Core4.TC4XMEMPROT_APP_StackOverflow_ACCESS_ERROR_data.u32WPAccessError_Address",1879257599,Equal);
  snprintf( chActionText, elCount(chActionText), "Read the u32WPAccessError_InstructionAddress variable value is equal to  to 2156150008"); 
  snprintf( chExpectedText, elCount(chExpectedText), "verify u32WPAccessError_InstructionAddress variable value is equal to 2156150008");
  TestStepAddActionExpected( chActionText, chExpectedText );
  E_DBGR_VariableCheck("ME_App_Tc4xMemProt_ContxRam_Core4.TC4XMEMPROT_APP_StackOverflow_ACCESS_ERROR_data.u32WPAccessError_InstructionAddress",2156150008,Equal);
  
}
testcase To_verify_the_software_shall_report_the_status_of_the_Stack_overflow_condition_for_Core_5() 
{
  /***************************************************************************************************************/    
                                              // Test Case Info
  /***************************************************************************************************************/
  setWriteDbgLevel(DebugOff);
  snprintf( chTestTitle, elCount(chTestTitle), "To_verify_the_software_shall_report_the_status_of_the_Stack_overflow_condition_for_Core_0" );
  snprintf( chTestDescription, elCount(chTestDescription), "Purpose:To_verify_the_software_shall_report_the_status_of_the_Stack_overflow_condition_for_Core_0");
  TestCaseAddInfo( chTestTitle, "TC_L30SW_Q-36623750", chTestDescription );
  
  /***************************************************************************************************************/    
                                              // Start of Test Case
  /***************************************************************************************************************/
  
  /***************************************************************************************************************/    
                                              // Test Step 0 PRECONDITIONS
  /***************************************************************************************************************/
  snprintf( chActionText, elCount(chActionText), "Flash the Software and ECU is running"); 
  snprintf( chExpectedText, elCount(chExpectedText), "Ecu is should be in running state"); 
  TestStepAddActionExpected( chActionText, chExpectedText );
  A_DBGR_BreakpointDeleteAll();
  A_DBGR_R();

  /***************************************************************************************************************/    
                                              // Test Step 1 Add the break point_1 at core_ID 
  /***************************************************************************************************************/
  snprintf( chActionText, elCount(chActionText), "Set Breakpoint in MEMPROT_HWIO_Run_StackOverflow_Tests\\6 Function call side"); 
  snprintf( chExpectedText, elCount(chExpectedText), "verify is Breakpoint Set MEMPROT_HWIO_Run_StackOverflow_Tests\\6 in Function call side"); 
  A_DBGR_BreakpointSet("MEMPROT_HWIO_Run_StackOverflow_Tests\\6");  
  A_DBGR_Go();
  
  snprintf( chActionText, elCount(chActionText), "verify Breakpoint should hit in MEMPROT_HWIO_Run_StackOverflow_Tests\\6"); 
  snprintf( chExpectedText, elCount(chExpectedText), "Breakpoint hit in MEMPROT_HWIO_Run_StackOverflow_Tests\\6 function"); 
  E_DBGR_BreakpointCheckForHalt("MEMPROT_HWIO_Run_StackOverflow_Tests\\6");
  /***************************************************************************************************************/    
                                              // Test Step2 Read the coreID value 
  /***************************************************************************************************************/
  snprintf( chActionText, elCount(chActionText), "Set the Coreid variable value to 5"); 
  snprintf( chExpectedText, elCount(chExpectedText), "verify Coreid variable value to 5");
  TestStepAddActionExpected( chActionText, chExpectedText );
  E_DBGR_VariableCheck("Coreid",5,Equal);
  /***************************************************************************************************************/    
                                              // Test Step3 Keeping break point at stack overflow condition 
  /***************************************************************************************************************/
  
  snprintf( chActionText, elCount(chActionText), "Set Breakpoint in MEMPROT_HWIO_Run_StackOverflow_Tests\\57+0x2 stack overflow condition"); 
  snprintf( chExpectedText, elCount(chExpectedText), "verify is Breakpoint Set MEMPROT_HWIO_Run_StackOverflow_Tests\\57+0x2  stack overflow condition"); 
  TestStepAddActionExpected( chActionText, chExpectedText );
  A_DBGR_BreakpointSet("MEMPROT_HWIO_Run_StackOverflow_Tests\\57+0x2");
  A_DBGR_Go();
  snprintf( chActionText, elCount(chActionText), "setting the Breakpoint at MEMPROT_HWIO_Run_StackOverflow_Tests\\57+0x2"); 
  snprintf( chExpectedText, elCount(chExpectedText), "Verify Breakpoint hit in MEMPROT_HWIO_Run_StackOverflow_Tests\\57+0x2"); 
  E_DBGR_BreakpointCheckForHalt("MEMPROT_HWIO_Run_StackOverflow_Tests\\57+0x2");
  snprintf( chActionText, elCount(chActionText), "Verify breakpoint reached at MEMPROT_HWIO_Run_StackOverflow_Tests\\57+0x2"); 
  snprintf( chExpectedText, elCount(chExpectedText), "Breakpoint reached at MEMPROT_HWIO_Run_StackOverflow_Tests\\57+0x2");
  TestStepAddActionExpected( chActionText, chExpectedText );
  A_DBGR_Go();
  E_DBGR_CheckState(T32_State_Stopped);
  /***************************************************************************************************************/    
                                              // Test Step4 Reading  the fault information data
  /***************************************************************************************************************/
  snprintf( chActionText, elCount(chActionText), "Read the bWPAccessError_Happened variable value equal to 1"); 
  snprintf( chExpectedText, elCount(chExpectedText), "verify bWPAccessError_Happened variable value equal to 1");
  TestStepAddActionExpected( chActionText, chExpectedText );
  E_DBGR_VariableCheck("ME_App_Tc4xMemProt_ContxRam_Core5.TC4XMEMPROT_APP_StackOverflow_ACCESS_ERROR_data.bWPAccessError_Happened",1,Equal);
  snprintf( chActionText, elCount(chActionText), "Read the u32WPAccessError_Address variable address equal to 1879257599"); 
  snprintf( chExpectedText, elCount(chExpectedText), "verify u32WPAccessError_Address variable address equal to 1879257599");
  TestStepAddActionExpected( chActionText, chExpectedText );
  E_DBGR_VariableCheck("ME_App_Tc4xMemProt_ContxRam_Core5.TC4XMEMPROT_APP_StackOverflow_ACCESS_ERROR_data.u32WPAccessError_Address",1879257599,Equal);
  snprintf( chActionText, elCount(chActionText), "Read the u32WPAccessError_InstructionAddress variable value is equal to  to 2156150008"); 
  snprintf( chExpectedText, elCount(chExpectedText), "verify u32WPAccessError_InstructionAddress variable value is equal to 2156150008");
  TestStepAddActionExpected( chActionText, chExpectedText );
  E_DBGR_VariableCheck("ME_App_Tc4xMemProt_ContxRam_Core5.TC4XMEMPROT_APP_StackOverflow_ACCESS_ERROR_data.u32WPAccessError_InstructionAddress",2156150008,Equal);
  
}
testcase To_verify_the_software_shall_report_the_status_of_the_Stack_underflow_condition_for_Core_0() 
{
  /***************************************************************************************************************/    
                                              // Test Case Info
  /***************************************************************************************************************/
  setWriteDbgLevel(DebugOff);
  snprintf( chTestTitle, elCount(chTestTitle), "To_verify_the_software_shall_report_the_status_of_the_Stack_overflow_condition_for_Core_0" );
  snprintf( chTestDescription, elCount(chTestDescription), "Purpose:To_verify_the_software_shall_report_the_status_of_the_Stack_overflow_condition_for_Core_0");
  TestCaseAddInfo( chTestTitle, "TC_L30SW_Q-36623750", chTestDescription );
  
  /***************************************************************************************************************/    
                                              // Start of Test Case
  /***************************************************************************************************************/
  
  /***************************************************************************************************************/    
                                              // Test Step 0 PRECONDITIONS
  /***************************************************************************************************************/
  snprintf( chActionText, elCount(chActionText), "Flash the Software and ECU is running "); 
  snprintf( chExpectedText, elCount(chExpectedText), "Ecu is should be in running state"); 
  TestStepAddActionExpected( chActionText, chExpectedText );
  A_DBGR_BreakpointDeleteAll();
  A_DBGR_R();

  /***************************************************************************************************************/    
                                              // Test Step 1 Add the break point_1 at core_ID 
  /***************************************************************************************************************/
  snprintf( chActionText, elCount(chActionText), "Set Breakpoint in MEMPROT_HWIO_Run_StackUnderflow_Tests\\6 Function call side"); 
  snprintf( chExpectedText, elCount(chExpectedText), "verify is Breakpoint Set MEMPROT_HWIO_Run_StackUnderflow_Tests\\6 in Function call side"); 
  A_DBGR_BreakpointSet("MEMPROT_HWIO_Run_StackUnderflow_Tests\\6");  
  A_DBGR_Go();
  
  snprintf( chActionText, elCount(chActionText), "verify Breakpoint should hit in MEMPROT_HWIO_Run_StackUnderflow_Tests\\6"); 
  snprintf( chExpectedText, elCount(chExpectedText), "Breakpoint hit in MEMPROT_HWIO_Run_StackUnderflow_Tests\\6 function"); 
  E_DBGR_BreakpointCheckForHalt("MEMPROT_HWIO_Run_StackUnderflow_Tests\\6");
  /***************************************************************************************************************/    
                                              // Test Step2 Read the coreID value 
  /***************************************************************************************************************/
  snprintf( chActionText, elCount(chActionText), "Set the Coreid variable value to 0"); 
  snprintf( chExpectedText, elCount(chExpectedText), "verify Coreid variable value to 0");
  TestStepAddActionExpected( chActionText, chExpectedText );
  E_DBGR_VariableCheck("Coreid",0,Equal);
  /***************************************************************************************************************/    
                                              // Test Step3 Keeping break point at stack overflow condition 
  /***************************************************************************************************************/
  
  snprintf( chActionText, elCount(chActionText), "Set Breakpoint in MEMPROT_HWIO_Run_StackUnderflow_Tests\\56+0x2 stack overflow condition"); 
  snprintf( chExpectedText, elCount(chExpectedText), "verify is Breakpoint Set MEMPROT_HWIO_Run_StackUnderflow_Tests\\56+0x2  stack overflow condition"); 
  TestStepAddActionExpected( chActionText, chExpectedText );
  A_DBGR_BreakpointSet("MEMPROT_HWIO_Run_StackUnderflow_Tests\\56+0x2");
  A_DBGR_Go();
  snprintf( chActionText, elCount(chActionText), "setting the Breakpoint at MEMPROT_HWIO_Run_StackUnderflow_Tests\\56+0x2"); 
  snprintf( chExpectedText, elCount(chExpectedText), "Verify Breakpoint hit in MEMPROT_HWIO_Run_StackUnderflow_Tests\\56+0x2"); 
  E_DBGR_BreakpointCheckForHalt("MEMPROT_HWIO_Run_StackUnderflow_Tests\\56+0x2");
  snprintf( chActionText, elCount(chActionText), "Verify breakpoint reached at MEMPROT_HWIO_Run_StackUnderflow_Tests\\56+0x2"); 
  snprintf( chExpectedText, elCount(chExpectedText), "Breakpoint reached at MEMPROT_HWIO_Run_StackUnderflow_Tests\\56+0x2");
  TestStepAddActionExpected( chActionText, chExpectedText );
  A_DBGR_Go();
  E_DBGR_CheckState(T32_State_Stopped);
  /***************************************************************************************************************/    
                                              // Test Step4 Reading  the fault information data
  /***************************************************************************************************************/
  snprintf( chActionText, elCount(chActionText), "Read the bWPAccessError_Happened variable value equal to 1"); 
  snprintf( chExpectedText, elCount(chExpectedText), "verify bWPAccessError_Happened variable value equal to 1");
  TestStepAddActionExpected( chActionText, chExpectedText );
  E_DBGR_VariableCheck("ME_App_Tc4xMemProt_ContxRam_Core0.TC4XMEMPROT_APP_StackUnderflow_ACCESS_ERROR_data.bWPAccessError_Happened",1,Equal);
  snprintf( chActionText, elCount(chActionText), "Read the u32WPAccessError_Address variable address equal to 1879283201"); 
  snprintf( chExpectedText, elCount(chExpectedText), "verify u32WPAccessError_Address variable address equal to 1879283201");
  TestStepAddActionExpected( chActionText, chExpectedText );
  E_DBGR_VariableCheck("ME_App_Tc4xMemProt_ContxRam_Core0.TC4XMEMPROT_APP_StackUnderflow_ACCESS_ERROR_data.u32WPAccessError_Address",1879283201,Equal);
  snprintf( chActionText, elCount(chActionText), "Read the u32WPAccessError_InstructionAddress variable value is equal to  to 2156150008"); 
  snprintf( chExpectedText, elCount(chExpectedText), "verify u32WPAccessError_InstructionAddress variable value is equal to 2156150008");
  TestStepAddActionExpected( chActionText, chExpectedText );
  E_DBGR_VariableCheck("ME_App_Tc4xMemProt_ContxRam_Core0.TC4XMEMPROT_APP_StackUnderflow_ACCESS_ERROR_data.u32WPAccessError_InstructionAddress",2156150008,Equal);
  
}
testcase To_verify_the_software_shall_report_the_status_of_the_Stack_underflow_condition_for_Core_1() 
{
  /***************************************************************************************************************/    
                                              // Test Case Info
  /***************************************************************************************************************/
  setWriteDbgLevel(DebugOff);
  snprintf( chTestTitle, elCount(chTestTitle), "To_verify_the_software_shall_report_the_status_of_the_Stack_overflow_condition_for_Core_0" );
  snprintf( chTestDescription, elCount(chTestDescription), "Purpose:To_verify_the_software_shall_report_the_status_of_the_Stack_overflow_condition_for_Core_0");
  TestCaseAddInfo( chTestTitle, "TC_L30SW_Q-36623750", chTestDescription );
  
  /***************************************************************************************************************/    
                                              // Start of Test Case
  /***************************************************************************************************************/
  
  /***************************************************************************************************************/    
                                              // Test Step 0 PRECONDITIONS
  /***************************************************************************************************************/
  snprintf( chActionText, elCount(chActionText), "Flash the Software and ECU is running "); 
  snprintf( chExpectedText, elCount(chExpectedText), "Ecu is should be in running state"); 
  TestStepAddActionExpected( chActionText, chExpectedText );
  A_DBGR_BreakpointDeleteAll();
  A_DBGR_R();

  /***************************************************************************************************************/    
                                              // Test Step 1 Add the break point_1 at core_ID 
  /***************************************************************************************************************/
  snprintf( chActionText, elCount(chActionText), "Set Breakpoint in MEMPROT_HWIO_Run_StackUnderflow_Tests\\6 Function call side"); 
  snprintf( chExpectedText, elCount(chExpectedText), "verify is Breakpoint Set MEMPROT_HWIO_Run_StackUnderflow_Tests\\6 in Function call side"); 
  A_DBGR_BreakpointSet("MEMPROT_HWIO_Run_StackUnderflow_Tests\\6");  
  A_DBGR_Go();
  
  snprintf( chActionText, elCount(chActionText), "verify Breakpoint should hit in MEMPROT_HWIO_Run_StackUnderflow_Tests\\6"); 
  snprintf( chExpectedText, elCount(chExpectedText), "Breakpoint hit in MEMPROT_HWIO_Run_StackUnderflow_Tests\\6 function"); 
  E_DBGR_BreakpointCheckForHalt("MEMPROT_HWIO_Run_StackUnderflow_Tests\\6");
  /***************************************************************************************************************/    
                                              // Test Step2 Read the coreID value 
  /***************************************************************************************************************/
  snprintf( chActionText, elCount(chActionText), "Set the Coreid variable value to 1"); 
  snprintf( chExpectedText, elCount(chExpectedText), "verify Coreid variable value to 1");
  TestStepAddActionExpected( chActionText, chExpectedText );
  E_DBGR_VariableCheck("Coreid",1,Equal);
  /***************************************************************************************************************/    
                                              // Test Step3 Keeping break point at stack overflow condition 
  /***************************************************************************************************************/
  
  snprintf( chActionText, elCount(chActionText), "Set Breakpoint in MEMPROT_HWIO_Run_StackUnderflow_Tests\\56+0x2 stack overflow condition"); 
  snprintf( chExpectedText, elCount(chExpectedText), "verify is Breakpoint Set MEMPROT_HWIO_Run_StackUnderflow_Tests\\56+0x2  stack overflow condition"); 
  TestStepAddActionExpected( chActionText, chExpectedText );
  A_DBGR_BreakpointSet("MEMPROT_HWIO_Run_StackUnderflow_Tests\\56+0x2");
  A_DBGR_Go();
  snprintf( chActionText, elCount(chActionText), "setting the Breakpoint at MEMPROT_HWIO_Run_StackUnderflow_Tests\\56+0x2"); 
  snprintf( chExpectedText, elCount(chExpectedText), "Verify Breakpoint hit in MEMPROT_HWIO_Run_StackUnderflow_Tests\\56+0x2"); 
  E_DBGR_BreakpointCheckForHalt("MEMPROT_HWIO_Run_StackUnderflow_Tests\\56+0x2");
  snprintf( chActionText, elCount(chActionText), "Verify breakpoint reached at MEMPROT_HWIO_Run_StackUnderflow_Tests\\56+0x2"); 
  snprintf( chExpectedText, elCount(chExpectedText), "Breakpoint reached at MEMPROT_HWIO_Run_StackUnderflow_Tests\\56+0x2");
  TestStepAddActionExpected( chActionText, chExpectedText );
  A_DBGR_Go();
  E_DBGR_CheckState(T32_State_Stopped);
  /***************************************************************************************************************/    
                                              // Test Step4 Reading  the fault information data
  /***************************************************************************************************************/
  snprintf( chActionText, elCount(chActionText), "Read the bWPAccessError_Happened variable value equal to 1"); 
  snprintf( chExpectedText, elCount(chExpectedText), "verify bWPAccessError_Happened variable value equal to 1");
  TestStepAddActionExpected( chActionText, chExpectedText );
  E_DBGR_VariableCheck("ME_App_Tc4xMemProt_ContxRam_Core1.TC4XMEMPROT_APP_StackUnderflow_ACCESS_ERROR_data.bWPAccessError_Happened",1,Equal);
  snprintf( chActionText, elCount(chActionText), "Read the u32WPAccessError_Address variable address equal to 1879283201"); 
  snprintf( chExpectedText, elCount(chExpectedText), "verify u32WPAccessError_Address variable address equal to 1879283201");
  TestStepAddActionExpected( chActionText, chExpectedText );
  E_DBGR_VariableCheck("ME_App_Tc4xMemProt_ContxRam_Core1.TC4XMEMPROT_APP_StackUnderflow_ACCESS_ERROR_data.u32WPAccessError_Address",1879283201,Equal);
  snprintf( chActionText, elCount(chActionText), "Read the u32WPAccessError_InstructionAddress variable value is equal to  to 2156150008"); 
  snprintf( chExpectedText, elCount(chExpectedText), "verify u32WPAccessError_InstructionAddress variable value is equal to 2156150008");
  TestStepAddActionExpected( chActionText, chExpectedText );
  E_DBGR_VariableCheck("ME_App_Tc4xMemProt_ContxRam_Core1.TC4XMEMPROT_APP_StackUnderflow_ACCESS_ERROR_data.u32WPAccessError_InstructionAddress",2156150008,Equal);
  
}
testcase To_verify_the_software_shall_report_the_status_of_the_Stack_underflow_condition_for_Core_2() 
{
  /***************************************************************************************************************/    
                                              // Test Case Info
  /***************************************************************************************************************/
  setWriteDbgLevel(DebugOff);
  snprintf( chTestTitle, elCount(chTestTitle), "To_verify_the_software_shall_report_the_status_of_the_Stack_overflow_condition_for_Core_0" );
  snprintf( chTestDescription, elCount(chTestDescription), "Purpose:To_verify_the_software_shall_report_the_status_of_the_Stack_overflow_condition_for_Core_0");
  TestCaseAddInfo( chTestTitle, "TC_L30SW_Q-36623750", chTestDescription );
  
  /***************************************************************************************************************/    
                                              // Start of Test Case
  /***************************************************************************************************************/
  
  /***************************************************************************************************************/    
                                              // Test Step 0 PRECONDITIONS
  /***************************************************************************************************************/
  snprintf( chActionText, elCount(chActionText), "Flash the Software and ECU is running "); 
  snprintf( chExpectedText, elCount(chExpectedText), "Ecu is should be in running state"); 
  TestStepAddActionExpected( chActionText, chExpectedText );
  A_DBGR_BreakpointDeleteAll();
  A_DBGR_R();

  /***************************************************************************************************************/    
                                              // Test Step 1 Add the break point_1 at core_ID 
  /***************************************************************************************************************/
  snprintf( chActionText, elCount(chActionText), "Set Breakpoint in MEMPROT_HWIO_Run_StackUnderflow_Tests\\6 Function call side"); 
  snprintf( chExpectedText, elCount(chExpectedText), "verify is Breakpoint Set MEMPROT_HWIO_Run_StackUnderflow_Tests\\6 in Function call side"); 
  A_DBGR_BreakpointSet("MEMPROT_HWIO_Run_StackUnderflow_Tests\\6");  
  A_DBGR_Go();
  
  snprintf( chActionText, elCount(chActionText), "verify Breakpoint should hit in MEMPROT_HWIO_Run_StackUnderflow_Tests\\6"); 
  snprintf( chExpectedText, elCount(chExpectedText), "Breakpoint hit in MEMPROT_HWIO_Run_StackUnderflow_Tests\\6 function"); 
  E_DBGR_BreakpointCheckForHalt("MEMPROT_HWIO_Run_StackUnderflow_Tests\\6");
  /***************************************************************************************************************/    
                                              // Test Step2 Read the coreID value 
  /***************************************************************************************************************/
  snprintf( chActionText, elCount(chActionText), "Set the Coreid variable value to 2"); 
  snprintf( chExpectedText, elCount(chExpectedText), "verify Coreid variable value to 2");
  TestStepAddActionExpected( chActionText, chExpectedText );
  E_DBGR_VariableCheck("Coreid",2,Equal);
  /***************************************************************************************************************/    
                                              // Test Step3 Keeping break point at stack overflow condition 
  /***************************************************************************************************************/
  
  snprintf( chActionText, elCount(chActionText), "Set Breakpoint in MEMPROT_HWIO_Run_StackUnderflow_Tests\\56+0x2 stack overflow condition"); 
  snprintf( chExpectedText, elCount(chExpectedText), "verify is Breakpoint Set MEMPROT_HWIO_Run_StackUnderflow_Tests\\56+0x2  stack overflow condition"); 
  TestStepAddActionExpected( chActionText, chExpectedText );
  A_DBGR_BreakpointSet("MEMPROT_HWIO_Run_StackUnderflow_Tests\\56+0x2");
  A_DBGR_Go();
  snprintf( chActionText, elCount(chActionText), "setting the Breakpoint at MEMPROT_HWIO_Run_StackUnderflow_Tests\\56+0x2"); 
  snprintf( chExpectedText, elCount(chExpectedText), "Verify Breakpoint hit in MEMPROT_HWIO_Run_StackUnderflow_Tests\\56+0x2"); 
  E_DBGR_BreakpointCheckForHalt("MEMPROT_HWIO_Run_StackUnderflow_Tests\\56+0x2");
  snprintf( chActionText, elCount(chActionText), "Verify breakpoint reached at MEMPROT_HWIO_Run_StackUnderflow_Tests\\56+0x2"); 
  snprintf( chExpectedText, elCount(chExpectedText), "Breakpoint reached at MEMPROT_HWIO_Run_StackUnderflow_Tests\\56+0x2");
  TestStepAddActionExpected( chActionText, chExpectedText );
  A_DBGR_Go();
  E_DBGR_CheckState(T32_State_Stopped);
  /***************************************************************************************************************/    
                                              // Test Step4 Reading  the fault information data
  /***************************************************************************************************************/
  snprintf( chActionText, elCount(chActionText), "Read the bWPAccessError_Happened variable value equal to 1"); 
  snprintf( chExpectedText, elCount(chExpectedText), "verify bWPAccessError_Happened variable value equal to 1");
  TestStepAddActionExpected( chActionText, chExpectedText );
  E_DBGR_VariableCheck("ME_App_Tc4xMemProt_ContxRam_Core2.TC4XMEMPROT_APP_StackUnderflow_ACCESS_ERROR_data.bWPAccessError_Happened",1,Equal);
  snprintf( chActionText, elCount(chActionText), "Read the u32WPAccessError_Address variable address equal to 1879283201"); 
  snprintf( chExpectedText, elCount(chExpectedText), "verify u32WPAccessError_Address variable address equal to 1879283201");
  TestStepAddActionExpected( chActionText, chExpectedText );
  E_DBGR_VariableCheck("ME_App_Tc4xMemProt_ContxRam_Core2.TC4XMEMPROT_APP_StackUnderflow_ACCESS_ERROR_data.u32WPAccessError_Address",1879283201,Equal);
  snprintf( chActionText, elCount(chActionText), "Read the u32WPAccessError_InstructionAddress variable value is equal to  to 2156150008"); 
  snprintf( chExpectedText, elCount(chExpectedText), "verify u32WPAccessError_InstructionAddress variable value is equal to 2156150008");
  TestStepAddActionExpected( chActionText, chExpectedText );
  E_DBGR_VariableCheck("ME_App_Tc4xMemProt_ContxRam_Core2.TC4XMEMPROT_APP_StackUnderflow_ACCESS_ERROR_data.u32WPAccessError_InstructionAddress",2156150008,Equal);
  
}
testcase To_verify_the_software_shall_report_the_status_of_the_Stack_underflow_condition_for_Core_3() 
{
  /***************************************************************************************************************/    
                                              // Test Case Info
  /***************************************************************************************************************/
  setWriteDbgLevel(DebugOff);
  snprintf( chTestTitle, elCount(chTestTitle), "To_verify_the_software_shall_report_the_status_of_the_Stack_overflow_condition_for_Core_0" );
  snprintf( chTestDescription, elCount(chTestDescription), "Purpose:To_verify_the_software_shall_report_the_status_of_the_Stack_overflow_condition_for_Core_0");
  TestCaseAddInfo( chTestTitle, "TC_L30SW_Q-36623750", chTestDescription );
  
  /***************************************************************************************************************/    
                                              // Start of Test Case
  /***************************************************************************************************************/
  
  /***************************************************************************************************************/    
                                              // Test Step 0 PRECONDITIONS
  /***************************************************************************************************************/
  snprintf( chActionText, elCount(chActionText), "Flash the Software and ECU is running "); 
  snprintf( chExpectedText, elCount(chExpectedText), "Ecu is should be in running state"); 
  TestStepAddActionExpected( chActionText, chExpectedText );
  A_DBGR_BreakpointDeleteAll();
  A_DBGR_R();

  /***************************************************************************************************************/    
                                              // Test Step 1 Add the break point_1 at core_ID 
  /***************************************************************************************************************/
  snprintf( chActionText, elCount(chActionText), "Set Breakpoint in MEMPROT_HWIO_Run_StackUnderflow_Tests\\6 Function call side"); 
  snprintf( chExpectedText, elCount(chExpectedText), "verify is Breakpoint Set MEMPROT_HWIO_Run_StackUnderflow_Tests\\6 in Function call side"); 
  A_DBGR_BreakpointSet("MEMPROT_HWIO_Run_StackUnderflow_Tests\\6");  
  A_DBGR_Go();
  
  snprintf( chActionText, elCount(chActionText), "verify Breakpoint should hit in MEMPROT_HWIO_Run_StackUnderflow_Tests\\6"); 
  snprintf( chExpectedText, elCount(chExpectedText), "Breakpoint hit in MEMPROT_HWIO_Run_StackUnderflow_Tests\\6 function"); 
  E_DBGR_BreakpointCheckForHalt("MEMPROT_HWIO_Run_StackUnderflow_Tests\\6");
  /***************************************************************************************************************/    
                                              // Test Step2 Read the coreID value 
  /***************************************************************************************************************/
  snprintf( chActionText, elCount(chActionText), "Set the Coreid variable value to 3"); 
  snprintf( chExpectedText, elCount(chExpectedText), "verify Coreid variable value to 3");
  TestStepAddActionExpected( chActionText, chExpectedText );
  E_DBGR_VariableCheck("Coreid",3,Equal);
  /***************************************************************************************************************/    
                                              // Test Step3 Keeping break point at stack overflow condition 
  /***************************************************************************************************************/
  
  snprintf( chActionText, elCount(chActionText), "Set Breakpoint in MEMPROT_HWIO_Run_StackUnderflow_Tests\\56+0x2 stack overflow condition"); 
  snprintf( chExpectedText, elCount(chExpectedText), "verify is Breakpoint Set MEMPROT_HWIO_Run_StackUnderflow_Tests\\56+0x2  stack overflow condition"); 
  TestStepAddActionExpected( chActionText, chExpectedText );
  A_DBGR_BreakpointSet("MEMPROT_HWIO_Run_StackUnderflow_Tests\\56+0x2");
  A_DBGR_Go();
  snprintf( chActionText, elCount(chActionText), "setting the Breakpoint at MEMPROT_HWIO_Run_StackUnderflow_Tests\\56+0x2"); 
  snprintf( chExpectedText, elCount(chExpectedText), "Verify Breakpoint hit in MEMPROT_HWIO_Run_StackUnderflow_Tests\\56+0x2"); 
  E_DBGR_BreakpointCheckForHalt("MEMPROT_HWIO_Run_StackUnderflow_Tests\\56+0x2");
  snprintf( chActionText, elCount(chActionText), "Verify breakpoint reached at MEMPROT_HWIO_Run_StackUnderflow_Tests\\56+0x2"); 
  snprintf( chExpectedText, elCount(chExpectedText), "Breakpoint reached at MEMPROT_HWIO_Run_StackUnderflow_Tests\\56+0x2");
  TestStepAddActionExpected( chActionText, chExpectedText );
  A_DBGR_Go();
  E_DBGR_CheckState(T32_State_Stopped);
  /***************************************************************************************************************/    
                                              // Test Step4 Reading  the fault information data
  /***************************************************************************************************************/
  snprintf( chActionText, elCount(chActionText), "Read the bWPAccessError_Happened variable value equal to 1"); 
  snprintf( chExpectedText, elCount(chExpectedText), "verify bWPAccessError_Happened variable value equal to 1");
  TestStepAddActionExpected( chActionText, chExpectedText );
  E_DBGR_VariableCheck("ME_App_Tc4xMemProt_ContxRam_Core3.TC4XMEMPROT_APP_StackUnderflow_ACCESS_ERROR_data.bWPAccessError_Happened",1,Equal);
  snprintf( chActionText, elCount(chActionText), "Read the u32WPAccessError_Address variable address equal to 1879283201"); 
  snprintf( chExpectedText, elCount(chExpectedText), "verify u32WPAccessError_Address variable address equal to 1879283201");
  TestStepAddActionExpected( chActionText, chExpectedText );
  E_DBGR_VariableCheck("ME_App_Tc4xMemProt_ContxRam_Core3.TC4XMEMPROT_APP_StackUnderflow_ACCESS_ERROR_data.u32WPAccessError_Address",1879283201,Equal);
  snprintf( chActionText, elCount(chActionText), "Read the u32WPAccessError_InstructionAddress variable value is equal to  to 2156150008"); 
  snprintf( chExpectedText, elCount(chExpectedText), "verify u32WPAccessError_InstructionAddress variable value is equal to 2156150008");
  TestStepAddActionExpected( chActionText, chExpectedText );
  E_DBGR_VariableCheck("ME_App_Tc4xMemProt_ContxRam_Core3.TC4XMEMPROT_APP_StackUnderflow_ACCESS_ERROR_data.u32WPAccessError_InstructionAddress",2156150008,Equal);
  
}
testcase To_verify_the_software_shall_report_the_status_of_the_Stack_underflow_condition_for_Core_4() 
{
  /***************************************************************************************************************/    
                                              // Test Case Info
  /***************************************************************************************************************/
  setWriteDbgLevel(DebugOff);
  snprintf( chTestTitle, elCount(chTestTitle), "To_verify_the_software_shall_report_the_status_of_the_Stack_overflow_condition_for_Core_0" );
  snprintf( chTestDescription, elCount(chTestDescription), "Purpose:To_verify_the_software_shall_report_the_status_of_the_Stack_overflow_condition_for_Core_0");
  TestCaseAddInfo( chTestTitle, "TC_L30SW_Q-36623750", chTestDescription );
  
  /***************************************************************************************************************/    
                                              // Start of Test Case
  /***************************************************************************************************************/
  
  /***************************************************************************************************************/    
                                              // Test Step 0 PRECONDITIONS
  /***************************************************************************************************************/
  snprintf( chActionText, elCount(chActionText), "Flash the Software and ECU is running "); 
  snprintf( chExpectedText, elCount(chExpectedText), "Ecu is should be in running state"); 
  TestStepAddActionExpected( chActionText, chExpectedText );
  A_DBGR_BreakpointDeleteAll();
  A_DBGR_R();

  /***************************************************************************************************************/    
                                              // Test Step 1 Add the break point_1 at core_ID 
  /***************************************************************************************************************/
  snprintf( chActionText, elCount(chActionText), "Set Breakpoint in MEMPROT_HWIO_Run_StackUnderflow_Tests\\6 Function call side"); 
  snprintf( chExpectedText, elCount(chExpectedText), "verify is Breakpoint Set MEMPROT_HWIO_Run_StackUnderflow_Tests\\6 in Function call side"); 
  A_DBGR_BreakpointSet("MEMPROT_HWIO_Run_StackUnderflow_Tests\\6");  
  A_DBGR_Go();
  
  snprintf( chActionText, elCount(chActionText), "verify Breakpoint should hit in MEMPROT_HWIO_Run_StackUnderflow_Tests\\6"); 
  snprintf( chExpectedText, elCount(chExpectedText), "Breakpoint hit in MEMPROT_HWIO_Run_StackUnderflow_Tests\\6 function"); 
  E_DBGR_BreakpointCheckForHalt("MEMPROT_HWIO_Run_StackUnderflow_Tests\\6");
  /***************************************************************************************************************/    
                                              // Test Step2 Read the coreID value 
  /***************************************************************************************************************/
  snprintf( chActionText, elCount(chActionText), "Set the Coreid variable value to 4"); 
  snprintf( chExpectedText, elCount(chExpectedText), "verify Coreid variable value to 4");
  TestStepAddActionExpected( chActionText, chExpectedText );
  E_DBGR_VariableCheck("Coreid",4,Equal);
  /***************************************************************************************************************/    
                                              // Test Step3 Keeping break point at stack overflow condition 
  /***************************************************************************************************************/
  
  snprintf( chActionText, elCount(chActionText), "Set Breakpoint in MEMPROT_HWIO_Run_StackUnderflow_Tests\\56+0x2 stack overflow condition"); 
  snprintf( chExpectedText, elCount(chExpectedText), "verify is Breakpoint Set MEMPROT_HWIO_Run_StackUnderflow_Tests\\56+0x2  stack overflow condition"); 
  TestStepAddActionExpected( chActionText, chExpectedText );
  A_DBGR_BreakpointSet("MEMPROT_HWIO_Run_StackUnderflow_Tests\\56+0x2");
  A_DBGR_Go();
  snprintf( chActionText, elCount(chActionText), "setting the Breakpoint at MEMPROT_HWIO_Run_StackUnderflow_Tests\\56+0x2"); 
  snprintf( chExpectedText, elCount(chExpectedText), "Verify Breakpoint hit in MEMPROT_HWIO_Run_StackUnderflow_Tests\\56+0x2"); 
  E_DBGR_BreakpointCheckForHalt("MEMPROT_HWIO_Run_StackUnderflow_Tests\\56+0x2");
  snprintf( chActionText, elCount(chActionText), "Verify breakpoint reached at MEMPROT_HWIO_Run_StackUnderflow_Tests\\56+0x2"); 
  snprintf( chExpectedText, elCount(chExpectedText), "Breakpoint reached at MEMPROT_HWIO_Run_StackUnderflow_Tests\\56+0x2");
  TestStepAddActionExpected( chActionText, chExpectedText );
  A_DBGR_Go();
  E_DBGR_CheckState(T32_State_Stopped);
  /***************************************************************************************************************/    
                                              // Test Step4 Reading  the fault information data
  /***************************************************************************************************************/
  snprintf( chActionText, elCount(chActionText), "Read the bWPAccessError_Happened variable value equal to 1"); 
  snprintf( chExpectedText, elCount(chExpectedText), "verify bWPAccessError_Happened variable value equal to 1");
  TestStepAddActionExpected( chActionText, chExpectedText );
  E_DBGR_VariableCheck("ME_App_Tc4xMemProt_ContxRam_Core4.TC4XMEMPROT_APP_StackUnderflow_ACCESS_ERROR_data.bWPAccessError_Happened",1,Equal);
  snprintf( chActionText, elCount(chActionText), "Read the u32WPAccessError_Address variable address equal to 1879283201"); 
  snprintf( chExpectedText, elCount(chExpectedText), "verify u32WPAccessError_Address variable address equal to 1879283201");
  TestStepAddActionExpected( chActionText, chExpectedText );
  E_DBGR_VariableCheck("ME_App_Tc4xMemProt_ContxRam_Core4.TC4XMEMPROT_APP_StackUnderflow_ACCESS_ERROR_data.u32WPAccessError_Address",1879283201,Equal);
  snprintf( chActionText, elCount(chActionText), "Read the u32WPAccessError_InstructionAddress variable value is equal to  to 2156150008"); 
  snprintf( chExpectedText, elCount(chExpectedText), "verify u32WPAccessError_InstructionAddress variable value is equal to 2156150008");
  TestStepAddActionExpected( chActionText, chExpectedText );
  E_DBGR_VariableCheck("ME_App_Tc4xMemProt_ContxRam_Core4.TC4XMEMPROT_APP_StackUnderflow_ACCESS_ERROR_data.u32WPAccessError_InstructionAddress",2156150008,Equal);
  
}
testcase To_verify_the_software_shall_report_the_status_of_the_Stack_underflow_condition_for_Core_5() 
{
  /***************************************************************************************************************/    
                                              // Test Case Info
  /***************************************************************************************************************/
  setWriteDbgLevel(DebugOff);
  snprintf( chTestTitle, elCount(chTestTitle), "To_verify_the_software_shall_report_the_status_of_the_Stack_overflow_condition_for_Core_0" );
  snprintf( chTestDescription, elCount(chTestDescription), "Purpose:To_verify_the_software_shall_report_the_status_of_the_Stack_overflow_condition_for_Core_0");
  TestCaseAddInfo( chTestTitle, "TC_L30SW_Q-36623750", chTestDescription );
  
  /***************************************************************************************************************/    
                                              // Start of Test Case
  /***************************************************************************************************************/
  
  /***************************************************************************************************************/    
                                              // Test Step 0 PRECONDITIONS
  /***************************************************************************************************************/
  snprintf( chActionText, elCount(chActionText), "Flash the Software and ECU is running "); 
  snprintf( chExpectedText, elCount(chExpectedText), "Ecu is should be in running state"); 
  TestStepAddActionExpected( chActionText, chExpectedText );
  A_DBGR_BreakpointDeleteAll();
  A_DBGR_R();

  /***************************************************************************************************************/    
                                              // Test Step 1 Add the break point_1 at core_ID 
  /***************************************************************************************************************/
  snprintf( chActionText, elCount(chActionText), "Set Breakpoint in MEMPROT_HWIO_Run_StackUnderflow_Tests\\6 Function call side"); 
  snprintf( chExpectedText, elCount(chExpectedText), "verify is Breakpoint Set MEMPROT_HWIO_Run_StackUnderflow_Tests\\6 in Function call side"); 
  A_DBGR_BreakpointSet("MEMPROT_HWIO_Run_StackUnderflow_Tests\\6");  
  A_DBGR_Go();
  
  snprintf( chActionText, elCount(chActionText), "verify Breakpoint should hit in MEMPROT_HWIO_Run_StackUnderflow_Tests\\6"); 
  snprintf( chExpectedText, elCount(chExpectedText), "Breakpoint hit in MEMPROT_HWIO_Run_StackUnderflow_Tests\\6 function"); 
  E_DBGR_BreakpointCheckForHalt("MEMPROT_HWIO_Run_StackUnderflow_Tests\\6");
  /***************************************************************************************************************/    
                                              // Test Step2 Read the coreID value 
  /***************************************************************************************************************/
  snprintf( chActionText, elCount(chActionText), "Set the Coreid variable value to 5"); 
  snprintf( chExpectedText, elCount(chExpectedText), "verify Coreid variable value to 5");
  TestStepAddActionExpected( chActionText, chExpectedText );
  E_DBGR_VariableCheck("Coreid",5,Equal);
  /***************************************************************************************************************/    
                                              // Test Step3 Keeping break point at stack overflow condition 
  /***************************************************************************************************************/
  
  snprintf( chActionText, elCount(chActionText), "Set Breakpoint in MEMPROT_HWIO_Run_StackUnderflow_Tests\\56+0x2 stack overflow condition"); 
  snprintf( chExpectedText, elCount(chExpectedText), "verify is Breakpoint Set MEMPROT_HWIO_Run_StackUnderflow_Tests\\56+0x2  stack overflow condition"); 
  TestStepAddActionExpected( chActionText, chExpectedText );
  A_DBGR_BreakpointSet("MEMPROT_HWIO_Run_StackUnderflow_Tests\\56+0x2");
  A_DBGR_Go();
  snprintf( chActionText, elCount(chActionText), "setting the Breakpoint at MEMPROT_HWIO_Run_StackUnderflow_Tests\\56+0x2"); 
  snprintf( chExpectedText, elCount(chExpectedText), "Verify Breakpoint hit in MEMPROT_HWIO_Run_StackUnderflow_Tests\\56+0x2"); 
  E_DBGR_BreakpointCheckForHalt("MEMPROT_HWIO_Run_StackUnderflow_Tests\\56+0x2");
  snprintf( chActionText, elCount(chActionText), "Verify breakpoint reached at MEMPROT_HWIO_Run_StackUnderflow_Tests\\56+0x2"); 
  snprintf( chExpectedText, elCount(chExpectedText), "Breakpoint reached at MEMPROT_HWIO_Run_StackUnderflow_Tests\\56+0x2");
  TestStepAddActionExpected( chActionText, chExpectedText );
  A_DBGR_Go();
  E_DBGR_CheckState(T32_State_Stopped);
  /***************************************************************************************************************/    
                                              // Test Step4 Reading  the fault information data
  /***************************************************************************************************************/
  snprintf( chActionText, elCount(chActionText), "Read the bWPAccessError_Happened variable value equal to 1"); 
  snprintf( chExpectedText, elCount(chExpectedText), "verify bWPAccessError_Happened variable value equal to 1");
  TestStepAddActionExpected( chActionText, chExpectedText );
  E_DBGR_VariableCheck("ME_App_Tc4xMemProt_ContxRam_Core5.TC4XMEMPROT_APP_StackUnderflow_ACCESS_ERROR_data.bWPAccessError_Happened",1,Equal);
  snprintf( chActionText, elCount(chActionText), "Read the u32WPAccessError_Address variable address equal to 1879283201"); 
  snprintf( chExpectedText, elCount(chExpectedText), "verify u32WPAccessError_Address variable address equal to 1879283201");
  TestStepAddActionExpected( chActionText, chExpectedText );
  E_DBGR_VariableCheck("ME_App_Tc4xMemProt_ContxRam_Core5.TC4XMEMPROT_APP_StackUnderflow_ACCESS_ERROR_data.u32WPAccessError_Address",1879283201,Equal);
  snprintf( chActionText, elCount(chActionText), "Read the u32WPAccessError_InstructionAddress variable value is equal to  to 2156150008"); 
  snprintf( chExpectedText, elCount(chExpectedText), "verify u32WPAccessError_InstructionAddress variable value is equal to 2156150008");
  TestStepAddActionExpected( chActionText, chExpectedText );
  E_DBGR_VariableCheck("ME_App_Tc4xMemProt_ContxRam_Core5.TC4XMEMPROT_APP_StackUnderflow_ACCESS_ERROR_data.u32WPAccessError_InstructionAddress",2156150008,Equal);
  
}
