/*@!Encoding:1252*/

includes
{
  #include "..\..\AutomationDependent\ProjectSpecific\GenLib_Includes.cin"
  #include "..\..\AutomationDependent\PowerSupply_libraries\Power_ctrl.can"
  #include "../../config.cin"
}

variables
{
  char chTestDescription[500];
  char chActionText[500];
  char chExpectedText[500];
  char chTestTitle[100];
  char canIdValue[256];
  byte dat_102[3] = {0xAA,0x55,0xAA};
  byte dat_8byte[8] =  {0x00,0x01,0x12,0xAA,0x00,0x01,0x12,0xAA};
  byte CANA_Wakeup[8] =  {0x08,0x00,0x00,0x00,0x00,0x00,0x00,0x01};
  byte CANB_Wakeup[4] =  {0x00,0x00,0x01,0x00};
  byte dat_tcno[1] =  {0xAA};
  byte dat_64byte[64] = {0xAA,0x55,0xAA,0x55,0xAA,0x55,0xAA,0x55,0xAA,0x55,0xAA,0x55,0xAA,0x55,0xAA,0x55,0xAA,0x55,0xAA,0x55,0xAA,0x55,0xAA,0x55,0xAA,0x55,0xAA,0x55,0xAA,0x55,0xAA,0x55,0xAA,0x55,0xAA,0x55,0xAA,0x55,0xAA,0x55,0xAA,0x55,0xAA,0x55,0xAA,0x55,0xAA,0x55,0xAA,0x55,0xAA,0x55,0xAA,0x55,0xAA,0x55,0xAA,0x55,0xAA,0x55,0xAA,0x55,0xAA,0x55};
  byte Output[64];
  char breakpoint[100] = "SetCANR_e_CanIfTxConfirmation\5";
  //long CANID[70] = { 0x00000401, 0x00000301, 0x00000201, 0x40000042, 0x4000039E, 0x40000211, 0x40000212, 0x4000039D, 0x4000020D, 0x4000039B, 0x4000003E, 0x400002B3, 0x40000398, 0x400000BA, 0x40000397, 0x40000270, 0x40000585, 0x4000056B, 0x4000052C, 0x400002D7, 0x40000523, 0x40000568, 0x40000522, 0x40000505, 0x40000593, 0x40000594, 0x40000582, 0x400005A4, 0x400000B6, 0x40000584, 0x400003C3, 0x400003C4, 0x400003C2, 0x400002D5, 0x400003A2, 0x400002D6, 0x4000057F, 0x40000590, 0x400005A1, 0x400005F9, 0x400000C0, 0x400002BF, 0x400003AA, 0x400003B1, 0x40000596, 0x400005C9, 0x400003A5, 0x4000003F, 0x400003A6, 0x400005D2, 0x400004F0, 0x40000599, 0x4000006F, 0x400005CA, 0x400005CB, 0x400005BA, 0x4000059B, 0x40000293, 0x400004E1, 0x400004DC, 0x400000AF, 0x400000AE, 0x40000595, 0x400005C4, 0x40000140, 0x400002D8, 0xC0000100, 0x80007000, 0x00000140, 0x00000140};
  long CANID[70] = {0x00000401, 0x00000301, 0x00000201, 0x00000042, 0x0000039E, 0x00000211, 0x00000212, 0x0000039D, 0x0000020D, 0x0000039B, 0x0000003E, 0x000002B3, 0x00000398, 0x000000BA, 0x00000397, 0x00000270, 0x00000585, 0x0000056B, 0x0000052C, 0x000002D7, 0x00000523, 0x00000568, 0x00000522, 0x00000505, 0x00000593, 0x00000594, 0x00000582, 0x000005A4, 0x000000B6, 0x00000584, 0x000003C3, 0x000003C4, 0x000003C2, 0x000002D5, 0x000003A2, 0x000002D6, 0x0000057F, 0x00000590, 0x000005A1, 0x000005F9, 0x000000C0, 0x000002BF, 0x000003AA, 0x000003B1, 0x00000596, 0x000005C9, 0x000003A5, 0x0000003F, 0x000003A6, 0x000005D2, 0x000004F0, 0x00000599, 0x0000006F, 0x000005CA, 0x000005CB, 0x000005BA, 0x0000059B, 0x00000293, 0x000004E1, 0x000004DC, 0x000000AF, 0x000000AE, 0x00000595, 0x000005C4, 0x00000140, 0x000002D8, 0xC0000100, 0x00007000, 0x00000140, 0x00000140 };
  long CANID_B[70] = {0x00000401, 0x00000301, 0x00000201, 0x00000042, 0x0000039E, 0x00000211, 0x00000212, 0x0000039D, 0x0000020D, 0x0000039B, 0x0000003E, 0x000002B3, 0x00000398, 0x000000BA, 0x00000397, 0x00000270, 0x00000585, 0x0000056B, 0x0000052C, 0x000002D7, 0x00000523, 0x00000568, 0x00000522, 0x00000505, 0x00000593, 0x00000594, 0x00000582, 0x000005A4, 0x000000B6, 0x00000584, 0x000003C3, 0x000003C4, 0x000003C2, 0x000002D5, 0x000003A2, 0x000002D6, 0x0000057F, 0x00000590, 0x000005A1, 0x000005F9, 0x000000C0, 0x000002BF, 0x000003AA, 0x000003B1, 0x00000596, 0x000005C9, 0x000003A5, 0x0000003F, 0x000003A6, 0x000005D2, 0x000004F0, 0x00000599, 0x0000006F, 0x000005CA, 0x000005CB, 0x000005BA, 0x0000059B, 0x00000293, 0x000004E1, 0x000004DC, 0x000000AF, 0x000000AE, 0x00000595, 0x000005C4, 0x00000140, 0x000002D8, 0xC0000100, 0x00007000, 0x00000140, 0x00000140 };
  //int i =0;
  int Stress =0;
  long val,cnt =0;
  int MAX_POLL_ATTEMPTS = 25;

  char variableName[256];
}

/***************************************************************************************************
----------------------------------------------------------------------------------------------------
Test case name:  ToVerify_MngCNDD_CanRxInitInterface_Initialization_with_Minimum_Message_Length_for_CANA_CAN2
----------------------------------------------------------------------------------------------------
Description:   To check NRC12 for Service 0x11

***************************************************************************************************/
testcase ToVerify_MngCNDD_CanRxInitInterface_Initialization_with_Minimum_Message_Length_for_CANA_CAN2()
{
  /***************************************************************************************************************/
                                                // Variable Definition
  /***************************************************************************************************************/



  /***************************************************************************************************************/
                                               // Local Values
  /***************************************************************************************************************/



  /***************************************************************************************************************/
                                              // Test Case Info
  /***************************************************************************************************************/
  setWriteDbgLevel(DebugOff);
  snprintf( chTestTitle, elCount(chTestTitle), "ToVerify_MngCNDD_CanRxInitInterface_Initialization_with_Minimum_Message_Length_for_CANA_CAN2" );
  snprintf( chTestDescription, elCount(chTestDescription), "Purpose:To check the  minimum lenth of CAN2 RX  ");
  TestCaseAddInfo( chTestTitle, "TC_L30SW_Q-36403603", chTestDescription );

  /***************************************************************************************************************/
                                              // Start of Test Case
  /***************************************************************************************************************/

  /***************************************************************************************************************/
                                              // Test Step 0 PRECONDITIONS
  /***************************************************************************************************************/
  snprintf( chActionText, elCount(chActionText), "Flash the Software and ECU is running ");
  snprintf( chExpectedText, elCount(chExpectedText), "Ecu is should be in running state");
  TestStepAddActionExpected( chActionText, chExpectedText );

  A_DBGR_BreakpointDeleteAll();
  A_DBGR_BreakpointSet("TestCan_Init");
  A_DBGR_R();

  snprintf( chActionText, elCount(chActionText), "Set Breakpoint in TestCan_Init ");
  snprintf( chExpectedText, elCount(chExpectedText), "verify is Breakpoint Set TestCan_Init");
  A_DBGR_BreakpointSet("TestCan_Init");

  A_DBGR_Go_Safe();
  /***************************************************************************************************************/
                                              // Test Step 1 Configure the values for the structure TsCNDD_CanCnfgType with the minimum message length for CANA.
  /***************************************************************************************************************/

  snprintf( chActionText, elCount(chActionText), "verify Breakpoint should hit in TestCan_Init ");
  snprintf( chExpectedText, elCount(chExpectedText), "Breakpoint hit in TestCan_Init function");
  E_DBGR_BreakpointCheckForHalt("TestCan_Init");

  snprintf( chActionText, elCount(chActionText), "Configure CanId values ");
  snprintf( chExpectedText, elCount(chExpectedText), "verify Configure CanId values");
  TestStepAddActionExpected( chActionText, chExpectedText );
  A_DBGR_VariableSet("VaCANR_CanRxMsgs[0].CanId","0x00000401");
  E_DBGR_VariableCheck("VaCANR_CanRxMsgs[0].CanId",0x00000401,Equal);

  snprintf( chActionText, elCount(chActionText), "Configure CanFilterMask values ");
  snprintf( chExpectedText, elCount(chExpectedText), "verify Configure CanFilterMask values");
  TestStepAddActionExpected( chActionText, chExpectedText );
  A_DBGR_VariableSet("VaCANR_CanRxMsgs[0].CanFilterMask","0x07FF");
  E_DBGR_VariableCheck("VaCANR_CanRxMsgs[0].CanFilterMask",0x07FF,Equal);

   snprintf( chActionText, elCount(chActionText), "Configure CanRxMessageIdx values ");
  snprintf( chExpectedText, elCount(chExpectedText), "verify Configure CanRxMessageIdx values");
  TestStepAddActionExpected( chActionText, chExpectedText );
  A_DBGR_VariableSet("VaCANR_CanRxMsgs[0].CanRxMessageIdx","0");
  E_DBGR_VariableCheck("VaCANR_CanRxMsgs[0].CanRxMessageIdx",0,Equal);

  snprintf( chActionText, elCount(chActionText), "Configure CanMessageLen values ");
  snprintf( chExpectedText, elCount(chExpectedText), "verify Configure CanMessageLen values");
  TestStepAddActionExpected( chActionText, chExpectedText );
  A_DBGR_VariableSet("VaCANR_CanRxMsgs[0].CanMessageLen","1");
  E_DBGR_VariableCheck("VaCANR_CanRxMsgs[0].CanMessageLen",1,Equal);

   snprintf( chActionText, elCount(chActionText), "Configure CanIdType values ");
  snprintf( chExpectedText, elCount(chExpectedText), "verify Configure CanIdType values");
  TestStepAddActionExpected( chActionText, chExpectedText );
  A_DBGR_VariableSet("VaCANR_CanRxMsgs[0].CanIdType","2");
  E_DBGR_VariableCheck("VaCANR_CanRxMsgs[0].CanIdType",2,Equal);

  snprintf( chActionText, elCount(chActionText), "Configure CanControllerId values ");
  snprintf( chExpectedText, elCount(chExpectedText), "verify Configure CanControllerId values");
  TestStepAddActionExpected( chActionText, chExpectedText );
  A_DBGR_VariableSet("VaCANR_CanRxMsgs[0].CanControllerId","0");
  E_DBGR_VariableCheck("VaCANR_CanRxMsgs[0].CanControllerId",0,Equal);

   /***************************************************************************************************************/
                                              // Test Step 2 Call the function MngCNDD_CanRxInit with the configured structure. MngCNDD_CanRxInit(&canConfigA);
  /***************************************************************************************************************/
  snprintf( chActionText, elCount(chActionText), "Set Breakpoint in MngCNDD_CanRxInit ");
  snprintf( chExpectedText, elCount(chExpectedText), "verify is Breakpoint Set MngCNDD_CanRxInit");
  TestStepAddActionExpected( chActionText, chExpectedText );

  A_DBGR_BreakpointSet("MngCNDD_CanRxInit");
  A_DBGR_Go();

  snprintf( chActionText, elCount(chActionText), "verify Breakpoint should hit in MngCNDD_CanRxInit ");
  snprintf( chExpectedText, elCount(chExpectedText), "Breakpoint hit in MngCNDD_CanRxInit function");
  E_DBGR_BreakpointCheckForHalt("MngCNDD_CanRxInit");

 /***************************************************************************************************************/
                                              // Test Step 3 Call SetCNDD_e_CanControllerMode with start mode. SetCNDD_e_CanControllerMode(0, 2); // Start mode for CAN controller 0
  /***************************************************************************************************************/
  snprintf( chActionText, elCount(chActionText), "Set Breakpoint in SetCNDD_e_CanControllerMode funtion ");
  snprintf( chExpectedText, elCount(chExpectedText), "Breakpoint is Set in SetCNDD_e_CanControllerMode");
  TestStepAddActionExpected( chActionText, chExpectedText );
  A_DBGR_BreakpointSet("SetCNDD_e_CanControllerMode");
  A_DBGR_Go();

  snprintf( chActionText, elCount(chActionText), " Verify Breakpoint should hit in SetCNDD_e_CanControllerMode ");
  snprintf( chExpectedText, elCount(chExpectedText), "Breakpoint hit in SetCNDD_e_CanControllerMode function");
  E_DBGR_BreakpointCheckForHalt("SetCNDD_e_CanControllerMode");

   /***************************************************************************************************************/
                                              // Test Step 4 set Breakpoint in SetCANR_h_CanIfRxIndication.
  /***************************************************************************************************************/
  snprintf( chActionText, elCount(chActionText), "set Breakpoint inSetCANR_h_CanIfRxIndication callback function ");
  snprintf( chExpectedText, elCount(chExpectedText), "Breakpoint is Set in SetCANR_h_CanIfRxIndication");
  TestStepAddActionExpected( chActionText, chExpectedText );
  A_DBGR_BreakpointSet("SetCANR_h_CanIfRxIndication");
  A_DBGR_Go();
  A_DBGR_Go();

  /***************************************************************************************************************/
                                              // Test Step 5 Verify that the transmitted message with minimum message length using canoe.
  /***************************************************************************************************************/
  snprintf( chActionText, elCount(chActionText), "Transmit CAN message. ID:0x00000401,PDU info:0x01");
  snprintf( chExpectedText, elCount(chExpectedText), "CAN message transmitted. ID:0x00000401,PDU info:0x01");
  A_CAN_SendMessage(0x00000401, dat_tcno, 1, 1,cc_eCAN_NORMAL);

   /***************************************************************************************************************/
                                              // Test Step 6 Verify SetCANR_h_CanIfRxIndication callback function invoked with relevant CAN_RECEIVE_MSG_INDEX, CAN_PDU_MESSAGE_ID, CAN_PDU_DATA_LENGTH, CAN_PDU_DATA_POINTER.
  /***************************************************************************************************************/
  snprintf( chActionText, elCount(chActionText), " Verify Breakpoint should hit in SetCANR_h_CanIfRxIndication ");
  snprintf( chExpectedText, elCount(chExpectedText), "Breakpoint hit in SetCANR_h_CanIfRxIndication function");
  E_DBGR_BreakpointCheckForHalt("SetCANR_h_CanIfRxIndication");

  snprintf( chActionText, elCount(chActionText), "verify CanrxmsgIdx");
  snprintf( chExpectedText, elCount(chExpectedText), "CanrxmsgIdx as 0");
  TestStepAddActionExpected( chActionText, chExpectedText );
  E_DBGR_VariableCheck("CanrxmsgIdx",0,Equal);
  snprintf( chActionText, elCount(chActionText), "Verify CanpdumsgId ");
  snprintf( chExpectedText, elCount(chExpectedText), " CanpdumsgId as 0x00000401");
  TestStepAddActionExpected( chActionText, chExpectedText );
  E_DBGR_VariableCheck("CanpdumsgId ",0x00000401,Equal);
   snprintf( chActionText, elCount(chActionText), "Verify Canpdudatalength");
  snprintf( chExpectedText, elCount(chExpectedText), "Canpdudatalength as 1");
  TestStepAddActionExpected( chActionText, chExpectedText );
  E_DBGR_VariableCheck("Canpdudatalength",1,Equal);
}




testcase Flashing()
{
sysExec("C:\\Automation\\GM_VIP_Automation\\LauterbachFlash.bat", "Commandline", "C:\\Automation\\GM_VIP_Automation");
//  write("result = %d",result);


  SysExec("python C:\\Automation\\GM_VIP_Automation\\Serial.py", "Commandline", "C:\\Users\\suresing\\AppData\\Local\\Programs\\Python\\Python313");
}

testcase To_verify_MngCNDD_CanRxInit_Interface_that_the_CAN_controller_for_CANB_CAN8_is_initialized_correctly()
{
  /***************************************************************************************************************/
                                                // Variable Definition
  /***************************************************************************************************************/



  /***************************************************************************************************************/
                                               // Local Values
  /***************************************************************************************************************/



  /***************************************************************************************************************/
                                              // Test Case Info
  /***************************************************************************************************************/
  setWriteDbgLevel(DebugOff);
  snprintf( chTestTitle, elCount(chTestTitle), "To_verify_MngCNDD_CanRxInit_Interface_that_the_CAN_controller_for_CANB_CAN8_is_initialized_correctly_and_messages_are_transmitted_as_expected" );
  snprintf( chTestDescription, elCount(chTestDescription), "Purpose:To check the RX message intialized of CAN8");
  TestCaseAddInfo( chTestTitle, "TC_L30SW_Q-36403601", chTestDescription );

  /***************************************************************************************************************/
                                              // Start of Test Case
  /***************************************************************************************************************/

  /***************************************************************************************************************/
                                              // Test Step 0 PRECONDITIONS
  /***************************************************************************************************************/
  snprintf( chActionText, elCount(chActionText), "Flash the Software and ECU is running ");
  snprintf( chExpectedText, elCount(chExpectedText), "Ecu is should be in running state");
  TestStepAddActionExpected( chActionText, chExpectedText );

  A_DBGR_BreakpointDeleteAll();
  A_DBGR_BreakpointSet("TestCan_Init");
  A_DBGR_R();
  A_DBGR_Go_Safe();
  /***************************************************************************************************************/
                                              // Test Step 1 Configure the values for the structure TsCNDD_CanCnfgType for CANB.
  /***************************************************************************************************************/

  snprintf( chActionText, elCount(chActionText), "verify Breakpoint should hit in TestCan_Init ");
  snprintf( chExpectedText, elCount(chExpectedText), "Breakpoint hit in TestCan_Init function");
  //TestStepAddActionExpected( chActionText, chExpectedText );
  E_DBGR_BreakpointCheckForHalt("TestCan_Init");

  snprintf( chActionText, elCount(chActionText), "Configure CanId values ");
  snprintf( chExpectedText, elCount(chExpectedText), "verify Configure CanId values");
  TestStepAddActionExpected( chActionText, chExpectedText );
  A_DBGR_VariableSet("VaCANR_CanRxMsgs[0].CanId","0x456");
  E_DBGR_VariableCheck("VaCANR_CanRxMsgs[0].CanId",0x456,Equal);

  snprintf( chActionText, elCount(chActionText), "Configure CanFilterMask values ");
  snprintf( chExpectedText, elCount(chExpectedText), "verify Configure CanFilterMask values");
  TestStepAddActionExpected( chActionText, chExpectedText );
  A_DBGR_VariableSet("VaCANR_CanRxMsgs[0].CanFilterMask","2047");
  E_DBGR_VariableCheck("VaCANR_CanRxMsgs[0].CanFilterMask",2047,Equal);

   snprintf( chActionText, elCount(chActionText), "Configure CanRxMessageIdx values ");
  snprintf( chExpectedText, elCount(chExpectedText), "verify Configure CanRxMessageIdx values");
  TestStepAddActionExpected( chActionText, chExpectedText );
  A_DBGR_VariableSet("VaCANR_CanRxMsgs[0].CanRxMessageIdx","0");
  E_DBGR_VariableCheck("VaCANR_CanRxMsgs[0].CanRxMessageIdx",0,Equal);

   snprintf( chActionText, elCount(chActionText), "Configure CanMessageLen values ");
  snprintf( chExpectedText, elCount(chExpectedText), "verify Configure CanMessageLen values");
  TestStepAddActionExpected( chActionText, chExpectedText );
  A_DBGR_VariableSet("VaCANR_CanRxMsgs[0].CanMessageLen","1");
  E_DBGR_VariableCheck("VaCANR_CanRxMsgs[0].CanMessageLen",1,Equal);

   snprintf( chActionText, elCount(chActionText), "Configure CanIdType values ");
  snprintf( chExpectedText, elCount(chExpectedText), "verify Configure CanIdType values");
  TestStepAddActionExpected( chActionText, chExpectedText );
  A_DBGR_VariableSet("VaCANR_CanRxMsgs[0].CanIdType","2");
  E_DBGR_VariableCheck("VaCANR_CanRxMsgs[0].CanIdType",2,Equal);

  snprintf( chActionText, elCount(chActionText), "Configure CanControllerId values ");
  snprintf( chExpectedText, elCount(chExpectedText), "verify Configure CanControllerId values");
  TestStepAddActionExpected( chActionText, chExpectedText );
  A_DBGR_VariableSet("VaCANR_CanRxMsgs[0].CanControllerId","1");
  E_DBGR_VariableCheck("VaCANR_CanRxMsgs[0].CanControllerId",1,Equal);

   /***************************************************************************************************************/
                                              // Test Step 2 Call the function MngCNDD_CanRxInit with the configured structure. MngCNDD_CanRxInit(&canConfigA);
  /***************************************************************************************************************/
  snprintf( chActionText, elCount(chActionText), "Set Breakpoint in MngCNDD_CanRxInit ");
  snprintf( chExpectedText, elCount(chExpectedText), "verify is Breakpoint Set MngCNDD_CanRxInit");
  TestStepAddActionExpected( chActionText, chExpectedText );

  //A_DBGR_R();
  A_DBGR_BreakpointSet("MngCNDD_CanRxInit");
  A_DBGR_Go();

  snprintf( chActionText, elCount(chActionText), "verify Breakpoint should hit in MngCNDD_CanRxInit ");
  snprintf( chExpectedText, elCount(chExpectedText), "Breakpoint hit in MngCNDD_CanRxInit function");
  //TestStepAddActionExpected( chActionText, chExpectedText );
  E_DBGR_BreakpointCheckForHalt("MngCNDD_CanRxInit");

 /***************************************************************************************************************/
                                              // Test Step 3 Call SetCNDD_e_CanControllerMode with start mode. SetCNDD_e_CanControllerMode(0, 2); // Start mode for CAN controller 0
  /***************************************************************************************************************/
  snprintf( chActionText, elCount(chActionText), "Set Breakpoint in SetCNDD_e_CanControllerMode funtion ");
  snprintf( chExpectedText, elCount(chExpectedText), "Breakpoint is Set in SetCNDD_e_CanControllerMode");
  TestStepAddActionExpected( chActionText, chExpectedText );
  A_DBGR_BreakpointSet("SetCNDD_e_CanControllerMode");
  A_DBGR_Go();

  snprintf( chActionText, elCount(chActionText), " Verify Breakpoint should hit in SetCNDD_e_CanControllerMode ");
  snprintf( chExpectedText, elCount(chExpectedText), "Breakpoint hit in SetCNDD_e_CanControllerMode function");
  //TestStepAddActionExpected( chActionText, chExpectedText );
  E_DBGR_BreakpointCheckForHalt("SetCNDD_e_CanControllerMode");

   /***************************************************************************************************************/
                                              // Test Step 4 set Breakpoint in SetCANR_h_CanIfRxIndication.
  /***************************************************************************************************************/
  snprintf( chActionText, elCount(chActionText), "set Breakpoint inSetCANR_h_CanIfRxIndication callback function ");
  snprintf( chExpectedText, elCount(chExpectedText), "Breakpoint is Set in SetCANR_h_CanIfRxIndication");
  TestStepAddActionExpected( chActionText, chExpectedText );
  A_DBGR_BreakpointSet("SetCANR_h_CanIfRxIndication");
  A_DBGR_Go();
  A_DBGR_Go();

  /***************************************************************************************************************/
                                              // Test Step 5 Verify that the transmitted message with minimum message length using canoe.
  /***************************************************************************************************************/
  snprintf( chActionText, elCount(chActionText), "Transmit CAN message. ID:0x401,PDU info:0x01");
  snprintf( chExpectedText, elCount(chExpectedText), "CAN message transmitted. ID:0x456,PDU info:0x01");
  //TestStepAddActionExpected( chActionText, chExpectedText );
  A_CAN_SendMessage(0x456, dat_tcno, 0x01, 2);

   /***************************************************************************************************************/
                                              // Test Step 6 Verify SetCANR_h_CanIfRxIndication callback function invoked with relevant CAN_RECEIVE_MSG_INDEX, CAN_PDU_MESSAGE_ID, CAN_PDU_DATA_LENGTH, CAN_PDU_DATA_POINTER.
  /***************************************************************************************************************/
  snprintf( chActionText, elCount(chActionText), " Verify Breakpoint should hit in SetCANR_h_CanIfRxIndication ");
  snprintf( chExpectedText, elCount(chExpectedText), "Breakpoint hit in SetCANR_h_CanIfRxIndication function");
 // TestStepAddActionExpected( chActionText, chExpectedText );
  E_DBGR_BreakpointCheckForHalt("SetCANR_h_CanIfRxIndication");

  snprintf( chActionText, elCount(chActionText), "verify CanrxmsgIdx");
  snprintf( chExpectedText, elCount(chExpectedText), "CanrxmsgIdx as 0");
  TestStepAddActionExpected( chActionText, chExpectedText );
  E_DBGR_VariableCheck("CanrxmsgIdx",0,Equal);
  snprintf( chActionText, elCount(chActionText), "Verify CanpdumsgId ");
  snprintf( chExpectedText, elCount(chExpectedText), " CanpdumsgId as 1025");
  TestStepAddActionExpected( chActionText, chExpectedText );
  E_DBGR_VariableCheck("CanpdumsgId ",0x456,Equal);
   snprintf( chActionText, elCount(chActionText), "Verify Canpdudatalength");
  snprintf( chExpectedText, elCount(chExpectedText), "Canpdudatalength as 1");
  TestStepAddActionExpected( chActionText, chExpectedText );
  E_DBGR_VariableCheck("Canpdudatalength",1,Equal);
}



testcase To_verify_MngCNDD_CanRxInit_Interface_that_the_CAN_controller_for_CANA_CAN2_and_CANB_CAN8_is_initialized_correctly()
{
  /***************************************************************************************************************/
                                                // Variable Definition
  /***************************************************************************************************************/



  /***************************************************************************************************************/
                                               // Local Values
  /***************************************************************************************************************/



  /***************************************************************************************************************/
                                              // Test Case Info
  /***************************************************************************************************************/
  setWriteDbgLevel(DebugOff);
  snprintf( chTestTitle, elCount(chTestTitle), "To_verify_MngCNDD_CanRxInit_Interface_that_the_CAN_controller_for_CANA_CAN2_and_CANB_CAN8_is_initialized_correctly_and_messages_are_transmitted_as_expected" );
  snprintf( chTestDescription, elCount(chTestDescription), "Purpose:To check the RX message intialized of CAN2 and CAN8");
  TestCaseAddInfo( chTestTitle, "TC_L30SW_Q-36403601", chTestDescription );

  /***************************************************************************************************************/
                                              // Start of Test Case
  /***************************************************************************************************************/

  /***************************************************************************************************************/
                                              // Test Step 0 PRECONDITIONS
  /***************************************************************************************************************/
  snprintf( chActionText, elCount(chActionText), "Flash the Software and ECU is running ");
  snprintf( chExpectedText, elCount(chExpectedText), "Ecu is should be in running state");
  TestStepAddActionExpected( chActionText, chExpectedText );

  A_DBGR_BreakpointDeleteAll();
  A_DBGR_R();

  snprintf( chActionText, elCount(chActionText), "Set Breakpoint in TestCan_Init ");
  snprintf( chExpectedText, elCount(chExpectedText), "verify is Breakpoint Set TestCan_Init");
  A_DBGR_BreakpointSet("TestCan_Init");

  A_DBGR_Go_Safe();
  /***************************************************************************************************************/
                                              // Test Step 1 Configure the values for the structure TsCNDD_CanCnfgType for CANB.
  /***************************************************************************************************************/

  snprintf( chActionText, elCount(chActionText), "verify Breakpoint should hit in TestCan_Init ");
  snprintf( chExpectedText, elCount(chExpectedText), "Breakpoint hit in TestCan_Init function");
  E_DBGR_BreakpointCheckForHalt("TestCan_Init");

  /**configuring CAN2 msg**/

  snprintf( chActionText, elCount(chActionText), "Configure CanId values ");
  snprintf( chExpectedText, elCount(chExpectedText), "verify Configure CanId values");
  TestStepAddActionExpected( chActionText, chExpectedText );
  A_DBGR_VariableSet("VaCANR_CanRxMsgs[0].CanId","0x456");
  E_DBGR_VariableCheck("VaCANR_CanRxMsgs[0].CanId",0x456,Equal);

  snprintf( chActionText, elCount(chActionText), "Configure CanFilterMask values ");
  snprintf( chExpectedText, elCount(chExpectedText), "verify Configure CanFilterMask values");
  TestStepAddActionExpected( chActionText, chExpectedText );
  A_DBGR_VariableSet("VaCANR_CanRxMsgs[0].CanFilterMask","2047");
  E_DBGR_VariableCheck("VaCANR_CanRxMsgs[0].CanFilterMask",2047,Equal);

   snprintf( chActionText, elCount(chActionText), "Configure CanRxMessageIdx values ");
  snprintf( chExpectedText, elCount(chExpectedText), "verify Configure CanRxMessageIdx values");
  TestStepAddActionExpected( chActionText, chExpectedText );
  A_DBGR_VariableSet("VaCANR_CanRxMsgs[0].CanRxMessageIdx","0");
  E_DBGR_VariableCheck("VaCANR_CanRxMsgs[0].CanRxMessageIdx",0,Equal);

   snprintf( chActionText, elCount(chActionText), "Configure CanMessageLen values ");
  snprintf( chExpectedText, elCount(chExpectedText), "verify Configure CanMessageLen values");
  TestStepAddActionExpected( chActionText, chExpectedText );
  A_DBGR_VariableSet("VaCANR_CanRxMsgs[0].CanMessageLen","1");
  E_DBGR_VariableCheck("VaCANR_CanRxMsgs[0].CanMessageLen",1,Equal);

   snprintf( chActionText, elCount(chActionText), "Configure CanIdType values ");
  snprintf( chExpectedText, elCount(chExpectedText), "verify Configure CanIdType values");
  TestStepAddActionExpected( chActionText, chExpectedText );
  A_DBGR_VariableSet("VaCANR_CanRxMsgs[0].CanIdType","2");
  E_DBGR_VariableCheck("VaCANR_CanRxMsgs[0].CanIdType",2,Equal);

  snprintf( chActionText, elCount(chActionText), "Configure CanControllerId values ");
  snprintf( chExpectedText, elCount(chExpectedText), "verify Configure CanControllerId values");
  TestStepAddActionExpected( chActionText, chExpectedText );
  A_DBGR_VariableSet("VaCANR_CanRxMsgs[0].CanControllerId","0");
  E_DBGR_VariableCheck("VaCANR_CanRxMsgs[0].CanControllerId",0,Equal);

  /****** configuring CAN8 msgs *****/

  snprintf( chActionText, elCount(chActionText), "Configure CanId values ");
  snprintf( chExpectedText, elCount(chExpectedText), "verify Configure CanId values");
  TestStepAddActionExpected( chActionText, chExpectedText );
  A_DBGR_VariableSet("VaCANR_CanRxMsgs[1].CanId","0x123");
  E_DBGR_VariableCheck("VaCANR_CanRxMsgs[1].CanId",0x123,Equal);

  snprintf( chActionText, elCount(chActionText), "Configure CanFilterMask values ");
  snprintf( chExpectedText, elCount(chExpectedText), "verify Configure CanFilterMask values");
  TestStepAddActionExpected( chActionText, chExpectedText );
  A_DBGR_VariableSet("VaCANR_CanRxMsgs[1].CanFilterMask","2047");
  E_DBGR_VariableCheck("VaCANR_CanRxMsgs[1].CanFilterMask",2047,Equal);

   snprintf( chActionText, elCount(chActionText), "Configure CanRxMessageIdx values ");
  snprintf( chExpectedText, elCount(chExpectedText), "verify Configure CanRxMessageIdx values");
  TestStepAddActionExpected( chActionText, chExpectedText );
  A_DBGR_VariableSet("VaCANR_CanRxMsgs[1].CanRxMessageIdx","1");
  E_DBGR_VariableCheck("VaCANR_CanRxMsgs[1].CanRxMessageIdx",1,Equal);

   snprintf( chActionText, elCount(chActionText), "Configure CanMessageLen values ");
  snprintf( chExpectedText, elCount(chExpectedText), "verify Configure CanMessageLen values");
  TestStepAddActionExpected( chActionText, chExpectedText );
  A_DBGR_VariableSet("VaCANR_CanRxMsgs[1].CanMessageLen","8");
  E_DBGR_VariableCheck("VaCANR_CanRxMsgs[1].CanMessageLen",8,Equal);

   snprintf( chActionText, elCount(chActionText), "Configure CanIdType values ");
  snprintf( chExpectedText, elCount(chExpectedText), "verify Configure CanIdType values");
  TestStepAddActionExpected( chActionText, chExpectedText );
  A_DBGR_VariableSet("VaCANR_CanRxMsgs[1].CanIdType","2");
  E_DBGR_VariableCheck("VaCANR_CanRxMsgs[1].CanIdType",2,Equal);

  snprintf( chActionText, elCount(chActionText), "Configure CanControllerId values ");
  snprintf( chExpectedText, elCount(chExpectedText), "verify Configure CanControllerId values");
  TestStepAddActionExpected( chActionText, chExpectedText );
  A_DBGR_VariableSet("VaCANR_CanRxMsgs[1].CanControllerId","1");
  E_DBGR_VariableCheck("VaCANR_CanRxMsgs[1].CanControllerId",1,Equal);

   /***************************************************************************************************************/
                                              // Test Step 2 Call the function MngCNDD_CanRxInit with the configured structure. MngCNDD_CanRxInit(&canConfigA);
  /***************************************************************************************************************/
  snprintf( chActionText, elCount(chActionText), "Set Breakpoint in MngCNDD_CanRxInit ");
  snprintf( chExpectedText, elCount(chExpectedText), "verify is Breakpoint Set MngCNDD_CanRxInit");
  TestStepAddActionExpected( chActionText, chExpectedText );

  A_DBGR_BreakpointSet("MngCNDD_CanRxInit");
  A_DBGR_Go();

  snprintf( chActionText, elCount(chActionText), "verify Breakpoint should hit in MngCNDD_CanRxInit ");
  snprintf( chExpectedText, elCount(chExpectedText), "Breakpoint hit in MngCNDD_CanRxInit function");
  E_DBGR_BreakpointCheckForHalt("MngCNDD_CanRxInit");

 /***************************************************************************************************************/
                                              // Test Step 3 Call SetCNDD_e_CanControllerMode with start mode. SetCNDD_e_CanControllerMode(0, 2); // Start mode for CAN controller 0
  /***************************************************************************************************************/
  snprintf( chActionText, elCount(chActionText), "Set Breakpoint in SetCNDD_e_CanControllerMode funtion ");
  snprintf( chExpectedText, elCount(chExpectedText), "Breakpoint is Set in SetCNDD_e_CanControllerMode");
  TestStepAddActionExpected( chActionText, chExpectedText );
  A_DBGR_BreakpointSet("SetCNDD_e_CanControllerMode");
  A_DBGR_Go();

  snprintf( chActionText, elCount(chActionText), " Verify Breakpoint should hit in SetCNDD_e_CanControllerMode ");
  snprintf( chExpectedText, elCount(chExpectedText), "Breakpoint hit in SetCNDD_e_CanControllerMode function");
  E_DBGR_BreakpointCheckForHalt("SetCNDD_e_CanControllerMode");

   /***************************************************************************************************************/
                                              // Test Step 4 set Breakpoint in SetCANR_h_CanIfRxIndication.
  /***************************************************************************************************************/
  snprintf( chActionText, elCount(chActionText), "set Breakpoint inSetCANR_h_CanIfRxIndication callback function ");
  snprintf( chExpectedText, elCount(chExpectedText), "Breakpoint is Set in SetCANR_h_CanIfRxIndication");
  TestStepAddActionExpected( chActionText, chExpectedText );
  A_DBGR_BreakpointSet("SetCANR_h_CanIfRxIndication");
  A_DBGR_Go();
  A_DBGR_Go();

  /***************************************************************************************************************/
                                              // Test Step 5 Verify that the transmitted CAN2 message using canoe.
  /***************************************************************************************************************/
  snprintf( chActionText, elCount(chActionText), "Transmit CAN message. ID:0x401,PDU info:0x01");
  snprintf( chExpectedText, elCount(chExpectedText), "CAN message transmitted. ID:0x456,PDU info:0x01");
  A_CAN_SendMessage(0x456, dat_tcno, 0x01, 1);

   /***************************************************************************************************************/
                                              // Test Step 6 Verify SetCANR_h_CanIfRxIndication callback function invoked with relevant CAN_RECEIVE_MSG_INDEX, CAN_PDU_MESSAGE_ID, CAN_PDU_DATA_LENGTH, CAN_PDU_DATA_POINTER.
  /***************************************************************************************************************/
  snprintf( chActionText, elCount(chActionText), " Verify Breakpoint should hit in SetCANR_h_CanIfRxIndication ");
  snprintf( chExpectedText, elCount(chExpectedText), "Breakpoint hit in SetCANR_h_CanIfRxIndication function");
  E_DBGR_BreakpointCheckForHalt("SetCANR_h_CanIfRxIndication");

  snprintf( chActionText, elCount(chActionText), "verify CanrxmsgIdx");
  snprintf( chExpectedText, elCount(chExpectedText), "CanrxmsgIdx as 0");
  TestStepAddActionExpected( chActionText, chExpectedText );
  E_DBGR_VariableCheck("CanrxmsgIdx",0,Equal);
  snprintf( chActionText, elCount(chActionText), "Verify CanpdumsgId ");
  snprintf( chExpectedText, elCount(chExpectedText), " CanpdumsgId as 0x456");
  TestStepAddActionExpected( chActionText, chExpectedText );
  E_DBGR_VariableCheck("CanpdumsgId ",0x456,Equal);
   snprintf( chActionText, elCount(chActionText), "Verify Canpdudatalength");
  snprintf( chExpectedText, elCount(chExpectedText), "Canpdudatalength as 1");
  TestStepAddActionExpected( chActionText, chExpectedText );
  E_DBGR_VariableCheck("Canpdudatalength",1,Equal);

  snprintf( chActionText, elCount(chActionText), "Flash the Software and ECU is running ");
  snprintf( chExpectedText, elCount(chExpectedText), "Ecu is should be in running state");
  TestStepAddActionExpected( chActionText, chExpectedText );

  A_DBGR_BreakpointDeleteAll();


  A_DBGR_Go();

  snprintf( chActionText, elCount(chActionText), "set Breakpoint inSetCANR_h_CanIfRxIndication callback function ");
  snprintf( chExpectedText, elCount(chExpectedText), "Breakpoint is Set in SetCANR_h_CanIfRxIndication");
  //TestStepAddActionExpected( chActionText, chExpectedText );
  A_DBGR_BreakpointSet("SetCANR_h_CanIfRxIndication");



  /***************************************************************************************************************/
                                              // Test Step 7 Verify that the transmitted CAN2 message using canoe.
  /***************************************************************************************************************/
  snprintf( chActionText, elCount(chActionText), "Transmit CAN message. ID:0x123,PDU info:0x01");
  snprintf( chExpectedText, elCount(chExpectedText), "CAN message transmitted. ID:0x123,PDU info:0x01");
  A_CAN_SendMessage(0x123, dat_64byte, 8, 2);

   /***************************************************************************************************************/
                                              // Test Step 6 Verify SetCANR_h_CanIfRxIndication callback function invoked with relevant CAN_RECEIVE_MSG_INDEX, CAN_PDU_MESSAGE_ID, CAN_PDU_DATA_LENGTH, CAN_PDU_DATA_POINTER.
  /***************************************************************************************************************/
  snprintf( chActionText, elCount(chActionText), " Verify Breakpoint should hit in SetCANR_h_CanIfRxIndication ");
  snprintf( chExpectedText, elCount(chExpectedText), "Breakpoint hit in SetCANR_h_CanIfRxIndication function");
  E_DBGR_BreakpointCheckForHalt("SetCANR_h_CanIfRxIndication");

  snprintf( chActionText, elCount(chActionText), "verify CanrxmsgIdx");
  snprintf( chExpectedText, elCount(chExpectedText), "CanrxmsgIdx as 1");
  TestStepAddActionExpected( chActionText, chExpectedText );
  E_DBGR_VariableCheck("CanrxmsgIdx",1,Equal);
  snprintf( chActionText, elCount(chActionText), "Verify CanpdumsgId ");
  snprintf( chExpectedText, elCount(chExpectedText), " CanpdumsgId as 0x123");
  TestStepAddActionExpected( chActionText, chExpectedText );
  E_DBGR_VariableCheck("CanpdumsgId ",0x123,Equal);
   snprintf( chActionText, elCount(chActionText), "Verify Canpdudatalength");
  snprintf( chExpectedText, elCount(chExpectedText), "Canpdudatalength as 8");
  TestStepAddActionExpected( chActionText, chExpectedText );
  E_DBGR_VariableCheck("Canpdudatalength",8,Equal);

  TestStepAddActionExpected( chActionText, chExpectedText );
  A_DBGR_Go();

}

testcase To_Verify_MngCNDD_CanRxInit_Interface_Initialization_with_Minimum_Message_Length_for_CANB_CAN8()
{
  /***************************************************************************************************************/
                                                // Variable Definition
  /***************************************************************************************************************/



  /***************************************************************************************************************/
                                               // Local Values
  /***************************************************************************************************************/



  /***************************************************************************************************************/
                                              // Test Case Info
  /***************************************************************************************************************/
  setWriteDbgLevel(DebugOff);
  snprintf( chTestTitle, elCount(chTestTitle), "To_Verify_MngCNDD_CanRxInit_Interface_Initialization_with_Minimum_Message_Length_for_CANB_CAN8" );
  snprintf( chTestDescription, elCount(chTestDescription), "Purpose:To check the RX message intialized of CAN8 with minimum Length");
  TestCaseAddInfo( chTestTitle, "TC_L30SW_Q-36403604", chTestDescription );

  /***************************************************************************************************************/
                                              // Start of Test Case
  /***************************************************************************************************************/

  /***************************************************************************************************************/
                                              // Test Step 0 PRECONDITIONS
  /***************************************************************************************************************/
  snprintf( chActionText, elCount(chActionText), "Flash the Software and ECU is running ");
  snprintf( chExpectedText, elCount(chExpectedText), "Ecu is should be in running state");
  //TestStepAddActionExpected( chActionText, chExpectedText );
  A_DBGR_BreakpointDeleteAll();
  A_DBGR_BreakpointSet("TestCan_Init");

  snprintf( chActionText, elCount(chActionText), "Flash the Software and ECU is running ");
  snprintf( chExpectedText, elCount(chExpectedText), "Ecu is should be in running state");
  A_DBGR_R();
  A_DBGR_Go_Safe();
  /***************************************************************************************************************/
                                              // Test Step 1 Configure the values for the structure TsCNDD_CanCnfgType for CANB.
  /***************************************************************************************************************/

  snprintf( chActionText, elCount(chActionText), "Set Breakpoint in TestCan_Init ");
  snprintf( chExpectedText, elCount(chExpectedText), "verify is Breakpoint Set TestCan_Init");
  //TestStepAddActionExpected( chActionText, chExpectedText );

  snprintf( chActionText, elCount(chActionText), "verify Breakpoint should hit in TestCan_Init ");
  snprintf( chExpectedText, elCount(chExpectedText), "Breakpoint hit in TestCan_Init function");

  E_DBGR_BreakpointCheckForHalt("TestCan_Init");

  snprintf( chActionText, elCount(chActionText), "Configure CanId values ");
  snprintf( chExpectedText, elCount(chExpectedText), "verify Configure CanId values");
  TestStepAddActionExpected( chActionText, chExpectedText );
  A_DBGR_VariableSet("VaCANR_CanRxMsgs[0].CanId","0x456");
  E_DBGR_VariableCheck("VaCANR_CanRxMsgs[0].CanId",0x456,Equal);

  snprintf( chActionText, elCount(chActionText), "Configure CanFilterMask values ");
  snprintf( chExpectedText, elCount(chExpectedText), "verify Configure CanFilterMask values");
  TestStepAddActionExpected( chActionText, chExpectedText );
  A_DBGR_VariableSet("VaCANR_CanRxMsgs[0].CanFilterMask","2047");
  E_DBGR_VariableCheck("VaCANR_CanRxMsgs[0].CanFilterMask",2047,Equal);

   snprintf( chActionText, elCount(chActionText), "Configure CanRxMessageIdx values ");
  snprintf( chExpectedText, elCount(chExpectedText), "verify Configure CanRxMessageIdx values");
  TestStepAddActionExpected( chActionText, chExpectedText );
  A_DBGR_VariableSet("VaCANR_CanRxMsgs[0].CanRxMessageIdx","0");
  E_DBGR_VariableCheck("VaCANR_CanRxMsgs[0].CanRxMessageIdx",0,Equal);

   snprintf( chActionText, elCount(chActionText), "Configure CanMessageLen values ");
  snprintf( chExpectedText, elCount(chExpectedText), "verify Configure CanMessageLen values");
  TestStepAddActionExpected( chActionText, chExpectedText );
  A_DBGR_VariableSet("VaCANR_CanRxMsgs[0].CanMessageLen","1");
  E_DBGR_VariableCheck("VaCANR_CanRxMsgs[0].CanMessageLen",1,Equal);

   snprintf( chActionText, elCount(chActionText), "Configure CanIdType values ");
  snprintf( chExpectedText, elCount(chExpectedText), "verify Configure CanIdType values");
  TestStepAddActionExpected( chActionText, chExpectedText );
  A_DBGR_VariableSet("VaCANR_CanRxMsgs[0].CanIdType","2");
  E_DBGR_VariableCheck("VaCANR_CanRxMsgs[0].CanIdType",2,Equal);

  snprintf( chActionText, elCount(chActionText), "Configure CanControllerId values ");
  snprintf( chExpectedText, elCount(chExpectedText), "verify Configure CanControllerId values");
  TestStepAddActionExpected( chActionText, chExpectedText );
  A_DBGR_VariableSet("VaCANR_CanRxMsgs[0].CanControllerId","1");
  E_DBGR_VariableCheck("VaCANR_CanRxMsgs[0].CanControllerId",1,Equal);

   /***************************************************************************************************************/
                                              // Test Step 2 Call the function MngCNDD_CanRxInit with the configured structure. MngCNDD_CanRxInit(&canConfigA);
  /***************************************************************************************************************/
  snprintf( chActionText, elCount(chActionText), "Set Breakpoint in MngCNDD_CanRxInit ");
  snprintf( chExpectedText, elCount(chExpectedText), "verify is Breakpoint Set MngCNDD_CanRxInit");
  TestStepAddActionExpected( chActionText, chExpectedText );

  A_DBGR_BreakpointSet("MngCNDD_CanRxInit");
  A_DBGR_Go();

  snprintf( chActionText, elCount(chActionText), "verify Breakpoint should hit in MngCNDD_CanRxInit ");
  snprintf( chExpectedText, elCount(chExpectedText), "Breakpoint hit in MngCNDD_CanRxInit function");
  E_DBGR_BreakpointCheckForHalt("MngCNDD_CanRxInit");

 /***************************************************************************************************************/
                                              // Test Step 3 Call SetCNDD_e_CanControllerMode with start mode. SetCNDD_e_CanControllerMode(0, 2); // Start mode for CAN controller 0
  /***************************************************************************************************************/
  snprintf( chActionText, elCount(chActionText), "Set Breakpoint in SetCNDD_e_CanControllerMode funtion ");
  snprintf( chExpectedText, elCount(chExpectedText), "Breakpoint is Set in SetCNDD_e_CanControllerMode");
  TestStepAddActionExpected( chActionText, chExpectedText );
  A_DBGR_BreakpointSet("SetCNDD_e_CanControllerMode");
  A_DBGR_Go();

  snprintf( chActionText, elCount(chActionText), " Verify Breakpoint should hit in SetCNDD_e_CanControllerMode ");
  snprintf( chExpectedText, elCount(chExpectedText), "Breakpoint hit in SetCNDD_e_CanControllerMode function");
  E_DBGR_BreakpointCheckForHalt("SetCNDD_e_CanControllerMode");

   /***************************************************************************************************************/
                                              // Test Step 4 set Breakpoint in SetCANR_h_CanIfRxIndication.
  /***************************************************************************************************************/
  snprintf( chActionText, elCount(chActionText), "set Breakpoint inSetCANR_h_CanIfRxIndication callback function ");
  snprintf( chExpectedText, elCount(chExpectedText), "Breakpoint is Set in SetCANR_h_CanIfRxIndication");
  TestStepAddActionExpected( chActionText, chExpectedText );
  A_DBGR_BreakpointSet("SetCANR_h_CanIfRxIndication");
  A_DBGR_Go();
  A_DBGR_Go();

  /***************************************************************************************************************/
                                              // Test Step 5 Verify that the transmitted message with minimum message length using canoe.
  /***************************************************************************************************************/
  snprintf( chActionText, elCount(chActionText), "Transmit CAN message. ID:0x401,PDU info:0x01");
  snprintf( chExpectedText, elCount(chExpectedText), "CAN message transmitted. ID:0x456,PDU info:0x01");
  A_CAN_SendMessage(0x456, dat_tcno, 0x01, 2,cc_eCAN_NORMAL);

   /***************************************************************************************************************/
                                              // Test Step 6 Verify SetCANR_h_CanIfRxIndication callback function invoked with relevant CAN_RECEIVE_MSG_INDEX, CAN_PDU_MESSAGE_ID, CAN_PDU_DATA_LENGTH, CAN_PDU_DATA_POINTER.
  /***************************************************************************************************************/
  snprintf( chActionText, elCount(chActionText), " Verify Breakpoint should hit in SetCANR_h_CanIfRxIndication ");
  snprintf( chExpectedText, elCount(chExpectedText), "Breakpoint hit in SetCANR_h_CanIfRxIndication function");
  E_DBGR_BreakpointCheckForHalt("SetCANR_h_CanIfRxIndication");

  snprintf( chActionText, elCount(chActionText), "verify CanrxmsgIdx");
  snprintf( chExpectedText, elCount(chExpectedText), "CanrxmsgIdx as 0");
  TestStepAddActionExpected( chActionText, chExpectedText );
  E_DBGR_VariableCheck("CanrxmsgIdx",0,Equal);
  snprintf( chActionText, elCount(chActionText), "Verify CanpdumsgId ");
  snprintf( chExpectedText, elCount(chExpectedText), " CanpdumsgId as 0x456");
  TestStepAddActionExpected( chActionText, chExpectedText );
  E_DBGR_VariableCheck("CanpdumsgId ",0x456,Equal);
   snprintf( chActionText, elCount(chActionText), "Verify Canpdudatalength");
  snprintf( chExpectedText, elCount(chExpectedText), "Canpdudatalength as 1");
  TestStepAddActionExpected( chActionText, chExpectedText );
  E_DBGR_VariableCheck("Canpdudatalength",1,Equal);
}




testcase To_Verify_MngCNDD_CanRxInit_Interface_Initialization_with_Maximum_Message_Length_for_CANB_CAN8()
{
  /***************************************************************************************************************/
                                                // Variable Definition
  /***************************************************************************************************************/



  /***************************************************************************************************************/
                                               // Local Values
  /***************************************************************************************************************/



  /***************************************************************************************************************/
                                              // Test Case Info
  /***************************************************************************************************************/
  setWriteDbgLevel(DebugOff);
  snprintf( chTestTitle, elCount(chTestTitle), "To_Verify_MngCNDD_CanRxInit_Interface_Initialization_with_Maximum_Message_Length_for_CANB_CAN8" );
  snprintf( chTestDescription, elCount(chTestDescription), "Purpose:To check the RX message intialized of CAN8 with maximum Length");
  TestCaseAddInfo( chTestTitle, "TC_L30SW_Q-36403605", chTestDescription );

  /***************************************************************************************************************/
                                              // Start of Test Case
  /***************************************************************************************************************/

  /***************************************************************************************************************/
                                              // Test Step 0 PRECONDITIONS
  /***************************************************************************************************************/
  snprintf( chActionText, elCount(chActionText), "Flash the Software and ECU is running ");
  snprintf( chExpectedText, elCount(chExpectedText), "Ecu is should be in running state");
  TestStepAddActionExpected( chActionText, chExpectedText );

  A_DBGR_BreakpointDeleteAll();
  A_DBGR_BreakpointSet("TestCan_Init");
  A_DBGR_R();
  A_DBGR_Go_Safe();
  /***************************************************************************************************************/
                                              // Test Step 1 Configure the values for the structure TsCNDD_CanCnfgType for CANB.
  /***************************************************************************************************************/

  snprintf( chActionText, elCount(chActionText), "Set Breakpoint in TestCan_Init ");
  snprintf( chExpectedText, elCount(chExpectedText), "verify is Breakpoint Set TestCan_Init");


  snprintf( chActionText, elCount(chActionText), "verify Breakpoint should hit in TestCan_Init ");
  snprintf( chExpectedText, elCount(chExpectedText), "Breakpoint hit in TestCan_Init function");

  E_DBGR_BreakpointCheckForHalt("TestCan_Init");

  snprintf( chActionText, elCount(chActionText), "Configure CanId values ");
  snprintf( chExpectedText, elCount(chExpectedText), "verify Configure CanId values");
  TestStepAddActionExpected( chActionText, chExpectedText );
  A_DBGR_VariableSet("VaCANR_CanRxMsgs[0].CanId","0x40000401");
  E_DBGR_VariableCheck("VaCANR_CanRxMsgs[0].CanId",0x40000401,Equal);

  snprintf( chActionText, elCount(chActionText), "Configure CanFilterMask values ");
  snprintf( chExpectedText, elCount(chExpectedText), "verify Configure CanFilterMask values");
  TestStepAddActionExpected( chActionText, chExpectedText );
  A_DBGR_VariableSet("VaCANR_CanRxMsgs[0].CanFilterMask","0x07C0");
  E_DBGR_VariableCheck("VaCANR_CanRxMsgs[0].CanFilterMask",0x07C0,Equal);

   snprintf( chActionText, elCount(chActionText), "Configure CanRxMessageIdx values ");
  snprintf( chExpectedText, elCount(chExpectedText), "verify Configure CanRxMessageIdx values");
  TestStepAddActionExpected( chActionText, chExpectedText );
  A_DBGR_VariableSet("VaCANR_CanRxMsgs[0].CanRxMessageIdx","0");
  E_DBGR_VariableCheck("VaCANR_CanRxMsgs[0].CanRxMessageIdx",0,Equal);

  snprintf( chActionText, elCount(chActionText), "Configure CanMessageLen values ");
  snprintf( chExpectedText, elCount(chExpectedText), "verify Configure CanMessageLen values");
  TestStepAddActionExpected( chActionText, chExpectedText );
  A_DBGR_VariableSet("VaCANR_CanRxMsgs[0].CanMessageLen","64");
  E_DBGR_VariableCheck("VaCANR_CanRxMsgs[0].CanMessageLen",64,Equal);

   snprintf( chActionText, elCount(chActionText), "Configure CanIdType values ");
  snprintf( chExpectedText, elCount(chExpectedText), "verify Configure CanIdType values");
  TestStepAddActionExpected( chActionText, chExpectedText );
  A_DBGR_VariableSet("VaCANR_CanRxMsgs[0].CanIdType","2");
  E_DBGR_VariableCheck("VaCANR_CanRxMsgs[0].CanIdType",2,Equal);

  snprintf( chActionText, elCount(chActionText), "Configure CanControllerId values ");
  snprintf( chExpectedText, elCount(chExpectedText), "verify Configure CanControllerId values");
  TestStepAddActionExpected( chActionText, chExpectedText );
  A_DBGR_VariableSet("VaCANR_CanRxMsgs[0].CanControllerId","1");
  E_DBGR_VariableCheck("VaCANR_CanRxMsgs[0].CanControllerId",1,Equal);

   /***************************************************************************************************************/
                                              // Test Step 2 Call the function MngCNDD_CanRxInit with the configured structure. MngCNDD_CanRxInit(&canConfigB);
  /***************************************************************************************************************/
  snprintf( chActionText, elCount(chActionText), "Set Breakpoint in MngCNDD_CanRxInit ");
  snprintf( chExpectedText, elCount(chExpectedText), "verify is Breakpoint Set MngCNDD_CanRxInit");
  TestStepAddActionExpected( chActionText, chExpectedText );

  A_DBGR_BreakpointSet("MngCNDD_CanRxInit");
  A_DBGR_Go();

  snprintf( chActionText, elCount(chActionText), "verify Breakpoint should hit in MngCNDD_CanRxInit ");
  snprintf( chExpectedText, elCount(chExpectedText), "Breakpoint hit in MngCNDD_CanRxInit function");
  E_DBGR_BreakpointCheckForHalt("MngCNDD_CanRxInit");

 /***************************************************************************************************************/
                                              // Test Step 3 Call SetCNDD_e_CanControllerMode with start mode. SetCNDD_e_CanControllerMode(0, 2); // Start mode for CAN controller 0
  /***************************************************************************************************************/
  snprintf( chActionText, elCount(chActionText), "Set Breakpoint in SetCNDD_e_CanControllerMode funtion ");
  snprintf( chExpectedText, elCount(chExpectedText), "Breakpoint is Set in SetCNDD_e_CanControllerMode");
  TestStepAddActionExpected( chActionText, chExpectedText );
  A_DBGR_BreakpointSet("SetCNDD_e_CanControllerMode");
  A_DBGR_Go();

  snprintf( chActionText, elCount(chActionText), " Verify Breakpoint should hit in SetCNDD_e_CanControllerMode ");
  snprintf( chExpectedText, elCount(chExpectedText), "Breakpoint hit in SetCNDD_e_CanControllerMode function");
  E_DBGR_BreakpointCheckForHalt("SetCNDD_e_CanControllerMode");

   /***************************************************************************************************************/
                                              // Test Step 4 set Breakpoint in SetCANR_h_CanIfRxIndication.
  /***************************************************************************************************************/
  snprintf( chActionText, elCount(chActionText), "set Breakpoint inSetCANR_h_CanIfRxIndication callback function ");
  snprintf( chExpectedText, elCount(chExpectedText), "Breakpoint is Set in SetCANR_h_CanIfRxIndication");
  TestStepAddActionExpected( chActionText, chExpectedText );
  A_DBGR_BreakpointSet("SetCANR_h_CanIfRxIndication");
  A_DBGR_Go();
  A_DBGR_Go();

  /***************************************************************************************************************/
                                              // Test Step 5 Verify that the transmitted message with minimum message length using canoe.
  /***************************************************************************************************************/
  snprintf( chActionText, elCount(chActionText), "Transmit CAN message. ID:0x401,PDU info:0x01");
  snprintf( chExpectedText, elCount(chExpectedText), "CAN message transmitted. ID:0x456,PDU info:0x01");
  A_CAN_SendMessage(0x00000401, dat_64byte, 64, 2, cc_eCAN_FD);
   /***************************************************************************************************************/
                                              // Test Step 6 Verify SetCANR_h_CanIfRxIndication callback function invoked with relevant CAN_RECEIVE_MSG_INDEX, CAN_PDU_MESSAGE_ID, CAN_PDU_DATA_LENGTH, CAN_PDU_DATA_POINTER.
  /***************************************************************************************************************/

  snprintf( chActionText, elCount(chActionText), " Verify Breakpoint should hit in SetCANR_h_CanIfRxIndication ");
  snprintf( chExpectedText, elCount(chExpectedText), "Breakpoint hit in SetCANR_h_CanIfRxIndication function");
  //TestStepAddActionExpected( chActionText, chExpectedText );
  E_DBGR_BreakpointCheckForHalt("SetCANR_h_CanIfRxIndication");

  snprintf( chActionText, elCount(chActionText), "verify CanrxmsgIdx");
  snprintf( chExpectedText, elCount(chExpectedText), "CanrxmsgIdx as 0");
  TestStepAddActionExpected( chActionText, chExpectedText );
  E_DBGR_VariableCheck("CanrxmsgIdx",0,Equal);
  snprintf( chActionText, elCount(chActionText), "Verify CanpdumsgId ");
  snprintf( chExpectedText, elCount(chExpectedText), " CanpdumsgId as 0x40000401");
  TestStepAddActionExpected( chActionText, chExpectedText );
  E_DBGR_VariableCheck("CanpdumsgId ",0x40000401,Equal);
   snprintf( chActionText, elCount(chActionText), "Verify Canpdudatalength");
  snprintf( chExpectedText, elCount(chExpectedText), "Canpdudatalength as 64");
  TestStepAddActionExpected( chActionText, chExpectedText );
  E_DBGR_VariableCheck("Canpdudatalength",64,Equal);
}



testcase To_Verify_MngCNDD_CanRxInit_Interface_Initialization_with_Maximum_Message_Length_for_CANA_CAN2()
{
    /***************************************************************************************************************/
                                                // Variable Definition
  /***************************************************************************************************************/



  /***************************************************************************************************************/
                                               // Local Values
  /***************************************************************************************************************/



  /***************************************************************************************************************/
                                              // Test Case Info
  /***************************************************************************************************************/
  setWriteDbgLevel(DebugOff);
  snprintf( chTestTitle, elCount(chTestTitle), "To_Verify_MngCNDD_CanRxInit_Interface_Initialization_with_Maximum_Message_Length_for_CANA_CAN2" );
  snprintf( chTestDescription, elCount(chTestDescription), "Purpose:To check the RX message intialized of CAN2 with maximum Length");
  TestCaseAddInfo( chTestTitle, "TC_L30SW_Q-36403606", chTestDescription );

  /***************************************************************************************************************/
                                              // Start of Test Case
  /***************************************************************************************************************/

  /***************************************************************************************************************/
                                              // Test Step 0 PRECONDITIONS
  /***************************************************************************************************************/
  snprintf( chActionText, elCount(chActionText), "Flash the Software and ECU is running ");
  snprintf( chExpectedText, elCount(chExpectedText), "Ecu is should be in running state");
  TestStepAddActionExpected( chActionText, chExpectedText );

  A_DBGR_BreakpointDeleteAll();
  A_DBGR_BreakpointSet("TestCan_Init");
  A_DBGR_R();
  A_DBGR_Go_Safe();
  /***************************************************************************************************************/
                                              // Test Step 1 Configure the values for the structure TsCNDD_CanCnfgType for CANB.
  /***************************************************************************************************************/

  snprintf( chActionText, elCount(chActionText), "Set Breakpoint in TestCan_Init ");
  snprintf( chExpectedText, elCount(chExpectedText), "verify is Breakpoint Set TestCan_Init");

  snprintf( chActionText, elCount(chActionText), "verify Breakpoint should hit in TestCan_Init ");
  snprintf( chExpectedText, elCount(chExpectedText), "Breakpoint hit in TestCan_Init function");

  E_DBGR_BreakpointCheckForHalt("TestCan_Init");

  snprintf( chActionText, elCount(chActionText), "Configure CanId values ");
  snprintf( chExpectedText, elCount(chExpectedText), "verify Configure CanId values");
  TestStepAddActionExpected( chActionText, chExpectedText );
  A_DBGR_VariableSet("VaCANR_CanRxMsgs[0].CanId","0x40000456");
  E_DBGR_VariableCheck("VaCANR_CanRxMsgs[0].CanId",0x40000456,Equal);

  snprintf( chActionText, elCount(chActionText), "Configure CanFilterMask values ");
  snprintf( chExpectedText, elCount(chExpectedText), "verify Configure CanFilterMask values");
  TestStepAddActionExpected( chActionText, chExpectedText );
  A_DBGR_VariableSet("VaCANR_CanRxMsgs[0].CanFilterMask","0x07C0");
  E_DBGR_VariableCheck("VaCANR_CanRxMsgs[0].CanFilterMask",0x07C0,Equal);

   snprintf( chActionText, elCount(chActionText), "Configure CanRxMessageIdx values ");
  snprintf( chExpectedText, elCount(chExpectedText), "verify Configure CanRxMessageIdx values");
  TestStepAddActionExpected( chActionText, chExpectedText );
  A_DBGR_VariableSet("VaCANR_CanRxMsgs[0].CanRxMessageIdx","0");
  E_DBGR_VariableCheck("VaCANR_CanRxMsgs[0].CanRxMessageIdx",0,Equal);

  snprintf( chActionText, elCount(chActionText), "Configure CanMessageLen values ");
  snprintf( chExpectedText, elCount(chExpectedText), "verify Configure CanMessageLen values");
  TestStepAddActionExpected( chActionText, chExpectedText );
  A_DBGR_VariableSet("VaCANR_CanRxMsgs[0].CanMessageLen","64");
  E_DBGR_VariableCheck("VaCANR_CanRxMsgs[0].CanMessageLen",64,Equal);

   snprintf( chActionText, elCount(chActionText), "Configure CanIdType values ");
  snprintf( chExpectedText, elCount(chExpectedText), "verify Configure CanIdType values");
  TestStepAddActionExpected( chActionText, chExpectedText );
  A_DBGR_VariableSet("VaCANR_CanRxMsgs[0].CanIdType","2");
  E_DBGR_VariableCheck("VaCANR_CanRxMsgs[0].CanIdType",2,Equal);

  snprintf( chActionText, elCount(chActionText), "Configure CanControllerId values ");
  snprintf( chExpectedText, elCount(chExpectedText), "verify Configure CanControllerId values");
  TestStepAddActionExpected( chActionText, chExpectedText );
  A_DBGR_VariableSet("VaCANR_CanRxMsgs[0].CanControllerId","0");
  E_DBGR_VariableCheck("VaCANR_CanRxMsgs[0].CanControllerId",0,Equal);

   /***************************************************************************************************************/
                                              // Test Step 2 Call the function MngCNDD_CanRxInit with the configured structure. MngCNDD_CanRxInit(&canConfigA);
  /***************************************************************************************************************/
  snprintf( chActionText, elCount(chActionText), "Set Breakpoint in MngCNDD_CanRxInit ");
  snprintf( chExpectedText, elCount(chExpectedText), "verify is Breakpoint Set MngCNDD_CanRxInit");
  TestStepAddActionExpected( chActionText, chExpectedText );

  A_DBGR_BreakpointSet("MngCNDD_CanRxInit");
  A_DBGR_Go();

  snprintf( chActionText, elCount(chActionText), "verify Breakpoint should hit in MngCNDD_CanRxInit ");
  snprintf( chExpectedText, elCount(chExpectedText), "Breakpoint hit in MngCNDD_CanRxInit function");
  E_DBGR_BreakpointCheckForHalt("MngCNDD_CanRxInit");

 /***************************************************************************************************************/
                                              // Test Step 3 Call SetCNDD_e_CanControllerMode with start mode. SetCNDD_e_CanControllerMode(0, 2); // Start mode for CAN controller 0
  /***************************************************************************************************************/
  snprintf( chActionText, elCount(chActionText), "Set Breakpoint in SetCNDD_e_CanControllerMode funtion ");
  snprintf( chExpectedText, elCount(chExpectedText), "Breakpoint is Set in SetCNDD_e_CanControllerMode");
  TestStepAddActionExpected( chActionText, chExpectedText );
  A_DBGR_BreakpointSet("SetCNDD_e_CanControllerMode");
  A_DBGR_Go();

  snprintf( chActionText, elCount(chActionText), " Verify Breakpoint should hit in SetCNDD_e_CanControllerMode ");
  snprintf( chExpectedText, elCount(chExpectedText), "Breakpoint hit in SetCNDD_e_CanControllerMode function");
  E_DBGR_BreakpointCheckForHalt("SetCNDD_e_CanControllerMode");

   /***************************************************************************************************************/
                                              // Test Step 4 set Breakpoint in SetCANR_h_CanIfRxIndication.
  /***************************************************************************************************************/
  snprintf( chActionText, elCount(chActionText), "set Breakpoint inSetCANR_h_CanIfRxIndication callback function ");
  snprintf( chExpectedText, elCount(chExpectedText), "Breakpoint is Set in SetCANR_h_CanIfRxIndication");
  TestStepAddActionExpected( chActionText, chExpectedText );
  A_DBGR_BreakpointSet("SetCANR_h_CanIfRxIndication");
  A_DBGR_Go();
  A_DBGR_Go();

  /***************************************************************************************************************/
                                              // Test Step 5 Verify that the transmitted message with minimum message length using canoe.
  /***************************************************************************************************************/
  snprintf( chActionText, elCount(chActionText), "Transmit CAN message. ID:0x401,PDU info:0x01");
  snprintf( chExpectedText, elCount(chExpectedText), "CAN message transmitted. ID:0x456,PDU info:0x01");
  A_CAN_SendMessage(0x00000456, dat_64byte, 64, 1,cc_eCAN_FD);
   /***************************************************************************************************************/
                                              // Test Step 6 Verify SetCANR_h_CanIfRxIndication callback function invoked with relevant CAN_RECEIVE_MSG_INDEX, CAN_PDU_MESSAGE_ID, CAN_PDU_DATA_LENGTH, CAN_PDU_DATA_POINTER.
  /***************************************************************************************************************/

  snprintf( chActionText, elCount(chActionText), " Verify Breakpoint should hit in SetCANR_h_CanIfRxIndication ");
  snprintf( chExpectedText, elCount(chExpectedText), "Breakpoint hit in SetCANR_h_CanIfRxIndication function");
  //TestStepAddActionExpected( chActionText, chExpectedText );
  E_DBGR_BreakpointCheckForHalt("SetCANR_h_CanIfRxIndication");

  snprintf( chActionText, elCount(chActionText), "verify CanrxmsgIdx");
  snprintf( chExpectedText, elCount(chExpectedText), "CanrxmsgIdx as 0");
  TestStepAddActionExpected( chActionText, chExpectedText );
  E_DBGR_VariableCheck("CanrxmsgIdx",0,Equal);
  snprintf( chActionText, elCount(chActionText), "Verify CanpdumsgId ");
  snprintf( chExpectedText, elCount(chExpectedText), " CanpdumsgId as 0x40000456");
  TestStepAddActionExpected( chActionText, chExpectedText );
  E_DBGR_VariableCheck("CanpdumsgId ",0x40000456,Equal);
   snprintf( chActionText, elCount(chActionText), "Verify Canpdudatalength");
  snprintf( chExpectedText, elCount(chExpectedText), "Canpdudatalength as 64");
  TestStepAddActionExpected( chActionText, chExpectedText );
  E_DBGR_VariableCheck("Canpdudatalength",64,Equal);
}



testcase To_Verify_MngCNDD_CanRxInit_Interface_Initialization_with_Extended_Message_ID_for_CANA_CAN2()
{
  /***************************************************************************************************************/
                                                // Variable Definition
  /***************************************************************************************************************/



  /***************************************************************************************************************/
                                               // Local Values
  /***************************************************************************************************************/



  /***************************************************************************************************************/
                                              // Test Case Info
  /***************************************************************************************************************/
  setWriteDbgLevel(DebugOff);
  snprintf( chTestTitle, elCount(chTestTitle), "To_Verify_MngCNDD_CanRxInit_Interface_Initialization_with_Extended_Message_ID_for_CANA_CAN2" );
  snprintf( chTestDescription, elCount(chTestDescription), "Purpose:To check the RX message intialized of CAN2 with Extended message type");
  TestCaseAddInfo( chTestTitle, "TC_L30SW_Q-36403607", chTestDescription );

  /***************************************************************************************************************/
                                              // Start of Test Case
  /***************************************************************************************************************/

  /***************************************************************************************************************/
                                              // Test Step 0 PRECONDITIONS
  /***************************************************************************************************************/
  snprintf( chActionText, elCount(chActionText), "Flash the Software and ECU is running ");
  snprintf( chExpectedText, elCount(chExpectedText), "Ecu is should be in running state");
  TestStepAddActionExpected( chActionText, chExpectedText );

  A_DBGR_BreakpointDeleteAll();
  A_DBGR_BreakpointSet("TestCan_Init");
  A_DBGR_R();
  A_DBGR_Go_Safe();
  /***************************************************************************************************************/
                                              // Test Step 1 Configure the values for the structure TsCNDD_CanCnfgType for CANB.
  /***************************************************************************************************************/

  snprintf( chActionText, elCount(chActionText), "Set Breakpoint in TestCan_Init ");
  snprintf( chExpectedText, elCount(chExpectedText), "verify is Breakpoint Set TestCan_Init");

  snprintf( chActionText, elCount(chActionText), "verify Breakpoint should hit in TestCan_Init ");
  snprintf( chExpectedText, elCount(chExpectedText), "Breakpoint hit in TestCan_Init function");

  E_DBGR_BreakpointCheckForHalt("TestCan_Init");

  snprintf( chActionText, elCount(chActionText), "Configure CanId values ");
  snprintf( chExpectedText, elCount(chExpectedText), "verify Configure CanId values");
  TestStepAddActionExpected( chActionText, chExpectedText );
  A_DBGR_VariableSet("VaCANR_CanRxMsgs[0].CanId","0x80000401");
//  E_DBGR_VariableCheck("VaCANR_CanRxMsgs[0].CanId",0x80000401,Equal);

  snprintf( chActionText, elCount(chActionText), "Configure CanFilterMask values ");
  snprintf( chExpectedText, elCount(chExpectedText), "verify Configure CanFilterMask values");
 // TestStepAddActionExpected( chActionText, chExpectedText );
  A_DBGR_VariableSet("VaCANR_CanRxMsgs[0].CanFilterMask","0x1FFFF000");
  E_DBGR_VariableCheck("VaCANR_CanRxMsgs[0].CanFilterMask",0x1FFFF000,Equal);

   snprintf( chActionText, elCount(chActionText), "Configure CanRxMessageIdx values ");
  snprintf( chExpectedText, elCount(chExpectedText), "verify Configure CanRxMessageIdx values");
  TestStepAddActionExpected( chActionText, chExpectedText );
  A_DBGR_VariableSet("VaCANR_CanRxMsgs[0].CanRxMessageIdx","0");
  E_DBGR_VariableCheck("VaCANR_CanRxMsgs[0].CanRxMessageIdx",0,Equal);

  snprintf( chActionText, elCount(chActionText), "Configure CanMessageLen values ");
  snprintf( chExpectedText, elCount(chExpectedText), "verify Configure CanMessageLen values");
  TestStepAddActionExpected( chActionText, chExpectedText );
  A_DBGR_VariableSet("VaCANR_CanRxMsgs[0].CanMessageLen","8");
  E_DBGR_VariableCheck("VaCANR_CanRxMsgs[0].CanMessageLen",8,Equal);

   snprintf( chActionText, elCount(chActionText), "Configure CanIdType values ");
  snprintf( chExpectedText, elCount(chExpectedText), "verify Configure CanIdType values");
  TestStepAddActionExpected( chActionText, chExpectedText );
  A_DBGR_VariableSet("VaCANR_CanRxMsgs[0].CanIdType","0");
  E_DBGR_VariableCheck("VaCANR_CanRxMsgs[0].CanIdType",0,Equal);

  snprintf( chActionText, elCount(chActionText), "Configure CanControllerId values ");
  snprintf( chExpectedText, elCount(chExpectedText), "verify Configure CanControllerId values");
  TestStepAddActionExpected( chActionText, chExpectedText );
  A_DBGR_VariableSet("VaCANR_CanRxMsgs[0].CanControllerId","0");
  E_DBGR_VariableCheck("VaCANR_CanRxMsgs[0].CanControllerId",0,Equal);

   /***************************************************************************************************************/
                                              // Test Step 2 Call the function MngCNDD_CanRxInit with the configured structure. MngCNDD_CanRxInit(&canConfigA);
  /***************************************************************************************************************/
  snprintf( chActionText, elCount(chActionText), "Set Breakpoint in MngCNDD_CanRxInit ");
  snprintf( chExpectedText, elCount(chExpectedText), "verify is Breakpoint Set MngCNDD_CanRxInit");
  TestStepAddActionExpected( chActionText, chExpectedText );

  A_DBGR_BreakpointSet("MngCNDD_CanRxInit");
  A_DBGR_Go();

  snprintf( chActionText, elCount(chActionText), "verify Breakpoint should hit in MngCNDD_CanRxInit ");
  snprintf( chExpectedText, elCount(chExpectedText), "Breakpoint hit in MngCNDD_CanRxInit function");
  E_DBGR_BreakpointCheckForHalt("MngCNDD_CanRxInit");

 /***************************************************************************************************************/
                                              // Test Step 3 Call SetCNDD_e_CanControllerMode with start mode. SetCNDD_e_CanControllerMode(0, 2); // Start mode for CAN controller 0
  /***************************************************************************************************************/
  snprintf( chActionText, elCount(chActionText), "Set Breakpoint in SetCNDD_e_CanControllerMode funtion ");
  snprintf( chExpectedText, elCount(chExpectedText), "Breakpoint is Set in SetCNDD_e_CanControllerMode");
  TestStepAddActionExpected( chActionText, chExpectedText );
  A_DBGR_BreakpointSet("SetCNDD_e_CanControllerMode");
  A_DBGR_Go();

  snprintf( chActionText, elCount(chActionText), " Verify Breakpoint should hit in SetCNDD_e_CanControllerMode ");
  snprintf( chExpectedText, elCount(chExpectedText), "Breakpoint hit in SetCNDD_e_CanControllerMode function");
  E_DBGR_BreakpointCheckForHalt("SetCNDD_e_CanControllerMode");

   /***************************************************************************************************************/
                                              // Test Step 4 set Breakpoint in SetCANR_h_CanIfRxIndication.
  /***************************************************************************************************************/
  snprintf( chActionText, elCount(chActionText), "set Breakpoint inSetCANR_h_CanIfRxIndication callback function ");
  snprintf( chExpectedText, elCount(chExpectedText), "Breakpoint is Set in SetCANR_h_CanIfRxIndication");
  TestStepAddActionExpected( chActionText, chExpectedText );
  A_DBGR_BreakpointSet("SetCANR_h_CanIfRxIndication");
  A_DBGR_Go();
  A_DBGR_Go();

  /***************************************************************************************************************/
                                              // Test Step 5 Verify that the transmitted message with minimum message length using canoe.
  /***************************************************************************************************************/
  snprintf( chActionText, elCount(chActionText), "Transmit CAN message. ID:0x401,PDU info:0x01");
  snprintf( chExpectedText, elCount(chExpectedText), "CAN message transmitted. ID:0x456,PDU info:0x01");
  A_CAN_SendMessage(0x80000401, dat_64byte, 8, 1);
   /***************************************************************************************************************/
                                              // Test Step 6 Verify SetCANR_h_CanIfRxIndication callback function invoked with relevant CAN_RECEIVE_MSG_INDEX, CAN_PDU_MESSAGE_ID, CAN_PDU_DATA_LENGTH, CAN_PDU_DATA_POINTER.
  /***************************************************************************************************************/

  snprintf( chActionText, elCount(chActionText), " Verify Breakpoint should hit in SetCANR_h_CanIfRxIndication ");
  snprintf( chExpectedText, elCount(chExpectedText), "Breakpoint hit in SetCANR_h_CanIfRxIndication function");
  //TestStepAddActionExpected( chActionText, chExpectedText );
  E_DBGR_BreakpointCheckForHalt("SetCANR_h_CanIfRxIndication");

  snprintf( chActionText, elCount(chActionText), "verify CanrxmsgIdx");
  snprintf( chExpectedText, elCount(chExpectedText), "CanrxmsgIdx as 0");
  TestStepAddActionExpected( chActionText, chExpectedText );
  E_DBGR_VariableCheck("CanrxmsgIdx",0,Equal);
//  snprintf( chActionText, elCount(chActionText), "Verify CanpdumsgId ");
//  snprintf( chExpectedText, elCount(chExpectedText), " CanpdumsgId as 0x80000401");
//  TestStepAddActionExpected( chActionText, chExpectedText );
//  E_DBGR_VariableCheck("CanpdumsgId ",0x80000401,Equal);
   snprintf( chActionText, elCount(chActionText), "Verify Canpdudatalength");
  snprintf( chExpectedText, elCount(chExpectedText), "Canpdudatalength as 8");
  TestStepAddActionExpected( chActionText, chExpectedText );
  E_DBGR_VariableCheck("Canpdudatalength",8,Equal);
}



testcase To_Verify_MngCNDD_CanRxInit_Interface_Initialization_with_Extended_Message_ID_for_CANB_CAN8()
{
  /***************************************************************************************************************/
                                                // Variable Definition
  /***************************************************************************************************************/



  /***************************************************************************************************************/
                                               // Local Values
  /***************************************************************************************************************/



  /***************************************************************************************************************/
                                              // Test Case Info
  /***************************************************************************************************************/
  setWriteDbgLevel(DebugOff);
  snprintf( chTestTitle, elCount(chTestTitle), "To_Verify_MngCNDD_CanRxInit_Interface_Initialization_with_Extended_Message_ID_for_CANB_CAN8" );
  snprintf( chTestDescription, elCount(chTestDescription), "Purpose:To check the RX message intialized of CAN8 with Extended message type");
  TestCaseAddInfo( chTestTitle, "TC_L30SW_Q-36403608", chTestDescription );

  /***************************************************************************************************************/
                                              // Start of Test Case
  /***************************************************************************************************************/

  /***************************************************************************************************************/
                                              // Test Step 0 PRECONDITIONS
  /***************************************************************************************************************/
  snprintf( chActionText, elCount(chActionText), "Flash the Software and ECU is running ");
  snprintf( chExpectedText, elCount(chExpectedText), "Ecu is should be in running state");
  TestStepAddActionExpected( chActionText, chExpectedText );

  A_DBGR_BreakpointDeleteAll();
  A_DBGR_BreakpointSet("TestCan_Init");
  A_DBGR_R();
  A_DBGR_Go_Safe();
  /***************************************************************************************************************/
                                              // Test Step 1 Configure the values for the structure TsCNDD_CanCnfgType for CANB.
  /***************************************************************************************************************/

  snprintf( chActionText, elCount(chActionText), "Set Breakpoint in TestCan_Init ");
  snprintf( chExpectedText, elCount(chExpectedText), "verify is Breakpoint Set TestCan_Init");


  snprintf( chActionText, elCount(chActionText), "verify Breakpoint should hit in TestCan_Init ");
  snprintf( chExpectedText, elCount(chExpectedText), "Breakpoint hit in TestCan_Init function");

  E_DBGR_BreakpointCheckForHalt("TestCan_Init");

  snprintf( chActionText, elCount(chActionText), "Configure CanId values ");
  snprintf( chExpectedText, elCount(chExpectedText), "verify Configure CanId values");
  TestStepAddActionExpected( chActionText, chExpectedText );
  A_DBGR_VariableSet("VaCANR_CanRxMsgs[0].CanId","0x80000401");
  //E_DBGR_VariableCheck("VaCANR_CanRxMsgs[0].CanId",0x80000401,Equal);

  snprintf( chActionText, elCount(chActionText), "Configure CanFilterMask values ");
  snprintf( chExpectedText, elCount(chExpectedText), "verify Configure CanFilterMask values");
  //TestStepAddActionExpected( chActionText, chExpectedText );
  A_DBGR_VariableSet("VaCANR_CanRxMsgs[0].CanFilterMask","0x1FFFF000");
  E_DBGR_VariableCheck("VaCANR_CanRxMsgs[0].CanFilterMask",0x1FFFF000,Equal);

   snprintf( chActionText, elCount(chActionText), "Configure CanRxMessageIdx values ");
  snprintf( chExpectedText, elCount(chExpectedText), "verify Configure CanRxMessageIdx values");
  TestStepAddActionExpected( chActionText, chExpectedText );
  A_DBGR_VariableSet("VaCANR_CanRxMsgs[0].CanRxMessageIdx","0");
  E_DBGR_VariableCheck("VaCANR_CanRxMsgs[0].CanRxMessageIdx",0,Equal);

  snprintf( chActionText, elCount(chActionText), "Configure CanMessageLen values ");
  snprintf( chExpectedText, elCount(chExpectedText), "verify Configure CanMessageLen values");
  TestStepAddActionExpected( chActionText, chExpectedText );
  A_DBGR_VariableSet("VaCANR_CanRxMsgs[0].CanMessageLen","8");
  E_DBGR_VariableCheck("VaCANR_CanRxMsgs[0].CanMessageLen",8,Equal);

   snprintf( chActionText, elCount(chActionText), "Configure CanIdType values ");
  snprintf( chExpectedText, elCount(chExpectedText), "verify Configure CanIdType values");
  TestStepAddActionExpected( chActionText, chExpectedText );
  A_DBGR_VariableSet("VaCANR_CanRxMsgs[0].CanIdType","0");
  E_DBGR_VariableCheck("VaCANR_CanRxMsgs[0].CanIdType",0,Equal);

  snprintf( chActionText, elCount(chActionText), "Configure CanControllerId values ");
  snprintf( chExpectedText, elCount(chExpectedText), "verify Configure CanControllerId values");
  TestStepAddActionExpected( chActionText, chExpectedText );
  A_DBGR_VariableSet("VaCANR_CanRxMsgs[0].CanControllerId","1");
  E_DBGR_VariableCheck("VaCANR_CanRxMsgs[0].CanControllerId",1,Equal);

   /***************************************************************************************************************/
                                              // Test Step 2 Call the function MngCNDD_CanRxInit with the configured structure. MngCNDD_CanRxInit(&canConfigA);
  /***************************************************************************************************************/
  snprintf( chActionText, elCount(chActionText), "Set Breakpoint in MngCNDD_CanRxInit ");
  snprintf( chExpectedText, elCount(chExpectedText), "verify is Breakpoint Set MngCNDD_CanRxInit");
  TestStepAddActionExpected( chActionText, chExpectedText );

  A_DBGR_BreakpointSet("MngCNDD_CanRxInit");
  A_DBGR_Go();

  snprintf( chActionText, elCount(chActionText), "verify Breakpoint should hit in MngCNDD_CanRxInit ");
  snprintf( chExpectedText, elCount(chExpectedText), "Breakpoint hit in MngCNDD_CanRxInit function");
  E_DBGR_BreakpointCheckForHalt("MngCNDD_CanRxInit");

 /***************************************************************************************************************/
                                              // Test Step 3 Call SetCNDD_e_CanControllerMode with start mode. SetCNDD_e_CanControllerMode(0, 2); // Start mode for CAN controller 0
  /***************************************************************************************************************/
  snprintf( chActionText, elCount(chActionText), "Set Breakpoint in SetCNDD_e_CanControllerMode funtion ");
  snprintf( chExpectedText, elCount(chExpectedText), "Breakpoint is Set in SetCNDD_e_CanControllerMode");
  TestStepAddActionExpected( chActionText, chExpectedText );
  A_DBGR_BreakpointSet("SetCNDD_e_CanControllerMode");
  A_DBGR_Go();

  snprintf( chActionText, elCount(chActionText), " Verify Breakpoint should hit in SetCNDD_e_CanControllerMode ");
  snprintf( chExpectedText, elCount(chExpectedText), "Breakpoint hit in SetCNDD_e_CanControllerMode function");
  E_DBGR_BreakpointCheckForHalt("SetCNDD_e_CanControllerMode");

   /***************************************************************************************************************/
                                              // Test Step 4 set Breakpoint in SetCANR_h_CanIfRxIndication.
  /***************************************************************************************************************/
  snprintf( chActionText, elCount(chActionText), "set Breakpoint inSetCANR_h_CanIfRxIndication callback function ");
  snprintf( chExpectedText, elCount(chExpectedText), "Breakpoint is Set in SetCANR_h_CanIfRxIndication");
  TestStepAddActionExpected( chActionText, chExpectedText );
  A_DBGR_BreakpointSet("SetCANR_h_CanIfRxIndication");
  A_DBGR_Go();
  A_DBGR_Go();

  /***************************************************************************************************************/
                                              // Test Step 5 Verify that the transmitted message with minimum message length using canoe.
  /***************************************************************************************************************/
  snprintf( chActionText, elCount(chActionText), "Transmit CAN message. ID:0x401,PDU info:0x01");
  snprintf( chExpectedText, elCount(chExpectedText), "CAN message transmitted. ID:0x456,PDU info:0x01");
  A_CAN_SendMessage(0x80000401, dat_64byte, 8, 2);
   /***************************************************************************************************************/
                                              // Test Step 6 Verify SetCANR_h_CanIfRxIndication callback function invoked with relevant CAN_RECEIVE_MSG_INDEX, CAN_PDU_MESSAGE_ID, CAN_PDU_DATA_LENGTH, CAN_PDU_DATA_POINTER.
  /***************************************************************************************************************/

  snprintf( chActionText, elCount(chActionText), " Verify Breakpoint should hit in SetCANR_h_CanIfRxIndication ");
  snprintf( chExpectedText, elCount(chExpectedText), "Breakpoint hit in SetCANR_h_CanIfRxIndication function");
  //TestStepAddActionExpected( chActionText, chExpectedText );
  E_DBGR_BreakpointCheckForHalt("SetCANR_h_CanIfRxIndication");

  snprintf( chActionText, elCount(chActionText), "verify CanrxmsgIdx");
  snprintf( chExpectedText, elCount(chExpectedText), "CanrxmsgIdx as 0");
  TestStepAddActionExpected( chActionText, chExpectedText );
  E_DBGR_VariableCheck("CanrxmsgIdx",0,Equal);
//  snprintf( chActionText, elCount(chActionText), "Verify CanpdumsgId ");
//  snprintf( chExpectedText, elCount(chExpectedText), " CanpdumsgId as 0x80000401");
//  TestStepAddActionExpected( chActionText, chExpectedText );
//  E_DBGR_VariableCheck("CanpdumsgId ",0x80000401,Equal);
   snprintf( chActionText, elCount(chActionText), "Verify Canpdudatalength");
  snprintf( chExpectedText, elCount(chExpectedText), "Canpdudatalength as 8");
  TestStepAddActionExpected( chActionText, chExpectedText );
  E_DBGR_VariableCheck("Canpdudatalength",8,Equal);
}



testcase To_Verify_MngCNDD_CanRxInit_Interface_Initialization_with_Standard_Message_ID_for_CANA_CAN2()
{
  /***************************************************************************************************************/
                                                // Variable Definition
  /***************************************************************************************************************/



  /***************************************************************************************************************/
                                               // Local Values
  /***************************************************************************************************************/



  /***************************************************************************************************************/
                                              // Test Case Info
  /***************************************************************************************************************/
  setWriteDbgLevel(DebugOff);
  snprintf( chTestTitle, elCount(chTestTitle), "To_Verify_MngCNDD_CanRxInit_Interface_Initialization_with_Standard_Message_ID_for_CANA_CAN2" );
  snprintf( chTestDescription, elCount(chTestDescription), "Purpose:To check the Standard type of CAN2 RX  ");
  TestCaseAddInfo( chTestTitle, "TC_L30SW_Q-36403609", chTestDescription );

  /***************************************************************************************************************/
                                              // Start of Test Case
  /***************************************************************************************************************/

  /***************************************************************************************************************/
                                              // Test Step 0 PRECONDITIONS
  /***************************************************************************************************************/
  snprintf( chActionText, elCount(chActionText), "Flash the Software and ECU is running ");
  snprintf( chExpectedText, elCount(chExpectedText), "Ecu is should be in running state");
  TestStepAddActionExpected( chActionText, chExpectedText );

  A_DBGR_BreakpointDeleteAll();
  A_DBGR_BreakpointSet("TestCan_Init");
  A_DBGR_R();
  A_DBGR_Go_Safe();


  /***************************************************************************************************************/
                                              // Test Step 1 Configure the values for the structure TsCNDD_CanCnfgType with the minimum message length for CANA. TsCNDD_CanCntrlrType canControllerA = {0, 1}; // CAN controller ID 0, Enabled TsCNDD_CanRxMessageType canRxMsgsA = { {0x123, 0x7FF, 0, 1, 2, 0} // Standard ID, 1 byte }; TsCNDD_CanCnfgSetType canConfigSetA = {&canControllerA, canRxMsgsA, 1}; TsCNDD_CanCnfgType canConfigA = {&canConfigSetA, 1};
  /***************************************************************************************************************/
  snprintf( chActionText, elCount(chActionText), "Set Breakpoint in TestCan_Init ");
  snprintf( chExpectedText, elCount(chExpectedText), "verify is Breakpoint Set TestCan_Init");

  snprintf( chActionText, elCount(chActionText), "verify Breakpoint should hit in TestCan_Init ");
  snprintf( chExpectedText, elCount(chExpectedText), "Breakpoint hit in TestCan_Init function");

  E_DBGR_BreakpointCheckForHalt("TestCan_Init");

  snprintf( chActionText, elCount(chActionText), "Configure CanId values ");
  snprintf( chExpectedText, elCount(chExpectedText), "verify Configure CanId values");
  TestStepAddActionExpected( chActionText, chExpectedText );
  E_DBGR_VariableCheck("VaCANR_CanRxMsgs[0].CanId",1025,Equal);
  snprintf( chActionText, elCount(chActionText), "Configure CanFilterMask values ");
  snprintf( chExpectedText, elCount(chExpectedText), "verify Configure CanFilterMask values");
  TestStepAddActionExpected( chActionText, chExpectedText );
  E_DBGR_VariableCheck("VaCANR_CanRxMsgs[0].CanFilterMask",2047,Equal);
   snprintf( chActionText, elCount(chActionText), "Configure CanRxMessageIdx values ");
  snprintf( chExpectedText, elCount(chExpectedText), "verify Configure CanRxMessageIdx values");
  TestStepAddActionExpected( chActionText, chExpectedText );
  E_DBGR_VariableCheck("VaCANR_CanRxMsgs[0].CanRxMessageIdx",0,Equal);
   snprintf( chActionText, elCount(chActionText), "Configure CanMessageLen values ");
  snprintf( chExpectedText, elCount(chExpectedText), "verify Configure CanMessageLen values");
  TestStepAddActionExpected( chActionText, chExpectedText );
  E_DBGR_VariableCheck("VaCANR_CanRxMsgs[0].CanMessageLen",1,Equal);
   snprintf( chActionText, elCount(chActionText), "Configure CanIdType values ");
  snprintf( chExpectedText, elCount(chExpectedText), "verify Configure CanIdType values");
  TestStepAddActionExpected( chActionText, chExpectedText );
  E_DBGR_VariableCheck("VaCANR_CanRxMsgs[0].CanIdType",2,Equal);
   snprintf( chActionText, elCount(chActionText), "Configure CanControllerId values ");
  snprintf( chExpectedText, elCount(chExpectedText), "verify Configure CanControllerId values");
  TestStepAddActionExpected( chActionText, chExpectedText );
  E_DBGR_VariableCheck("VaCANR_CanRxMsgs[0].CanControllerId",0,Equal);

   /***************************************************************************************************************/
                                              // Test Step 2 Call the function MngCNDD_CanRxInit with the configured structure. MngCNDD_CanRxInit(&canConfigA);
  /***************************************************************************************************************/
  snprintf( chActionText, elCount(chActionText), "Set Breakpoint in MngCNDD_CanRxInit ");
  snprintf( chExpectedText, elCount(chExpectedText), "verify is Breakpoint Set MngCNDD_CanRxInit");
  TestStepAddActionExpected( chActionText, chExpectedText );

 // A_DBGR_R();
  A_DBGR_BreakpointSet("MngCNDD_CanRxInit");
  A_DBGR_Go();

  snprintf( chActionText, elCount(chActionText), "verify Breakpoint should hit in MngCNDD_CanRxInit ");
  snprintf( chExpectedText, elCount(chExpectedText), "Breakpoint hit in MngCNDD_CanRxInit function");
  //TestStepAddActionExpected( chActionText, chExpectedText );
  E_DBGR_BreakpointCheckForHalt("MngCNDD_CanRxInit");

 /***************************************************************************************************************/
                                              // Test Step 3 Call SetCNDD_e_CanControllerMode with start mode. SetCNDD_e_CanControllerMode(0, 2); // Start mode for CAN controller 0
  /***************************************************************************************************************/
  snprintf( chActionText, elCount(chActionText), "Set Breakpoint in SetCNDD_e_CanControllerMode funtion ");
  snprintf( chExpectedText, elCount(chExpectedText), "Breakpoint is Set in SetCNDD_e_CanControllerMode");
  TestStepAddActionExpected( chActionText, chExpectedText );
  A_DBGR_BreakpointSet("SetCNDD_e_CanControllerMode");
  A_DBGR_Go();

  snprintf( chActionText, elCount(chActionText), " Verify Breakpoint should hit in SetCNDD_e_CanControllerMode ");
  snprintf( chExpectedText, elCount(chExpectedText), "Breakpoint hit in SetCNDD_e_CanControllerMode function");
  //TestStepAddActionExpected( chActionText, chExpectedText );
  E_DBGR_BreakpointCheckForHalt("SetCNDD_e_CanControllerMode");

   /***************************************************************************************************************/
                                              // Test Step 4 set Breakpoint in SetCANR_h_CanIfRxIndication.
  /***************************************************************************************************************/
  snprintf( chActionText, elCount(chActionText), "set Breakpoint inSetCANR_h_CanIfRxIndication callback function ");
  snprintf( chExpectedText, elCount(chExpectedText), "Breakpoint is Set in SetCANR_h_CanIfRxIndication");
  TestStepAddActionExpected( chActionText, chExpectedText );
  A_DBGR_BreakpointSet("SetCANR_h_CanIfRxIndication");
  A_DBGR_Go();
  A_DBGR_Go();

  /***************************************************************************************************************/
                                              // Test Step 5 Verify that the transmitted message with minimum message length using canoe.
  /***************************************************************************************************************/
  snprintf( chActionText, elCount(chActionText), "Transmit CAN message. ID:0x401,PDU info:0x01");
  snprintf( chExpectedText, elCount(chExpectedText), "CAN message transmitted. ID:0x401,PDU info:0x01");
  //TestStepAddActionExpected( chActionText, chExpectedText );
  A_CAN_SendMessage(1025, dat_tcno, 0x01, 1);

   /***************************************************************************************************************/
                                              // Test Step 6 Verify SetCANR_h_CanIfRxIndication callback function invoked with relevant CAN_RECEIVE_MSG_INDEX, CAN_PDU_MESSAGE_ID, CAN_PDU_DATA_LENGTH, CAN_PDU_DATA_POINTER.
  /***************************************************************************************************************/
  snprintf( chActionText, elCount(chActionText), " Verify Breakpoint should hit in SetCANR_h_CanIfRxIndication ");
  snprintf( chExpectedText, elCount(chExpectedText), "Breakpoint hit in SetCANR_h_CanIfRxIndication function");
 // TestStepAddActionExpected( chActionText, chExpectedText );
  E_DBGR_BreakpointCheckForHalt("SetCANR_h_CanIfRxIndication");

  snprintf( chActionText, elCount(chActionText), "verify CanrxmsgIdx");
  snprintf( chExpectedText, elCount(chExpectedText), "CanrxmsgIdx as 0");
  TestStepAddActionExpected( chActionText, chExpectedText );
  E_DBGR_VariableCheck("CanrxmsgIdx",0,Equal);
  snprintf( chActionText, elCount(chActionText), "Verify CanpdumsgId ");
  snprintf( chExpectedText, elCount(chExpectedText), " CanpdumsgId as 1025");
  TestStepAddActionExpected( chActionText, chExpectedText );
  E_DBGR_VariableCheck("CanpdumsgId ",1025,Equal);
   snprintf( chActionText, elCount(chActionText), "Verify Canpdudatalength");
  snprintf( chExpectedText, elCount(chExpectedText), "Canpdudatalength as 1");
  TestStepAddActionExpected( chActionText, chExpectedText );
  E_DBGR_VariableCheck("Canpdudatalength",1,Equal);
}



testcase To_Verify_MngCNDD_CanRxInit_Interface_Initialization_with_Standard_Message_ID_for_CANB_CAN8()
{
  /***************************************************************************************************************/
                                                // Variable Definition
  /***************************************************************************************************************/



  /***************************************************************************************************************/
                                               // Local Values
  /***************************************************************************************************************/



  /***************************************************************************************************************/
                                              // Test Case Info
  /***************************************************************************************************************/
  setWriteDbgLevel(DebugOff);
  snprintf( chTestTitle, elCount(chTestTitle), "To_Verify_MngCNDD_CanRxInit_Interface_Initialization_with_Standard_Message_ID_for_CANB_CAN8" );
  snprintf( chTestDescription, elCount(chTestDescription), "Purpose:To check the Standard type of CAN8 RX  ");
  TestCaseAddInfo( chTestTitle, "TC_L30SW_Q-36403610", chTestDescription );

  /***************************************************************************************************************/
                                              // Start of Test Case
  /***************************************************************************************************************/

  /***************************************************************************************************************/
                                              // Test Step 0 PRECONDITIONS
  /***************************************************************************************************************/
  snprintf( chActionText, elCount(chActionText), "Flash the Software and ECU is running ");
  snprintf( chExpectedText, elCount(chExpectedText), "Ecu is should be in running state");
  TestStepAddActionExpected( chActionText, chExpectedText );

  A_DBGR_BreakpointDeleteAll();
  A_DBGR_BreakpointSet("TestCan_Init");
  A_DBGR_R();
  A_DBGR_Go_Safe();
  /***************************************************************************************************************/
                                              // Test Step 1 Configure the values for the structure TsCNDD_CanCnfgType for CANB.
  /***************************************************************************************************************/

  snprintf( chActionText, elCount(chActionText), "Set Breakpoint in TestCan_Init ");
  snprintf( chExpectedText, elCount(chExpectedText), "verify is Breakpoint Set TestCan_Init");
  //TestStepAddActionExpected( chActionText, chExpectedText );

  snprintf( chActionText, elCount(chActionText), "verify Breakpoint should hit in TestCan_Init ");
  snprintf( chExpectedText, elCount(chExpectedText), "Breakpoint hit in TestCan_Init function");
  //TestStepAddActionExpected( chActionText, chExpectedText );
  E_DBGR_BreakpointCheckForHalt("TestCan_Init");

  snprintf( chActionText, elCount(chActionText), "Configure CanId values ");
  snprintf( chExpectedText, elCount(chExpectedText), "verify Configure CanId values");
  TestStepAddActionExpected( chActionText, chExpectedText );
  A_DBGR_VariableSet("VaCANR_CanRxMsgs[0].CanId","0x456");
  E_DBGR_VariableCheck("VaCANR_CanRxMsgs[0].CanId",0x456,Equal);

  snprintf( chActionText, elCount(chActionText), "Configure CanFilterMask values ");
  snprintf( chExpectedText, elCount(chExpectedText), "verify Configure CanFilterMask values");
  TestStepAddActionExpected( chActionText, chExpectedText );
  A_DBGR_VariableSet("VaCANR_CanRxMsgs[0].CanFilterMask","2047");
  E_DBGR_VariableCheck("VaCANR_CanRxMsgs[0].CanFilterMask",2047,Equal);

   snprintf( chActionText, elCount(chActionText), "Configure CanRxMessageIdx values ");
  snprintf( chExpectedText, elCount(chExpectedText), "verify Configure CanRxMessageIdx values");
  TestStepAddActionExpected( chActionText, chExpectedText );
  A_DBGR_VariableSet("VaCANR_CanRxMsgs[0].CanRxMessageIdx","0");
  E_DBGR_VariableCheck("VaCANR_CanRxMsgs[0].CanRxMessageIdx",0,Equal);

   snprintf( chActionText, elCount(chActionText), "Configure CanMessageLen values ");
  snprintf( chExpectedText, elCount(chExpectedText), "verify Configure CanMessageLen values");
  TestStepAddActionExpected( chActionText, chExpectedText );
  A_DBGR_VariableSet("VaCANR_CanRxMsgs[0].CanMessageLen","1");
  E_DBGR_VariableCheck("VaCANR_CanRxMsgs[0].CanMessageLen",1,Equal);

   snprintf( chActionText, elCount(chActionText), "Configure CanIdType values ");
  snprintf( chExpectedText, elCount(chExpectedText), "verify Configure CanIdType values");
  TestStepAddActionExpected( chActionText, chExpectedText );
  A_DBGR_VariableSet("VaCANR_CanRxMsgs[0].CanIdType","2");
  E_DBGR_VariableCheck("VaCANR_CanRxMsgs[0].CanIdType",2,Equal);

  snprintf( chActionText, elCount(chActionText), "Configure CanControllerId values ");
  snprintf( chExpectedText, elCount(chExpectedText), "verify Configure CanControllerId values");
  TestStepAddActionExpected( chActionText, chExpectedText );
  A_DBGR_VariableSet("VaCANR_CanRxMsgs[0].CanControllerId","1");
  E_DBGR_VariableCheck("VaCANR_CanRxMsgs[0].CanControllerId",1,Equal);

   /***************************************************************************************************************/
                                              // Test Step 2 Call the function MngCNDD_CanRxInit with the configured structure. MngCNDD_CanRxInit(&canConfigA);
  /***************************************************************************************************************/
  snprintf( chActionText, elCount(chActionText), "Set Breakpoint in MngCNDD_CanRxInit ");
  snprintf( chExpectedText, elCount(chExpectedText), "verify is Breakpoint Set MngCNDD_CanRxInit");
  TestStepAddActionExpected( chActionText, chExpectedText );

  //A_DBGR_R();
  A_DBGR_BreakpointSet("MngCNDD_CanRxInit");
  A_DBGR_Go();

  snprintf( chActionText, elCount(chActionText), "verify Breakpoint should hit in MngCNDD_CanRxInit ");
  snprintf( chExpectedText, elCount(chExpectedText), "Breakpoint hit in MngCNDD_CanRxInit function");
  //TestStepAddActionExpected( chActionText, chExpectedText );
  E_DBGR_BreakpointCheckForHalt("MngCNDD_CanRxInit");

 /***************************************************************************************************************/
                                              // Test Step 3 Call SetCNDD_e_CanControllerMode with start mode. SetCNDD_e_CanControllerMode(0, 2); // Start mode for CAN controller 0
  /***************************************************************************************************************/
  snprintf( chActionText, elCount(chActionText), "Set Breakpoint in SetCNDD_e_CanControllerMode funtion ");
  snprintf( chExpectedText, elCount(chExpectedText), "Breakpoint is Set in SetCNDD_e_CanControllerMode");
  TestStepAddActionExpected( chActionText, chExpectedText );
  A_DBGR_BreakpointSet("SetCNDD_e_CanControllerMode");
  A_DBGR_Go();

  snprintf( chActionText, elCount(chActionText), " Verify Breakpoint should hit in SetCNDD_e_CanControllerMode ");
  snprintf( chExpectedText, elCount(chExpectedText), "Breakpoint hit in SetCNDD_e_CanControllerMode function");
  //TestStepAddActionExpected( chActionText, chExpectedText );
  E_DBGR_BreakpointCheckForHalt("SetCNDD_e_CanControllerMode");

   /***************************************************************************************************************/
                                              // Test Step 4 set Breakpoint in SetCANR_h_CanIfRxIndication.
  /***************************************************************************************************************/
  snprintf( chActionText, elCount(chActionText), "set Breakpoint inSetCANR_h_CanIfRxIndication callback function ");
  snprintf( chExpectedText, elCount(chExpectedText), "Breakpoint is Set in SetCANR_h_CanIfRxIndication");
  TestStepAddActionExpected( chActionText, chExpectedText );
  A_DBGR_BreakpointSet("SetCANR_h_CanIfRxIndication");
  A_DBGR_Go();
  A_DBGR_Go();

  /***************************************************************************************************************/
                                              // Test Step 5 Verify that the transmitted message with minimum message length using canoe.
  /***************************************************************************************************************/
  snprintf( chActionText, elCount(chActionText), "Transmit CAN message. ID:0x401,PDU info:0x01");
  snprintf( chExpectedText, elCount(chExpectedText), "CAN message transmitted. ID:0x456,PDU info:0x01");
  //TestStepAddActionExpected( chActionText, chExpectedText );
  A_CAN_SendMessage(0x456, dat_tcno, 0x01, 2);

   /***************************************************************************************************************/
                                              // Test Step 6 Verify SetCANR_h_CanIfRxIndication callback function invoked with relevant CAN_RECEIVE_MSG_INDEX, CAN_PDU_MESSAGE_ID, CAN_PDU_DATA_LENGTH, CAN_PDU_DATA_POINTER.
  /***************************************************************************************************************/
  snprintf( chActionText, elCount(chActionText), " Verify Breakpoint should hit in SetCANR_h_CanIfRxIndication ");
  snprintf( chExpectedText, elCount(chExpectedText), "Breakpoint hit in SetCANR_h_CanIfRxIndication function");
 // TestStepAddActionExpected( chActionText, chExpectedText );
  E_DBGR_BreakpointCheckForHalt("SetCANR_h_CanIfRxIndication");

  snprintf( chActionText, elCount(chActionText), "verify CanrxmsgIdx");
  snprintf( chExpectedText, elCount(chExpectedText), "CanrxmsgIdx as 0");
  TestStepAddActionExpected( chActionText, chExpectedText );
  E_DBGR_VariableCheck("CanrxmsgIdx",0,Equal);
  snprintf( chActionText, elCount(chActionText), "Verify CanpdumsgId ");
  snprintf( chExpectedText, elCount(chExpectedText), " CanpdumsgId as 1025");
  TestStepAddActionExpected( chActionText, chExpectedText );
  E_DBGR_VariableCheck("CanpdumsgId ",0x456,Equal);
   snprintf( chActionText, elCount(chActionText), "Verify Canpdudatalength");
  snprintf( chExpectedText, elCount(chExpectedText), "Canpdudatalength as 1");
  TestStepAddActionExpected( chActionText, chExpectedText );
  E_DBGR_VariableCheck("Canpdudatalength",1,Equal);
}



testcase To_verify_the_Interface_CntrlCNDD_h_CanWrt_Transmission_with_Maximum_Message_Length_on_CANB_CAN8()
{
  /***************************************************************************************************************/
                                                // Variable Definition
  /***************************************************************************************************************/



  /***************************************************************************************************************/
                                               // Local Values
  /***************************************************************************************************************/



  /***************************************************************************************************************/
                                              // Test Case Info
  /***************************************************************************************************************/
  setWriteDbgLevel(DebugOff);
  snprintf( chTestTitle, elCount(chTestTitle), "To_verify_the_Interface_CntrlCNDD_h_CanWrt_Transmission_with_Maximum_Message_Length_on_CANB_CAN8" );
  snprintf( chTestDescription, elCount(chTestDescription), "Purpose:To check the CntrlCNDD_h_CanWrt interface CAN8 for TX msgs  ");
  TestCaseAddInfo( chTestTitle, "TC_L30SW_Q-36403599", chTestDescription );

  /***************************************************************************************************************/
                                              // Start of Test Case
  /***************************************************************************************************************/

  /***************************************************************************************************************/
                                              // Test Step 0 PRECONDITIONS
  /***************************************************************************************************************/
  snprintf( chActionText, elCount(chActionText), "Flash the Software and ECU is running ");
  snprintf( chExpectedText, elCount(chExpectedText), "Ecu is should be in running state");
  TestStepAddActionExpected( chActionText, chExpectedText );

  A_DBGR_BreakpointDeleteAll();
  A_DBGR_BreakpointSet("TestCan_Init");
  A_DBGR_R();
  A_DBGR_Go_Safe();
  /***************************************************************************************************************/
                                              // Test Step 1 Define PDU info and call CntrlCNDD_h_CanWrt with PDU info
  /***************************************************************************************************************/

  snprintf( chActionText, elCount(chActionText), "Set Breakpoint in TestCan_Init ");
  snprintf( chExpectedText, elCount(chExpectedText), "verify is Breakpoint Set TestCan_Init");


  snprintf( chActionText, elCount(chActionText), "verify Breakpoint should hit in TestCan_Init ");
  snprintf( chExpectedText, elCount(chExpectedText), "Breakpoint hit in TestCan_Init function");

  E_DBGR_BreakpointCheckForHalt("TestCan_Init");

  snprintf( chActionText, elCount(chActionText), "Configure CanId values ");
  snprintf( chExpectedText, elCount(chExpectedText), "verify Configure CanId values");
  TestStepAddActionExpected( chActionText, chExpectedText );
  A_DBGR_VariableSet("VsPdu[17].e_e_CAN_ID","0x40000301");
  E_DBGR_VariableCheck("VsPdu[17].e_e_CAN_ID",0x40000301,Equal);

  snprintf( chActionText, elCount(chActionText), "Configure CanMessageLen values ");
  snprintf( chExpectedText, elCount(chExpectedText), "verify Configure CanMessageLen values");
  TestStepAddActionExpected( chActionText, chExpectedText );
  A_DBGR_VariableSet("VsPdu[17].e_Cnt_Length","64");
  E_DBGR_VariableCheck("VsPdu[17].e_Cnt_Length",64,Equal);

  snprintf( chActionText, elCount(chActionText), "Configure PDU ID ");
  snprintf( chExpectedText, elCount(chExpectedText), "verify PDU ID");
  TestStepAddActionExpected( chActionText, chExpectedText );
  A_DBGR_VariableSet("VsPdu[17].e_e_PDU_ID","17");
  E_DBGR_VariableCheck("VsPdu[17].e_e_PDU_ID",17,Equal);

   /***************************************************************************************************************/
                                              // Test Step 2 Keep a breakpoint in SetCANR_e_CanIfTxConfirmation and check CAN PDU ID.
  /***************************************************************************************************************/
  snprintf( chActionText, elCount(chActionText), "Debugger running ");
  snprintf( chExpectedText, elCount(chExpectedText), "Debugger go");
  TestStepAddActionExpected( chActionText, chExpectedText );
  A_DBGR_Go();


  /***************************************************************************************************************/
                                              // Test Step 5 verify canoe trace that msg is transmitted.
  /***************************************************************************************************************/
  snprintf( chActionText, elCount(chActionText), "Transmit CAN message. ID:0x40000101,PDU info:0x01");
  snprintf( chExpectedText, elCount(chExpectedText), "CAN message transmitted. ID:0x40000101,PDU info:0x01");

  E_CAN_WaitForMessageByID(0x00000301,15000,cc_eCAN_PRESENT,"CAN2");
  TestStepAddActionExpected( chActionText, chExpectedText );
}



testcase To_verify_the_Interface_CntrlCNDD_h_CanWrt_Transmission_with_Maximum_Message_Length_on_CANA_CAN2()
{
  /***************************************************************************************************************/
                                                // Variable Definition
  /***************************************************************************************************************/



  /***************************************************************************************************************/
                                               // Local Values
  /***************************************************************************************************************/



  /***************************************************************************************************************/
                                              // Test Case Info
  /***************************************************************************************************************/
  setWriteDbgLevel(DebugOff);
  snprintf( chTestTitle, elCount(chTestTitle), "To_verify_the_Interface_CntrlCNDD_h_CanWrt_Transmission_with_Maximum_Message_Length_on_CANA_CAN2" );
  snprintf( chTestDescription, elCount(chTestDescription), "Purpose:To check the CntrlCNDD_h_CanWrt interface CAN2 for TX msgs  ");
  TestCaseAddInfo( chTestTitle, "TC_L30SW_Q-36403600", chTestDescription );

  /***************************************************************************************************************/
                                              // Start of Test Case
  /***************************************************************************************************************/

  /***************************************************************************************************************/
                                              // Test Step 0 PRECONDITIONS
  /***************************************************************************************************************/
  snprintf( chActionText, elCount(chActionText), "Flash the Software and ECU is running ");
  snprintf( chExpectedText, elCount(chExpectedText), "Ecu is should be in running state");
  //TestStepAddActionExpected( chActionText, chExpectedText );

  A_DBGR_BreakpointDeleteAll();
  A_DBGR_BreakpointSet("TestCan_Init");
  A_DBGR_R();
  A_DBGR_Go_Safe();
  /***************************************************************************************************************/
                                              // Test Step 1 Define PDU info and call CntrlCNDD_h_CanWrt with PDU info
  /***************************************************************************************************************/

  snprintf( chActionText, elCount(chActionText), "Set Breakpoint in TestCan_Init ");
  snprintf( chExpectedText, elCount(chExpectedText), "verify is Breakpoint Set TestCan_Init");

  snprintf( chActionText, elCount(chActionText), "verify Breakpoint should hit in TestCan_Init ");
  snprintf( chExpectedText, elCount(chExpectedText), "Breakpoint hit in TestCan_Init function");

  E_DBGR_BreakpointCheckForHalt("TestCan_Init");

  snprintf( chActionText, elCount(chActionText), "Configure CanId values ");
  snprintf( chExpectedText, elCount(chExpectedText), "verify Configure CanId values");
  TestStepAddActionExpected( chActionText, chExpectedText );
  A_DBGR_VariableSet("VsPdu[16].e_e_CAN_ID","0x40000101");
  E_DBGR_VariableCheck("VsPdu[16].e_e_CAN_ID",0x40000101,Equal);

  snprintf( chActionText, elCount(chActionText), "Configure CanMessageLen values ");
  snprintf( chExpectedText, elCount(chExpectedText), "verify Configure CanMessageLen values");
  TestStepAddActionExpected( chActionText, chExpectedText );
  A_DBGR_VariableSet("VsPdu[16].e_Cnt_Length","64");
  E_DBGR_VariableCheck("VsPdu[16].e_Cnt_Length",64,Equal);

  snprintf( chActionText, elCount(chActionText), "Configure PDU ID ");
  snprintf( chExpectedText, elCount(chExpectedText), "verify PDU ID");
  TestStepAddActionExpected( chActionText, chExpectedText );
  A_DBGR_VariableSet("VsPdu[16].e_e_PDU_ID","1");
  E_DBGR_VariableCheck("VsPdu[16].e_e_PDU_ID",1,Equal);

  snprintf( chActionText, elCount(chActionText), "Debugger running ");
  snprintf( chExpectedText, elCount(chExpectedText), "Debugger go");
  TestStepAddActionExpected( chActionText, chExpectedText );
  A_DBGR_Go();


  /***************************************************************************************************************/
                                              // Test Step 2 verify canoe trace that msg is transmitted.
  /***************************************************************************************************************/
  snprintf( chActionText, elCount(chActionText), "Transmit CAN message. ID:0x40000101,PDU info:0x01");
  snprintf( chExpectedText, elCount(chExpectedText), "CAN message transmitted. ID:0x40000101,PDU info:0x01");

  E_CAN_WaitForMessageByID(0x00000101,15000,cc_eCAN_PRESENT,"CAN1");
  TestStepAddActionExpected( chActionText, chExpectedText );
}

testcase To_Verify_CntrlCNDD_h_CanWrt_Interface_transmitted_Message_successfully_for_CANA_CAN2()
{
  /***************************************************************************************************************/
                                                // Variable Definition
  /***************************************************************************************************************/



  /***************************************************************************************************************/
                                               // Local Values
  /***************************************************************************************************************/



  /***************************************************************************************************************/
                                              // Test Case Info
  /***************************************************************************************************************/
  setWriteDbgLevel(DebugOff);
  snprintf( chTestTitle, elCount(chTestTitle), "To_Verify_CntrlCNDD_h_CanWrt_Interface_transmitted_Message_successfully_for_CANA_CAN2" );
  snprintf( chTestDescription, elCount(chTestDescription), "Purpose:To check the CntrlCNDD_h_CanWrt interface CAN2 for TX msgs  ");
  TestCaseAddInfo( chTestTitle, "TC_L30SW_Q-36403613", chTestDescription );

  /***************************************************************************************************************/
                                              // Start of Test Case
  /***************************************************************************************************************/

  /***************************************************************************************************************/
                                              // Test Step 0 PRECONDITIONS
  /***************************************************************************************************************/
  snprintf( chActionText, elCount(chActionText), "Flash the Software and ECU is running ");
  snprintf( chExpectedText, elCount(chExpectedText), "Ecu is should be in running state");
  //TestStepAddActionExpected( chActionText, chExpectedText );
  A_DBGR_BreakpointDeleteAll();
  A_DBGR_BreakpointSet("TestCan_Init");
  A_DBGR_R();
  A_DBGR_Go_Safe();
  /***************************************************************************************************************/
                                              // Test Step 1 Define PDU info and call CntrlCNDD_h_CanWrt with PDU info
  /***************************************************************************************************************/

  snprintf( chActionText, elCount(chActionText), "Set Breakpoint in TestCan_Init ");
  snprintf( chExpectedText, elCount(chExpectedText), "verify is Breakpoint Set TestCan_Init");

  snprintf( chActionText, elCount(chActionText), "verify Breakpoint should hit in TestCan_Init ");
  snprintf( chExpectedText, elCount(chExpectedText), "Breakpoint hit in TestCan_Init function");
  E_DBGR_BreakpointCheckForHalt("TestCan_Init");

  snprintf( chActionText, elCount(chActionText), "Configure CanId values ");
  snprintf( chExpectedText, elCount(chExpectedText), "verify Configure CanId values");
  TestStepAddActionExpected( chActionText, chExpectedText );
  A_DBGR_VariableSet("VsPdu[16].e_e_CAN_ID","0x40000101");
  E_DBGR_VariableCheck("VsPdu[16].e_e_CAN_ID",0x40000101,Equal);

  snprintf( chActionText, elCount(chActionText), "Configure CanMessageLen values ");
  snprintf( chExpectedText, elCount(chExpectedText), "verify Configure CanMessageLen values");
  TestStepAddActionExpected( chActionText, chExpectedText );
  A_DBGR_VariableSet("VsPdu[16].e_Cnt_Length","8");
  E_DBGR_VariableCheck("VsPdu[17].e_Cnt_Length",8,Equal);

  snprintf( chActionText, elCount(chActionText), "Configure PDU ID ");
  snprintf( chExpectedText, elCount(chExpectedText), "verify PDU ID");
  TestStepAddActionExpected( chActionText, chExpectedText );
  A_DBGR_VariableSet("VsPdu[17].e_e_PDU_ID","0");
  E_DBGR_VariableCheck("VsPdu[17].e_e_PDU_ID",0,Equal);

  snprintf( chActionText, elCount(chActionText), "Debugger running ");
  snprintf( chExpectedText, elCount(chExpectedText), "Debugger go");
  TestStepAddActionExpected( chActionText, chExpectedText );
  A_DBGR_Go();


  /***************************************************************************************************************/
                                              // Test Step 2 verify canoe trace that msg is transmitted.
  /***************************************************************************************************************/
  snprintf( chActionText, elCount(chActionText), "Transmit CAN message. ID:0x40000101,PDU info:0x01");
  snprintf( chExpectedText, elCount(chExpectedText), "CAN message transmitted. ID:0x40000101,PDU info:0x01");

  E_CAN_WaitForMessageByID(0x00000101,15000,cc_eCAN_PRESENT,"CAN1");
  TestStepAddActionExpected( chActionText, chExpectedText );
}

testcase To_verify_the_Interface_CntrlCNDD_h_CanWrt_Transmission_with_Minimum_Message_Length_on_CANA_CAN2()
{
  /***************************************************************************************************************/
                                                // Variable Definition
  /***************************************************************************************************************/



  /***************************************************************************************************************/
                                               // Local Values
  /***************************************************************************************************************/



  /***************************************************************************************************************/
                                              // Test Case Info
  /***************************************************************************************************************/
  setWriteDbgLevel(DebugOff);
  snprintf( chTestTitle, elCount(chTestTitle), "To_verify_the_Interface_CntrlCNDD_h_CanWrt_Transmission_with_Minimum_Message_Length_on_CANA_CAN2" );
  snprintf( chTestDescription, elCount(chTestDescription), "Purpose:To check the CntrlCNDD_h_CanWrt interface CAN2 for TX msgs  ");
  TestCaseAddInfo( chTestTitle, "TC_L30SW_Q-36403613", chTestDescription );

  /***************************************************************************************************************/
                                              // Start of Test Case
  /***************************************************************************************************************/

  /***************************************************************************************************************/
                                              // Test Step 0 PRECONDITIONS
  /***************************************************************************************************************/
  snprintf( chActionText, elCount(chActionText), "Flash the Software and ECU is running ");
  snprintf( chExpectedText, elCount(chExpectedText), "Ecu is should be in running state");
 // TestStepAddActionExpected( chActionText, chExpectedText );
  A_DBGR_BreakpointDeleteAll();
  A_DBGR_BreakpointSet("TestCan_Init");
  A_DBGR_R();
  A_DBGR_Go_Safe();
  /***************************************************************************************************************/
                                              // Test Step 1 Define PDU info and call CntrlCNDD_h_CanWrt with PDU info
  /***************************************************************************************************************/

  snprintf( chActionText, elCount(chActionText), "Set Breakpoint in TestCan_Init ");
  snprintf( chExpectedText, elCount(chExpectedText), "verify is Breakpoint Set TestCan_Init");

  snprintf( chActionText, elCount(chActionText), "verify Breakpoint should hit in TestCan_Init ");
  snprintf( chExpectedText, elCount(chExpectedText), "Breakpoint hit in TestCan_Init function");
  E_DBGR_BreakpointCheckForHalt("TestCan_Init");

  snprintf( chActionText, elCount(chActionText), "Configure CanId values ");
  snprintf( chExpectedText, elCount(chExpectedText), "verify Configure CanId values");
  TestStepAddActionExpected( chActionText, chExpectedText );
  A_DBGR_VariableSet("VsPdu[17].e_e_CAN_ID","0x40000101");
  E_DBGR_VariableCheck("VsPdu[17].e_e_CAN_ID",0x40000101,Equal);

  snprintf( chActionText, elCount(chActionText), "Configure CanMessageLen values ");
  snprintf( chExpectedText, elCount(chExpectedText), "verify Configure CanMessageLen values");
  TestStepAddActionExpected( chActionText, chExpectedText );
  A_DBGR_VariableSet("VsPdu[17].e_Cnt_Length","8");
  E_DBGR_VariableCheck("VsPdu[17].e_Cnt_Length",8,Equal);

  snprintf( chActionText, elCount(chActionText), "Configure PDU ID ");
  snprintf( chExpectedText, elCount(chExpectedText), "verify PDU ID");
  TestStepAddActionExpected( chActionText, chExpectedText );
  A_DBGR_VariableSet("VsPdu[0].e_e_PDU_ID","0");
  E_DBGR_VariableCheck("VsPdu[0].e_e_PDU_ID",0,Equal);

  snprintf( chActionText, elCount(chActionText), "Debugger running ");
  snprintf( chExpectedText, elCount(chExpectedText), "Debugger go");
  TestStepAddActionExpected( chActionText, chExpectedText );
  A_DBGR_Go();


  /***************************************************************************************************************/
                                              // Test Step 2 verify canoe trace that msg is transmitted.
  /***************************************************************************************************************/
  snprintf( chActionText, elCount(chActionText), "Transmit CAN message. ID:0x40000101,PDU info:0x01");
  snprintf( chExpectedText, elCount(chExpectedText), "CAN message transmitted. ID:0x40000101,PDU info:0x01");

  E_CAN_WaitForMessageByID(0x00000101,15000,cc_eCAN_PRESENT,"CAN1");
  TestStepAddActionExpected( chActionText, chExpectedText );
}

testcase To_Verify_SetCANR_e_CanIfTxConfirmation_Interface_transmitted_Message_successfully_for_Standard_CANB_CAN8()
{
    /***************************************************************************************************************/
                                                // Variable Definition
  /***************************************************************************************************************/



  /***************************************************************************************************************/
                                               // Local Values
  /***************************************************************************************************************/



  /***************************************************************************************************************/
                                              // Test Case Info
  /***************************************************************************************************************/
  setWriteDbgLevel(DebugOff);
  snprintf( chTestTitle, elCount(chTestTitle), "To_Verify_SetCANR_e_CanIfTxConfirmation_Interface_transmitted_Message_successfully_for_Standard_CANB_CAN8" );
  snprintf( chTestDescription, elCount(chTestDescription), "Purpose:To check the SetCANR_e_CanIfTxConfirmation interface CAN8 for TX msgs  ");
  TestCaseAddInfo( chTestTitle, "TC_L30SW_Q-36403617", chTestDescription );

  /***************************************************************************************************************/
                                              // Start of Test Case
  /***************************************************************************************************************/

  /***************************************************************************************************************/
                                              // Test Step 0 PRECONDITIONS
  /***************************************************************************************************************/
  snprintf( chActionText, elCount(chActionText), "Flash the Software and ECU is running ");
  snprintf( chExpectedText, elCount(chExpectedText), "Ecu is should be in running state");
  //TestStepAddActionExpected( chActionText, chExpectedText );
  A_DBGR_BreakpointDeleteAll();
  A_DBGR_BreakpointSet("TestCan_Init");

  snprintf( chActionText, elCount(chActionText), "Flash the Software and ECU is running ");
  snprintf( chExpectedText, elCount(chExpectedText), "Ecu is should be in running state");
 // TestStepAddActionExpected( chActionText, chExpectedText );
  A_DBGR_R();
  A_DBGR_Go_Safe();
  /***************************************************************************************************************/
                                              // Test Step 1 Define PDU info and call CntrlCNDD_h_CanWrt with PDU info
  /***************************************************************************************************************/

  snprintf( chActionText, elCount(chActionText), "Set Breakpoint in TestCan_Init ");
  snprintf( chExpectedText, elCount(chExpectedText), "verify is Breakpoint Set TestCan_Init");

  snprintf( chActionText, elCount(chActionText), "verify Breakpoint should hit in TestCan_Init ");
  snprintf( chExpectedText, elCount(chExpectedText), "Breakpoint hit in TestCan_Init function");

  E_DBGR_BreakpointCheckForHalt("TestCan_Init");

  snprintf( chActionText, elCount(chActionText), "Configure CanId values ");
  snprintf( chExpectedText, elCount(chExpectedText), "verify Configure CanId values");
  TestStepAddActionExpected( chActionText, chExpectedText );
  A_DBGR_VariableSet("VsPdu[17].e_e_CAN_ID","0x40000101");
  E_DBGR_VariableCheck("VsPdu[17].e_e_CAN_ID",0x40000101,Equal);

  snprintf( chActionText, elCount(chActionText), "Configure CanMessageLen values ");
  snprintf( chExpectedText, elCount(chExpectedText), "verify Configure CanMessageLen values");
  TestStepAddActionExpected( chActionText, chExpectedText );
  A_DBGR_VariableSet("VsPdu[17].e_Cnt_Length","64");
  E_DBGR_VariableCheck("VsPdu[17].e_Cnt_Length",64,Equal);

  snprintf( chActionText, elCount(chActionText), "Configure PDU ID ");
  snprintf( chExpectedText, elCount(chExpectedText), "verify PDU ID");
  TestStepAddActionExpected( chActionText, chExpectedText );
  A_DBGR_VariableSet("VsPdu[17].e_e_PDU_ID","0");
  E_DBGR_VariableCheck("VsPdu[17].e_e_PDU_ID",0,Equal);

   /***************************************************************************************************************/
                                              // Test Step 2 Keep a breakpoint in SetCANR_e_CanIfTxConfirmation and check CAN PDU ID.
  /***************************************************************************************************************/
  snprintf( chActionText, elCount(chActionText), "set Breakpoint SetCANR_e_CanIfTxConfirmation callback function ");
  snprintf( chExpectedText, elCount(chExpectedText), "Breakpoint is Set in SetCANR_e_CanIfTxConfirmation");
  TestStepAddActionExpected( chActionText, chExpectedText );
  A_DBGR_BreakpointSet("SetCANR_e_CanIfTxConfirmation");

  A_DBGR_Go();

  snprintf( chActionText, elCount(chActionText), "SetCANR_e_CanIfTxConfirmation reached");
  snprintf( chExpectedText, elCount(chExpectedText), "reached SetCANR_e_CanIfTxConfirmation");
  //TestStepAddActionExpected( chActionText, chExpectedText );
  E_DBGR_BreakpointCheckForHalt("SetCANR_e_CanIfTxConfirmation");

  snprintf( chActionText, elCount(chActionText), "Debugger running ");
  snprintf( chExpectedText, elCount(chExpectedText), "Debugger go");
  TestStepAddActionExpected( chActionText, chExpectedText );
  A_DBGR_BreakpointDeleteAll();
  A_DBGR_Go();
  /***************************************************************************************************************/
                                              // Test Step 3 verify canoe trace that msg is transmitted.
  /***************************************************************************************************************/
  snprintf( chActionText, elCount(chActionText), "Transmit CAN message. ID:0x40000100,PDU info:0x01");
  snprintf( chExpectedText, elCount(chExpectedText), "CAN message transmitted. ID:0x40000100,PDU info:0x01");

  E_CAN_WaitForMessageByID(0x00000101,15000,cc_eCAN_PRESENT,"CAN2");
  TestStepAddActionExpected( chActionText, chExpectedText );



}

testcase To_Verify_SetCANR_e_CanIfTxConfirmation_Interface_transmitted_Message_successfully_for_Standard_CANA_CAN2()
{
  /***************************************************************************************************************/
                                                // Variable Definition
  /***************************************************************************************************************/



  /***************************************************************************************************************/
                                               // Local Values
  /***************************************************************************************************************/



  /***************************************************************************************************************/
                                              // Test Case Info
  /***************************************************************************************************************/
  setWriteDbgLevel(DebugOff);
  snprintf( chTestTitle, elCount(chTestTitle), "To_Verify_SetCANR_e_CanIfTxConfirmation_Interface_transmitted_Message_successfully_for_Standard_CANA_CAN2" );
  snprintf( chTestDescription, elCount(chTestDescription), "Purpose:To check the SetCANR_e_CanIfTxConfirmation interface CAN2 for TX msgs  ");
  TestCaseAddInfo( chTestTitle, "TC_L30SW_Q-36403616", chTestDescription );

  /***************************************************************************************************************/
                                              // Start of Test Case
  /***************************************************************************************************************/

  /***************************************************************************************************************/
                                              // Test Step 0 PRECONDITIONS
  /***************************************************************************************************************/
  snprintf( chActionText, elCount(chActionText), "Flash the Software and ECU is running ");
  snprintf( chExpectedText, elCount(chExpectedText), "Ecu is should be in running state");
  //TestStepAddActionExpected( chActionText, chExpectedText );
  A_DBGR_BreakpointDeleteAll();
  A_DBGR_BreakpointSet("TestCan_Init");
  A_DBGR_R();
  A_DBGR_Go_Safe();
  /***************************************************************************************************************/
                                              // Test Step 1 Define PDU info and call CntrlCNDD_h_CanWrt with PDU info
  /***************************************************************************************************************/

  snprintf( chActionText, elCount(chActionText), "Set Breakpoint in TestCan_Init ");
  snprintf( chExpectedText, elCount(chExpectedText), "verify is Breakpoint Set TestCan_Init");

  snprintf( chActionText, elCount(chActionText), "verify Breakpoint should hit in TestCan_Init ");
  snprintf( chExpectedText, elCount(chExpectedText), "Breakpoint hit in TestCan_Init function");
  E_DBGR_BreakpointCheckForHalt("TestCan_Init");

  snprintf( chActionText, elCount(chActionText), "Configure CanId values ");
  snprintf( chExpectedText, elCount(chExpectedText), "verify Configure CanId values");
  TestStepAddActionExpected( chActionText, chExpectedText );
  A_DBGR_VariableSet("VsPdu[17].e_e_CAN_ID","0x40000101");
  E_DBGR_VariableCheck("VsPdu[17].e_e_CAN_ID",0x40000101,Equal);

  snprintf( chActionText, elCount(chActionText), "Configure CanMessageLen values ");
  snprintf( chExpectedText, elCount(chExpectedText), "verify Configure CanMessageLen values");
  TestStepAddActionExpected( chActionText, chExpectedText );
  A_DBGR_VariableSet("VsPdu[17].e_Cnt_Length","8");
  E_DBGR_VariableCheck("VsPdu[17].e_Cnt_Length",8,Equal);

  snprintf( chActionText, elCount(chActionText), "Configure PDU ID ");
  snprintf( chExpectedText, elCount(chExpectedText), "verify PDU ID");
  TestStepAddActionExpected( chActionText, chExpectedText );
  A_DBGR_VariableSet("VsPdu[17].e_e_PDU_ID","0");
  E_DBGR_VariableCheck("VsPdu[17].e_e_PDU_ID",0,Equal);

  snprintf( chActionText, elCount(chActionText), "Debugger running ");
  snprintf( chExpectedText, elCount(chExpectedText), "Debugger go");
  TestStepAddActionExpected( chActionText, chExpectedText );
  A_DBGR_Go();

  /***************************************************************************************************************/
                                              // Test Step 2 verify canoe trace that msg is transmitted.
  /***************************************************************************************************************/
  snprintf( chActionText, elCount(chActionText), "Transmit CAN message. ID:0x40000101,PDU info:0x01");
  snprintf( chExpectedText, elCount(chExpectedText), "CAN message transmitted. ID:0x40000101,PDU info:0x01");
  E_CAN_WaitForMessageByID(0x00000101,15000,cc_eCAN_PRESENT,"CAN1");

   /***************************************************************************************************************/
                                              // Test Step 3 Keep a breakpoint in SetCANR_e_CanIfTxConfirmation and check CAN PDU ID.
  /***************************************************************************************************************/
  snprintf( chActionText, elCount(chActionText), "set Breakpoint SetCANR_e_CanIfTxConfirmation callback function ");
  snprintf( chExpectedText, elCount(chExpectedText), "Breakpoint is Set in SetCANR_e_CanIfTxConfirmation");
  TestStepAddActionExpected( chActionText, chExpectedText );
  A_DBGR_BreakpointSet("SetCANR_e_CanIfTxConfirmation");
  E_DBGR_BreakpointCheckForHalt("SetCANR_e_CanIfTxConfirmation");
}

testcase To_Verify_CntrlCNDD_h_CanWrt_Interface_transmitted_Message_successfully_for_CANB_CAN8()
{
  /***************************************************************************************************************/
                                                // Variable Definition
  /***************************************************************************************************************/



  /***************************************************************************************************************/
                                               // Local Values
  /***************************************************************************************************************/



  /***************************************************************************************************************/
                                              // Test Case Info
  /***************************************************************************************************************/
  setWriteDbgLevel(DebugOff);
  snprintf( chTestTitle, elCount(chTestTitle), "To_Verify_CntrlCNDD_h_CanWrt_Interface_transmitted_Message_successfully_for_CANB_CAN8" );
  snprintf( chTestDescription, elCount(chTestDescription), "Purpose:To check the CntrlCNDD_h_CanWrt interface CAN8 for TX msgs  ");
  TestCaseAddInfo( chTestTitle, "TC_L30SW_Q-36403618", chTestDescription );

  /***************************************************************************************************************/
                                              // Start of Test Case
  /***************************************************************************************************************/

  /***************************************************************************************************************/
                                              // Test Step 0 PRECONDITIONS
  /***************************************************************************************************************/
  snprintf( chActionText, elCount(chActionText), "Flash the Software and ECU is running ");
  snprintf( chExpectedText, elCount(chExpectedText), "Ecu is should be in running state");
  TestStepAddActionExpected( chActionText, chExpectedText );

  A_DBGR_BreakpointDeleteAll();
  A_DBGR_BreakpointSet("TestCan_Init");
  A_DBGR_R();
  A_DBGR_Go_Safe();
  /***************************************************************************************************************/
                                              // Test Step 1 Define PDU info and call CntrlCNDD_h_CanWrt with PDU info
  /***************************************************************************************************************/

  snprintf( chActionText, elCount(chActionText), "Set Breakpoint in TestCan_Init ");
  snprintf( chExpectedText, elCount(chExpectedText), "verify is Breakpoint Set TestCan_Init");

  snprintf( chActionText, elCount(chActionText), "verify Breakpoint should hit in TestCan_Init ");
  snprintf( chExpectedText, elCount(chExpectedText), "Breakpoint hit in TestCan_Init function");

  E_DBGR_BreakpointCheckForHalt("TestCan_Init");

  snprintf( chActionText, elCount(chActionText), "Configure CanId values ");
  snprintf( chExpectedText, elCount(chExpectedText), "verify Configure CanId values");
  TestStepAddActionExpected( chActionText, chExpectedText );
  A_DBGR_VariableSet("VsPdu[17].e_e_CAN_ID","0x40000100");
  E_DBGR_VariableCheck("VsPdu[17].e_e_CAN_ID",0x40000100,Equal);

  snprintf( chActionText, elCount(chActionText), "Configure CanMessageLen values ");
  snprintf( chExpectedText, elCount(chExpectedText), "verify Configure CanMessageLen values");
  TestStepAddActionExpected( chActionText, chExpectedText );
  A_DBGR_VariableSet("VsPdu[17].e_Cnt_Length","8");
  E_DBGR_VariableCheck("VsPdu[17].e_Cnt_Length",8,Equal);

  snprintf( chActionText, elCount(chActionText), "Configure PDU ID ");
  snprintf( chExpectedText, elCount(chExpectedText), "verify PDU ID");
  TestStepAddActionExpected( chActionText, chExpectedText );
  A_DBGR_VariableSet("VsPdu[17].e_e_PDU_ID","0");
  E_DBGR_VariableCheck("VsPdu[17].e_e_PDU_ID",0,Equal);

  snprintf( chActionText, elCount(chActionText), "Debugger running ");
  snprintf( chExpectedText, elCount(chExpectedText), "Debugger go");
  TestStepAddActionExpected( chActionText, chExpectedText );
  A_DBGR_Go();


  /***************************************************************************************************************/
                                              // Test Step 2 verify canoe trace that msg is transmitted.
  /***************************************************************************************************************/
  snprintf( chActionText, elCount(chActionText), "Transmit CAN message. ID:0x40000100,PDU info:0x01");
  snprintf( chExpectedText, elCount(chExpectedText), "CAN message transmitted. ID:0x40000100,PDU info:0x01");

  E_CAN_WaitForMessageByID(0x00000100,15000,cc_eCAN_PRESENT,"CAN2");
  TestStepAddActionExpected( chActionText, chExpectedText );
}

testcase To_Verify_CntrlCNDD_h_CanWrt_Interface_transmitted_Message_successfully_for_CANA_CAN2_and_CANB_CAN8()
{
  /***************************************************************************************************************/
                                                // Variable Definition
  /***************************************************************************************************************/



  /***************************************************************************************************************/
                                               // Local Values
  /***************************************************************************************************************/



  /***************************************************************************************************************/
                                              // Test Case Info
  /***************************************************************************************************************/
  setWriteDbgLevel(DebugOff);
  snprintf( chTestTitle, elCount(chTestTitle), "To_Verify_CntrlCNDD_h_CanWrt_Interface_transmitted_Message_successfully_for_CANA_CAN2_and_CANB_CAN8" );
  snprintf( chTestDescription, elCount(chTestDescription), "Purpose:To check the CntrlCNDD_h_CanWrt interface fot CAN2 CAN8 for TX msgs  ");
  TestCaseAddInfo( chTestTitle, "TC_L30SW_Q-36403619", chTestDescription );

  /***************************************************************************************************************/
                                              // Start of Test Case
  /***************************************************************************************************************/

  /***************************************************************************************************************/
                                              // Test Step 0 PRECONDITIONS
  /***************************************************************************************************************/
  snprintf( chActionText, elCount(chActionText), "Flash the Software and ECU is running ");
  snprintf( chExpectedText, elCount(chExpectedText), "Ecu is should be in running state");
  //TestStepAddActionExpected( chActionText, chExpectedText );
  A_DBGR_BreakpointDeleteAll();
  A_DBGR_BreakpointSet("TestCan_Init");
  A_DBGR_R();
  A_DBGR_Go_Safe();
  /***************************************************************************************************************/
                                              // Test Step 1 Define PDU info and call CntrlCNDD_h_CanWrt with PDU info
  /***************************************************************************************************************/

  snprintf( chActionText, elCount(chActionText), "Set Breakpoint in TestCan_Init ");
  snprintf( chExpectedText, elCount(chExpectedText), "verify is Breakpoint Set TestCan_Init");

  snprintf( chActionText, elCount(chActionText), "verify Breakpoint should hit in TestCan_Init ");
  snprintf( chExpectedText, elCount(chExpectedText), "Breakpoint hit in TestCan_Init function");
  E_DBGR_BreakpointCheckForHalt("TestCan_Init");

  snprintf( chActionText, elCount(chActionText), "Configure CanId values ");
  snprintf( chExpectedText, elCount(chExpectedText), "verify Configure CanId values");
  TestStepAddActionExpected( chActionText, chExpectedText );
  A_DBGR_VariableSet("VsPdu[17].e_e_CAN_ID","0x40000101");
  E_DBGR_VariableCheck("VsPdu[17].e_e_CAN_ID",0x40000101,Equal);

  snprintf( chActionText, elCount(chActionText), "Configure CanMessageLen values ");
  snprintf( chExpectedText, elCount(chExpectedText), "verify Configure CanMessageLen values");
  TestStepAddActionExpected( chActionText, chExpectedText );
  A_DBGR_VariableSet("VsPdu[17].e_Cnt_Length","8");
  E_DBGR_VariableCheck("VsPdu[17].e_Cnt_Length",8,Equal);

  snprintf( chActionText, elCount(chActionText), "Configure PDU ID ");
  snprintf( chExpectedText, elCount(chExpectedText), "verify PDU ID");
  TestStepAddActionExpected( chActionText, chExpectedText );
  A_DBGR_VariableSet("VsPdu[17].e_e_PDU_ID","0");
  E_DBGR_VariableCheck("VsPdu[17].e_e_PDU_ID",0,Equal);

  snprintf( chActionText, elCount(chActionText), "Debugger running ");
  snprintf( chExpectedText, elCount(chExpectedText), "Debugger go");
  TestStepAddActionExpected( chActionText, chExpectedText );
  A_DBGR_Go();

  /***************************************************************************************************************/
                                              // Test Step 2 verify canoe trace that msg is transmitted.
  /***************************************************************************************************************/
  snprintf( chActionText, elCount(chActionText), "Transmit CAN message. ID:0x40000101,PDU info:0x01");
  snprintf( chExpectedText, elCount(chExpectedText), "CAN message transmitted. ID:0x40000101,PDU info:0x01");
  E_CAN_WaitForMessageByID(0x00000101,15000,cc_eCAN_PRESENT,"CAN1");

  snprintf( chActionText, elCount(chActionText), "Transmit CAN message. ID:0x40000101,PDU info:0x01");
  snprintf( chExpectedText, elCount(chExpectedText), "CAN message transmitted. ID:0x40000101,PDU info:0x01");
  TestStepAddActionExpected( chActionText, chExpectedText );
  E_CAN_WaitForMessageByID(0x00000101,15000,cc_eCAN_PRESENT,"CAN2");

}



testcase To_verify_the_Interface_CntrlCNDD_h_CanWrt_Transmission_with_Minimum_Message_Length_on_CANB_CAN8()
{
  /***************************************************************************************************************/
                                                // Variable Definition
  /***************************************************************************************************************/



  /***************************************************************************************************************/
                                               // Local Values
  /***************************************************************************************************************/



  /***************************************************************************************************************/
                                              // Test Case Info
  /***************************************************************************************************************/
  setWriteDbgLevel(DebugOff);
  snprintf( chTestTitle, elCount(chTestTitle), "To_verify_the_Interface_CntrlCNDD_h_CanWrt_Transmission_with_Minimum_Message_Length_on_CANB_CAN8" );
  snprintf( chTestDescription, elCount(chTestDescription), "Purpose:To check the CntrlCNDD_h_CanWrt interface CAN8 for TX msgs  ");
  TestCaseAddInfo( chTestTitle, "TC_L30SW_Q-36403620", chTestDescription );

  /***************************************************************************************************************/
                                              // Start of Test Case
  /***************************************************************************************************************/

  /***************************************************************************************************************/
                                              // Test Step 0 PRECONDITIONS
  /***************************************************************************************************************/
  snprintf( chActionText, elCount(chActionText), "Flash the Software and ECU is running ");
  snprintf( chExpectedText, elCount(chExpectedText), "Ecu is should be in running state");
  TestStepAddActionExpected( chActionText, chExpectedText );

  A_DBGR_BreakpointDeleteAll();
  A_DBGR_BreakpointSet("TestCan_Init");
  A_DBGR_R();
  A_DBGR_Go_Safe();
  /***************************************************************************************************************/
                                              // Test Step 1 Define PDU info and call CntrlCNDD_h_CanWrt with PDU info
  /***************************************************************************************************************/
  snprintf( chActionText, elCount(chActionText), "verify Breakpoint should hit in TestCan_Init ");
  snprintf( chExpectedText, elCount(chExpectedText), "Breakpoint hit in TestCan_Init function");

  E_DBGR_BreakpointCheckForHalt("TestCan_Init");

  snprintf( chActionText, elCount(chActionText), "Configure CanId values ");
  snprintf( chExpectedText, elCount(chExpectedText), "verify Configure CanId values");
  TestStepAddActionExpected( chActionText, chExpectedText );
  A_DBGR_VariableSet("VsPdu[17].e_e_CAN_ID","0x40000100");
  E_DBGR_VariableCheck("VsPdu[17].e_e_CAN_ID",0x40000100,Equal);

  snprintf( chActionText, elCount(chActionText), "Configure CanMessageLen values ");
  snprintf( chExpectedText, elCount(chExpectedText), "verify Configure CanMessageLen values");
  TestStepAddActionExpected( chActionText, chExpectedText );
  A_DBGR_VariableSet("VsPdu[17].e_Cnt_Length","1");
  E_DBGR_VariableCheck("VsPdu[17].e_Cnt_Length",1,Equal);

  snprintf( chActionText, elCount(chActionText), "Configure PDU ID ");
  snprintf( chExpectedText, elCount(chExpectedText), "verify PDU ID");
  TestStepAddActionExpected( chActionText, chExpectedText );
  A_DBGR_VariableSet("VsPdu[17].e_e_PDU_ID","0");
  E_DBGR_VariableCheck("VsPdu[17].e_e_PDU_ID",0,Equal);

   /***************************************************************************************************************/
                                              // Test Step 2 Keep a breakpoint in SetCANR_e_CanIfTxConfirmation and check CAN PDU ID.
  /***************************************************************************************************************/
  snprintf( chActionText, elCount(chActionText), "Debugger running ");
  snprintf( chExpectedText, elCount(chExpectedText), "Debugger go");
  TestStepAddActionExpected( chActionText, chExpectedText );
  A_DBGR_Go();


  /***************************************************************************************************************/
                                              // Test Step 5 verify canoe trace that msg is transmitted.
  /***************************************************************************************************************/
  snprintf( chActionText, elCount(chActionText), "Transmit CAN message. ID:0x40000100,PDU info:0x01");
  snprintf( chExpectedText, elCount(chExpectedText), "CAN message transmitted. ID:0x40000100,PDU info:0x01");

  E_CAN_WaitForMessageByID(0x00000100,15000,cc_eCAN_PRESENT,"CAN2");
  TestStepAddActionExpected( chActionText, chExpectedText );
}





testcase Verify_SetCNDD_e_CanControllerMode_Interface_Transition_to_Stop_Mode_for_CANA_CAN2()
{
  /***************************************************************************************************************/
                                                // Variable Definition
  /***************************************************************************************************************/



  /***************************************************************************************************************/
                                               // Local Values
  /***************************************************************************************************************/



  /***************************************************************************************************************/
                                              // Test Case Info
  /***************************************************************************************************************/
  setWriteDbgLevel(DebugOff);
  snprintf( chTestTitle, elCount(chTestTitle), "Verify_SetCNDD_e_CanControllerMode_Interface_Transition_to_Stop_Mode_for_CANA_CAN2" );
  snprintf( chTestDescription, elCount(chTestDescription), "Purpose:To check the interface SetCNDD_e_CanControllerMode by setting to stop mode of CAN2 ");
  TestCaseAddInfo( chTestTitle, "TC_L30SW_Q-36403634", chTestDescription );

  /***************************************************************************************************************/
                                              // Start of Test Case
  /***************************************************************************************************************/

  /***************************************************************************************************************/
                                              // Test Step 0 PRECONDITIONS
  /***************************************************************************************************************/
  snprintf( chActionText, elCount(chActionText), "Flash the Software and ECU is running ");
  snprintf( chExpectedText, elCount(chExpectedText), "Ecu is should be in running state");
  //TestStepAddActionExpected( chActionText, chExpectedText );
  A_DBGR_BreakpointDeleteAll();
  A_DBGR_BreakpointSet("SetCNDD_e_CanControllerMode");

  snprintf( chActionText, elCount(chActionText), "Flash the Software and ECU is running ");
  snprintf( chExpectedText, elCount(chExpectedText), "Ecu is should be in running state");

  A_DBGR_R();
  A_DBGR_Go_Safe();

  /***************************************************************************************************************/
                                              // Test Step 1 Call SetCNDD_e_CanControllerMode with stop mode to put CAN controller in stop mode.
  /***************************************************************************************************************/
  snprintf( chActionText, elCount(chActionText), "Set Breakpoint in SetCNDD_e_CanControllerMode ");
  snprintf( chExpectedText, elCount(chExpectedText), "verify is Breakpoint Set SetCNDD_e_CanControllerMode");

  snprintf( chActionText, elCount(chActionText), "verify Breakpoint should hit in SetCNDD_e_CanControllerMode ");
  snprintf( chExpectedText, elCount(chExpectedText), "Breakpoint hit in SetCNDD_e_CanControllerMode function");

  E_DBGR_BreakpointCheckForHalt("SetCNDD_e_CanControllerMode");

  snprintf( chActionText, elCount(chActionText), "Configure Controller mode");
  snprintf( chExpectedText, elCount(chExpectedText), "verify Configure Controller mode");
  TestStepAddActionExpected( chActionText, chExpectedText );
  A_DBGR_VariableSet("can_modetransition","1");
  E_DBGR_VariableCheck("can_modetransition",1,Equal);

  snprintf( chActionText, elCount(chActionText), "Delete all Breakpoints");
  snprintf( chExpectedText, elCount(chExpectedText), "verify Delete all Breakpoints");
  TestStepAddActionExpected( chActionText, chExpectedText );
  A_DBGR_BreakpointDeleteAll();
  A_DBGR_BreakpointSet("SetCANR_e_CanIfCntrlrModeIndication");

   /***************************************************************************************************************/
                                              // Test Step 2 Keep a breakpoint in SetCANR_e_CanIfCntrlrModeIndication callback function.
  /***************************************************************************************************************/
  snprintf( chActionText, elCount(chActionText), "Set Breakpoint in SetCANR_e_CanIfCntrlrModeIndication ");
  snprintf( chExpectedText, elCount(chExpectedText), "verify is Breakpoint Set SetCANR_e_CanIfCntrlrModeIndication");
  A_DBGR_Go();

  snprintf( chActionText, elCount(chActionText), "verify Breakpoint should hit in SetCANR_e_CanIfCntrlrModeIndication ");
  snprintf( chExpectedText, elCount(chExpectedText), "Breakpoint hit in SetCANR_e_CanIfCntrlrModeIndication function");

  E_DBGR_BreakpointCheckForHalt("SetCANR_e_CanIfCntrlrModeIndication");

  snprintf( chActionText, elCount(chActionText), "Verify ChannelId ");
  snprintf( chExpectedText, elCount(chExpectedText), " ChannelId as 0");
  TestStepAddActionExpected( chActionText, chExpectedText );
  E_DBGR_VariableCheck("ChannelId ",0,Equal);
   snprintf( chActionText, elCount(chActionText), "Verify Cancontrollermode");
  snprintf( chExpectedText, elCount(chExpectedText), "Cancontrollermode as 3");
  TestStepAddActionExpected( chActionText, chExpectedText );
  E_DBGR_VariableCheck("Cancontrollermode",3,Equal);

  snprintf( chActionText, elCount(chActionText), "ECU in Running state ");
  snprintf( chExpectedText, elCount(chExpectedText), "verify ECU in Running state");
  TestStepAddActionExpected( chActionText, chExpectedText );
  A_DBGR_BreakpointDeleteAll();
  A_DBGR_Go();
  E_DBGR_CheckState(T32_State_Running);

}



testcase Verify_SetCNDD_e_CanControllerMode_Interface_Transition_to_Stop_Mode_for_CANB_CAN8()
{
  /***************************************************************************************************************/
                                                // Variable Definition
  /***************************************************************************************************************/



  /***************************************************************************************************************/
                                               // Local Values
  /***************************************************************************************************************/



  /***************************************************************************************************************/
                                              // Test Case Info
  /***************************************************************************************************************/
  setWriteDbgLevel(DebugOff);
  snprintf( chTestTitle, elCount(chTestTitle), "Verify_SetCNDD_e_CanControllerMode_Interface_Transition_to_Stop_Mode_for_CANB_CAN8" );
  snprintf( chTestDescription, elCount(chTestDescription), "Purpose:To check the interface SetCNDD_e_CanControllerMode by setting to stop mode of CAN8 ");
  TestCaseAddInfo( chTestTitle, "TC_L30SW_Q-36403635", chTestDescription );

  /***************************************************************************************************************/
                                              // Start of Test Case
  /***************************************************************************************************************/

  /***************************************************************************************************************/
                                              // Test Step 0 PRECONDITIONS
  /***************************************************************************************************************/
  snprintf( chActionText, elCount(chActionText), "Flash the Software and ECU is running ");
  snprintf( chExpectedText, elCount(chExpectedText), "Ecu is should be in running state");
  TestStepAddActionExpected( chActionText, chExpectedText );

  A_DBGR_BreakpointDeleteAll();
  A_DBGR_BreakpointSet("SetCNDD_e_CanControllerMode");
  A_DBGR_R();
  A_DBGR_Go_Safe();

  /***************************************************************************************************************/
                                              // Test Step 1 Call SetCNDD_e_CanControllerMode with stop mode to put CAN controller in stop mode.
  /***************************************************************************************************************/


  snprintf( chActionText, elCount(chActionText), "verify Breakpoint should hit in SetCNDD_e_CanControllerMode ");
  snprintf( chExpectedText, elCount(chExpectedText), "Breakpoint hit in SetCNDD_e_CanControllerMode function");
  E_DBGR_BreakpointCheckForHalt("SetCNDD_e_CanControllerMode");

  snprintf( chActionText, elCount(chActionText), "Configure Controller mode");
  snprintf( chExpectedText, elCount(chExpectedText), "verify Configure Controller mode");
  TestStepAddActionExpected( chActionText, chExpectedText );
  E_DBGR_VariableCheck_until("channelid",1,Equal);
  A_DBGR_VariableSet("can_modetransition","1");
  E_DBGR_VariableCheck("can_modetransition",1,Equal);

  snprintf( chActionText, elCount(chActionText), "Delete all Breakpoints");
  snprintf( chExpectedText, elCount(chExpectedText), "verify Delete all Breakpoints");
  TestStepAddActionExpected( chActionText, chExpectedText );
  A_DBGR_BreakpointDeleteAll();

   /***************************************************************************************************************/
                                              // Test Step 2 Keep a breakpoint in SetCANR_e_CanIfCntrlrModeIndication callback function.
  /***************************************************************************************************************/
  snprintf( chActionText, elCount(chActionText), "Set Breakpoint in SetCANR_e_CanIfCntrlrModeIndication ");
  snprintf( chExpectedText, elCount(chExpectedText), "verify is Breakpoint Set SetCANR_e_CanIfCntrlrModeIndication");
  A_DBGR_BreakpointSet("SetCANR_e_CanIfCntrlrModeIndication");  


  snprintf( chActionText, elCount(chActionText), "Run software");
  snprintf( chExpectedText, elCount(chExpectedText), "verify Software is running");
  A_DBGR_Go();



  snprintf( chActionText, elCount(chActionText), "verify Breakpoint should hit in SetCANR_e_CanIfCntrlrModeIndication ");
  snprintf( chExpectedText, elCount(chExpectedText), "Breakpoint hit in SetCANR_e_CanIfCntrlrModeIndication function");

  E_DBGR_BreakpointCheckForHalt("SetCANR_e_CanIfCntrlrModeIndication");

  cnt = 0;
  while(1)
  {
    if (cnt >= MAX_POLL_ATTEMPTS)
    {
      testStepFail("Timeout", "ChannelId polling exceeded maximum attempts");
      break;
    }
    if(cnt == 0)
    {
      snprintf( chActionText, elCount(chActionText), "Run software");
      snprintf( chExpectedText, elCount(chExpectedText), "verify Software is running");

      TestStepAddActionExpected( chActionText, chExpectedText );
    }
  A_DBGR_Go();

    snprintf( chActionText, elCount(chActionText), "Verify ChannelId ");
    snprintf( chExpectedText, elCount(chExpectedText), " ChannelId as 1");
    A_DBGR_VariableRead("ChannelId",val);
    if (val == 1)
    {
      cnt =0;
      break;
    }
    cnt = cnt +1;
  }
  snprintf( chActionText, elCount(chActionText), "Verify Cancontrollermode");
  snprintf( chExpectedText, elCount(chExpectedText), "Cancontrollermode as 3");
  //TestStepAddActionExpected( chActionText, chExpectedText );
  E_DBGR_VariableCheck("Cancontrollermode",3,Equal);

  snprintf( chActionText, elCount(chActionText), "ECU in Running state ");
  snprintf( chExpectedText, elCount(chExpectedText), "verify ECU in Running state");
  TestStepAddActionExpected( chActionText, chExpectedText );
  A_DBGR_BreakpointDeleteAll();
  A_DBGR_Go();
  E_DBGR_CheckState(T32_State_Running);
}



testcase Verify_SetCNDD_e_CanControllerMode_Interface_Transition_to_Invalid_Mode_for_CANA_CAN2()
{
  /***************************************************************************************************************/
                                                // Variable Definition
  /***************************************************************************************************************/



  /***************************************************************************************************************/
                                               // Local Values
  /***************************************************************************************************************/



  /***************************************************************************************************************/
                                              // Test Case Info
  /***************************************************************************************************************/
  setWriteDbgLevel(DebugOff);
  snprintf( chTestTitle, elCount(chTestTitle), "Verify_SetCNDD_e_CanControllerMode_Interface_Transition_to_Invalid_Mode_for_CANA_CAN2" );
  snprintf( chTestDescription, elCount(chTestDescription), "Purpose:To check the interface SetCNDD_e_CanControllerMode by setting to Invalid mode of CAN2 ");
  TestCaseAddInfo( chTestTitle, "TC_L30SW_Q-36403636", chTestDescription );

  /***************************************************************************************************************/
                                              // Start of Test Case
  /***************************************************************************************************************/

  /***************************************************************************************************************/
                                              // Test Step 0 PRECONDITIONS
  /***************************************************************************************************************/
  snprintf( chActionText, elCount(chActionText), "Flash the Software and ECU is running ");
  snprintf( chExpectedText, elCount(chExpectedText), "Ecu is should be in running state");
  TestStepAddActionExpected( chActionText, chExpectedText );

  A_DBGR_BreakpointDeleteAll();
  A_DBGR_BreakpointSet("SetCNDD_e_CanControllerMode");
  A_DBGR_R();
  A_DBGR_Go_Safe();

  /***************************************************************************************************************/
                                              // Test Step 1 Call SetCNDD_e_CanControllerMode with stop mode to put CAN controller in invalid mode.
  /***************************************************************************************************************/
  snprintf( chActionText, elCount(chActionText), "verify Breakpoint should hit in SetCNDD_e_CanControllerMode ");
  snprintf( chExpectedText, elCount(chExpectedText), "Breakpoint hit in SetCNDD_e_CanControllerMode function");

  E_DBGR_BreakpointCheckForHalt("SetCNDD_e_CanControllerMode");

  snprintf( chActionText, elCount(chActionText), "Configure Controller mode");
  snprintf( chExpectedText, elCount(chExpectedText), "verify Configure Controller mode");
  TestStepAddActionExpected( chActionText, chExpectedText );
  A_DBGR_VariableSet("can_modetransition","255");
  E_DBGR_VariableCheck("can_modetransition",255,Equal);

  snprintf( chActionText, elCount(chActionText), "Delete all Breakpoints");
  snprintf( chExpectedText, elCount(chExpectedText), "verify Delete all Breakpoints");
  TestStepAddActionExpected( chActionText, chExpectedText );
  A_DBGR_BreakpointDeleteAll();
  A_DBGR_BreakpointSet("SetCANR_e_CanIfCntrlrModeIndication");

   /***************************************************************************************************************/
                                              // Test Step 2 Keep a breakpoint in SetCANR_e_CanIfCntrlrModeIndication callback function.
  /***************************************************************************************************************/
  snprintf( chActionText, elCount(chActionText), "Set Breakpoint in SetCANR_e_CanIfCntrlrModeIndication ");
  snprintf( chExpectedText, elCount(chExpectedText), "verify is Breakpoint Set SetCANR_e_CanIfCntrlrModeIndication");
  A_DBGR_Go();

  snprintf( chActionText, elCount(chActionText), "verify Breakpoint should hit in SetCANR_e_CanIfCntrlrModeIndication ");
  snprintf( chExpectedText, elCount(chExpectedText), "Breakpoint hit in SetCANR_e_CanIfCntrlrModeIndication function");

  E_DBGR_BreakpointCheckForHalt("SetCANR_e_CanIfCntrlrModeIndication");

  snprintf( chActionText, elCount(chActionText), "Verify ChannelId ");
  snprintf( chExpectedText, elCount(chExpectedText), " ChannelId as 0");
  TestStepAddActionExpected( chActionText, chExpectedText );
  E_DBGR_VariableCheck("ChannelId ",0,Equal);
   snprintf( chActionText, elCount(chActionText), "Verify Cancontrollermode");
  snprintf( chExpectedText, elCount(chExpectedText), "Cancontrollermode as 3");
  TestStepAddActionExpected( chActionText, chExpectedText );
  E_DBGR_VariableCheck("Cancontrollermode",3,Equal);

  snprintf( chActionText, elCount(chActionText), "ECU in Running state ");
  snprintf( chExpectedText, elCount(chExpectedText), "verify ECU in Running state");
  TestStepAddActionExpected( chActionText, chExpectedText );
  A_DBGR_BreakpointDeleteAll();
  A_DBGR_Go();
  E_DBGR_CheckState(T32_State_Running);
}



testcase Verify_SetCNDD_e_CanControllerMode_Interface_Transition_to_Invalid_Mode_for_CANB_CAN8()
{
  /***************************************************************************************************************/
                                                // Variable Definition
  /***************************************************************************************************************/



  /***************************************************************************************************************/
                                               // Local Values
  /***************************************************************************************************************/



  /***************************************************************************************************************/
                                              // Test Case Info
  /***************************************************************************************************************/
  setWriteDbgLevel(DebugOff);
  snprintf( chTestTitle, elCount(chTestTitle), "Verify_SetCNDD_e_CanControllerMode_Interface_Transition_to_Invalid_Mode_for_CANB_CAN8" );
  snprintf( chTestDescription, elCount(chTestDescription), "Purpose:To check the interface SetCNDD_e_CanControllerMode by setting to invalid mode of CAN8 ");
  TestCaseAddInfo( chTestTitle, "TC_L30SW_Q-36403637", chTestDescription );

  /***************************************************************************************************************/
                                              // Start of Test Case
  /***************************************************************************************************************/

  /***************************************************************************************************************/
                                              // Test Step 0 PRECONDITIONS
  /***************************************************************************************************************/
   snprintf( chActionText, elCount(chActionText), "Flash the Software and ECU is running ");
  snprintf( chExpectedText, elCount(chExpectedText), "Ecu is should be in running state");
  TestStepAddActionExpected( chActionText, chExpectedText );

  A_DBGR_BreakpointDeleteAll();
  A_DBGR_BreakpointSet("SetCNDD_e_CanControllerMode");
  A_DBGR_R();
  A_DBGR_Go_Safe();

  /***************************************************************************************************************/
                                              // Test Step 1 Call SetCNDD_e_CanControllerMode with stop mode to put CAN controller in invalid mode.
  /***************************************************************************************************************/
  snprintf( chActionText, elCount(chActionText), "Set Breakpoint in SetCNDD_e_CanControllerMode ");
  snprintf( chExpectedText, elCount(chExpectedText), "verify is Breakpoint Set SetCNDD_e_CanControllerMode");


  snprintf( chActionText, elCount(chActionText), "verify Breakpoint should hit in SetCNDD_e_CanControllerMode ");
  snprintf( chExpectedText, elCount(chExpectedText), "Breakpoint hit in SetCNDD_e_CanControllerMode function");

  E_DBGR_BreakpointCheckForHalt("SetCNDD_e_CanControllerMode");

  snprintf( chActionText, elCount(chActionText), "Configure Controller mode");
  snprintf( chExpectedText, elCount(chExpectedText), "verify Configure Controller mode");
  TestStepAddActionExpected( chActionText, chExpectedText );
  E_DBGR_VariableCheck_until("channelid",1,Equal);
  A_DBGR_VariableSet("can_modetransition","255");
  E_DBGR_VariableCheck("can_modetransition",255,Equal);

  snprintf( chActionText, elCount(chActionText), "Delete all Breakpoints");
  snprintf( chExpectedText, elCount(chExpectedText), "verify Delete all Breakpoints");
  TestStepAddActionExpected( chActionText, chExpectedText );
  A_DBGR_BreakpointDeleteAll();

   /***************************************************************************************************************/
                                              // Test Step 2 Keep a breakpoint in SetCANR_e_CanIfCntrlrModeIndication callback function.
  /***************************************************************************************************************/
  snprintf( chActionText, elCount(chActionText), "Set Breakpoint in SetCANR_e_CanIfCntrlrModeIndication ");
  snprintf( chExpectedText, elCount(chExpectedText), "verify is Breakpoint Set SetCANR_e_CanIfCntrlrModeIndication");
  A_DBGR_BreakpointSet("SetCANR_e_CanIfCntrlrModeIndication");  
  snprintf( chActionText, elCount(chActionText), "Run software");
  snprintf( chExpectedText, elCount(chExpectedText), "verify Software is running");
  A_DBGR_Go();

  snprintf( chActionText, elCount(chActionText), "verify Breakpoint should hit in SetCANR_e_CanIfCntrlrModeIndication ");
  snprintf( chExpectedText, elCount(chExpectedText), "Breakpoint hit in SetCANR_e_CanIfCntrlrModeIndication function");

  E_DBGR_BreakpointCheckForHalt("SetCANR_e_CanIfCntrlrModeIndication");
  cnt = 0;
  while(1)
  {
    if (cnt >= MAX_POLL_ATTEMPTS)
    {
      testStepFail("Timeout", "ChannelId polling exceeded maximum attempts");
      break;
    }
    if(cnt == 0)
    {
      snprintf( chActionText, elCount(chActionText), "Run software");
      snprintf( chExpectedText, elCount(chExpectedText), "verify Software is running");
      TestStepAddActionExpected( chActionText, chExpectedText );
    }
  A_DBGR_Go();

    snprintf( chActionText, elCount(chActionText), "Verify ChannelId ");
    snprintf( chExpectedText, elCount(chExpectedText), " ChannelId as 1");
    A_DBGR_VariableRead("ChannelId",val);
    if (val == 1)
    {
      cnt =0;
      break;
    }
    cnt = cnt +1;
  }
   snprintf( chActionText, elCount(chActionText), "Verify Cancontrollermode");
  snprintf( chExpectedText, elCount(chExpectedText), "Cancontrollermode as 3");
  //TestStepAddActionExpected( chActionText, chExpectedText );
  E_DBGR_VariableCheck("Cancontrollermode",3,Equal);

  snprintf( chActionText, elCount(chActionText), "ECU in Running state ");
  snprintf( chExpectedText, elCount(chExpectedText), "verify ECU in Running state");
  TestStepAddActionExpected( chActionText, chExpectedText );
  A_DBGR_BreakpointDeleteAll();
  A_DBGR_Go();
  E_DBGR_CheckState(T32_State_Running);

}



testcase To_Verify_SetCNDD_e_CanControllerMode_Interface_Transition_to_Start_Mode_for_CANA_CAN2()
{
  /***************************************************************************************************************/
                                                // Variable Definition
  /***************************************************************************************************************/



  /***************************************************************************************************************/
                                               // Local Values
  /***************************************************************************************************************/



  /***************************************************************************************************************/
                                              // Test Case Info
  /***************************************************************************************************************/
  setWriteDbgLevel(DebugOff);
  snprintf( chTestTitle, elCount(chTestTitle), "To_Verify_SetCNDD_e_CanControllerMode_Interface_Transition_to_Start_Mode_for_CANA_CAN2" );
  snprintf( chTestDescription, elCount(chTestDescription), "Purpose:To check the interface SetCNDD_e_CanControllerMode by setting to start mode of CAN2 ");
  TestCaseAddInfo( chTestTitle, "TC_L30SW_Q-36403638", chTestDescription );

  /***************************************************************************************************************/
                                              // Start of Test Case
  /***************************************************************************************************************/

  /***************************************************************************************************************/
                                              // Test Step 0 PRECONDITIONS
  /***************************************************************************************************************/
  snprintf( chActionText, elCount(chActionText), "Flash the Software and ECU is running ");
  snprintf( chExpectedText, elCount(chExpectedText), "Ecu is should be in running state");
  TestStepAddActionExpected( chActionText, chExpectedText );

  A_DBGR_BreakpointDeleteAll();
  A_DBGR_BreakpointSet("SetCNDD_e_CanControllerMode");
  A_DBGR_R();
  A_DBGR_Go_Safe();

  /***************************************************************************************************************/
                                              // Test Step 1 Call SetCNDD_e_CanControllerMode with start mode to put CAN controller in start mode.
  /***************************************************************************************************************/
  snprintf( chActionText, elCount(chActionText), "verify Breakpoint should hit in SetCNDD_e_CanControllerMode ");
  snprintf( chExpectedText, elCount(chExpectedText), "Breakpoint hit in SetCNDD_e_CanControllerMode function");

  E_DBGR_BreakpointCheckForHalt("SetCNDD_e_CanControllerMode");

  snprintf( chActionText, elCount(chActionText), "Configure Controller mode");
  snprintf( chExpectedText, elCount(chExpectedText), "verify Configure Controller mode");
  TestStepAddActionExpected( chActionText, chExpectedText );
  A_DBGR_VariableSet("can_modetransition","0");
  E_DBGR_VariableCheck("can_modetransition",0,Equal);

  snprintf( chActionText, elCount(chActionText), "Delete all Breakpoints");
  snprintf( chExpectedText, elCount(chExpectedText), "verify Delete all Breakpoints");
  TestStepAddActionExpected( chActionText, chExpectedText );
  A_DBGR_BreakpointDeleteAll();
  A_DBGR_BreakpointSet("SetCANR_e_CanIfCntrlrModeIndication");

   /***************************************************************************************************************/
                                              // Test Step 2 Keep a breakpoint in SetCANR_e_CanIfCntrlrModeIndication callback function.
  /***************************************************************************************************************/
  snprintf( chActionText, elCount(chActionText), "Set Breakpoint in SetCANR_e_CanIfCntrlrModeIndication ");
  snprintf( chExpectedText, elCount(chExpectedText), "verify is Breakpoint Set SetCANR_e_CanIfCntrlrModeIndication");
  A_DBGR_Go();

  snprintf( chActionText, elCount(chActionText), "verify Breakpoint should hit in SetCANR_e_CanIfCntrlrModeIndication ");
  snprintf( chExpectedText, elCount(chExpectedText), "Breakpoint hit in SetCANR_e_CanIfCntrlrModeIndication function");

  E_DBGR_BreakpointCheckForHalt("SetCANR_e_CanIfCntrlrModeIndication");

  snprintf( chActionText, elCount(chActionText), "Verify ChannelId ");
  snprintf( chExpectedText, elCount(chExpectedText), " ChannelId as 0");
  TestStepAddActionExpected( chActionText, chExpectedText );
  E_DBGR_VariableCheck("ChannelId ",0,Equal);
   snprintf( chActionText, elCount(chActionText), "Verify Cancontrollermode");
  snprintf( chExpectedText, elCount(chExpectedText), "Cancontrollermode as 2");
  TestStepAddActionExpected( chActionText, chExpectedText );
  E_DBGR_VariableCheck("Cancontrollermode",2,Equal);

  snprintf( chActionText, elCount(chActionText), "ECU in Running state ");
  snprintf( chExpectedText, elCount(chExpectedText), "verify ECU in Running state");
  TestStepAddActionExpected( chActionText, chExpectedText );
  A_DBGR_BreakpointDeleteAll();
  A_DBGR_Go();
  E_DBGR_CheckState(T32_State_Running);

}



testcase To_Verify_SetCNDD_e_CanControllerMode_Interface_Transition_to_Start_Mode_for_CANB_CAN8()
{
   /***************************************************************************************************************/
                                                // Variable Definition
  /***************************************************************************************************************/



  /***************************************************************************************************************/
                                               // Local Values
  /***************************************************************************************************************/



  /***************************************************************************************************************/
                                              // Test Case Info
  /***************************************************************************************************************/
  setWriteDbgLevel(DebugOff);
  snprintf( chTestTitle, elCount(chTestTitle), "To_Verify_SetCNDD_e_CanControllerMode_Interface_Transition_to_Start_Mode_for_CANB_CAN8" );
  snprintf( chTestDescription, elCount(chTestDescription), "Purpose:To check the interface SetCNDD_e_CanControllerMode by setting to start mode of CAN8 ");
  TestCaseAddInfo( chTestTitle, "TC_L30SW_Q-36403639", chTestDescription );

  /***************************************************************************************************************/
                                              // Start of Test Case
  /***************************************************************************************************************/

  /***************************************************************************************************************/
                                              // Test Step 0 PRECONDITIONS
  /***************************************************************************************************************/
   snprintf( chActionText, elCount(chActionText), "Flash the Software and ECU is running ");
  snprintf( chExpectedText, elCount(chExpectedText), "Ecu is should be in running state");
  TestStepAddActionExpected( chActionText, chExpectedText );

  A_DBGR_BreakpointDeleteAll();
  A_DBGR_BreakpointSet("SetCNDD_e_CanControllerMode");
  A_DBGR_R();
  A_DBGR_Go_Safe();

  /***************************************************************************************************************/
                                              // Test Step 1 Call SetCNDD_e_CanControllerMode with stop mode to put CAN controller in invalid mode.
  /***************************************************************************************************************/
  snprintf( chActionText, elCount(chActionText), "verify Breakpoint should hit in SetCNDD_e_CanControllerMode ");
  snprintf( chExpectedText, elCount(chExpectedText), "Breakpoint hit in SetCNDD_e_CanControllerMode function");

  E_DBGR_BreakpointCheckForHalt("SetCNDD_e_CanControllerMode");



  E_DBGR_VariableCheck_until("channelid",1,Equal);
  snprintf( chActionText, elCount(chActionText), "Configure Controller mode");
  snprintf( chExpectedText, elCount(chExpectedText), "verify Configure Controller mode");
  TestStepAddActionExpected( chActionText, chExpectedText );
  A_DBGR_VariableSet("can_modetransition","0");
  E_DBGR_VariableCheck("can_modetransition",0,Equal);

  snprintf( chActionText, elCount(chActionText), "Delete all Breakpoints");
  snprintf( chExpectedText, elCount(chExpectedText), "verify Delete all Breakpoints");
  TestStepAddActionExpected( chActionText, chExpectedText );
  A_DBGR_BreakpointDeleteAll();
  A_DBGR_BreakpointSet("SetCANR_e_CanIfCntrlrModeIndication");

   /***************************************************************************************************************/
                                              // Test Step 2 Keep a breakpoint in SetCANR_e_CanIfCntrlrModeIndication callback function.
  /***************************************************************************************************************/
  snprintf( chActionText, elCount(chActionText), "Set Breakpoint in SetCANR_e_CanIfCntrlrModeIndication ");
  snprintf( chExpectedText, elCount(chExpectedText), "verify is Breakpoint Set SetCANR_e_CanIfCntrlrModeIndication");

  snprintf( chActionText, elCount(chActionText), "Run software");
  snprintf( chExpectedText, elCount(chExpectedText), "verify Software is running");
  A_DBGR_Go();

  snprintf( chActionText, elCount(chActionText), "verify Breakpoint should hit in SetCANR_e_CanIfCntrlrModeIndication ");
  snprintf( chExpectedText, elCount(chExpectedText), "Breakpoint hit in SetCANR_e_CanIfCntrlrModeIndication function");

  E_DBGR_BreakpointCheckForHalt("SetCANR_e_CanIfCntrlrModeIndication");

  E_DBGR_VariableCheck_until("ChannelId",1,Equal);
  snprintf( chActionText, elCount(chActionText), "Verify Cancontrollermode");
  snprintf( chExpectedText, elCount(chExpectedText), "Cancontrollermode as 2");
  //TestStepAddActionExpected( chActionText, chExpectedText );
  E_DBGR_VariableCheck("Cancontrollermode",2,Equal);

  snprintf( chActionText, elCount(chActionText), "ECU in Running state ");
  snprintf( chExpectedText, elCount(chExpectedText), "verify ECU in Running state");
  TestStepAddActionExpected( chActionText, chExpectedText );
  A_DBGR_BreakpointDeleteAll();
  A_DBGR_Go();
  E_DBGR_CheckState(T32_State_Running);

}



testcase Verify_SetCNDD_e_CanControllerMode_Interface_Transition_to_Sleep_Mode_for_CANA_CAN2()
{
  /***************************************************************************************************************/
                                                // Variable Definition
  /***************************************************************************************************************/



  /***************************************************************************************************************/
                                               // Local Values
  /***************************************************************************************************************/



  /***************************************************************************************************************/
                                              // Test Case Info
  /***************************************************************************************************************/
  setWriteDbgLevel(DebugOff);
  snprintf( chTestTitle, elCount(chTestTitle), "Verify_SetCNDD_e_CanControllerMode_Interface_Transition_to_Sleep_Mode_for_CANA_CAN2" );
  snprintf( chTestDescription, elCount(chTestDescription), "Purpose:To check the interface SetCNDD_e_CanControllerMode by setting to Sleep mode of CAN2 ");
  TestCaseAddInfo( chTestTitle, "TC_L30SW_Q-36403640", chTestDescription );

  /***************************************************************************************************************/
                                              // Start of Test Case
  /***************************************************************************************************************/

  /***************************************************************************************************************/
                                              // Test Step 0 PRECONDITIONS
  /***************************************************************************************************************/
  snprintf( chActionText, elCount(chActionText), "Flash the Software and ECU is running ");
  snprintf( chExpectedText, elCount(chExpectedText), "Ecu is should be in running state");
  TestStepAddActionExpected( chActionText, chExpectedText );

  A_DBGR_BreakpointDeleteAll();
  A_DBGR_BreakpointSet("SetCNDD_e_CanControllerMode");
  A_DBGR_R();
  A_DBGR_Go_Safe();

  /***************************************************************************************************************/
                                              // Test Step 1 Call SetCNDD_e_CanControllerMode with stop mode to put CAN controller in invalid mode.
  /***************************************************************************************************************/
  snprintf( chActionText, elCount(chActionText), "verify Breakpoint should hit in SetCNDD_e_CanControllerMode ");
  snprintf( chExpectedText, elCount(chExpectedText), "Breakpoint hit in SetCNDD_e_CanControllerMode function");

  E_DBGR_BreakpointCheckForHalt("SetCNDD_e_CanControllerMode");

  snprintf( chActionText, elCount(chActionText), "Configure Controller mode");
  snprintf( chExpectedText, elCount(chExpectedText), "verify Configure Controller mode");
  TestStepAddActionExpected( chActionText, chExpectedText );
  A_DBGR_VariableSet("can_modetransition","2");
  E_DBGR_VariableCheck("can_modetransition",2,Equal);

  snprintf( chActionText, elCount(chActionText), "Delete all Breakpoints");
  snprintf( chExpectedText, elCount(chExpectedText), "verify Delete all Breakpoints");
  TestStepAddActionExpected( chActionText, chExpectedText );
  A_DBGR_BreakpointDeleteAll();
  A_DBGR_BreakpointSet("SetCANR_e_CanIfCntrlrModeIndication");

   /***************************************************************************************************************/
                                              // Test Step 2 Keep a breakpoint in SetCANR_e_CanIfCntrlrModeIndication callback function.
  /***************************************************************************************************************/
  snprintf( chActionText, elCount(chActionText), "Set Breakpoint in SetCANR_e_CanIfCntrlrModeIndication ");
  snprintf( chExpectedText, elCount(chExpectedText), "verify is Breakpoint Set SetCANR_e_CanIfCntrlrModeIndication");
  A_DBGR_Go();

  snprintf( chActionText, elCount(chActionText), "verify Breakpoint should hit in SetCANR_e_CanIfCntrlrModeIndication ");
  snprintf( chExpectedText, elCount(chExpectedText), "Breakpoint hit in SetCANR_e_CanIfCntrlrModeIndication function");

  E_DBGR_BreakpointCheckForHalt("SetCANR_e_CanIfCntrlrModeIndication");

  snprintf( chActionText, elCount(chActionText), "Verify ChannelId ");
  snprintf( chExpectedText, elCount(chExpectedText), " ChannelId as 0");
  TestStepAddActionExpected( chActionText, chExpectedText );
  E_DBGR_VariableCheck("ChannelId ",0,Equal);
   snprintf( chActionText, elCount(chActionText), "Verify Cancontrollermode");
  snprintf( chExpectedText, elCount(chExpectedText), "Cancontrollermode as 1");
  TestStepAddActionExpected( chActionText, chExpectedText );
  E_DBGR_VariableCheck("Cancontrollermode",1,Equal);

  snprintf( chActionText, elCount(chActionText), "ECU in Running state ");
  snprintf( chExpectedText, elCount(chExpectedText), "verify ECU in Running state");
  TestStepAddActionExpected( chActionText, chExpectedText );
  A_DBGR_BreakpointDeleteAll();
  A_DBGR_Go();
  E_DBGR_CheckState(T32_State_Running);
}



testcase Verify_SetCNDD_e_CanControllerMode_Interface_Transition_to_Sleep_Mode_for_CANB_CAN8()
{
  /***************************************************************************************************************/
                                                // Variable Definition
  /***************************************************************************************************************/



  /***************************************************************************************************************/
                                               // Local Values
  /***************************************************************************************************************/



  /***************************************************************************************************************/
                                              // Test Case Info
  /***************************************************************************************************************/
  setWriteDbgLevel(DebugOff);
  snprintf( chTestTitle, elCount(chTestTitle), "To_Verify_SetCNDD_e_CanControllerMode_Interface_Transition_to_Start_Mode_for_CANB_CAN8" );
  snprintf( chTestDescription, elCount(chTestDescription), "Purpose:To check the interface SetCNDD_e_CanControllerMode by setting to sleep mode of CAN8 ");
  TestCaseAddInfo( chTestTitle, "TC_L30SW_Q-36403641", chTestDescription );

  /***************************************************************************************************************/
                                              // Start of Test Case
  /***************************************************************************************************************/

  /***************************************************************************************************************/
                                              // Test Step 0 PRECONDITIONS
  /***************************************************************************************************************/
   snprintf( chActionText, elCount(chActionText), "Flash the Software and ECU is running ");
  snprintf( chExpectedText, elCount(chExpectedText), "Ecu is should be in running state");
  TestStepAddActionExpected( chActionText, chExpectedText );

  A_DBGR_BreakpointDeleteAll();
  A_DBGR_BreakpointSet("SetCNDD_e_CanControllerMode");
  A_DBGR_R();
  A_DBGR_Go_Safe();

  /***************************************************************************************************************/
                                              // Test Step 1 Call SetCNDD_e_CanControllerMode with stop mode to put CAN controller in invalid mode.
  /***************************************************************************************************************/
  snprintf( chActionText, elCount(chActionText), "verify Breakpoint should hit in SetCNDD_e_CanControllerMode ");
  snprintf( chExpectedText, elCount(chExpectedText), "Breakpoint hit in SetCNDD_e_CanControllerMode function");

  E_DBGR_BreakpointCheckForHalt("SetCNDD_e_CanControllerMode");

  snprintf( chActionText, elCount(chActionText), "Configure Controller mode");
  snprintf( chExpectedText, elCount(chExpectedText), "verify Configure Controller mode");
  TestStepAddActionExpected( chActionText, chExpectedText );
  E_DBGR_VariableCheck_until("channelid",1,Equal);
  A_DBGR_VariableSet("can_modetransition","2");
  E_DBGR_VariableCheck("can_modetransition",2,Equal);

  snprintf( chActionText, elCount(chActionText), "Delete all Breakpoints");
  snprintf( chExpectedText, elCount(chExpectedText), "verify Delete all Breakpoints");
  TestStepAddActionExpected( chActionText, chExpectedText );
  A_DBGR_BreakpointDeleteAll();

   /***************************************************************************************************************/
                                              // Test Step 2 Keep a breakpoint in SetCANR_e_CanIfCntrlrModeIndication callback function.
  /***************************************************************************************************************/
  snprintf( chActionText, elCount(chActionText), "Set Breakpoint in SetCANR_e_CanIfCntrlrModeIndication ");
  snprintf( chExpectedText, elCount(chExpectedText), "verify is Breakpoint Set SetCANR_e_CanIfCntrlrModeIndication");
  A_DBGR_BreakpointSet("SetCANR_e_CanIfCntrlrModeIndication");  
  snprintf( chActionText, elCount(chActionText), "Run software");
  snprintf( chExpectedText, elCount(chExpectedText), "verify Software is running");
  A_DBGR_Go();

  snprintf( chActionText, elCount(chActionText), "verify Breakpoint should hit in SetCANR_e_CanIfCntrlrModeIndication ");
  snprintf( chExpectedText, elCount(chExpectedText), "Breakpoint hit in SetCANR_e_CanIfCntrlrModeIndication function");

  E_DBGR_BreakpointCheckForHalt("SetCANR_e_CanIfCntrlrModeIndication");

  cnt = 0;
  while(1)
  {
    if (cnt >= MAX_POLL_ATTEMPTS)
    {
      testStepFail("Timeout", "ChannelId polling exceeded maximum attempts");
      break;
    }
    if(cnt == 0)
    {
      snprintf( chActionText, elCount(chActionText), "Run software");
      snprintf( chExpectedText, elCount(chExpectedText), "verify Software is running");
      TestStepAddActionExpected( chActionText, chExpectedText );
    }
  A_DBGR_Go();

    snprintf( chActionText, elCount(chActionText), "Verify ChannelId ");
    snprintf( chExpectedText, elCount(chExpectedText), " ChannelId as 1");
    A_DBGR_VariableRead("ChannelId",val);
    if (val == 1)
    {
      cnt =0;
      break;
    }
    cnt = cnt +1;
  }
  snprintf( chActionText, elCount(chActionText), "Verify Cancontrollermode");
  snprintf( chExpectedText, elCount(chExpectedText), "Cancontrollermode as 1");
  //TestStepAddActionExpected( chActionText, chExpectedText );
  E_DBGR_VariableCheck("Cancontrollermode",1,Equal);

  snprintf( chActionText, elCount(chActionText), "ECU in Running state ");
  snprintf( chExpectedText, elCount(chExpectedText), "verify ECU in Running state");
  TestStepAddActionExpected( chActionText, chExpectedText );
  A_DBGR_BreakpointDeleteAll();
  A_DBGR_Go();
  E_DBGR_CheckState(T32_State_Running);

}



testcase Verify_SetCNDD_e_CanControllerMode_Interface_Transition_to_WakeUp_Mode_for_CANA_CAN2()
{
  /***************************************************************************************************************/
                                                // Variable Definition
  /***************************************************************************************************************/



  /***************************************************************************************************************/
                                               // Local Values
  /***************************************************************************************************************/



  /***************************************************************************************************************/
                                              // Test Case Info
  /***************************************************************************************************************/
  setWriteDbgLevel(DebugOff);
  snprintf( chTestTitle, elCount(chTestTitle), "Verify_SetCNDD_e_CanControllerMode_Interface_Transition_to_WakeUp_Mode_for_CANA_CAN2" );
  snprintf( chTestDescription, elCount(chTestDescription), "Purpose:To check the interface SetCNDD_e_CanControllerMode by setting to Wakeup mode of CAN2 ");
  TestCaseAddInfo( chTestTitle, "TC_L30SW_Q-36403642", chTestDescription );

  /***************************************************************************************************************/
                                              // Start of Test Case
  /***************************************************************************************************************/

  /***************************************************************************************************************/
                                              // Test Step 0 PRECONDITIONS
  /***************************************************************************************************************/
   snprintf( chActionText, elCount(chActionText), "Flash the Software and ECU is running ");
  snprintf( chExpectedText, elCount(chExpectedText), "Ecu is should be in running state");
  TestStepAddActionExpected( chActionText, chExpectedText );

  A_DBGR_BreakpointDeleteAll();
  A_DBGR_BreakpointSet("SetCNDD_e_CanControllerMode");
  A_DBGR_R();
  A_DBGR_Go_Safe();

  /***************************************************************************************************************/
                                              // Test Step 1 Call SetCNDD_e_CanControllerMode with stop mode to put CAN controller in invalid mode.
  /***************************************************************************************************************/
  snprintf( chActionText, elCount(chActionText), "verify Breakpoint should hit in SetCNDD_e_CanControllerMode ");
  snprintf( chExpectedText, elCount(chExpectedText), "Breakpoint hit in SetCNDD_e_CanControllerMode function");

  E_DBGR_BreakpointCheckForHalt("SetCNDD_e_CanControllerMode");

  snprintf( chActionText, elCount(chActionText), "Configure Controller mode");
  snprintf( chExpectedText, elCount(chExpectedText), "verify Configure Controller mode");
  TestStepAddActionExpected( chActionText, chExpectedText );
  A_DBGR_VariableSet("can_modetransition","3");
  E_DBGR_VariableCheck("can_modetransition",3,Equal);

  snprintf( chActionText, elCount(chActionText), "Delete all Breakpoints");
  snprintf( chExpectedText, elCount(chExpectedText), "verify Delete all Breakpoints");
  TestStepAddActionExpected( chActionText, chExpectedText );
  A_DBGR_BreakpointDeleteAll();
  A_DBGR_BreakpointSet("SetCANR_e_CanIfCntrlrModeIndication");

   /***************************************************************************************************************/
                                              // Test Step 2 Keep a breakpoint in SetCANR_e_CanIfCntrlrModeIndication callback function.
  /***************************************************************************************************************/
  snprintf( chActionText, elCount(chActionText), "Set Breakpoint in SetCANR_e_CanIfCntrlrModeIndication ");
  snprintf( chExpectedText, elCount(chExpectedText), "verify is Breakpoint Set SetCANR_e_CanIfCntrlrModeIndication");
  A_DBGR_Go();

  snprintf( chActionText, elCount(chActionText), "verify Breakpoint should hit in SetCANR_e_CanIfCntrlrModeIndication ");
  snprintf( chExpectedText, elCount(chExpectedText), "Breakpoint hit in SetCANR_e_CanIfCntrlrModeIndication function");

  E_DBGR_BreakpointCheckForHalt("SetCANR_e_CanIfCntrlrModeIndication");

  snprintf( chActionText, elCount(chActionText), "Verify ChannelId ");
  snprintf( chExpectedText, elCount(chExpectedText), " ChannelId as 0");
  TestStepAddActionExpected( chActionText, chExpectedText );
  E_DBGR_VariableCheck("ChannelId ",0,Equal);
   snprintf( chActionText, elCount(chActionText), "Verify Cancontrollermode");
  snprintf( chExpectedText, elCount(chExpectedText), "Cancontrollermode as 3");
  TestStepAddActionExpected( chActionText, chExpectedText );
  E_DBGR_VariableCheck("Cancontrollermode",3,Equal);

  snprintf( chActionText, elCount(chActionText), "ECU in Running state ");
  snprintf( chExpectedText, elCount(chExpectedText), "verify ECU in Running state");
  TestStepAddActionExpected( chActionText, chExpectedText );
  A_DBGR_BreakpointDeleteAll();
  A_DBGR_Go();
  E_DBGR_CheckState(T32_State_Running);
}



testcase Verify_SetCNDD_e_CanControllerMode_Interface_Transition_to_WakeUp_Mode_for_CANB_CAN8()
{
  /***************************************************************************************************************/
                                                // Variable Definition
  /***************************************************************************************************************/



  /***************************************************************************************************************/
                                               // Local Values
  /***************************************************************************************************************/



  /***************************************************************************************************************/
                                              // Test Case Info
  /***************************************************************************************************************/
  setWriteDbgLevel(DebugOff);
  snprintf( chTestTitle, elCount(chTestTitle), "To_Verify_SetCNDD_e_CanControllerMode_Interface_Transition_to_Start_Mode_for_CANB_CAN8" );
  snprintf( chTestDescription, elCount(chTestDescription), "Purpose:To check the interface SetCNDD_e_CanControllerMode by setting to wakeup mode of CAN8 ");
  TestCaseAddInfo( chTestTitle, "TC_L30SW_Q-36403643", chTestDescription );

  /***************************************************************************************************************/
                                              // Start of Test Case
  /***************************************************************************************************************/

  /***************************************************************************************************************/
                                              // Test Step 0 PRECONDITIONS
  /***************************************************************************************************************/
   snprintf( chActionText, elCount(chActionText), "Flash the Software and ECU is running ");
  snprintf( chExpectedText, elCount(chExpectedText), "Ecu is should be in running state");
  TestStepAddActionExpected( chActionText, chExpectedText );

  A_DBGR_BreakpointDeleteAll();
  A_DBGR_BreakpointSet("SetCNDD_e_CanControllerMode");
  A_DBGR_R();
  A_DBGR_Go_Safe();

  /***************************************************************************************************************/
                                              // Test Step 1 Call SetCNDD_e_CanControllerMode with stop mode to put CAN controller in invalid mode.
  /***************************************************************************************************************/

  snprintf( chActionText, elCount(chActionText), "verify Breakpoint should hit in SetCNDD_e_CanControllerMode ");
  snprintf( chExpectedText, elCount(chExpectedText), "Breakpoint hit in SetCNDD_e_CanControllerMode function");
  E_DBGR_BreakpointCheckForHalt("SetCNDD_e_CanControllerMode");

  snprintf( chActionText, elCount(chActionText), "Configure Controller mode");
  snprintf( chExpectedText, elCount(chExpectedText), "verify Configure Controller mode");
  TestStepAddActionExpected( chActionText, chExpectedText );
  E_DBGR_VariableCheck_until("channelid",1,Equal);
  A_DBGR_VariableSet("can_modetransition","3");
  E_DBGR_VariableCheck("can_modetransition",3,Equal);

  snprintf( chActionText, elCount(chActionText), "Delete all Breakpoints");
  snprintf( chExpectedText, elCount(chExpectedText), "verify Delete all Breakpoints");
  TestStepAddActionExpected( chActionText, chExpectedText );
  A_DBGR_BreakpointDeleteAll();

   /***************************************************************************************************************/
                                              // Test Step 2 Keep a breakpoint in SetCANR_e_CanIfCntrlrModeIndication callback function.
  /***************************************************************************************************************/
  snprintf( chActionText, elCount(chActionText), "Set Breakpoint in SetCANR_e_CanIfCntrlrModeIndication ");
  snprintf( chExpectedText, elCount(chExpectedText), "verify is Breakpoint Set SetCANR_e_CanIfCntrlrModeIndication");
  A_DBGR_BreakpointSet("SetCANR_e_CanIfCntrlrModeIndication");  
  snprintf( chActionText, elCount(chActionText), "Run software");
  snprintf( chExpectedText, elCount(chExpectedText), "verify Software is running");
  A_DBGR_Go();

  snprintf( chActionText, elCount(chActionText), "verify Breakpoint should hit in SetCANR_e_CanIfCntrlrModeIndication ");
  snprintf( chExpectedText, elCount(chExpectedText), "Breakpoint hit in SetCANR_e_CanIfCntrlrModeIndication function");

  E_DBGR_BreakpointCheckForHalt("SetCANR_e_CanIfCntrlrModeIndication");

  cnt = 0;
  while(1)
  {
    if (cnt >= MAX_POLL_ATTEMPTS)
    {
      testStepFail("Timeout", "ChannelId polling exceeded maximum attempts");
      break;
    }
    if(cnt == 0)
    {
      snprintf( chActionText, elCount(chActionText), "Run software");
      snprintf( chExpectedText, elCount(chExpectedText), "verify Software is running");
      TestStepAddActionExpected( chActionText, chExpectedText );
    }
  A_DBGR_Go();

    snprintf( chActionText, elCount(chActionText), "Verify ChannelId ");
    snprintf( chExpectedText, elCount(chExpectedText), " ChannelId as 1");
    A_DBGR_VariableRead("ChannelId",val);
    if (val == 1)
    {
      cnt =0;
      break;
    }
    cnt = cnt +1;
  }

  snprintf( chActionText, elCount(chActionText), "Verify Cancontrollermode");
  snprintf( chExpectedText, elCount(chExpectedText), "Cancontrollermode as 3");
  //TestStepAddActionExpected( chActionText, chExpectedText );
  E_DBGR_VariableCheck("Cancontrollermode",3,Equal);

  snprintf( chActionText, elCount(chActionText), "ECU in Running state ");
  snprintf( chExpectedText, elCount(chExpectedText), "verify ECU in Running state");
  TestStepAddActionExpected( chActionText, chExpectedText );
  A_DBGR_BreakpointDeleteAll();
  A_DBGR_Go();
  E_DBGR_CheckState(T32_State_Running);

}



testcase Verify_MngCNDD_CanMainMode_interface_Mode_Transition_to_Stop_Mode_for_CANA_CAN2()
{
  /***************************************************************************************************************/
                                                // Variable Definition
  /***************************************************************************************************************/



  /***************************************************************************************************************/
                                               // Local Values
  /***************************************************************************************************************/



  /***************************************************************************************************************/
                                              // Test Case Info
  /***************************************************************************************************************/
  setWriteDbgLevel(DebugOff);
  snprintf( chTestTitle, elCount(chTestTitle), "Verify_MngCNDD_CanMainMode_interface_Mode_Transition_to_Stop_Mode_for_CANA_CAN2" );
  snprintf( chTestDescription, elCount(chTestDescription), "Purpose:To check the interface MngCNDD_CanMainMode by setting to stop mode of CAN2 ");
  TestCaseAddInfo( chTestTitle, "TC_L30SW_Q-36403644", chTestDescription );

  /***************************************************************************************************************/
                                              // Start of Test Case
  /***************************************************************************************************************/

  /***************************************************************************************************************/
                                              // Test Step 0 PRECONDITIONS
  /***************************************************************************************************************/
  snprintf( chActionText, elCount(chActionText), "Flash the Software and ECU is running ");
  snprintf( chExpectedText, elCount(chExpectedText), "Ecu is should be in running state");
  TestStepAddActionExpected( chActionText, chExpectedText );

  A_DBGR_BreakpointDeleteAll();
  A_DBGR_BreakpointSet("SetCNDD_e_CanControllerMode");
  A_DBGR_R();
  A_DBGR_Go_Safe();

  /***************************************************************************************************************/
                                              // Test Step 1 Call SetCNDD_e_CanControllerMode with stop mode to put CAN controller in invalid mode.
  /***************************************************************************************************************/
  snprintf( chActionText, elCount(chActionText), "verify Breakpoint should hit in SetCNDD_e_CanControllerMode ");
  snprintf( chExpectedText, elCount(chExpectedText), "Breakpoint hit in SetCNDD_e_CanControllerMode function");

  E_DBGR_BreakpointCheckForHalt("SetCNDD_e_CanControllerMode");

  snprintf( chActionText, elCount(chActionText), "Configure Controller mode");
  snprintf( chExpectedText, elCount(chExpectedText), "verify Configure Controller mode");
  TestStepAddActionExpected( chActionText, chExpectedText );
  A_DBGR_VariableSet("can_modetransition","1");
  E_DBGR_VariableCheck("can_modetransition",1,Equal);

  snprintf( chActionText, elCount(chActionText), "Delete all Breakpoints");
  snprintf( chExpectedText, elCount(chExpectedText), "verify Delete all Breakpoints");
  TestStepAddActionExpected( chActionText, chExpectedText );
  A_DBGR_BreakpointDeleteAll();
  A_DBGR_BreakpointSet("MngCNDD_CanMainMode");

  /***************************************************************************************************************/
                                              // Test Step 2 Keep a breakpoint in MngCNDD_CanMainMode callback function.
  /***************************************************************************************************************/
  snprintf( chActionText, elCount(chActionText), "Set Breakpoint in MngCNDD_CanMainMode ");
  snprintf( chExpectedText, elCount(chExpectedText), "verify is Breakpoint Set MngCNDD_CanMainMode");
  A_DBGR_Go();

  snprintf( chActionText, elCount(chActionText), "verify Breakpoint should hit in MngCNDD_CanMainMode ");
  snprintf( chExpectedText, elCount(chExpectedText), "Breakpoint hit in MngCNDD_CanMainMode function");
  //TestStepAddActionExpected( chActionText, chExpectedText );
  E_DBGR_BreakpointCheckForHalt("MngCNDD_CanMainMode");

   snprintf( chActionText, elCount(chActionText), "Flash the Software and ECU is running ");
  snprintf( chExpectedText, elCount(chExpectedText), "Ecu is should be in running state");
  TestStepAddActionExpected( chActionText, chExpectedText );

  A_DBGR_BreakpointDeleteAll();
  A_DBGR_BreakpointSet("SetCANR_e_CanIfCntrlrModeIndication");
   /***************************************************************************************************************/
                                              // Test Step 3 Keep a breakpoint in SetCANR_e_CanIfCntrlrModeIndication callback function.
  /***************************************************************************************************************/
  snprintf( chActionText, elCount(chActionText), "Set Breakpoint in SetCANR_e_CanIfCntrlrModeIndication ");
  snprintf( chExpectedText, elCount(chExpectedText), "verify is Breakpoint Set SetCANR_e_CanIfCntrlrModeIndication");
  //TestStepAddActionExpected( chActionText, chExpectedText );
  A_DBGR_Go();

  snprintf( chActionText, elCount(chActionText), "verify Breakpoint should hit in SetCANR_e_CanIfCntrlrModeIndication ");
  snprintf( chExpectedText, elCount(chExpectedText), "Breakpoint hit in SetCANR_e_CanIfCntrlrModeIndication function");
  //TestStepAddActionExpected( chActionText, chExpectedText );
  E_DBGR_BreakpointCheckForHalt("SetCANR_e_CanIfCntrlrModeIndication");

  snprintf( chActionText, elCount(chActionText), "Verify ChannelId ");
  snprintf( chExpectedText, elCount(chExpectedText), " ChannelId as 0");
  TestStepAddActionExpected( chActionText, chExpectedText );
  E_DBGR_VariableCheck("ChannelId ",0,Equal);
   snprintf( chActionText, elCount(chActionText), "Verify Cancontrollermode");
  snprintf( chExpectedText, elCount(chExpectedText), "Cancontrollermode as 3");
  TestStepAddActionExpected( chActionText, chExpectedText );
  E_DBGR_VariableCheck("Cancontrollermode",3,Equal);

  snprintf( chActionText, elCount(chActionText), "ECU in Running state ");
  snprintf( chExpectedText, elCount(chExpectedText), "verify ECU in Running state");
  TestStepAddActionExpected( chActionText, chExpectedText );
  A_DBGR_BreakpointDeleteAll();
  A_DBGR_Go();
  E_DBGR_CheckState(T32_State_Running);
}



testcase Verify_MngCNDD_CanMainMode_interface_Mode_Transition_to_Start_Mode_for_CANA_CAN2()
{
  /***************************************************************************************************************/
                                                // Variable Definition
  /***************************************************************************************************************/



  /***************************************************************************************************************/
                                               // Local Values
  /***************************************************************************************************************/



  /***************************************************************************************************************/
                                              // Test Case Info
  /***************************************************************************************************************/
  setWriteDbgLevel(DebugOff);
  snprintf( chTestTitle, elCount(chTestTitle), "Verify_MngCNDD_CanMainMode_interface_Mode_Transition_to_Start_Mode_for_CANA_CAN2" );
  snprintf( chTestDescription, elCount(chTestDescription), "Purpose:To check the interface MngCNDD_CanMainMode by setting to start mode of CAN2 ");
  TestCaseAddInfo( chTestTitle, "TC_L30SW_Q-36403645", chTestDescription );

  /***************************************************************************************************************/
                                              // Start of Test Case
  /***************************************************************************************************************/

  /***************************************************************************************************************/
                                              // Test Step 0 PRECONDITIONS
  /***************************************************************************************************************/
   snprintf( chActionText, elCount(chActionText), "Flash the Software and ECU is running ");
  snprintf( chExpectedText, elCount(chExpectedText), "Ecu is should be in running state");
  TestStepAddActionExpected( chActionText, chExpectedText );

  A_DBGR_BreakpointDeleteAll();
  A_DBGR_BreakpointSet("SetCNDD_e_CanControllerMode");
  A_DBGR_R();
  A_DBGR_Go_Safe();

  /***************************************************************************************************************/
                                              // Test Step 1 Call SetCNDD_e_CanControllerMode with stop mode to put CAN controller in invalid mode.
  /***************************************************************************************************************/
  snprintf( chActionText, elCount(chActionText), "verify Breakpoint should hit in SetCNDD_e_CanControllerMode ");
  snprintf( chExpectedText, elCount(chExpectedText), "Breakpoint hit in SetCNDD_e_CanControllerMode function");

  E_DBGR_BreakpointCheckForHalt("SetCNDD_e_CanControllerMode");

  snprintf( chActionText, elCount(chActionText), "Configure Controller mode");
  snprintf( chExpectedText, elCount(chExpectedText), "verify Configure Controller mode");
  TestStepAddActionExpected( chActionText, chExpectedText );
  A_DBGR_VariableSet("can_modetransition","0");
  E_DBGR_VariableCheck("can_modetransition",0,Equal);

  snprintf( chActionText, elCount(chActionText), "Delete all Breakpoints");
  snprintf( chExpectedText, elCount(chExpectedText), "verify Delete all Breakpoints");
  TestStepAddActionExpected( chActionText, chExpectedText );
  A_DBGR_BreakpointDeleteAll();
  A_DBGR_BreakpointSet("MngCNDD_CanMainMode");

  /***************************************************************************************************************/
                                              // Test Step 2 Keep a breakpoint in MngCNDD_CanMainMode callback function.
  /***************************************************************************************************************/
  snprintf( chActionText, elCount(chActionText), "Set Breakpoint in MngCNDD_CanMainMode ");
  snprintf( chExpectedText, elCount(chExpectedText), "verify is Breakpoint Set MngCNDD_CanMainMode");
  A_DBGR_Go();

  snprintf( chActionText, elCount(chActionText), "verify Breakpoint should hit in MngCNDD_CanMainMode ");
  snprintf( chExpectedText, elCount(chExpectedText), "Breakpoint hit in MngCNDD_CanMainMode function");

  E_DBGR_BreakpointCheckForHalt("MngCNDD_CanMainMode");

   snprintf( chActionText, elCount(chActionText), "Flash the Software and ECU is running ");
  snprintf( chExpectedText, elCount(chExpectedText), "Ecu is should be in running state");
  TestStepAddActionExpected( chActionText, chExpectedText );

  A_DBGR_BreakpointDeleteAll();
  A_DBGR_BreakpointSet("SetCANR_e_CanIfCntrlrModeIndication");
   /***************************************************************************************************************/
                                              // Test Step 3 Keep a breakpoint in SetCANR_e_CanIfCntrlrModeIndication callback function.
  /***************************************************************************************************************/
  snprintf( chActionText, elCount(chActionText), "Set Breakpoint in SetCANR_e_CanIfCntrlrModeIndication ");
  snprintf( chExpectedText, elCount(chExpectedText), "verify is Breakpoint Set SetCANR_e_CanIfCntrlrModeIndication");
  //TestStepAddActionExpected( chActionText, chExpectedText );
  A_DBGR_Go();

  snprintf( chActionText, elCount(chActionText), "verify Breakpoint should hit in SetCANR_e_CanIfCntrlrModeIndication ");
  snprintf( chExpectedText, elCount(chExpectedText), "Breakpoint hit in SetCANR_e_CanIfCntrlrModeIndication function");
  //TestStepAddActionExpected( chActionText, chExpectedText );
  E_DBGR_BreakpointCheckForHalt("SetCANR_e_CanIfCntrlrModeIndication");

  snprintf( chActionText, elCount(chActionText), "Verify ChannelId ");
  snprintf( chExpectedText, elCount(chExpectedText), " ChannelId as 0");
  TestStepAddActionExpected( chActionText, chExpectedText );
  E_DBGR_VariableCheck("ChannelId ",0,Equal);
   snprintf( chActionText, elCount(chActionText), "Verify Cancontrollermode");
  snprintf( chExpectedText, elCount(chExpectedText), "Cancontrollermode as 2");
  TestStepAddActionExpected( chActionText, chExpectedText );
  E_DBGR_VariableCheck("Cancontrollermode",2,Equal);

  snprintf( chActionText, elCount(chActionText), "ECU in Running state ");
  snprintf( chExpectedText, elCount(chExpectedText), "verify ECU in Running state");
  TestStepAddActionExpected( chActionText, chExpectedText );
  A_DBGR_BreakpointDeleteAll();
  A_DBGR_Go();
  E_DBGR_CheckState(T32_State_Running);
}





testcase Verify_the_interface_MngCNDD_CanMainRead_for_CANA_CAN2()
{
  /***************************************************************************************************************/
                                                // Variable Definition
  /***************************************************************************************************************/



  /***************************************************************************************************************/
                                               // Local Values
  /***************************************************************************************************************/



  /***************************************************************************************************************/
                                              // Test Case Info
  /***************************************************************************************************************/
  setWriteDbgLevel(DebugOff);
  snprintf( chTestTitle, elCount(chTestTitle), "Verify_the_interface_MngCNDD_CanMainRead_upon_CAN_Message_Reception_callback_function_SetCANR_h_CanIfRxIndication_should_invoke_for_CANA_CAN2" );
  snprintf( chTestDescription, elCount(chTestDescription), "Purpose:To check MngCNDD_CanMainRead of CAN2 RX  ");
  TestCaseAddInfo( chTestTitle, "TC_L30SW_Q-36403632", chTestDescription );

  /***************************************************************************************************************/
                                              // Start of Test Case
  /***************************************************************************************************************/

  /***************************************************************************************************************/
                                              // Test Step 0 PRECONDITIONS
  /***************************************************************************************************************/
   snprintf( chActionText, elCount(chActionText), "Flash the Software and ECU is running ");
  snprintf( chExpectedText, elCount(chExpectedText), "Ecu is should be in running state");
  TestStepAddActionExpected( chActionText, chExpectedText );

  A_DBGR_BreakpointDeleteAll();
  A_DBGR_BreakpointSet("TestCan_Init");
  A_DBGR_R();
  A_DBGR_Go_Safe();

  /***************************************************************************************************************/
                                              // Test Step 1 Configure the values for the structure TsCNDD_CanCnfgType with the minimum message length for CANA.
  /***************************************************************************************************************/
  snprintf( chActionText, elCount(chActionText), "verify Breakpoint should hit in TestCan_Init ");
  snprintf( chExpectedText, elCount(chExpectedText), "Breakpoint hit in TestCan_Init function");

  E_DBGR_BreakpointCheckForHalt("TestCan_Init");

  snprintf( chActionText, elCount(chActionText), "Configure CanId values ");
  snprintf( chExpectedText, elCount(chExpectedText), "verify Configure CanId values");
  TestStepAddActionExpected( chActionText, chExpectedText );
  A_DBGR_VariableSet("VaCANR_CanRxMsgs[0].CanId","0x00000123");
  E_DBGR_VariableCheck("VaCANR_CanRxMsgs[0].CanId",0x00000123,Equal);

  snprintf( chActionText, elCount(chActionText), "Configure CanFilterMask values ");
  snprintf( chExpectedText, elCount(chExpectedText), "verify Configure CanFilterMask values");
  TestStepAddActionExpected( chActionText, chExpectedText );
  A_DBGR_VariableSet("VaCANR_CanRxMsgs[0].CanFilterMask","0x07FF");
  E_DBGR_VariableCheck("VaCANR_CanRxMsgs[0].CanFilterMask",0x07FF,Equal);

   snprintf( chActionText, elCount(chActionText), "Configure CanRxMessageIdx values ");
  snprintf( chExpectedText, elCount(chExpectedText), "verify Configure CanRxMessageIdx values");
  TestStepAddActionExpected( chActionText, chExpectedText );
  A_DBGR_VariableSet("VaCANR_CanRxMsgs[0].CanRxMessageIdx","0");
  E_DBGR_VariableCheck("VaCANR_CanRxMsgs[0].CanRxMessageIdx",0,Equal);

  snprintf( chActionText, elCount(chActionText), "Configure CanMessageLen values ");
  snprintf( chExpectedText, elCount(chExpectedText), "verify Configure CanMessageLen values");
  TestStepAddActionExpected( chActionText, chExpectedText );
  A_DBGR_VariableSet("VaCANR_CanRxMsgs[0].CanMessageLen","1");
  E_DBGR_VariableCheck("VaCANR_CanRxMsgs[0].CanMessageLen",1,Equal);

   snprintf( chActionText, elCount(chActionText), "Configure CanIdType values ");
  snprintf( chExpectedText, elCount(chExpectedText), "verify Configure CanIdType values");
  TestStepAddActionExpected( chActionText, chExpectedText );
  A_DBGR_VariableSet("VaCANR_CanRxMsgs[0].CanIdType","2");
  E_DBGR_VariableCheck("VaCANR_CanRxMsgs[0].CanIdType",2,Equal);

  snprintf( chActionText, elCount(chActionText), "Configure CanControllerId values ");
  snprintf( chExpectedText, elCount(chExpectedText), "verify Configure CanControllerId values");
  TestStepAddActionExpected( chActionText, chExpectedText );
  A_DBGR_VariableSet("VaCANR_CanRxMsgs[0].CanControllerId","0");
  E_DBGR_VariableCheck("VaCANR_CanRxMsgs[0].CanControllerId",0,Equal);

   /***************************************************************************************************************/
                                              // Test Step 2 Call the function MngCNDD_CanRxInit with the configured structure. MngCNDD_CanRxInit(&canConfigA);
  /***************************************************************************************************************/
  snprintf( chActionText, elCount(chActionText), "Set Breakpoint in MngCNDD_CanRxInit ");
  snprintf( chExpectedText, elCount(chExpectedText), "verify is Breakpoint Set MngCNDD_CanRxInit");
  TestStepAddActionExpected( chActionText, chExpectedText );

  A_DBGR_BreakpointSet("MngCNDD_CanRxInit");
  A_DBGR_Go();

  snprintf( chActionText, elCount(chActionText), "verify Breakpoint should hit in MngCNDD_CanRxInit ");
  snprintf( chExpectedText, elCount(chExpectedText), "Breakpoint hit in MngCNDD_CanRxInit function");
  E_DBGR_BreakpointCheckForHalt("MngCNDD_CanRxInit");

 /***************************************************************************************************************/
                                              // Test Step 3 Call SetCNDD_e_CanControllerMode with start mode. SetCNDD_e_CanControllerMode(0, 2); // Start mode for CAN controller 0
  /***************************************************************************************************************/
  snprintf( chActionText, elCount(chActionText), "Set Breakpoint in SetCNDD_e_CanControllerMode funtion ");
  snprintf( chExpectedText, elCount(chExpectedText), "Breakpoint is Set in SetCNDD_e_CanControllerMode");
  TestStepAddActionExpected( chActionText, chExpectedText );
  A_DBGR_BreakpointSet("SetCNDD_e_CanControllerMode");
  A_DBGR_Go();
  A_DBGR_Go();

  snprintf( chActionText, elCount(chActionText), " Verify Breakpoint should hit in SetCNDD_e_CanControllerMode ");
  snprintf( chExpectedText, elCount(chExpectedText), "Breakpoint hit in SetCNDD_e_CanControllerMode function");
  E_DBGR_BreakpointCheckForHalt("SetCNDD_e_CanControllerMode");

  /***************************************************************************************************************/
                                              // Test Step 4 set Breakpoint in MngCNDD_CanMainRead.
  /***************************************************************************************************************/
  snprintf( chActionText, elCount(chActionText), "set Breakpoint MngCNDD_CanMainRead callback function ");
  snprintf( chExpectedText, elCount(chExpectedText), "Breakpoint is Set in MngCNDD_CanMainRead");
  TestStepAddActionExpected( chActionText, chExpectedText );
  A_DBGR_BreakpointSet("MngCNDD_CanMainRead");
  A_DBGR_Go();
  snprintf( chActionText, elCount(chActionText), " Verify Breakpoint should hit in MngCNDD_CanMainRead ");
  snprintf( chExpectedText, elCount(chExpectedText), "Breakpoint hit in MngCNDD_CanMainRead function");
  E_DBGR_BreakpointCheckForHalt("MngCNDD_CanMainRead");

  snprintf( chActionText, elCount(chActionText), "Flash the Software and ECU is running ");
  snprintf( chExpectedText, elCount(chExpectedText), "Ecu is should be in running state");
  TestStepAddActionExpected( chActionText, chExpectedText );

  A_DBGR_BreakpointDeleteAll();
  A_DBGR_BreakpointSet("SetCANR_h_CanIfRxIndication");


   /***************************************************************************************************************/
                                              // Test Step 5 set Breakpoint in SetCANR_h_CanIfRxIndication.
  /***************************************************************************************************************/
  snprintf( chActionText, elCount(chActionText), "set Breakpoint inSetCANR_h_CanIfRxIndication callback function ");
  snprintf( chExpectedText, elCount(chExpectedText), "Breakpoint is Set in SetCANR_h_CanIfRxIndication");
  //TestStepAddActionExpected( chActionText, chExpectedText );
  A_DBGR_Go();

  /***************************************************************************************************************/
                                              // Test Step 6 Verify that the transmitted message with minimum message length using canoe.
  /***************************************************************************************************************/
  snprintf( chActionText, elCount(chActionText), "Transmit CAN message. ID:0x123,PDU info:0x01");
  snprintf( chExpectedText, elCount(chExpectedText), "CAN message transmitted. ID:0x123,PDU info:0x01");
  A_CAN_SendMessage(0x00000123, dat_tcno, 1, 1);

   /***************************************************************************************************************/
                                              // Test Step 6 Verify SetCANR_h_CanIfRxIndication callback function invoked with relevant CAN_RECEIVE_MSG_INDEX, CAN_PDU_MESSAGE_ID, CAN_PDU_DATA_LENGTH, CAN_PDU_DATA_POINTER.
  /***************************************************************************************************************/
  snprintf( chActionText, elCount(chActionText), " Verify Breakpoint should hit in SetCANR_h_CanIfRxIndication ");
  snprintf( chExpectedText, elCount(chExpectedText), "Breakpoint hit in SetCANR_h_CanIfRxIndication function");
  E_DBGR_BreakpointCheckForHalt("SetCANR_h_CanIfRxIndication");

  snprintf( chActionText, elCount(chActionText), "verify CanrxmsgIdx");
  snprintf( chExpectedText, elCount(chExpectedText), "CanrxmsgIdx as 0");
  TestStepAddActionExpected( chActionText, chExpectedText );
  E_DBGR_VariableCheck("CanrxmsgIdx",0,Equal);
  snprintf( chActionText, elCount(chActionText), "Verify CanpdumsgId ");
  snprintf( chExpectedText, elCount(chExpectedText), " CanpdumsgId as 0x00000123");
  TestStepAddActionExpected( chActionText, chExpectedText );
  E_DBGR_VariableCheck("CanpdumsgId ",0x00000123,Equal);
   snprintf( chActionText, elCount(chActionText), "Verify Canpdudatalength");
  snprintf( chExpectedText, elCount(chExpectedText), "Canpdudatalength as 1");
  TestStepAddActionExpected( chActionText, chExpectedText );
  E_DBGR_VariableCheck("Canpdudatalength",1,Equal);
}

testcase Verify_the_interface_MngCNDD_CanMainRead_for_CANB_CAN8()
{
  /***************************************************************************************************************/
                                                // Variable Definition
  /***************************************************************************************************************/



  /***************************************************************************************************************/
                                               // Local Values
  /***************************************************************************************************************/



  /***************************************************************************************************************/
                                              // Test Case Info
  /***************************************************************************************************************/
  setWriteDbgLevel(DebugOff);
  snprintf( chTestTitle, elCount(chTestTitle), "Verify_the_interface_MngCNDD_CanMainRead_upon_CAN_Message_Reception_callback_function_SetCANR_h_CanIfRxIndication_for_CANB_CAN8_should_invoke" );
  snprintf( chTestDescription, elCount(chTestDescription), "Purpose:To check the MngCNDD_CanMainRead interface for CAN8");
  TestCaseAddInfo( chTestTitle, "C_L30SW_Q-36403633", chTestDescription );

  /***************************************************************************************************************/
                                              // Start of Test Case
  /***************************************************************************************************************/

  /***************************************************************************************************************/
                                              // Test Step 0 PRECONDITIONS
  /***************************************************************************************************************/
  snprintf( chActionText, elCount(chActionText), "Flash the Software and ECU is running ");
  snprintf( chExpectedText, elCount(chExpectedText), "Ecu is should be in running state");
  TestStepAddActionExpected( chActionText, chExpectedText );

  A_DBGR_BreakpointDeleteAll();
  A_DBGR_BreakpointSet("TestCan_Init");
  A_DBGR_R();
  A_DBGR_Go_Safe();
  /***************************************************************************************************************/
                                              // Test Step 1 Configure the values for the structure TsCNDD_CanCnfgType for CANB.
  /***************************************************************************************************************/
  snprintf( chActionText, elCount(chActionText), "verify Breakpoint should hit in TestCan_Init ");
  snprintf( chExpectedText, elCount(chExpectedText), "Breakpoint hit in TestCan_Init function");
  //TestStepAddActionExpected( chActionText, chExpectedText );
  E_DBGR_BreakpointCheckForHalt("TestCan_Init");

  snprintf( chActionText, elCount(chActionText), "Configure CanId values ");
  snprintf( chExpectedText, elCount(chExpectedText), "verify Configure CanId values");
  TestStepAddActionExpected( chActionText, chExpectedText );
  A_DBGR_VariableSet("VaCANR_CanRxMsgs[0].CanId","0x456");
  E_DBGR_VariableCheck("VaCANR_CanRxMsgs[0].CanId",0x456,Equal);

  snprintf( chActionText, elCount(chActionText), "Configure CanFilterMask values ");
  snprintf( chExpectedText, elCount(chExpectedText), "verify Configure CanFilterMask values");
  TestStepAddActionExpected( chActionText, chExpectedText );
  A_DBGR_VariableSet("VaCANR_CanRxMsgs[0].CanFilterMask","2047");
  E_DBGR_VariableCheck("VaCANR_CanRxMsgs[0].CanFilterMask",2047,Equal);

   snprintf( chActionText, elCount(chActionText), "Configure CanRxMessageIdx values ");
  snprintf( chExpectedText, elCount(chExpectedText), "verify Configure CanRxMessageIdx values");
  TestStepAddActionExpected( chActionText, chExpectedText );
  A_DBGR_VariableSet("VaCANR_CanRxMsgs[0].CanRxMessageIdx","0");
  E_DBGR_VariableCheck("VaCANR_CanRxMsgs[0].CanRxMessageIdx",0,Equal);

   snprintf( chActionText, elCount(chActionText), "Configure CanMessageLen values ");
  snprintf( chExpectedText, elCount(chExpectedText), "verify Configure CanMessageLen values");
  TestStepAddActionExpected( chActionText, chExpectedText );
  A_DBGR_VariableSet("VaCANR_CanRxMsgs[0].CanMessageLen","1");
  E_DBGR_VariableCheck("VaCANR_CanRxMsgs[0].CanMessageLen",1,Equal);

   snprintf( chActionText, elCount(chActionText), "Configure CanIdType values ");
  snprintf( chExpectedText, elCount(chExpectedText), "verify Configure CanIdType values");
  TestStepAddActionExpected( chActionText, chExpectedText );
  A_DBGR_VariableSet("VaCANR_CanRxMsgs[0].CanIdType","2");
  E_DBGR_VariableCheck("VaCANR_CanRxMsgs[0].CanIdType",2,Equal);

  snprintf( chActionText, elCount(chActionText), "Configure CanControllerId values ");
  snprintf( chExpectedText, elCount(chExpectedText), "verify Configure CanControllerId values");
  TestStepAddActionExpected( chActionText, chExpectedText );
  A_DBGR_VariableSet("VaCANR_CanRxMsgs[0].CanControllerId","1");
  E_DBGR_VariableCheck("VaCANR_CanRxMsgs[0].CanControllerId",1,Equal);

   /***************************************************************************************************************/
                                              // Test Step 2 Call the function MngCNDD_CanRxInit with the configured structure. MngCNDD_CanRxInit(&canConfigA);
  /***************************************************************************************************************/
  snprintf( chActionText, elCount(chActionText), "Set Breakpoint in MngCNDD_CanRxInit ");
  snprintf( chExpectedText, elCount(chExpectedText), "verify is Breakpoint Set MngCNDD_CanRxInit");
  TestStepAddActionExpected( chActionText, chExpectedText );

  //A_DBGR_R();
  A_DBGR_BreakpointSet("MngCNDD_CanRxInit");
  A_DBGR_Go();

  snprintf( chActionText, elCount(chActionText), "verify Breakpoint should hit in MngCNDD_CanRxInit ");
  snprintf( chExpectedText, elCount(chExpectedText), "Breakpoint hit in MngCNDD_CanRxInit function");
  //TestStepAddActionExpected( chActionText, chExpectedText );
  E_DBGR_BreakpointCheckForHalt("MngCNDD_CanRxInit");

 /***************************************************************************************************************/
                                              // Test Step 3 Call SetCNDD_e_CanControllerMode with start mode. SetCNDD_e_CanControllerMode(0, 2); // Start mode for CAN controller 0
  /***************************************************************************************************************/
  snprintf( chActionText, elCount(chActionText), "Set Breakpoint in SetCNDD_e_CanControllerMode funtion ");
  snprintf( chExpectedText, elCount(chExpectedText), "Breakpoint is Set in SetCNDD_e_CanControllerMode");
  TestStepAddActionExpected( chActionText, chExpectedText );
  A_DBGR_BreakpointSet("SetCNDD_e_CanControllerMode");
  A_DBGR_Go();
  A_DBGR_Go();

  snprintf( chActionText, elCount(chActionText), " Verify Breakpoint should hit in SetCNDD_e_CanControllerMode ");
  snprintf( chExpectedText, elCount(chExpectedText), "Breakpoint hit in SetCNDD_e_CanControllerMode function");
  //TestStepAddActionExpected( chActionText, chExpectedText );
  E_DBGR_BreakpointCheckForHalt("SetCNDD_e_CanControllerMode");

  /***************************************************************************************************************/
                                              // Test Step 4 set Breakpoint in MngCNDD_CanMainRead.
  /***************************************************************************************************************/
  snprintf( chActionText, elCount(chActionText), "set Breakpoint MngCNDD_CanMainRead callback function ");
  snprintf( chExpectedText, elCount(chExpectedText), "Breakpoint is Set in MngCNDD_CanMainRead");
  TestStepAddActionExpected( chActionText, chExpectedText );
  A_DBGR_BreakpointSet("MngCNDD_CanMainRead");
  A_DBGR_Go();
  snprintf( chActionText, elCount(chActionText), " Verify Breakpoint should hit in MngCNDD_CanMainRead ");
  snprintf( chExpectedText, elCount(chExpectedText), "Breakpoint hit in MngCNDD_CanMainRead function");
  E_DBGR_BreakpointCheckForHalt("MngCNDD_CanMainRead");

  snprintf( chActionText, elCount(chActionText), "Flash the Software and ECU is running ");
  snprintf( chExpectedText, elCount(chExpectedText), "Ecu is should be in running state");
  TestStepAddActionExpected( chActionText, chExpectedText );

  A_DBGR_BreakpointDeleteAll();
  A_DBGR_BreakpointSet("SetCANR_h_CanIfRxIndication");

   /***************************************************************************************************************/
                                              // Test Step 5 set Breakpoint in SetCANR_h_CanIfRxIndication.
  /***************************************************************************************************************/
  snprintf( chActionText, elCount(chActionText), "set Breakpoint inSetCANR_h_CanIfRxIndication callback function ");
  snprintf( chExpectedText, elCount(chExpectedText), "Breakpoint is Set in SetCANR_h_CanIfRxIndication");
  //TestStepAddActionExpected( chActionText, chExpectedText );
  A_DBGR_Go();

  /***************************************************************************************************************/
                                              // Test Step 6 Verify that the transmitted message using canoe.
  /***************************************************************************************************************/
  snprintf( chActionText, elCount(chActionText), "Transmit CAN message. ID:0x401,PDU info:0x01");
  snprintf( chExpectedText, elCount(chExpectedText), "CAN message transmitted. ID:0x456,PDU info:0x01");
  //TestStepAddActionExpected( chActionText, chExpectedText );
  A_CAN_SendMessage(0x456, dat_tcno, 0x01, 2);

   /***************************************************************************************************************/
                                              // Test Step 7 Verify SetCANR_h_CanIfRxIndication callback function invoked with relevant CAN_RECEIVE_MSG_INDEX, CAN_PDU_MESSAGE_ID, CAN_PDU_DATA_LENGTH, CAN_PDU_DATA_POINTER.
  /***************************************************************************************************************/
  snprintf( chActionText, elCount(chActionText), " Verify Breakpoint should hit in SetCANR_h_CanIfRxIndication ");
  snprintf( chExpectedText, elCount(chExpectedText), "Breakpoint hit in SetCANR_h_CanIfRxIndication function");
 // TestStepAddActionExpected( chActionText, chExpectedText );
  E_DBGR_BreakpointCheckForHalt("SetCANR_h_CanIfRxIndication");

  snprintf( chActionText, elCount(chActionText), "verify CanrxmsgIdx");
  snprintf( chExpectedText, elCount(chExpectedText), "CanrxmsgIdx as 0");
  TestStepAddActionExpected( chActionText, chExpectedText );
  E_DBGR_VariableCheck("CanrxmsgIdx",0,Equal);
  snprintf( chActionText, elCount(chActionText), "Verify CanpdumsgId ");
  snprintf( chExpectedText, elCount(chExpectedText), " CanpdumsgId as 1025");
  TestStepAddActionExpected( chActionText, chExpectedText );
  E_DBGR_VariableCheck("CanpdumsgId ",0x456,Equal);
   snprintf( chActionText, elCount(chActionText), "Verify Canpdudatalength");
  snprintf( chExpectedText, elCount(chExpectedText), "Canpdudatalength as 1");
  TestStepAddActionExpected( chActionText, chExpectedText );
  E_DBGR_VariableCheck("Canpdudatalength",1,Equal);

}

testcase Verify_MngCNDD_CanMainBusOff_Interface_CAN_Bus_Off_Detection_for_CANA_CAN2()
{
  /***************************************************************************************************************/
                                                // Variable Definition
  /***************************************************************************************************************/



  /***************************************************************************************************************/
                                               // Local Values
  /***************************************************************************************************************/



  /***************************************************************************************************************/
                                              // Test Case Info
  /***************************************************************************************************************/
  setWriteDbgLevel(DebugOff);
  snprintf( chTestTitle, elCount(chTestTitle), "Verify_MngCNDD_CanMainBusOff_Interface_CAN_Bus_Off_Detection_for_CANA_CAN2" );
  snprintf( chTestDescription, elCount(chTestDescription), "Purpose:To check the MngCNDD_CanMainBusOff interface CANA");
  TestCaseAddInfo( chTestTitle, "TC_L30SW_Q-36403646", chTestDescription );

  /***************************************************************************************************************/
                                              // Start of Test Case
  /***************************************************************************************************************/

  /***************************************************************************************************************/
                                              // Test Step 0 PRECONDITIONS
  /***************************************************************************************************************/
  /***************************************************************************************************************/
  snprintf( chActionText, elCount(chActionText), "Flash the Software and ECU is running ");
  snprintf( chExpectedText, elCount(chExpectedText), "Ecu is should be in running state");
  TestStepAddActionExpected( chActionText, chExpectedText );

  A_DBGR_BreakpointDeleteAll();
  A_DBGR_BreakpointSet("SetCANR_e_CanIfCntrlrBusOff ");
  canConfigureBusOff(1, 0x101, 1);
  A_DBGR_R();
  A_DBGR_Go_Safe();
  /***************************************************************************************************************/
                                              // Test Step 1 set Breakpoint in SetCANR_e_CanIfCntrlrBusOff.
  /***************************************************************************************************************/

  /***************************************************************************************************************/
                                              // Test Step 3 Breakpoint should hit in SetCANR_e_CanIfCntrlrBusOff.
  /***************************************************************************************************************/
  snprintf( chActionText, elCount(chActionText), " Verify Breakpoint should hit in SetCANR_e_CanIfCntrlrBusOff  ");
  snprintf( chExpectedText, elCount(chExpectedText), "Breakpoint hit in SetCANR_e_CanIfCntrlrBusOff function");
  E_DBGR_BreakpointCheckForHalt("SetCANR_e_CanIfCntrlrBusOff");

  /***************************************************************************************************************/
                                              // Test Step 4 set Baudarate to normal.
  /***************************************************************************************************************/
  snprintf( chActionText, elCount(chActionText), "reverting simulated CAN BUSOFF condition");
  snprintf( chExpectedText, elCount(chExpectedText), "reverting CAN BUSOFF condition");
  TestStepAddActionExpected( chActionText, chExpectedText );
  canConfigureBusOff(1, 0x101, 0);
}



testcase Verify_SetCNDD_e_CanTrcvOpMode_Interface_by_Setting_CAN_Transceiver_to_Normal_Mode_for_CANA_CAN2()
{
  /***************************************************************************************************************/
                                                // Variable Definition
  /***************************************************************************************************************/



  /***************************************************************************************************************/
                                               // Local Values
  /***************************************************************************************************************/



  /***************************************************************************************************************/
                                              // Test Case Info
  /***************************************************************************************************************/
  setWriteDbgLevel(DebugOff);
  snprintf( chTestTitle, elCount(chTestTitle), "Verify_SetCNDD_e_CanTrcvOpMode_Interface_by_Setting_CAN_Transceiver_to_Normal_Mode_for_CANA_CAN2" );
  snprintf( chTestDescription, elCount(chTestDescription), "Purpose:To check the interface SetCNDD_e_CanTrcvOpMode by setting to Normal mode of CAN2 ");
  TestCaseAddInfo( chTestTitle, "TC_L30SW_Q-36403652", chTestDescription );

  /***************************************************************************************************************/
                                              // Start of Test Case
  /***************************************************************************************************************/

  /***************************************************************************************************************/
                                              // Test Step 0 PRECONDITIONS
  /***************************************************************************************************************/
   snprintf( chActionText, elCount(chActionText), "Flash the Software and ECU is running ");
  snprintf( chExpectedText, elCount(chExpectedText), "Ecu is should be in running state");
  TestStepAddActionExpected( chActionText, chExpectedText );

  A_DBGR_BreakpointDeleteAll();
  A_DBGR_BreakpointSet("SetCNDD_e_CanTrcvOpMode");
  A_DBGR_R();
  A_DBGR_Go_Safe();
  /***************************************************************************************************************/
                                              // Test Step 1 Call SetCNDD_e_CanTrcvOpMode with stop mode to put CAN controller in normal mode.
  /***************************************************************************************************************/
  snprintf( chActionText, elCount(chActionText), "verify Breakpoint should hit in SetCNDD_e_CanTrcvOpMode ");
  snprintf( chExpectedText, elCount(chExpectedText), "Breakpoint hit in SetCNDD_e_CanTrcvOpMode function");

  E_DBGR_BreakpointCheckForHalt("SetCNDD_e_CanTrcvOpMode");

  snprintf( chActionText, elCount(chActionText), "Configure Transciver mode");
  snprintf( chExpectedText, elCount(chExpectedText), "verify Configure Transciver mode");
  TestStepAddActionExpected( chActionText, chExpectedText );
  A_DBGR_VariableSet("can_trcv_mode","0");
  E_DBGR_VariableCheck("can_trcv_mode",0,Equal);

  snprintf( chActionText, elCount(chActionText), "Delete all Breakpoints");
  snprintf( chExpectedText, elCount(chExpectedText), "verify Delete all Breakpoints");
  TestStepAddActionExpected( chActionText, chExpectedText );
  A_DBGR_BreakpointDeleteAll();
  A_DBGR_BreakpointSet("SetCANR_e_CanIfTrcvModeIndication");

   /***************************************************************************************************************/
                                              // Test Step 2 Keep a breakpoint in SetCANR_e_CanIfTrcvModeIndication callback function.
  /***************************************************************************************************************/
  snprintf( chActionText, elCount(chActionText), "Set Breakpoint in SetCANR_e_CanIfTrcvModeIndication ");
  snprintf( chExpectedText, elCount(chExpectedText), "verify is Breakpoint Set SetCANR_e_CanIfTrcvModeIndication");
  A_DBGR_Go();

  snprintf( chActionText, elCount(chActionText), "verify Breakpoint should hit in SetCANR_e_CanIfTrcvModeIndication ");
  snprintf( chExpectedText, elCount(chExpectedText), "Breakpoint hit in SetCANR_e_CanIfTrcvModeIndication function");

  E_DBGR_BreakpointCheckForHalt("SetCANR_e_CanIfTrcvModeIndication");

  snprintf( chActionText, elCount(chActionText), "Verify ChannelId ");
  snprintf( chExpectedText, elCount(chExpectedText), " ChannelId as 0");
  TestStepAddActionExpected( chActionText, chExpectedText );
  E_DBGR_VariableCheck("ChannelId ",0,Equal);
  snprintf( chActionText, elCount(chActionText), "Verify TranscMode");
  snprintf( chExpectedText, elCount(chExpectedText), "TranscMode as 0");
  TestStepAddActionExpected( chActionText, chExpectedText );
  E_DBGR_VariableCheck("Cantrcvmode",0,Equal);

  snprintf( chActionText, elCount(chActionText), "Flash the Software and ECU is running ");
  snprintf( chExpectedText, elCount(chExpectedText), "Ecu is should be in running state");
  TestStepAddActionExpected( chActionText, chExpectedText );
  A_DBGR_BreakpointDeleteAll();
  A_DBGR_Go();
  E_DBGR_CheckState(T32_State_Running);
}



testcase Verify_SetCNDD_e_CanTrcvOpMode_Interface_by_Setting_CAN_Transceiver_to_Sleep_Mode_for_CANA_CAN2()
{
  /***************************************************************************************************************/
                                                // Variable Definition
  /***************************************************************************************************************/



  /***************************************************************************************************************/
                                               // Local Values
  /***************************************************************************************************************/



  /***************************************************************************************************************/
                                              // Test Case Info
  /***************************************************************************************************************/
  setWriteDbgLevel(DebugOff);
  snprintf( chTestTitle, elCount(chTestTitle), "Verify_SetCNDD_e_CanTrcvOpMode_Interface_by_Setting_CAN_Transceiver_to_Sleep_Mode_for_CANA_CAN2" );
  snprintf( chTestDescription, elCount(chTestDescription), "Purpose:To check the interface SetCNDD_e_CanTrcvOpMode by setting to sleep mode of CAN2 ");
  TestCaseAddInfo( chTestTitle, "TC_L30SW_Q-36403653", chTestDescription );

  /***************************************************************************************************************/
                                              // Start of Test Case
  /***************************************************************************************************************/

  /***************************************************************************************************************/
                                              // Test Step 0 PRECONDITIONS
  /***************************************************************************************************************/
   snprintf( chActionText, elCount(chActionText), "Flash the Software and ECU is running ");
  snprintf( chExpectedText, elCount(chExpectedText), "Ecu is should be in running state");
  TestStepAddActionExpected( chActionText, chExpectedText );

  A_DBGR_BreakpointDeleteAll();
  A_DBGR_BreakpointSet("SetCNDD_e_CanTrcvOpMode");
  A_DBGR_R();
  A_DBGR_Go_Safe();

  /***************************************************************************************************************/
                                              // Test Step 1 Call SetCNDD_e_CanTrcvOpMode with stop mode to put CAN controller in normal mode.
  /***************************************************************************************************************/
  snprintf( chActionText, elCount(chActionText), "verify Breakpoint should hit in SetCNDD_e_CanTrcvOpMode ");
  snprintf( chExpectedText, elCount(chExpectedText), "Breakpoint hit in SetCNDD_e_CanTrcvOpMode function");

  E_DBGR_BreakpointCheckForHalt("SetCNDD_e_CanTrcvOpMode");

  snprintf( chActionText, elCount(chActionText), "Configure Transciver mode");
  snprintf( chExpectedText, elCount(chExpectedText), "verify Configure Transciver mode");
  TestStepAddActionExpected( chActionText, chExpectedText );
  A_DBGR_VariableSet("can_trcv_mode","1");
  E_DBGR_VariableCheck("can_trcv_mode",1,Equal);

  snprintf( chActionText, elCount(chActionText), "Delete all Breakpoints");
  snprintf( chExpectedText, elCount(chExpectedText), "verify Delete all Breakpoints");
  TestStepAddActionExpected( chActionText, chExpectedText );
  A_DBGR_BreakpointDeleteAll();
  A_DBGR_BreakpointSet("SetCANR_e_CanIfTrcvModeIndication");

   /***************************************************************************************************************/
                                              // Test Step 2 Keep a breakpoint in SetCANR_e_CanIfTrcvModeIndication callback function.
  /***************************************************************************************************************/
  snprintf( chActionText, elCount(chActionText), "Set Breakpoint in SetCANR_e_CanIfTrcvModeIndication ");
  snprintf( chExpectedText, elCount(chExpectedText), "verify is Breakpoint Set SetCANR_e_CanIfTrcvModeIndication");
  A_DBGR_Go();

  snprintf( chActionText, elCount(chActionText), "verify Breakpoint should hit in SetCANR_e_CanIfTrcvModeIndication ");
  snprintf( chExpectedText, elCount(chExpectedText), "Breakpoint hit in SetCANR_e_CanIfTrcvModeIndication function");

  E_DBGR_BreakpointCheckForHalt("SetCANR_e_CanIfTrcvModeIndication");

  snprintf( chActionText, elCount(chActionText), "Verify ChannelId ");
  snprintf( chExpectedText, elCount(chExpectedText), " ChannelId as 0");
  TestStepAddActionExpected( chActionText, chExpectedText );
  E_DBGR_VariableCheck("ChannelId ",0,Equal);
   snprintf( chActionText, elCount(chActionText), "Verify TranscMode");
  snprintf( chExpectedText, elCount(chExpectedText), "TranscMode as 1");
  TestStepAddActionExpected( chActionText, chExpectedText );
  E_DBGR_VariableCheck("Cantrcvmode",1,Equal);

  snprintf( chActionText, elCount(chActionText), "Flash the Software and ECU is running ");
  snprintf( chExpectedText, elCount(chExpectedText), "Ecu is should be in running state");
  TestStepAddActionExpected( chActionText, chExpectedText );
  A_DBGR_BreakpointDeleteAll();
  A_DBGR_Go();
  E_DBGR_CheckState(T32_State_Running);
}



testcase Verify_SetCNDD_e_CanTrcvOpMode_Interface_by_Setting_CAN_Transceiver_to_Standby_Mode_for_CANA_CAN2()
{
  /***************************************************************************************************************/
                                                // Variable Definition
  /***************************************************************************************************************/



  /***************************************************************************************************************/
                                               // Local Values
  /***************************************************************************************************************/



  /***************************************************************************************************************/
                                              // Test Case Info
  /***************************************************************************************************************/
  setWriteDbgLevel(DebugOff);
  snprintf( chTestTitle, elCount(chTestTitle), "Verify_SetCNDD_e_CanTrcvOpMode_Interface_by_Setting_CAN_Transceiver_to_Standby_Mode_for_CANA_CAN2" );
  snprintf( chTestDescription, elCount(chTestDescription), "Purpose:To check the interface SetCNDD_e_CanTrcvOpMode by setting to standby mode of CAN2 ");
  TestCaseAddInfo( chTestTitle, "TC_L30SW_Q-36403654", chTestDescription );

  /***************************************************************************************************************/
                                              // Start of Test Case
  /***************************************************************************************************************/

  /***************************************************************************************************************/
                                              // Test Step 0 PRECONDITIONS
  /***************************************************************************************************************/
   snprintf( chActionText, elCount(chActionText), "Flash the Software and ECU is running ");
  snprintf( chExpectedText, elCount(chExpectedText), "Ecu is should be in running state");
  TestStepAddActionExpected( chActionText, chExpectedText );

  A_DBGR_BreakpointDeleteAll();
  A_DBGR_BreakpointSet("SetCNDD_e_CanTrcvOpMode");
  A_DBGR_R();
  A_DBGR_Go_Safe();

  /***************************************************************************************************************/
                                              // Test Step 1 Call SetCNDD_e_CanTrcvOpMode with stop mode to put CAN controller in normal mode.
  /***************************************************************************************************************/
  snprintf( chActionText, elCount(chActionText), "verify Breakpoint should hit in SetCNDD_e_CanTrcvOpMode ");
  snprintf( chExpectedText, elCount(chExpectedText), "Breakpoint hit in SetCNDD_e_CanTrcvOpMode function");

  E_DBGR_BreakpointCheckForHalt("SetCNDD_e_CanTrcvOpMode");

  snprintf( chActionText, elCount(chActionText), "Configure Transciver mode");
  snprintf( chExpectedText, elCount(chExpectedText), "verify Configure Transciver mode");
  TestStepAddActionExpected( chActionText, chExpectedText );
  A_DBGR_VariableSet("can_trcv_mode","2");
  E_DBGR_VariableCheck("can_trcv_mode",2,Equal);

  snprintf( chActionText, elCount(chActionText), "Delete all Breakpoints");
  snprintf( chExpectedText, elCount(chExpectedText), "verify Delete all Breakpoints");
  TestStepAddActionExpected( chActionText, chExpectedText );
  A_DBGR_BreakpointDeleteAll();
  A_DBGR_BreakpointSet("SetCANR_e_CanIfTrcvModeIndication");

   /***************************************************************************************************************/
                                              // Test Step 2 Keep a breakpoint in SetCANR_e_CanIfTrcvModeIndication callback function.
  /***************************************************************************************************************/
  snprintf( chActionText, elCount(chActionText), "Set Breakpoint in SetCANR_e_CanIfTrcvModeIndication ");
  snprintf( chExpectedText, elCount(chExpectedText), "verify is Breakpoint Set SetCANR_e_CanIfTrcvModeIndication");
  A_DBGR_Go();

  snprintf( chActionText, elCount(chActionText), "verify Breakpoint should hit in SetCANR_e_CanIfTrcvModeIndication ");
  snprintf( chExpectedText, elCount(chExpectedText), "Breakpoint hit in SetCANR_e_CanIfTrcvModeIndication function");

  E_DBGR_BreakpointCheckForHalt("SetCANR_e_CanIfTrcvModeIndication");

  snprintf( chActionText, elCount(chActionText), "Verify ChannelId ");
  snprintf( chExpectedText, elCount(chExpectedText), " ChannelId as 0");
  TestStepAddActionExpected( chActionText, chExpectedText );
  E_DBGR_VariableCheck("ChannelId ",0,Equal);
   snprintf( chActionText, elCount(chActionText), "Verify TranscMode");
  snprintf( chExpectedText, elCount(chExpectedText), "TranscMode as 2");
  TestStepAddActionExpected( chActionText, chExpectedText );
  E_DBGR_VariableCheck("Cantrcvmode",2,Equal);

  snprintf( chActionText, elCount(chActionText), "Flash the Software and ECU is running ");
  snprintf( chExpectedText, elCount(chExpectedText), "Ecu is should be in running state");
  TestStepAddActionExpected( chActionText, chExpectedText );
  A_DBGR_BreakpointDeleteAll();
  A_DBGR_Go();
  E_DBGR_CheckState(T32_State_Running);
}



testcase Verify_SetCNDD_e_CanTrcvOpMode_Interface_by_Setting_CAN_Transceiver_to_LISTEN_ONLY_Mode_for_CANA_CAN2()
{
  /***************************************************************************************************************/
                                                // Variable Definition
  /***************************************************************************************************************/



  /***************************************************************************************************************/
                                               // Local Values
  /***************************************************************************************************************/



  /***************************************************************************************************************/
                                              // Test Case Info
  /***************************************************************************************************************/
  setWriteDbgLevel(DebugOff);
  snprintf( chTestTitle, elCount(chTestTitle), "Verify_SetCNDD_e_CanTrcvOpMode_Interface_by_Setting_CAN_Transceiver_to_LISTEN_ONLY_Mode_for_CANA_CAN2" );
  snprintf( chTestDescription, elCount(chTestDescription), "Purpose:To check the interface SetCNDD_e_CanTrcvOpMode by setting to LISTEN_ONLY_Mode mode of CAN2 ");
  TestCaseAddInfo( chTestTitle, "TC_L30SW_Q-36403655", chTestDescription );

  /***************************************************************************************************************/
                                              // Start of Test Case
  /***************************************************************************************************************/

  /***************************************************************************************************************/
                                              // Test Step 0 PRECONDITIONS
  /***************************************************************************************************************/
   snprintf( chActionText, elCount(chActionText), "Flash the Software and ECU is running ");
  snprintf( chExpectedText, elCount(chExpectedText), "Ecu is should be in running state");
  TestStepAddActionExpected( chActionText, chExpectedText );

  A_DBGR_BreakpointDeleteAll();
  A_DBGR_BreakpointSet("SetCNDD_e_CanTrcvOpMode");
  A_DBGR_R();
  A_DBGR_Go_Safe();

  /***************************************************************************************************************/
                                              // Test Step 1 Call SetCNDD_e_CanTrcvOpMode with stop mode to put CAN controller in normal mode.
  /***************************************************************************************************************/
  snprintf( chActionText, elCount(chActionText), "verify Breakpoint should hit in SetCNDD_e_CanTrcvOpMode ");
  snprintf( chExpectedText, elCount(chExpectedText), "Breakpoint hit in SetCNDD_e_CanTrcvOpMode function");

  E_DBGR_BreakpointCheckForHalt("SetCNDD_e_CanTrcvOpMode");

  snprintf( chActionText, elCount(chActionText), "Configure Transciver mode");
  snprintf( chExpectedText, elCount(chExpectedText), "verify Configure Transciver mode");
  TestStepAddActionExpected( chActionText, chExpectedText );
  A_DBGR_VariableSet("can_trcv_mode","3");
  E_DBGR_VariableCheck("can_trcv_mode",3,Equal);

  snprintf( chActionText, elCount(chActionText), "Delete all Breakpoints");
  snprintf( chExpectedText, elCount(chExpectedText), "verify Delete all Breakpoints");
  TestStepAddActionExpected( chActionText, chExpectedText );
  A_DBGR_BreakpointDeleteAll();
  A_DBGR_BreakpointSet("SetCANR_e_CanIfTrcvModeIndication");

   /***************************************************************************************************************/
                                              // Test Step 2 Keep a breakpoint in SetCANR_e_CanIfTrcvModeIndication callback function.
  /***************************************************************************************************************/
  snprintf( chActionText, elCount(chActionText), "Set Breakpoint in SetCANR_e_CanIfTrcvModeIndication ");
  snprintf( chExpectedText, elCount(chExpectedText), "verify is Breakpoint Set SetCANR_e_CanIfTrcvModeIndication");
  A_DBGR_Go();

  snprintf( chActionText, elCount(chActionText), "verify Breakpoint should hit in SetCANR_e_CanIfTrcvModeIndication ");
  snprintf( chExpectedText, elCount(chExpectedText), "Breakpoint hit in SetCANR_e_CanIfTrcvModeIndication function");

  E_DBGR_BreakpointCheckForHalt("SetCANR_e_CanIfTrcvModeIndication");

  snprintf( chActionText, elCount(chActionText), "Verify ChannelId ");
  snprintf( chExpectedText, elCount(chExpectedText), " ChannelId as 0");
  TestStepAddActionExpected( chActionText, chExpectedText );
  E_DBGR_VariableCheck("ChannelId ",0,Equal);
   snprintf( chActionText, elCount(chActionText), "Verify TranscMode");
  snprintf( chExpectedText, elCount(chExpectedText), "TranscMode as 3");
  TestStepAddActionExpected( chActionText, chExpectedText );
  E_DBGR_VariableCheck("Cantrcvmode",3,Equal);

  snprintf( chActionText, elCount(chActionText), "Flash the Software and ECU is running ");
  snprintf( chExpectedText, elCount(chExpectedText), "Ecu is should be in running state");
  TestStepAddActionExpected( chActionText, chExpectedText );
  A_DBGR_BreakpointDeleteAll();
  A_DBGR_Go();
  E_DBGR_CheckState(T32_State_Running);
}

testcase Verify_SetCNDD_e_CanTrcvOpMode_Interface_by_Setting_CAN_Transceiver_to_Normal_Mode_for_CANB_CAN8()
{
  /***************************************************************************************************************/
                                                // Variable Definition
  /***************************************************************************************************************/



  /***************************************************************************************************************/
                                               // Local Values
  /***************************************************************************************************************/



  /***************************************************************************************************************/
                                              // Test Case Info
  /***************************************************************************************************************/
  setWriteDbgLevel(DebugOff);
  snprintf( chTestTitle, elCount(chTestTitle), "Verify_SetCNDD_e_CanTrcvOpMode_Interface_by_Setting_CAN_Transceiver_to_Normal_Mode_for_CANB_CAN8" );
  snprintf( chTestDescription, elCount(chTestDescription), "Purpose:To check the interface SetCNDD_e_CanTrcvOpMode by setting to Normal mode of CAN8 ");
  TestCaseAddInfo( chTestTitle, "TC_L30SW_Q-36403658", chTestDescription );

  /***************************************************************************************************************/
                                              // Start of Test Case
  /***************************************************************************************************************/

  /***************************************************************************************************************/
                                              // Test Step 0 PRECONDITIONS
  /***************************************************************************************************************/
   snprintf( chActionText, elCount(chActionText), "Flash the Software and ECU is running ");
  snprintf( chExpectedText, elCount(chExpectedText), "Ecu is should be in running state");
  TestStepAddActionExpected( chActionText, chExpectedText );

  A_DBGR_BreakpointDeleteAll();
  A_DBGR_BreakpointSet("SetCNDD_e_CanTrcvOpMode");
  A_DBGR_R();
  A_DBGR_Go_Safe();

  /***************************************************************************************************************/
                                              // Test Step 1 Call SetCNDD_e_CanTrcvOpMode with stop mode to put CAN controller in normal mode.
  /***************************************************************************************************************/
  snprintf( chActionText, elCount(chActionText), "Set Breakpoint in SetCNDD_e_CanTrcvOpMode ");
  snprintf( chExpectedText, elCount(chExpectedText), "verify is Breakpoint Set SetCNDD_e_CanTrcvOpMode");

  snprintf( chActionText, elCount(chActionText), "verify Breakpoint should hit in SetCNDD_e_CanTrcvOpMode ");
  snprintf( chExpectedText, elCount(chExpectedText), "Breakpoint hit in SetCNDD_e_CanTrcvOpMode function");

  E_DBGR_BreakpointCheckForHalt("SetCNDD_e_CanTrcvOpMode");

  snprintf( chActionText, elCount(chActionText), "Configure Transciver mode");
  snprintf( chExpectedText, elCount(chExpectedText), "verify Configure Transciver mode");
  TestStepAddActionExpected( chActionText, chExpectedText );
  A_DBGR_VariableSet("can_trcv_mode","0");
  E_DBGR_VariableCheck("can_trcv_mode",0,Equal);

  snprintf( chActionText, elCount(chActionText), "Delete all Breakpoints");
  snprintf( chExpectedText, elCount(chExpectedText), "verify Delete all Breakpoints");
  TestStepAddActionExpected( chActionText, chExpectedText );
  A_DBGR_BreakpointDeleteAll();
  A_DBGR_BreakpointSet("SetCANR_e_CanIfTrcvModeIndication");

   /***************************************************************************************************************/
                                              // Test Step 2 Keep a breakpoint in SetCANR_e_CanIfTrcvModeIndication callback function.
  /***************************************************************************************************************/
  snprintf( chActionText, elCount(chActionText), "Set Breakpoint in SetCANR_e_CanIfTrcvModeIndication ");
  snprintf( chExpectedText, elCount(chExpectedText), "verify is Breakpoint Set SetCANR_e_CanIfTrcvModeIndication");
  A_DBGR_Go();

  snprintf( chActionText, elCount(chActionText), "verify Breakpoint should hit in SetCANR_e_CanIfTrcvModeIndication ");
  snprintf( chExpectedText, elCount(chExpectedText), "Breakpoint hit in SetCANR_e_CanIfTrcvModeIndication function");

  E_DBGR_BreakpointCheckForHalt("SetCANR_e_CanIfTrcvModeIndication");

  cnt = 0;
  while(1)
  {
    if (cnt >= MAX_POLL_ATTEMPTS)
    {
      testStepFail("Timeout", "ChannelId polling exceeded maximum attempts");
      break;
    }
    if(cnt == 0)
    {
      snprintf( chActionText, elCount(chActionText), "Run software");
      snprintf( chExpectedText, elCount(chExpectedText), "verify Software is running");
      TestStepAddActionExpected( chActionText, chExpectedText );
    }

    snprintf( chActionText, elCount(chActionText), "Verify ChannelId ");
    snprintf( chExpectedText, elCount(chExpectedText), " ChannelId as 1");
    A_DBGR_VariableRead("ChannelId",val);
    if (val == 1)
    {
      cnt = 0;
      break;
    }
    cnt = cnt +1;
    A_DBGR_Go();
  }

  snprintf( chActionText, elCount(chActionText), "Verify TranscMode");
  snprintf( chExpectedText, elCount(chExpectedText), "TranscMode as 0");
  //TestStepAddActionExpected( chActionText, chExpectedText );
  E_DBGR_VariableCheck("Cantrcvmode",0,Equal);

  snprintf( chActionText, elCount(chActionText), "Flash the Software and ECU is running ");
  snprintf( chExpectedText, elCount(chExpectedText), "Ecu is should be in running state");
  TestStepAddActionExpected( chActionText, chExpectedText );
  A_DBGR_BreakpointDeleteAll();
  A_DBGR_Go();
  E_DBGR_CheckState(T32_State_Running);
}



testcase Verify_SetCNDD_e_CanTrcvOpMode_Interface_by_Setting_CAN_Transceiver_to_Sleep_Mode_for_CANB_CAN8()
{
  /***************************************************************************************************************/
                                                // Variable Definition
  /***************************************************************************************************************/



  /***************************************************************************************************************/
                                               // Local Values
  /***************************************************************************************************************/



  /***************************************************************************************************************/
                                              // Test Case Info
  /***************************************************************************************************************/
  setWriteDbgLevel(DebugOff);
  snprintf( chTestTitle, elCount(chTestTitle), "Verify_SetCNDD_e_CanTrcvOpMode_Interface_by_Setting_CAN_Transceiver_to_Sleep_Mode_for_CANB_CAN8" );
  snprintf( chTestDescription, elCount(chTestDescription), "Purpose:To check the interface SetCNDD_e_CanTrcvOpMode by setting to sleep mode of CAN8 ");
  TestCaseAddInfo( chTestTitle, "TC_L30SW_Q-36403659", chTestDescription );

  /***************************************************************************************************************/
                                              // Start of Test Case
  /***************************************************************************************************************/

  /***************************************************************************************************************/
                                              // Test Step 0 PRECONDITIONS
  /***************************************************************************************************************/
   snprintf( chActionText, elCount(chActionText), "Flash the Software and ECU is running ");
  snprintf( chExpectedText, elCount(chExpectedText), "Ecu is should be in running state");
  TestStepAddActionExpected( chActionText, chExpectedText );

  A_DBGR_BreakpointDeleteAll();
  A_DBGR_BreakpointSet("SetCNDD_e_CanTrcvOpMode");
  A_DBGR_R();
  A_DBGR_Go_Safe();

  /***************************************************************************************************************/
                                              // Test Step 1 Call SetCNDD_e_CanTrcvOpMode with stop mode to put CAN controller in normal mode.
  /***************************************************************************************************************/
  snprintf( chActionText, elCount(chActionText), "verify Breakpoint should hit in SetCNDD_e_CanTrcvOpMode ");
  snprintf( chExpectedText, elCount(chExpectedText), "Breakpoint hit in SetCNDD_e_CanTrcvOpMode function");

  E_DBGR_BreakpointCheckForHalt("SetCNDD_e_CanTrcvOpMode");

  snprintf( chActionText, elCount(chActionText), "Configure Transciver mode");
  snprintf( chExpectedText, elCount(chExpectedText), "verify Configure Transciver mode");
  TestStepAddActionExpected( chActionText, chExpectedText );
  A_DBGR_VariableSet("can_trcv_mode","1");
  E_DBGR_VariableCheck("can_trcv_mode",1,Equal);

  snprintf( chActionText, elCount(chActionText), "Delete all Breakpoints");
  snprintf( chExpectedText, elCount(chExpectedText), "verify Delete all Breakpoints");
  TestStepAddActionExpected( chActionText, chExpectedText );
  A_DBGR_BreakpointDeleteAll();
  A_DBGR_BreakpointSet("SetCANR_e_CanIfTrcvModeIndication");

   /***************************************************************************************************************/
                                              // Test Step 2 Keep a breakpoint in SetCANR_e_CanIfTrcvModeIndication callback function.
  /***************************************************************************************************************/
  snprintf( chActionText, elCount(chActionText), "Set Breakpoint in SetCANR_e_CanIfTrcvModeIndication ");
  snprintf( chExpectedText, elCount(chExpectedText), "verify is Breakpoint Set SetCANR_e_CanIfTrcvModeIndication");
  A_DBGR_Go();

  snprintf( chActionText, elCount(chActionText), "verify Breakpoint should hit in SetCANR_e_CanIfTrcvModeIndication ");
  snprintf( chExpectedText, elCount(chExpectedText), "Breakpoint hit in SetCANR_e_CanIfTrcvModeIndication function");
  E_DBGR_BreakpointCheckForHalt("SetCANR_e_CanIfTrcvModeIndication");

  E_DBGR_VariableCheck_until("ChannelId",1,Equal);


  snprintf( chActionText, elCount(chActionText), "Verify TranscMode");
  snprintf( chExpectedText, elCount(chExpectedText), "TranscMode as 1");
  //TestStepAddActionExpected( chActionText, chExpectedText );
  E_DBGR_VariableCheck("Cantrcvmode",1,Equal);

  snprintf( chActionText, elCount(chActionText), "Flash the Software and ECU is running ");
  snprintf( chExpectedText, elCount(chExpectedText), "Ecu is should be in running state");
  TestStepAddActionExpected( chActionText, chExpectedText );
  A_DBGR_BreakpointDeleteAll();
  A_DBGR_Go();
  E_DBGR_CheckState(T32_State_Running);
}



testcase Verify_SetCNDD_e_CanTrcvOpMode_Interface_by_Setting_CAN_Transceiver_to_Standby_Mode_for_CANB_CAN8()
{
  /***************************************************************************************************************/
                                                // Variable Definition
  /***************************************************************************************************************/



  /***************************************************************************************************************/
                                               // Local Values
  /***************************************************************************************************************/



  /***************************************************************************************************************/
                                              // Test Case Info
  /***************************************************************************************************************/
  setWriteDbgLevel(DebugOff);
  snprintf( chTestTitle, elCount(chTestTitle), "Verify_SetCNDD_e_CanTrcvOpMode_Interface_by_Setting_CAN_Transceiver_to_Standby_Mode_for_CANB_CAN8" );
  snprintf( chTestDescription, elCount(chTestDescription), "Purpose:To check the interface SetCNDD_e_CanTrcvOpMode by setting to standby mode of CAN8 ");
  TestCaseAddInfo( chTestTitle, "TC_L30SW_Q-36403660", chTestDescription );

  /***************************************************************************************************************/
                                              // Start of Test Case
  /***************************************************************************************************************/

  /***************************************************************************************************************/
                                              // Test Step 0 PRECONDITIONS
  /***************************************************************************************************************/
   snprintf( chActionText, elCount(chActionText), "Flash the Software and ECU is running ");
  snprintf( chExpectedText, elCount(chExpectedText), "Ecu is should be in running state");
  TestStepAddActionExpected( chActionText, chExpectedText );

  A_DBGR_BreakpointDeleteAll();
  A_DBGR_BreakpointSet("SetCNDD_e_CanTrcvOpMode");
  A_DBGR_R();
  A_DBGR_Go_Safe();

  /***************************************************************************************************************/
                                              // Test Step 1 Call SetCNDD_e_CanTrcvOpMode with stop mode to put CAN controller in normal mode.
  /***************************************************************************************************************/
  snprintf( chActionText, elCount(chActionText), "verify Breakpoint should hit in SetCNDD_e_CanTrcvOpMode ");
  snprintf( chExpectedText, elCount(chExpectedText), "Breakpoint hit in SetCNDD_e_CanTrcvOpMode function");

  E_DBGR_BreakpointCheckForHalt("SetCNDD_e_CanTrcvOpMode");

  snprintf( chActionText, elCount(chActionText), "Configure Transciver mode");
  snprintf( chExpectedText, elCount(chExpectedText), "verify Configure Transciver mode");
  TestStepAddActionExpected( chActionText, chExpectedText );
  A_DBGR_VariableSet("can_trcv_mode","2");
  E_DBGR_VariableCheck("can_trcv_mode",2,Equal);

  snprintf( chActionText, elCount(chActionText), "Delete all Breakpoints");
  snprintf( chExpectedText, elCount(chExpectedText), "verify Delete all Breakpoints");
  TestStepAddActionExpected( chActionText, chExpectedText );
  A_DBGR_BreakpointDeleteAll();
  A_DBGR_BreakpointSet("SetCANR_e_CanIfTrcvModeIndication");

   /***************************************************************************************************************/
                                              // Test Step 2 Keep a breakpoint in SetCANR_e_CanIfTrcvModeIndication callback function.
  /***************************************************************************************************************/
  snprintf( chActionText, elCount(chActionText), "Set Breakpoint in SetCANR_e_CanIfTrcvModeIndication ");
  snprintf( chExpectedText, elCount(chExpectedText), "verify is Breakpoint Set SetCANR_e_CanIfTrcvModeIndication");

  snprintf( chActionText, elCount(chActionText), "Run software");
  snprintf( chExpectedText, elCount(chExpectedText), "verify Software is running");
  A_DBGR_Go();


  snprintf( chActionText, elCount(chActionText), "verify Breakpoint should hit in SetCANR_e_CanIfTrcvModeIndication ");
  snprintf( chExpectedText, elCount(chExpectedText), "Breakpoint hit in SetCANR_e_CanIfTrcvModeIndication function");

  E_DBGR_BreakpointCheckForHalt("SetCANR_e_CanIfTrcvModeIndication");

  E_DBGR_VariableCheck_until("ChannelId",1,Equal);

  snprintf( chActionText, elCount(chActionText), "Verify TranscMode");
  snprintf( chExpectedText, elCount(chExpectedText), "TranscMode as 2");
  //TestStepAddActionExpected( chActionText, chExpectedText );
  E_DBGR_VariableCheck("Cantrcvmode",2,Equal);

  snprintf( chActionText, elCount(chActionText), "Flash the Software and ECU is running ");
  snprintf( chExpectedText, elCount(chExpectedText), "Ecu is should be in running state");
  TestStepAddActionExpected( chActionText, chExpectedText );
  A_DBGR_BreakpointDeleteAll();
  A_DBGR_Go();
  E_DBGR_CheckState(T32_State_Running);
}



testcase Verify_SetCNDD_e_CanTrcvOpMode_Interface_by_Setting_CAN_Transceiver_to_LISTEN_ONLY_Mode_for_CANB_CAN8()
{
  /***************************************************************************************************************/
                                                // Variable Definition
  /***************************************************************************************************************/



  /***************************************************************************************************************/
                                               // Local Values
  /***************************************************************************************************************/



  /***************************************************************************************************************/
                                              // Test Case Info
  /***************************************************************************************************************/
  setWriteDbgLevel(DebugOff);
  snprintf( chTestTitle, elCount(chTestTitle), "Verify_SetCNDD_e_CanTrcvOpMode_Interface_by_Setting_CAN_Transceiver_to_LISTEN_ONLY_Mode_for_CANB_CAN8" );
  snprintf( chTestDescription, elCount(chTestDescription), "Purpose:To check the interface SetCNDD_e_CanTrcvOpMode by setting to Listen_only mode of CAN8 ");
  TestCaseAddInfo( chTestTitle, "TC_L30SW_Q-36403661", chTestDescription );

  /***************************************************************************************************************/
                                              // Start of Test Case
  /***************************************************************************************************************/

  /***************************************************************************************************************/
                                              // Test Step 0 PRECONDITIONS
  /***************************************************************************************************************/
   snprintf( chActionText, elCount(chActionText), "Flash the Software and ECU is running ");
  snprintf( chExpectedText, elCount(chExpectedText), "Ecu is should be in running state");
  TestStepAddActionExpected( chActionText, chExpectedText );

  A_DBGR_BreakpointDeleteAll();
  A_DBGR_BreakpointSet("SetCNDD_e_CanTrcvOpMode");
  A_DBGR_R();
  A_DBGR_Go_Safe();

  /***************************************************************************************************************/
                                              // Test Step 1 Call SetCNDD_e_CanTrcvOpMode with stop mode to put CAN controller in normal mode.
  /***************************************************************************************************************/
  snprintf( chActionText, elCount(chActionText), "verify Breakpoint should hit in SetCNDD_e_CanTrcvOpMode ");
  snprintf( chExpectedText, elCount(chExpectedText), "Breakpoint hit in SetCNDD_e_CanTrcvOpMode function");

  E_DBGR_BreakpointCheckForHalt("SetCNDD_e_CanTrcvOpMode");

  snprintf( chActionText, elCount(chActionText), "Configure Transciver mode");
  snprintf( chExpectedText, elCount(chExpectedText), "verify Configure Transciver mode");
  TestStepAddActionExpected( chActionText, chExpectedText );
  A_DBGR_VariableSet("can_trcv_mode","3");
  E_DBGR_VariableCheck("can_trcv_mode",3,Equal);

  snprintf( chActionText, elCount(chActionText), "Delete all Breakpoints");
  snprintf( chExpectedText, elCount(chExpectedText), "verify Delete all Breakpoints");
  TestStepAddActionExpected( chActionText, chExpectedText );
  A_DBGR_BreakpointDeleteAll();
  A_DBGR_BreakpointSet("SetCANR_e_CanIfTrcvModeIndication");

   /***************************************************************************************************************/
                                              // Test Step 2 Keep a breakpoint in SetCANR_e_CanIfTrcvModeIndication callback function.
  /***************************************************************************************************************/
  snprintf( chActionText, elCount(chActionText), "Set Breakpoint in SetCANR_e_CanIfTrcvModeIndication ");
  snprintf( chExpectedText, elCount(chExpectedText), "verify is Breakpoint Set SetCANR_e_CanIfTrcvModeIndication");
  A_DBGR_Go();

  snprintf( chActionText, elCount(chActionText), "verify Breakpoint should hit in SetCANR_e_CanIfTrcvModeIndication ");
  snprintf( chExpectedText, elCount(chExpectedText), "Breakpoint hit in SetCANR_e_CanIfTrcvModeIndication function");

  E_DBGR_BreakpointCheckForHalt("SetCANR_e_CanIfTrcvModeIndication");

  E_DBGR_VariableCheck_until("ChannelId",1,Equal);


  snprintf( chActionText, elCount(chActionText), "Verify TranscMode");
  snprintf( chExpectedText, elCount(chExpectedText), "TranscMode as 3");
  //TestStepAddActionExpected( chActionText, chExpectedText );
  E_DBGR_VariableCheck("Cantrcvmode",3,Equal);

  snprintf( chActionText, elCount(chActionText), "Flash the Software and ECU is running ");
  snprintf( chExpectedText, elCount(chExpectedText), "Ecu is should be in running state");
  TestStepAddActionExpected( chActionText, chExpectedText );
  A_DBGR_BreakpointDeleteAll();
  A_DBGR_Go();
  E_DBGR_CheckState(T32_State_Running);
}



testcase To_Verify_CntrlCNDD_h_CanWrt_Interface_should_not_transmitted_Message_by_disabling_CAN_channel_for_CANA_CAN2()
{
    /***************************************************************************************************************/
                                                // Variable Definition
  /***************************************************************************************************************/



  /***************************************************************************************************************/
                                               // Local Values
  /***************************************************************************************************************/



  /***************************************************************************************************************/
                                              // Test Case Info
  /***************************************************************************************************************/
  setWriteDbgLevel(DebugOff);
  snprintf( chTestTitle, elCount(chTestTitle), "To_Verify_CntrlCNDD_h_CanWrt_Interface_should_not_transmitted_Message_by_disabling_CAN_channel_for_CANA_CAN2" );
  snprintf( chTestDescription, elCount(chTestDescription), "Purpose:To check the CntrlCNDD_h_CanWrt by disabling CAN2");
  TestCaseAddInfo( chTestTitle, "TC_L30SW_Q-36403603", chTestDescription );

  /***************************************************************************************************************/
                                              // Start of Test Case
  /***************************************************************************************************************/

  /***************************************************************************************************************/
                                              // Test Step 0 PRECONDITIONS
  /***************************************************************************************************************/
   snprintf( chActionText, elCount(chActionText), "Flash the Software and ECU is running ");
  snprintf( chExpectedText, elCount(chExpectedText), "Ecu is should be in running state");
  TestStepAddActionExpected( chActionText, chExpectedText );

  A_DBGR_BreakpointDeleteAll();
  A_DBGR_BreakpointSet("TestCan_Init");
  A_DBGR_R();
  A_DBGR_Go_Safe();

  /***************************************************************************************************************/
                                              // Test Step 1 Configure the values for the structure TsCNDD_CanCnfgType with the minimum message length for CANA.
  /***************************************************************************************************************/
  snprintf( chActionText, elCount(chActionText), "verify Breakpoint should hit in TestCan_Init ");
  snprintf( chExpectedText, elCount(chExpectedText), "Breakpoint hit in TestCan_Init function");

  E_DBGR_BreakpointCheckForHalt("TestCan_Init");

  snprintf( chActionText, elCount(chActionText), "Configure CanId values ");
  snprintf( chExpectedText, elCount(chExpectedText), "verify Configure CanId values");
  TestStepAddActionExpected( chActionText, chExpectedText );
  A_DBGR_VariableSet("VaCANR_CanControllerData[0].CanControllerActivation","0");
  E_DBGR_VariableCheck("VaCANR_CanControllerData[0].CanControllerActivation",0,Equal);

  snprintf( chActionText, elCount(chActionText), "Configure CanId values ");
  snprintf( chExpectedText, elCount(chExpectedText), "verify Configure CanId values");
  TestStepAddActionExpected( chActionText, chExpectedText );
  A_DBGR_VariableSet("VaCANR_CanControllerData[1].CanControllerActivation","0");
  E_DBGR_VariableCheck("VaCANR_CanControllerData[1].CanControllerActivation",0,Equal);


   /***************************************************************************************************************/
                                              // Test Step 2 Call the function MngCNDD_CanRxInit with the configured structure. MngCNDD_CanRxInit(&canConfigA);
  /***************************************************************************************************************/
  snprintf( chActionText, elCount(chActionText), "Set Breakpoint in MngCNDD_CanRxInit ");
  snprintf( chExpectedText, elCount(chExpectedText), "verify is Breakpoint Set MngCNDD_CanRxInit");
  TestStepAddActionExpected( chActionText, chExpectedText );

  A_DBGR_BreakpointSet("MngCNDD_CanRxInit");
  A_DBGR_Go();

  snprintf( chActionText, elCount(chActionText), "verify Breakpoint should hit in MngCNDD_CanRxInit ");
  snprintf( chExpectedText, elCount(chExpectedText), "Breakpoint hit in MngCNDD_CanRxInit function");
  E_DBGR_BreakpointCheckForHalt("MngCNDD_CanRxInit");

 /***************************************************************************************************************/
                                              // Test Step 3 Call SetCNDD_e_CanControllerMode with start mode. SetCNDD_e_CanControllerMode(0, 2); // Start mode for CAN controller 0
  /***************************************************************************************************************/
  snprintf( chActionText, elCount(chActionText), "Set Breakpoint in SetCNDD_e_CanControllerMode funtion ");
  snprintf( chExpectedText, elCount(chExpectedText), "Breakpoint is Set in SetCNDD_e_CanControllerMode");
  TestStepAddActionExpected( chActionText, chExpectedText );
  A_DBGR_BreakpointSet("SetCNDD_e_CanControllerMode");
  A_DBGR_Go();
  A_DBGR_Go();

  snprintf( chActionText, elCount(chActionText), " Verify Breakpoint should hit in SetCNDD_e_CanControllerMode ");
  snprintf( chExpectedText, elCount(chExpectedText), "Breakpoint hit in SetCNDD_e_CanControllerMode function");
  E_DBGR_BreakpointCheckForHalt("SetCNDD_e_CanControllerMode");

   /***************************************************************************************************************/
                                              // Test Step 4 set Breakpoint in SetCANR_e_CanIfTxConfirmation.
  /***************************************************************************************************************/
  snprintf( chActionText, elCount(chActionText), "set Breakpoint SetCANR_e_CanIfTxConfirmation callback function ");
  snprintf( chExpectedText, elCount(chExpectedText), "Breakpoint is Set in SetCANR_e_CanIfTxConfirmation");
  TestStepAddActionExpected( chActionText, chExpectedText );
  A_DBGR_BreakpointSet("SetCANR_e_CanIfTxConfirmation");
  A_DBGR_Go();

   /***************************************************************************************************************/
                                              // Test Step 6 Verify SetCANR_e_CanIfTxConfirmation callback function should not invoked.
  /***************************************************************************************************************/
  snprintf( chActionText, elCount(chActionText), " Verify Breakpoint should hit in SetCANR_e_CanIfTxConfirmation ");
  snprintf( chExpectedText, elCount(chExpectedText), "Breakpoint hit in SetCANR_e_CanIfTxConfirmation function");
  //TestStepAddActionExpected( chActionText, chExpectedText );
  E_DBGR_CheckState(T32_State_Running);

}



testcase Verify_DsblCNDD_CanInterrupts_Interface_by_Disabling_CAN_Interrupts_for_CANB_CAN8()
{
  /***************************************************************************************************************/
                                                // Variable Definition
  /***************************************************************************************************************/



  /***************************************************************************************************************/
                                               // Local Values
  /***************************************************************************************************************/



  /***************************************************************************************************************/
                                              // Test Case Info
  /***************************************************************************************************************/
  setWriteDbgLevel(DebugOff);
  snprintf( chTestTitle, elCount(chTestTitle), "Verify_DsblCNDD_CanInterrupts_Interface_by_Disabling_CAN_Interrupts_for_CANB_CAN8" );
  snprintf( chTestDescription, elCount(chTestDescription), "Purpose:To check the DsblCNDD_CanInterrupts interface CAN8");
  TestCaseAddInfo( chTestTitle, "TC_L30SW_Q-36403664", chTestDescription );

 /***************************************************************************************************************/
                                              // Start of Test Case
  /***************************************************************************************************************/

  /***************************************************************************************************************/
                                              // Test Step 0 PRECONDITIONS
   /***************************************************************************************************************/
    snprintf( chActionText, elCount(chActionText), "Flash the Software and ECU is running ");
  snprintf( chExpectedText, elCount(chExpectedText), "Ecu is should be in running state");
  TestStepAddActionExpected( chActionText, chExpectedText );

  A_DBGR_BreakpointDeleteAll();
  A_DBGR_R();
  A_DBGR_Go();
  A_DBGR_Go();
  /***************************************************************************************************************/
                                              // Test Step 1 Define PDU info and call DsblCNDD_CanInterrupts.
  /***************************************************************************************************************/
  snprintf( chActionText, elCount(chActionText), "Configure disable variable to invoke DsblCNDD_CanInterrupts interface");
  snprintf( chExpectedText, elCount(chExpectedText), "verify Configure disable value as 1");
  //TestStepAddActionExpected( chActionText, chExpectedText );
  A_DBGR_VariableSet("disable","1");
  E_DBGR_VariableCheck("disable",1,Equal);

  /***************************************************************************************************************/
                                              // Test Step 2 Keep a breakpoint in DsblCNDD_CanInterrupts and check CAN PDU ID.
  /***************************************************************************************************************/
  snprintf( chActionText, elCount(chActionText), "set Breakpoint DsblCNDD_CanInterrupts callback function ");
  snprintf( chExpectedText, elCount(chExpectedText), "Breakpoint is Set in DsblCNDD_CanInterrupts");
  TestStepAddActionExpected( chActionText, chExpectedText );
  A_DBGR_BreakpointSet("TestCan_DisableInterrupt\\7");
  E_DBGR_BreakpointCheckForHalt("TestCan_DisableInterrupt\\7");

  snprintf( chActionText, elCount(chActionText), "Flash the Software and ECU is running ");
  snprintf( chExpectedText, elCount(chExpectedText), "Ecu is should be in running state");
  TestStepAddActionExpected( chActionText, chExpectedText );
  A_DBGR_BreakpointDeleteAll();
  A_DBGR_BreakpointSet("SetCANR_e_CanIfTxConfirmation");
  A_DBGR_Go();

   /***************************************************************************************************************/
                                              // Test Step 3 Keep a breakpoint in SetCANR_e_CanIfTxConfirmation and check CAN PDU ID.
  /***************************************************************************************************************/
  snprintf( chActionText, elCount(chActionText), "set Breakpoint SetCANR_e_CanIfTxConfirmation callback function ");
  snprintf( chExpectedText, elCount(chExpectedText), "Breakpoint is Set in SetCANR_e_CanIfTxConfirmation");
  //TestStepAddActionExpected( chActionText, chExpectedText );
  /***************************************************************************************************************/
                                              // Test Step 4 Verify SetCANR_e_CanIfTxConfirmation callback function should not invoked.
  /***************************************************************************************************************/
  snprintf( chActionText, elCount(chActionText), " Verify Breakpoint should hit in SetCANR_e_CanIfTxConfirmation ");
  snprintf( chExpectedText, elCount(chExpectedText), "Breakpoint hit in SetCANR_e_CanIfTxConfirmation function");
  E_DBGR_CheckState(T32_State_Running);
}



testcase Verify_DsblCNDD_CanInterrupts_Interface_by_Disabling_CAN_Interrupts_for_CANA_CAN2()
{
  /***************************************************************************************************************/
                                                // Variable Definition
  /***************************************************************************************************************/



  /***************************************************************************************************************/
                                               // Local Values
  /***************************************************************************************************************/



  /***************************************************************************************************************/
                                              // Test Case Info
  /***************************************************************************************************************/
  setWriteDbgLevel(DebugOff);
  snprintf( chTestTitle, elCount(chTestTitle), "Verify_DsblCNDD_CanInterrupts_Interface_by_Disabling_CAN_Interrupts_for_CANA_CAN2" );
  snprintf( chTestDescription, elCount(chTestDescription), "Purpose:To check the DsblCNDD_CanInterrupts interface CAN2");
  TestCaseAddInfo( chTestTitle, "TC_L30SW_Q-36403665", chTestDescription );

 /***************************************************************************************************************/
                                              // Start of Test Case
  /***************************************************************************************************************/

  /***************************************************************************************************************/
                                              // Test Step 0 PRECONDITIONS
   /***************************************************************************************************************/
  snprintf( chActionText, elCount(chActionText), "Flash the Software and ECU is running ");
  snprintf( chExpectedText, elCount(chExpectedText), "Ecu is should be in running state");
  TestStepAddActionExpected( chActionText, chExpectedText );

  A_DBGR_BreakpointDeleteAll();
  A_DBGR_R();
  A_DBGR_Go();
  A_DBGR_Go();
  /***************************************************************************************************************/
                                              // Test Step 1 Define PDU info and call DsblCNDD_CanInterrupts.
  /***************************************************************************************************************/
  snprintf( chActionText, elCount(chActionText), "Configure disable variable to invoke DsblCNDD_CanInterrupts interface");
  snprintf( chExpectedText, elCount(chExpectedText), "verify Configure disable value as 1");
  //TestStepAddActionExpected( chActionText, chExpectedText );
  A_DBGR_VariableSet("disable","1");
  E_DBGR_VariableCheck("disable",1,Equal);

 /***************************************************************************************************************/
                                              // Test Step 2 Keep a breakpoint in DsblCNDD_CanInterrupts and check CAN PDU ID.
  /***************************************************************************************************************/
  snprintf( chActionText, elCount(chActionText), "set Breakpoint DsblCNDD_CanInterrupts callback function ");
  snprintf( chExpectedText, elCount(chExpectedText), "Breakpoint is Set in DsblCNDD_CanInterrupts");
  TestStepAddActionExpected( chActionText, chExpectedText );
  A_DBGR_BreakpointSet("TestCan_DisableInterrupt");
  E_DBGR_BreakpointCheckForHalt("TestCan_DisableInterrupt");

  snprintf( chActionText, elCount(chActionText), "Flash the Software and ECU is running ");
  snprintf( chExpectedText, elCount(chExpectedText), "Ecu is should be in running state");
  TestStepAddActionExpected( chActionText, chExpectedText );
  A_DBGR_BreakpointDeleteAll();
  A_DBGR_BreakpointSet("SetCANR_e_CanIfTxConfirmation");
  A_DBGR_Go();

   /***************************************************************************************************************/
                                              // Test Step 3 Keep a breakpoint in SetCANR_e_CanIfTxConfirmation and check CAN PDU ID.
  /***************************************************************************************************************/
  snprintf( chActionText, elCount(chActionText), "set Breakpoint SetCANR_e_CanIfTxConfirmation callback function ");
  snprintf( chExpectedText, elCount(chExpectedText), "Breakpoint is Set in SetCANR_e_CanIfTxConfirmation");
  //TestStepAddActionExpected( chActionText, chExpectedText );
  /***************************************************************************************************************/
                                              // Test Step 4 Verify SetCANR_e_CanIfTxConfirmation callback function should not invoked.
  /***************************************************************************************************************/
  snprintf( chActionText, elCount(chActionText), " Verify Breakpoint should hit in SetCANR_e_CanIfTxConfirmation ");
  snprintf( chExpectedText, elCount(chExpectedText), "Breakpoint hit in SetCANR_e_CanIfTxConfirmation function");
  E_DBGR_CheckState(T32_State_Running);
}



testcase Verify_Re_enabling_CAN_Interrupts_After_Disabling_for_CANA_CAN2()
{
  /***************************************************************************************************************/
                                                // Variable Definition
  /***************************************************************************************************************/



  /***************************************************************************************************************/
                                               // Local Values
  /***************************************************************************************************************/



  /***************************************************************************************************************/
                                              // Test Case Info
  /***************************************************************************************************************/
  setWriteDbgLevel(DebugOff);
  snprintf( chTestTitle, elCount(chTestTitle), "Verify_Re_enabling_CAN_Interrupts_After_Disabling_for_CANA_CAN2" );
  snprintf( chTestDescription, elCount(chTestDescription), "Purpose:To check the DsblCNDD_CanInterrupts interface CAN2");
  TestCaseAddInfo( chTestTitle, "TC_L30SW_Q-36403666", chTestDescription );

  /***************************************************************************************************************/
                                              // Start of Test Case
  /***************************************************************************************************************/

  /***************************************************************************************************************/
                                              // Test Step 0 PRECONDITIONS
  /***************************************************************************************************************/
  snprintf( chActionText, elCount(chActionText), "Flash the Software and ECU is running ");
  snprintf( chExpectedText, elCount(chExpectedText), "Ecu is should be in running state");
  TestStepAddActionExpected( chActionText, chExpectedText );

  A_DBGR_BreakpointDeleteAll();
  A_DBGR_R();
  A_DBGR_Go();
  A_DBGR_Go();
  /***************************************************************************************************************/
                                              // Test Step 1 Define PDU info and call DsblCNDD_CanInterrupts.
  /***************************************************************************************************************/
  snprintf( chActionText, elCount(chActionText), "Configure disable variable to invoke DsblCNDD_CanInterrupts interface");
  snprintf( chExpectedText, elCount(chExpectedText), "verify Configure disable value as 1");
  //TestStepAddActionExpected( chActionText, chExpectedText );
  A_DBGR_VariableSet("disable","1");
  E_DBGR_VariableCheck("disable",1,Equal);

  /***************************************************************************************************************/
                                              // Test Step 2 Keep a breakpoint in DsblCNDD_CanInterrupts and check CAN PDU ID.
  /***************************************************************************************************************/
  snprintf( chActionText, elCount(chActionText), "set Breakpoint DsblCNDD_CanInterrupts callback function ");
  snprintf( chExpectedText, elCount(chExpectedText), "Breakpoint is Set in DsblCNDD_CanInterrupts");
  TestStepAddActionExpected( chActionText, chExpectedText );
  A_DBGR_BreakpointSet("TestCan_DisableInterrupt");
  E_DBGR_BreakpointCheckForHalt("TestCan_DisableInterrupt");

  snprintf( chActionText, elCount(chActionText), "Flash the Software and ECU is running ");
  snprintf( chExpectedText, elCount(chExpectedText), "Ecu is should be in running state");
  TestStepAddActionExpected( chActionText, chExpectedText );
  A_DBGR_BreakpointDeleteAll();
  A_DBGR_BreakpointSet("SetCANR_e_CanIfTxConfirmation");
  A_DBGR_Go();

   /***************************************************************************************************************/
                                              // Test Step 3 Keep a breakpoint in SetCANR_e_CanIfTxConfirmation and check CAN PDU ID.
  /***************************************************************************************************************/
  snprintf( chActionText, elCount(chActionText), "set Breakpoint SetCANR_e_CanIfTxConfirmation callback function ");
  snprintf( chExpectedText, elCount(chExpectedText), "Breakpoint is Set in SetCANR_e_CanIfTxConfirmation");
  //TestStepAddActionExpected( chActionText, chExpectedText );
  /***************************************************************************************************************/
                                              // Test Step 4 Verify SetCANR_e_CanIfTxConfirmation callback function should not invoked.
  /***************************************************************************************************************/
  snprintf( chActionText, elCount(chActionText), " Verify ECU Should be Running ");
  snprintf( chExpectedText, elCount(chExpectedText), "Verify ECU Should be Running");
  E_DBGR_CheckState(T32_State_Running);

  /***************************************************************************************************************/
                                              // Test Step 5 Define PDU info and call EnblCNDD_CanInterrupts.
  /***************************************************************************************************************/
  snprintf( chActionText, elCount(chActionText), "Configure disable variable to invoke EnblCNDD_CanInterrupts interface");
  snprintf( chExpectedText, elCount(chExpectedText), "verify Configure disable value as 1");
  TestStepAddActionExpected( chActionText, chExpectedText );
  A_DBGR_VariableSet("disable","0");
  E_DBGR_VariableCheck("disable",0,Equal);

  /***************************************************************************************************************/
                                              // Test Step 6 Keep a breakpoint in EnblCNDD_CanInterrupts and check CAN PDU ID.
  /***************************************************************************************************************/
  snprintf( chActionText, elCount(chActionText), "set Breakpoint EnblCNDD_CanInterrupts callback function ");
  snprintf( chExpectedText, elCount(chExpectedText), "Breakpoint is Set in EnblCNDD_CanInterrupts");
  TestStepAddActionExpected( chActionText, chExpectedText );
  A_DBGR_BreakpointSet("TestCan_EnableInterrupt");
  E_DBGR_BreakpointCheckForHalt("TestCan_EnableInterrupt");

  snprintf( chActionText, elCount(chActionText), "Flash the Software and ECU is running ");
  snprintf( chExpectedText, elCount(chExpectedText), "Ecu is should be in running state");
  TestStepAddActionExpected( chActionText, chExpectedText );
  A_DBGR_BreakpointDeleteAll();
  A_DBGR_Go();
  /***************************************************************************************************************/
                                              // Test Step 7 check TX msg's transmiting
  /***************************************************************************************************************/
  E_CAN_WaitForMessageByID(0x00000101,15000,cc_eCAN_PRESENT,"CAN1");
  TestStepAddActionExpected( chActionText, chExpectedText );
  /***************************************************************************************************************/
                                              // Test Step 7 Keep a breakpoint in SetCANR_e_CanIfTxConfirmation and check CAN PDU ID.
  /***************************************************************************************************************/
//  snprintf( chActionText, elCount(chActionText), "Breakpoint SetCANR_e_CanIfTxConfirmation should set  ");
//  snprintf( chExpectedText, elCount(chExpectedText), "SetCANR_e_CanIfTxConfirmation set");
//  //TestStepAddActionExpected( chActionText, chExpectedText );
//  A_DBGR_BreakpointSet("SetCANR_e_CanIfTxConfirmation");
//  /***************************************************************************************************************/
//                                              // Test Step 8 Breakpoint should hit in SetCANR_e_CanIfTxConfirmation
//  /***************************************************************************************************************/
//  snprintf( chActionText, elCount(chActionText), "Breakpoint SetCANR_e_CanIfTxConfirmation should hit  ");
//  snprintf( chExpectedText, elCount(chExpectedText), "SetCANR_e_CanIfTxConfirmation hit");
//  E_DBGR_BreakpointCheckForHalt("SetCANR_e_CanIfTxConfirmation");


}



testcase Verify_Re_enabling_CAN_Interrupts_After_Disabling_for_CANB_CAN8()
{
  /***************************************************************************************************************/
                                                // Variable Definition
  /***************************************************************************************************************/



  /***************************************************************************************************************/
                                               // Local Values
  /***************************************************************************************************************/



  /***************************************************************************************************************/
                                              // Test Case Info
  /***************************************************************************************************************/
  setWriteDbgLevel(DebugOff);
  snprintf( chTestTitle, elCount(chTestTitle), "Verify_Re_enabling_CAN_Interrupts_After_Disabling_for_CANB_CAN8" );
  snprintf( chTestDescription, elCount(chTestDescription), "Purpose:To check the DsblCNDD_CanInterrupts interface CAN8");
  TestCaseAddInfo( chTestTitle, "TC_L30SW_Q-36403667", chTestDescription );

  /***************************************************************************************************************/
                                              // Start of Test Case
  /***************************************************************************************************************/

  /***************************************************************************************************************/
                                              // Test Step 0 PRECONDITIONS
  /***************************************************************************************************************/
  snprintf( chActionText, elCount(chActionText), "Flash the Software and ECU is running ");
  snprintf( chExpectedText, elCount(chExpectedText), "Ecu is should be in running state");
  //TestStepAddActionExpected( chActionText, chExpectedText );

  A_DBGR_BreakpointDeleteAll();
  snprintf( chActionText, elCount(chActionText), "ECU is reset ");
  snprintf( chExpectedText, elCount(chExpectedText), "Ecu is should be in reset state");
  //TestStepAddActionExpected( chActionText, chExpectedText );
  A_DBGR_R();
  snprintf( chActionText, elCount(chActionText), "Flash the Software and ECU is running ");
  snprintf( chExpectedText, elCount(chExpectedText), "Ecu is should be in running state");
  //TestStepAddActionExpected( chActionText, chExpectedText );
  A_DBGR_Go();
  A_DBGR_Go();
  /***************************************************************************************************************/
                                              // Test Step 1 Define PDU info and call DsblCNDD_CanInterrupts.
  /***************************************************************************************************************/
  snprintf( chActionText, elCount(chActionText), "Configure disable variable to invoke DsblCNDD_CanInterrupts interface");
  snprintf( chExpectedText, elCount(chExpectedText), "verify Configure disable value as 1");
  //TestStepAddActionExpected( chActionText, chExpectedText );
  A_DBGR_VariableSet("disable","1");
  E_DBGR_VariableCheck("disable",1,Equal);

  /***************************************************************************************************************/
                                              // Test Step 2 Keep a breakpoint in DsblCNDD_CanInterrupts and check CAN PDU ID.
  /***************************************************************************************************************/
  snprintf( chActionText, elCount(chActionText), "set Breakpoint DsblCNDD_CanInterrupts callback function ");
  snprintf( chExpectedText, elCount(chExpectedText), "Breakpoint is Set in DsblCNDD_CanInterrupts");
  TestStepAddActionExpected( chActionText, chExpectedText );
  A_DBGR_BreakpointSet("TestCan_DisableInterrupt\\7");
  E_DBGR_BreakpointCheckForHalt("TestCan_DisableInterrupt\\7");

  snprintf( chActionText, elCount(chActionText), "Flash the Software and ECU is running ");
  snprintf( chExpectedText, elCount(chExpectedText), "Ecu is should be in running state");
  TestStepAddActionExpected( chActionText, chExpectedText );
  A_DBGR_BreakpointDeleteAll();
  A_DBGR_BreakpointSet("SetCANR_e_CanIfTxConfirmation");
  A_DBGR_Go();

   /***************************************************************************************************************/
                                              // Test Step 3 Keep a breakpoint in SetCANR_e_CanIfTxConfirmation and check CAN PDU ID.
  /***************************************************************************************************************/
  snprintf( chActionText, elCount(chActionText), "set Breakpoint SetCANR_e_CanIfTxConfirmation callback function ");
  snprintf( chExpectedText, elCount(chExpectedText), "Breakpoint is Set in SetCANR_e_CanIfTxConfirmation");
  //TestStepAddActionExpected( chActionText, chExpectedText );
  /***************************************************************************************************************/
                                              // Test Step 4 Verify SetCANR_e_CanIfTxConfirmation callback function should not invoked.
  /***************************************************************************************************************/
  snprintf( chActionText, elCount(chActionText), " Verify Breakpoint should hit in SetCANR_e_CanIfTxConfirmation ");
  snprintf( chExpectedText, elCount(chExpectedText), "Breakpoint hit in SetCANR_e_CanIfTxConfirmation function");
  E_DBGR_CheckState(T32_State_Running);

  /***************************************************************************************************************/
                                              // Test Step 5 Define PDU info and call EnblCNDD_CanInterrupts.
  /***************************************************************************************************************/
  snprintf( chActionText, elCount(chActionText), "Configure disable variable to invoke EnblCNDD_CanInterrupts interface");
  snprintf( chExpectedText, elCount(chExpectedText), "verify Configure disable value as 1");
  TestStepAddActionExpected( chActionText, chExpectedText );
  A_DBGR_VariableSet("disable","0");
  E_DBGR_VariableCheck("disable",0,Equal);

  /***************************************************************************************************************/
                                              // Test Step 6 Keep a breakpoint in EnblCNDD_CanInterrupts and check CAN PDU ID.
  /***************************************************************************************************************/
  snprintf( chActionText, elCount(chActionText), "set Breakpoint EnblCNDD_CanInterrupts callback function ");
  snprintf( chExpectedText, elCount(chExpectedText), "Breakpoint is Set in EnblCNDD_CanInterrupts");
  TestStepAddActionExpected( chActionText, chExpectedText );
  A_DBGR_BreakpointSet("TestCan_EnableInterrupt");
  E_DBGR_BreakpointCheckForHalt("TestCan_EnableInterrupt");

  snprintf( chActionText, elCount(chActionText), "Flash the Software and ECU is running ");
  snprintf( chExpectedText, elCount(chExpectedText), "Ecu is should be in running state");
  TestStepAddActionExpected( chActionText, chExpectedText );
  A_DBGR_BreakpointDeleteAll();
  A_DBGR_Go();

   /***************************************************************************************************************/
                                              // Test Step 7 check TX msg's transmiting
  /***************************************************************************************************************/
  E_CAN_WaitForMessageByID(0x00000101,15000,cc_eCAN_PRESENT,"CAN2");
  TestStepAddActionExpected( chActionText, chExpectedText );
}



testcase Verify_DsblCNDD_CanInterrupts_Interface_by_Disabling_CAN_Interrupts_for_Invalid_CAN_Channel()
{
   /***************************************************************************************************************/
                                                // Variable Definition
  /***************************************************************************************************************/



  /***************************************************************************************************************/
                                               // Local Values
  /***************************************************************************************************************/



  /***************************************************************************************************************/
                                              // Test Case Info
  /***************************************************************************************************************/
  setWriteDbgLevel(DebugOff);
  snprintf( chTestTitle, elCount(chTestTitle), "Verify_DsblCNDD_CanInterrupts_Interface_by_Disabling_CAN_Interrupts_for_Invalid_CAN_Channel" );
  snprintf( chTestDescription, elCount(chTestDescription), "Purpose:To check the DsblCNDD_CanInterrupts interface for invalid channel");
  TestCaseAddInfo( chTestTitle, "TC_L30SW_Q-36403668", chTestDescription );

  /***************************************************************************************************************/
                                              // Start of Test Case
  /***************************************************************************************************************/

  /***************************************************************************************************************/
                                              // Test Step 0 PRECONDITIONS
  /***************************************************************************************************************/
  snprintf( chActionText, elCount(chActionText), "Flash the Software and ECU is running ");
  snprintf( chExpectedText, elCount(chExpectedText), "Ecu is should be in running state");
  //TestStepAddActionExpected( chActionText, chExpectedText );

  A_DBGR_BreakpointDeleteAll();
  snprintf( chActionText, elCount(chActionText), "ECU is reset ");
  snprintf( chExpectedText, elCount(chExpectedText), "Ecu is should be in reset state");
 // TestStepAddActionExpected( chActionText, chExpectedText );
  A_DBGR_R();
  snprintf( chActionText, elCount(chActionText), "Flash the Software and ECU is running ");
  snprintf( chExpectedText, elCount(chExpectedText), "Ecu is should be in running state");
  //TestStepAddActionExpected( chActionText, chExpectedText );
  A_DBGR_Go();
  A_DBGR_Go();
  /***************************************************************************************************************/
                                              // Test Step 1 Define PDU info and call DsblCNDD_CanInterrupts.
  /***************************************************************************************************************/
  snprintf( chActionText, elCount(chActionText), "Configure disable variable to invoke DsblCNDD_CanInterrupts interface");
  snprintf( chExpectedText, elCount(chExpectedText), "verify Configure disable value as 1");
  //TestStepAddActionExpected( chActionText, chExpectedText );
  A_DBGR_VariableSet("disable","1");
  E_DBGR_VariableCheck("disable",1,Equal);

  /***************************************************************************************************************/
                                              // Test Step 2 Keep a breakpoint in DsblCNDD_CanInterrupts with invalid channel.
  /***************************************************************************************************************/
  snprintf( chActionText, elCount(chActionText), "set Breakpoint DsblCNDD_CanInterrupts callback function ");
  snprintf( chExpectedText, elCount(chExpectedText), "Breakpoint is Set in DsblCNDD_CanInterrupts");
  TestStepAddActionExpected( chActionText, chExpectedText );
  A_DBGR_BreakpointSet("DsblCNDD_CanInterrupts");
  E_DBGR_BreakpointCheckForHalt("DsblCNDD_CanInterrupts");

  snprintf( chActionText, elCount(chActionText), "Configure channelid values ");
  snprintf( chExpectedText, elCount(chExpectedText), "verify Configure channelid values");
  TestStepAddActionExpected( chActionText, chExpectedText );
  A_DBGR_VariableSet("channelid","255");
  E_DBGR_VariableCheck("channelid",255,Equal);

  snprintf( chActionText, elCount(chActionText), "ECU running ");
  snprintf( chExpectedText, elCount(chExpectedText), "verify ECU running");
  TestStepAddActionExpected( chActionText, chExpectedText );
  A_DBGR_Go();


  snprintf( chActionText, elCount(chActionText), "Delete breakpoints ");
  snprintf( chExpectedText, elCount(chExpectedText), "Deleted breakpoints ");
  //TestStepAddActionExpected( chActionText, chExpectedText );
  A_DBGR_BreakpointDeleteAll();

  snprintf( chActionText, elCount(chActionText), "Configure channelid values ");
  snprintf( chExpectedText, elCount(chExpectedText), "verify Configure channelid values");
  //TestStepAddActionExpected( chActionText, chExpectedText );
  A_DBGR_VariableSet("channelid","255");
  E_DBGR_VariableCheck("channelid",255,Equal);


  snprintf( chActionText, elCount(chActionText), "Flash the Software and ECU is running ");
  snprintf( chExpectedText, elCount(chExpectedText), "Ecu is should be in running state");
  TestStepAddActionExpected( chActionText, chExpectedText );
  A_DBGR_Go();

  /***************************************************************************************************************/
                                              // Test Step 3 check TX msg's transmiting
  /***************************************************************************************************************/
  snprintf( chActionText, elCount(chActionText), "TX msg in trace");
  snprintf( chExpectedText, elCount(chExpectedText), "TX msg in Trace");
  //TestStepAddActionExpected( chActionText, chExpectedText );
  E_CAN_WaitForMessageByID(0x101,15000,cc_eCAN_PRESENT,"CAN2");
}



testcase Verify_EnblCNDD_CanInterrupts_interface_by_Enabling_CAN_Interrupts_for_CANB_CAN8()
{
     /***************************************************************************************************************/
                                                // Variable Definition
  /***************************************************************************************************************/



  /***************************************************************************************************************/
                                               // Local Values
  /***************************************************************************************************************/



  /***************************************************************************************************************/
                                              // Test Case Info
  /***************************************************************************************************************/
  setWriteDbgLevel(DebugOff);
  snprintf( chTestTitle, elCount(chTestTitle), "Verify_EnblCNDD_CanInterrupts_interface_by_Enabling_CAN_Interrupts_for_CANB_CAN8" );
  snprintf( chTestDescription, elCount(chTestDescription), "Purpose:To check the EnblCNDD_CanInterrupts interface for CANB channel");
  TestCaseAddInfo( chTestTitle, "TC_L30SW_Q-36403669", chTestDescription );

  /***************************************************************************************************************/
                                              // Start of Test Case
  /***************************************************************************************************************/

  /***************************************************************************************************************/
                                              // Test Step 0 PRECONDITIONS
  /***************************************************************************************************************/
  snprintf( chActionText, elCount(chActionText), "Flash the Software and ECU is running ");
  snprintf( chExpectedText, elCount(chExpectedText), "Ecu is should be in running state");
  TestStepAddActionExpected( chActionText, chExpectedText );

  A_DBGR_BreakpointDeleteAll();
  A_DBGR_R();
  A_DBGR_Go();
  A_DBGR_Go();
  /***************************************************************************************************************/
                                              // Test Step 1 Define PDU info and call EnblCNDD_CanInterrupts.
  /***************************************************************************************************************/
  snprintf( chActionText, elCount(chActionText), "Configure disable variable to invoke EnblCNDD_CanInterrupts interface");
  snprintf( chExpectedText, elCount(chExpectedText), "verify Configure disable value as 0");
  //TestStepAddActionExpected( chActionText, chExpectedText );
  A_DBGR_VariableSet("disable","0");
  E_DBGR_VariableCheck("disable",0,Equal);

  /***************************************************************************************************************/
                                              // Test Step 2 Keep a breakpoint in EnblCNDD_CanInterrupts with invalid channel.
  /***************************************************************************************************************/
  snprintf( chActionText, elCount(chActionText), "set Breakpoint EnblCNDD_CanInterrupts callback function ");
  snprintf( chExpectedText, elCount(chExpectedText), "Breakpoint is Set in EnblCNDD_CanInterrupts");
  TestStepAddActionExpected( chActionText, chExpectedText );
  A_DBGR_BreakpointSet("EnblCNDD_CanInterrupts");
  E_DBGR_BreakpointCheckForHalt("EnblCNDD_CanInterrupts");

  snprintf( chActionText, elCount(chActionText), "Flash the Software and ECU is running ");
  snprintf( chExpectedText, elCount(chExpectedText), "Ecu is should be in running state");
  TestStepAddActionExpected( chActionText, chExpectedText );
  A_DBGR_BreakpointDeleteAll();
  A_DBGR_BreakpointSet("SetCANR_e_CanIfTxConfirmation");
  A_DBGR_Go();

   /***************************************************************************************************************/
                                              // Test Step 3 Keep a breakpoint in SetCANR_e_CanIfTxConfirmation and check CAN PDU ID.
  /***************************************************************************************************************/
  snprintf( chActionText, elCount(chActionText), "set Breakpoint SetCANR_e_CanIfTxConfirmation callback function ");
  snprintf( chExpectedText, elCount(chExpectedText), "Breakpoint is Set in SetCANR_e_CanIfTxConfirmation");
  //TestStepAddActionExpected( chActionText, chExpectedText );
  /***************************************************************************************************************/
                                              // Test Step 4 Verify SetCANR_e_CanIfTxConfirmation callback function should invoked.
  /***************************************************************************************************************/
  snprintf( chActionText, elCount(chActionText), " Verify Breakpoint should hit in SetCANR_e_CanIfTxConfirmation ");
  snprintf( chExpectedText, elCount(chExpectedText), "Breakpoint hit in SetCANR_e_CanIfTxConfirmation function");
  E_DBGR_BreakpointCheckForHalt("SetCANR_e_CanIfTxConfirmation");
}



testcase Verify_EnblCNDD_CanInterrupts_interface_by_Enabling_CAN_Interrupts_for_Invalid_Can_channel()
{
  /***************************************************************************************************************/
                                                // Variable Definition
  /***************************************************************************************************************/



  /***************************************************************************************************************/
                                               // Local Values
  /***************************************************************************************************************/



  /***************************************************************************************************************/
                                              // Test Case Info
  /***************************************************************************************************************/
  setWriteDbgLevel(DebugOff);
  snprintf( chTestTitle, elCount(chTestTitle), "Verify_EnblCNDD_CanInterrupts_interface_by_Enabling_CAN_Interrupts_for_Invalid_Can_channel" );
  snprintf( chTestDescription, elCount(chTestDescription), "Purpose:To check the EnblCNDD_CanInterrupts interface for invalid channel");
  TestCaseAddInfo( chTestTitle, "TC_L30SW_Q-36403671", chTestDescription );

  /***************************************************************************************************************/
                                              // Start of Test Case
  /***************************************************************************************************************/

  /***************************************************************************************************************/
                                              // Test Step 0 PRECONDITIONS
  /***************************************************************************************************************/
  snprintf( chActionText, elCount(chActionText), "Flash the Software and ECU is running ");
  snprintf( chExpectedText, elCount(chExpectedText), "Ecu is should be in running state");
  TestStepAddActionExpected( chActionText, chExpectedText );

  A_DBGR_BreakpointDeleteAll();
  A_DBGR_R();
  A_DBGR_Go();
  A_DBGR_Go();
  /***************************************************************************************************************/
                                              // Test Step 1 Define PDU info and call DsblCNDD_CanInterrupts.
  /***************************************************************************************************************/
  snprintf( chActionText, elCount(chActionText), "Configure disable variable to invoke DsblCNDD_CanInterrupts interface");
  snprintf( chExpectedText, elCount(chExpectedText), "verify Configure disable value as 1");
  //TestStepAddActionExpected( chActionText, chExpectedText );
  A_DBGR_VariableSet("disable","1");
  E_DBGR_VariableCheck("disable",1,Equal);

  /***************************************************************************************************************/
                                              // Test Step 2 Keep a breakpoint in EnblCNDD_CanInterrupts.
  /***************************************************************************************************************/
  snprintf( chActionText, elCount(chActionText), "set Breakpoint EnblCNDD_CanInterrupts callback function ");
  snprintf( chExpectedText, elCount(chExpectedText), "Breakpoint is Set in EnblCNDD_CanInterrupts");
  TestStepAddActionExpected( chActionText, chExpectedText );
  A_DBGR_BreakpointSet("EnblCNDD_CanInterrupts");

  /***************************************************************************************************************/
                                              // Test Step 3  call EnblCNDD_CanInterrupts.
  /***************************************************************************************************************/
  snprintf( chActionText, elCount(chActionText), "Configure disable variable to invoke EnblCNDD_CanInterrupts interface");
  snprintf( chExpectedText, elCount(chExpectedText), "verify Configure disable value as 0");
  //TestStepAddActionExpected( chActionText, chExpectedText );
  A_DBGR_VariableSet("disable","0");
  E_DBGR_VariableCheck("disable",0,Equal);

  /***************************************************************************************************************/
                                              // Test Step 4 Verify EnblCNDD_CanInterrupts callback function should invoked.
  /***************************************************************************************************************/
  snprintf( chActionText, elCount(chActionText), " Verify Breakpoint should hit in EnblCNDD_CanInterrupts ");
  snprintf( chExpectedText, elCount(chExpectedText), "Breakpoint hit in EnblCNDD_CanInterrupts function");
  TestStepAddActionExpected( chActionText, chExpectedText );
  E_DBGR_BreakpointCheckForHalt("EnblCNDD_CanInterrupts");

  /***************************************************************************************************************/
                                              // Test Step 5 Keep a breakpoint in EnblCNDD_CanInterrupts with invalid channel.
  /***************************************************************************************************************/

  snprintf( chActionText, elCount(chActionText), "Configure channelid values ");
  snprintf( chExpectedText, elCount(chExpectedText), "verify Configure channelid values");
  TestStepAddActionExpected( chActionText, chExpectedText );
  A_DBGR_VariableSet("channelid","255");
  E_DBGR_VariableCheck("channelid",255,Equal);

  snprintf( chActionText, elCount(chActionText), "Flash the Software and ECU is running ");
  snprintf( chExpectedText, elCount(chExpectedText), "Ecu is should be in running state");
  TestStepAddActionExpected( chActionText, chExpectedText );
  A_DBGR_Go();

  snprintf( chActionText, elCount(chActionText), "Configure channelid values ");
  snprintf( chExpectedText, elCount(chExpectedText), "verify Configure channelid values");
  //TestStepAddActionExpected( chActionText, chExpectedText );
  A_DBGR_VariableSet("channelid","255");
  E_DBGR_VariableCheck("channelid",255,Equal);

  snprintf( chActionText, elCount(chActionText), "Flash the Software and ECU is running ");
  snprintf( chExpectedText, elCount(chExpectedText), "Ecu is should be in running state");
  TestStepAddActionExpected( chActionText, chExpectedText );
  //A_DBGR_BreakpointDeleteAll();
  A_DBGR_Go();

  snprintf( chActionText, elCount(chActionText), "Configure channelid values ");
  snprintf( chExpectedText, elCount(chExpectedText), "verify Configure channelid values");
  //TestStepAddActionExpected( chActionText, chExpectedText );
  A_DBGR_VariableSet("channelid","255");
  E_DBGR_VariableCheck("channelid",255,Equal);

  snprintf( chActionText, elCount(chActionText), "Flash the Software and ECU is running ");
  snprintf( chExpectedText, elCount(chExpectedText), "Ecu is should be in running state");
  TestStepAddActionExpected( chActionText, chExpectedText );
  A_DBGR_Go();

  snprintf( chActionText, elCount(chActionText), "Configure channelid values ");
  snprintf( chExpectedText, elCount(chExpectedText), "verify Configure channelid values");
  //TestStepAddActionExpected( chActionText, chExpectedText );
  A_DBGR_VariableSet("channelid","255");
  E_DBGR_VariableCheck("channelid",255,Equal);

  snprintf( chActionText, elCount(chActionText), "Flash the Software and ECU is running ");
  snprintf( chExpectedText, elCount(chExpectedText), "Ecu is should be in running state");
  TestStepAddActionExpected( chActionText, chExpectedText );
  A_DBGR_BreakpointDeleteAll();
  A_DBGR_BreakpointSet("SetCANR_e_CanIfTxConfirmation");
   /***************************************************************************************************************/
                                              // Test Step 6 Keep a breakpoint in SetCANR_e_CanIfTxConfirmation and check CAN PDU ID.
  /***************************************************************************************************************/
  snprintf( chActionText, elCount(chActionText), "set Breakpoint SetCANR_e_CanIfTxConfirmation callback function ");
  snprintf( chExpectedText, elCount(chExpectedText), "Breakpoint is Set in SetCANR_e_CanIfTxConfirmation");
  //TestStepAddActionExpected( chActionText, chExpectedText );

  snprintf( chActionText, elCount(chActionText), "Flash the Software and ECU is running ");
  snprintf( chExpectedText, elCount(chExpectedText), "Ecu is should be in running state");
  //TestStepAddActionExpected( chActionText, chExpectedText );

  A_DBGR_Go();
  /***************************************************************************************************************/
                                              // Test Step 7 Verify SetCANR_e_CanIfTxConfirmation callback function should not invoked.
  /***************************************************************************************************************/
  snprintf( chActionText, elCount(chActionText), " Verify Breakpoint should hit in SetCANR_e_CanIfTxConfirmation ");
  snprintf( chExpectedText, elCount(chExpectedText), "Breakpoint hit in SetCANR_e_CanIfTxConfirmation function");
  E_DBGR_CheckState(T32_State_Running);
}





testcase Verify_MngCNDD_CanTrcvInitialize_interface_negative_scenario_by_sending_different_CANID_Wakeup_frame_for_CANB_CAN8()
{
  /***************************************************************************************************************/
                                                // Variable Definition
  /***************************************************************************************************************/



  /***************************************************************************************************************/
                                               // Local Values
  /***************************************************************************************************************/



  /***************************************************************************************************************/
                                              // Test Case Info
  /***************************************************************************************************************/
  setWriteDbgLevel(DebugOff);
  snprintf( chTestTitle, elCount(chTestTitle), "Verify_MngCNDD_CanTrcvInitialize_interface_negative_scenario_by_sending_different_CANID_Wakeup_frame_for_CANB_CAN8" );
  snprintf( chTestDescription, elCount(chTestDescription), "Purpose:To check the MngCNDD_CanTrcvInitialize interface for CAN8 channel");
  TestCaseAddInfo( chTestTitle, "TC_L30SW_Q-36403650", chTestDescription );

 /***************************************************************************************************************/
                                              // Start of Test Case
  /***************************************************************************************************************/

  /***************************************************************************************************************/
                                              // Test Step 0 PRECONDITIONS
  /***************************************************************************************************************/
  snprintf( chActionText, elCount(chActionText), "Flash the Software and ECU is running ");
  snprintf( chExpectedText, elCount(chExpectedText), "ECU should be in running state");
  TestStepAddActionExpected( chActionText, chExpectedText );

  A_DBGR_BreakpointDeleteAll();
  A_DBGR_BreakpointSet("TestCanTrcv_Init");
  A_DBGR_BreakpointSet("TestCan_Init");
  A_DBGR_R();
  A_DBGR_Go();
  /***************************************************************************************************************/
                                              // Test Step 1 Call the function MngCNDD_CanTrcvInitialize to initialize the CAN transceiver.
  /***************************************************************************************************************/
  snprintf( chActionText, elCount(chActionText), "Set Breakpoint TestCanTrcv_Init callback function ");
  snprintf( chExpectedText, elCount(chExpectedText), "Breakpoint is Set in TestCanTrcv_Init");
  //TestStepAddActionExpected( chActionText, chExpectedText );
  A_DBGR_Go();

  snprintf( chActionText, elCount(chActionText), "Verify Breakpoint should hit in TestCanTrcv_Init ");
  snprintf( chExpectedText, elCount(chExpectedText), "Breakpoint hit in TestCanTrcv_Init function");
  //TestStepAddActionExpected( chActionText, chExpectedText );
  E_DBGR_BreakpointCheckForHalt("TestCanTrcv_Init");

  /***************************************************************************************************************/
                                              // Test Step 2 Configure the values for the structure TsCNDD_CanTrcvCnfgType for CAN2 Channel.
  /***************************************************************************************************************/
  snprintf( chActionText, elCount(chActionText), "Set Breakpoint in TestCan_Init ");
  snprintf( chExpectedText, elCount(chExpectedText), "Verify Breakpoint is Set in TestCan_Init");
  TestStepAddActionExpected( chActionText, chExpectedText );
  A_DBGR_Go();

  snprintf( chActionText, elCount(chActionText), "Verify Breakpoint should hit in TestCan_Init ");
  snprintf( chExpectedText, elCount(chExpectedText), "Breakpoint hit in TestCan_Init function");
 // TestStepAddActionExpected( chActionText, chExpectedText );
  E_DBGR_BreakpointCheckForHalt("TestCan_Init");

  snprintf( chActionText, elCount(chActionText), "Configure CanTrcvPnFrameDataMaskIndex variable");
  snprintf( chExpectedText, elCount(chExpectedText), "Verify CanTrcvPnFrameDataMaskIndex is configured as 0");
  TestStepAddActionExpected( chActionText, chExpectedText );
  A_DBGR_VariableSet("VsCANR_PnFrameData1[0].CanTrcvPnFrameDataMaskIndex","0");
  E_DBGR_VariableCheck("VsCANR_PnFrameData1[0].CanTrcvPnFrameDataMaskIndex",0,Equal);

  snprintf( chActionText, elCount(chActionText), "Configure CanTrcvPnFrameDataMask variable");
  snprintf( chExpectedText, elCount(chExpectedText), "Verify CanTrcvPnFrameDataMask is configured as 1");
  TestStepAddActionExpected( chActionText, chExpectedText );
  A_DBGR_VariableSet("VsCANR_PnFrameData1[0].CanTrcvPnFrameDataMask","1");
  E_DBGR_VariableCheck("VsCANR_PnFrameData1[0].CanTrcvPnFrameDataMask",1,Equal);

  snprintf( chActionText, elCount(chActionText), "Configure CanTrcvPnFrameDataMaskIndex variable");
  snprintf( chExpectedText, elCount(chExpectedText), "Verify CanTrcvPnFrameDataMaskIndex is configured as 7");
  TestStepAddActionExpected( chActionText, chExpectedText );
  A_DBGR_VariableSet("VsCANR_PnFrameData1[7].CanTrcvPnFrameDataMaskIndex","7");
  E_DBGR_VariableCheck("VsCANR_PnFrameData1[7].CanTrcvPnFrameDataMaskIndex",7,Equal);

  snprintf( chActionText, elCount(chActionText), "Configure CanTrcvPnFrameDataMask variable");
  snprintf( chExpectedText, elCount(chExpectedText), "Verify CanTrcvPnFrameDataMask is configured as 8");
  TestStepAddActionExpected( chActionText, chExpectedText );
  A_DBGR_VariableSet("VsCANR_PnFrameData1[7].CanTrcvPnFrameDataMask","8");
  E_DBGR_VariableCheck("VsCANR_PnFrameData1[7].CanTrcvPnFrameDataMask",8,Equal);

  snprintf( chActionText, elCount(chActionText), "Configure CanTrcvPnFrameCanId variable");
  snprintf( chExpectedText, elCount(chExpectedText), "Verify CanTrcvPnFrameCanId is configured as 0x123");
  TestStepAddActionExpected( chActionText, chExpectedText );
  A_DBGR_VariableSet("VsCANR_PnConfig[0].CanTrcvPnFrameCanId","0x123");
  E_DBGR_VariableCheck("VsCANR_PnConfig[0].CanTrcvPnFrameCanId",0x123,Equal);

  snprintf( chActionText, elCount(chActionText), "Configure CanTrcvPnFrameCanIdMask variable");
  snprintf( chExpectedText, elCount(chExpectedText), "Verify CanTrcvPnFrameCanIdMask is configured as 0");
  TestStepAddActionExpected( chActionText, chExpectedText );
  A_DBGR_VariableSet("VsCANR_PnConfig[0].CanTrcvPnFrameCanIdMask","0");
  E_DBGR_VariableCheck("VsCANR_PnConfig[0].CanTrcvPnFrameCanIdMask",0,Equal);

  snprintf( chActionText, elCount(chActionText), "Configure CanTrcvPnFrameIdType variable");
  snprintf( chExpectedText, elCount(chExpectedText), "Verify CanTrcvPnFrameIdType is configured as 0");
  TestStepAddActionExpected( chActionText, chExpectedText );
  A_DBGR_VariableSet("VsCANR_PnConfig[0].CanTrcvPnFrameIdType","0");
  E_DBGR_VariableCheck("VsCANR_PnConfig[0].CanTrcvPnFrameIdType",0,Equal);

  snprintf( chActionText, elCount(chActionText), "Configure CanTrcvPnFrameDlc variable");
  snprintf( chExpectedText, elCount(chExpectedText), "Verify CanTrcvPnFrameDlc is configured as 8");
  TestStepAddActionExpected( chActionText, chExpectedText );
  A_DBGR_VariableSet("VsCANR_PnConfig[0].CanTrcvPnFrameDlc","8");
  E_DBGR_VariableCheck("VsCANR_PnConfig[0].CanTrcvPnFrameDlc",8,Equal);

  snprintf( chActionText, elCount(chActionText), "Configure CanTrcvPnEnabled variable");
  snprintf( chExpectedText, elCount(chExpectedText), "Verify CanTrcvPnEnabled is configured as 1");
  TestStepAddActionExpected( chActionText, chExpectedText );
  A_DBGR_VariableSet("VsCANR_PnConfig[0].CanTrcvPnEnabled","1");
  E_DBGR_VariableCheck("VsCANR_PnConfig[0].CanTrcvPnEnabled",1,Equal);

  snprintf( chActionText, elCount(chActionText), "Configure CanTrcvChannelId variable");
  snprintf( chExpectedText, elCount(chExpectedText), "Verify CanTrcvChannelId is configured as 0");
  TestStepAddActionExpected( chActionText, chExpectedText );
  A_DBGR_VariableSet("VsCANR_TrcvChannels[0].CanTrcvChannelId","0");
  E_DBGR_VariableCheck("VsCANR_TrcvChannels[0].CanTrcvChannelId",0,Equal);

  snprintf( chActionText, elCount(chActionText), "Configure CanTrcvChannelUsed variable");
  snprintf( chExpectedText, elCount(chExpectedText), "Verify CanTrcvChannelUsed is configured as 1");
  TestStepAddActionExpected( chActionText, chExpectedText );
  A_DBGR_VariableSet("VsCANR_TrcvChannels[0].CanTrcvChannelUsed","1");
  E_DBGR_VariableCheck("VsCANR_TrcvChannels[0].CanTrcvChannelUsed",1,Equal);

  snprintf( chActionText, elCount(chActionText), "Configure CanTrcvPinWakeupEnabled variable");
  snprintf( chExpectedText, elCount(chExpectedText), "Verify CanTrcvPinWakeupEnabled is configured as 0");
  TestStepAddActionExpected( chActionText, chExpectedText );
  A_DBGR_VariableSet("VsCANR_TrcvChannels[0].CanTrcvPinWakeupEnabled","0");
  E_DBGR_VariableCheck("VsCANR_TrcvChannels[0].CanTrcvPinWakeupEnabled",0,Equal);

  snprintf( chActionText, elCount(chActionText), "Configure CanTrcvNumberOfChannels variable");
  snprintf( chExpectedText, elCount(chExpectedText), "Verify CanTrcvNumberOfChannels is configured as 2");
  TestStepAddActionExpected( chActionText, chExpectedText );
  A_DBGR_VariableSet("VsCANR_CanTrcvConfig.CanTrcvNumberOfChannels","2");
  E_DBGR_VariableCheck("VsCANR_CanTrcvConfig.CanTrcvNumberOfChannels",2,Equal);

  snprintf( chActionText, elCount(chActionText), "Flash the Software and ECU is running ");
  snprintf( chExpectedText, elCount(chExpectedText), "ECU should be in running state");
  TestStepAddActionExpected( chActionText, chExpectedText );
  A_DBGR_Go();

  /***************************************************************************************************************/
                                              // Test Step 3  Call the function Test_SetHWIO_PowerDown by setting StartPowerDown to 1 then check transceiver is in the SLEEP mode and PMIC to STANDBY mode
  /***************************************************************************************************************/
  snprintf( chActionText, elCount(chActionText), "Configure StartPowerDown variable to invoke Test_SetHWIO_PowerDown interface");
  snprintf( chExpectedText, elCount(chExpectedText), "Verify StartPowerDown is configured as 1");
  //TestStepAddActionExpected( chActionText, chExpectedText );
  A_DBGR_VariableSet("StartPowerDown","1");
 // E_DBGR_VariableCheck("StartPowerDown",1,Equal);

  snprintf( chActionText, elCount(chActionText), "Check Trace32 is stopped");
  snprintf( chExpectedText, elCount(chExpectedText), "Verify Trace32 is stopped");
 // TestStepAddActionExpected( chActionText, chExpectedText );
  E_DBGR_CheckState(T32_State_Down);
   /***************************************************************************************************************/
                                              // Test Step Verify Transceiver is in sleep or not.
  /***************************************************************************************************************/
  snprintf( chActionText, elCount(chActionText), "Transmit CAN message. ID:0x40000101, PDU info:0x01");
  snprintf( chExpectedText, elCount(chExpectedText), "CAN message transmitted. ID:0x40000101, PDU info:0x01");
  TestStepAddActionExpected( chActionText, chExpectedText );

  E_CAN_WaitForMessageByID(0x00000101,15000,cc_eCAN_ABSENT,"CAN1");

  /***************************************************************************************************************/
                                              // Test Step 4  This step involves sending a CAN wakeup frame with ID 0x123 and 8 bytes of data from Canoe.
  /***************************************************************************************************************/
  snprintf( chActionText, elCount(chActionText), "Transmit CAN message. ID:0x444");
  snprintf( chExpectedText, elCount(chExpectedText), "CAN message transmitted. ID:0x444");
  TestStepAddActionExpected( chActionText, chExpectedText );
  A_CAN_SendMessage(0x444, CANA_Wakeup, 8, 2);
  A_CAN_SendMessage(0x444, CANA_Wakeup, 8, 2);

  /***************************************************************************************************************/
                                              // Test Step 5  Verify Transceiver wakeUp or not.
  /***************************************************************************************************************/
  snprintf( chActionText, elCount(chActionText), "Transmit CAN message. ID:0x40000101, PDU info:0x01");
  snprintf( chExpectedText, elCount(chExpectedText), "CAN message transmitted. ID:0x40000101, PDU info:0x01");
  //TestStepAddActionExpected( chActionText, chExpectedText );

  E_CAN_WaitForMessageByID(0x00000101,15000,cc_eCAN_ABSENT,"CAN1");

    /***************************************************************************************************************/
                                              // Test Step 6  This step involves sending a CAN wakeup frame with ID 0x123 and 8 bytes of data from Canoe.
  /***************************************************************************************************************/
  snprintf( chActionText, elCount(chActionText), "Transmit CAN message. ID:0x444");
  snprintf( chExpectedText, elCount(chExpectedText), "CAN message transmitted. ID:0x444");
  TestStepAddActionExpected( chActionText, chExpectedText );
  A_CAN_SendMessage(0x123, CANA_Wakeup, 8, 1);
  A_CAN_SendMessage(0x123, CANA_Wakeup, 8, 1);
}



testcase Verify_MngCNDD_CanTrcvInitialize_interface_for_CAN_Transceiver_Initialization_for_CANA_CAN2()
{
  /***************************************************************************************************************/
                                                // Variable Definition
  /***************************************************************************************************************/



  /***************************************************************************************************************/
                                               // Local Values
  /***************************************************************************************************************/



  /***************************************************************************************************************/
                                              // Test Case Info
  /***************************************************************************************************************/
  setWriteDbgLevel(DebugOff);
  snprintf( chTestTitle, elCount(chTestTitle), "Verify_MngCNDD_CanTrcvInitialize_interface_for_CAN_Transceiver_Initialization_for_CANA_CAN2" );
  snprintf( chTestDescription, elCount(chTestDescription), "Purpose:To check the MngCNDD_CanTrcvInitialize interface for CAN2 channel");
  TestCaseAddInfo( chTestTitle, "TC_L30SW_Q-36403647", chTestDescription );

  /***************************************************************************************************************/
                                              // Start of Test Case
  /***************************************************************************************************************/

  /***************************************************************************************************************/
                                              // Test Step 0 PRECONDITIONS
  /***************************************************************************************************************/
  snprintf( chActionText, elCount(chActionText), "Flash the Software and ECU is running ");
  snprintf( chExpectedText, elCount(chExpectedText), "ECU should be in running state");
  TestStepAddActionExpected( chActionText, chExpectedText );
  A_DBGR_BreakpointDeleteAll();
  A_DBGR_BreakpointSet("TestCanTrcv_Init");
  A_DBGR_R();
  A_DBGR_Go();
  /***************************************************************************************************************/
                                              // Test Step 1 Call the function MngCNDD_CanTrcvInitialize to initialize the CAN transceiver.
  /***************************************************************************************************************/
  snprintf( chActionText, elCount(chActionText), "Set Breakpoint TestCanTrcv_Init callback function ");
  snprintf( chExpectedText, elCount(chExpectedText), "Breakpoint is Set in TestCanTrcv_Init");
  //TestStepAddActionExpected( chActionText, chExpectedText );
  A_DBGR_Go();

  snprintf( chActionText, elCount(chActionText), "Verify Breakpoint should hit in TestCanTrcv_Init ");
  snprintf( chExpectedText, elCount(chExpectedText), "Breakpoint hit in TestCanTrcv_Init function");
  //TestStepAddActionExpected( chActionText, chExpectedText );
  E_DBGR_BreakpointCheckForHalt("TestCanTrcv_Init");

  /***************************************************************************************************************/
                                              // Test Step 2 Configure the values for the structure TsCNDD_CanTrcvCnfgType for CAN2 Channel.
  /***************************************************************************************************************/
  snprintf( chActionText, elCount(chActionText), "Set Breakpoint in TestCan_Init ");
  snprintf( chExpectedText, elCount(chExpectedText), "Verify Breakpoint is Set in TestCan_Init");
  TestStepAddActionExpected( chActionText, chExpectedText );
  A_DBGR_BreakpointSet("TestCan_Init");
  A_DBGR_Go();

  snprintf( chActionText, elCount(chActionText), "Verify Breakpoint should hit in TestCan_Init ");
  snprintf( chExpectedText, elCount(chExpectedText), "Breakpoint hit in TestCan_Init function");
 // TestStepAddActionExpected( chActionText, chExpectedText );
  E_DBGR_BreakpointCheckForHalt("TestCan_Init");

  snprintf( chActionText, elCount(chActionText), "Configure CanTrcvPnFrameDataMaskIndex variable");
  snprintf( chExpectedText, elCount(chExpectedText), "Verify CanTrcvPnFrameDataMaskIndex is configured as 0");
  TestStepAddActionExpected( chActionText, chExpectedText );
  A_DBGR_VariableSet("VsCANR_PnFrameData1[0].CanTrcvPnFrameDataMaskIndex","0");
  E_DBGR_VariableCheck("VsCANR_PnFrameData1[0].CanTrcvPnFrameDataMaskIndex",0,Equal);

  snprintf( chActionText, elCount(chActionText), "Configure CanTrcvPnFrameDataMask variable");
  snprintf( chExpectedText, elCount(chExpectedText), "Verify CanTrcvPnFrameDataMask is configured as 1");
  TestStepAddActionExpected( chActionText, chExpectedText );
  A_DBGR_VariableSet("VsCANR_PnFrameData1[0].CanTrcvPnFrameDataMask","1");
  E_DBGR_VariableCheck("VsCANR_PnFrameData1[0].CanTrcvPnFrameDataMask",1,Equal);

  snprintf( chActionText, elCount(chActionText), "Configure CanTrcvPnFrameDataMaskIndex variable");
  snprintf( chExpectedText, elCount(chExpectedText), "Verify CanTrcvPnFrameDataMaskIndex is configured as 7");
  TestStepAddActionExpected( chActionText, chExpectedText );
  A_DBGR_VariableSet("VsCANR_PnFrameData1[7].CanTrcvPnFrameDataMaskIndex","7");
  E_DBGR_VariableCheck("VsCANR_PnFrameData1[7].CanTrcvPnFrameDataMaskIndex",7,Equal);

  snprintf( chActionText, elCount(chActionText), "Configure CanTrcvPnFrameDataMask variable");
  snprintf( chExpectedText, elCount(chExpectedText), "Verify CanTrcvPnFrameDataMask is configured as 8");
  TestStepAddActionExpected( chActionText, chExpectedText );
  A_DBGR_VariableSet("VsCANR_PnFrameData1[7].CanTrcvPnFrameDataMask","8");
  E_DBGR_VariableCheck("VsCANR_PnFrameData1[7].CanTrcvPnFrameDataMask",8,Equal);

  snprintf( chActionText, elCount(chActionText), "Configure CanTrcvPnFrameCanId variable");
  snprintf( chExpectedText, elCount(chExpectedText), "Verify CanTrcvPnFrameCanId is configured as 0x123");
  TestStepAddActionExpected( chActionText, chExpectedText );
  A_DBGR_VariableSet("VsCANR_PnConfig[0].CanTrcvPnFrameCanId","0x123");
  E_DBGR_VariableCheck("VsCANR_PnConfig[0].CanTrcvPnFrameCanId",0x123,Equal);

  snprintf( chActionText, elCount(chActionText), "Configure CanTrcvPnFrameCanIdMask variable");
  snprintf( chExpectedText, elCount(chExpectedText), "Verify CanTrcvPnFrameCanIdMask is configured as 0");
  TestStepAddActionExpected( chActionText, chExpectedText );
  A_DBGR_VariableSet("VsCANR_PnConfig[0].CanTrcvPnFrameCanIdMask","0");
  E_DBGR_VariableCheck("VsCANR_PnConfig[0].CanTrcvPnFrameCanIdMask",0,Equal);

  snprintf( chActionText, elCount(chActionText), "Configure CanTrcvPnFrameIdType variable");
  snprintf( chExpectedText, elCount(chExpectedText), "Verify CanTrcvPnFrameIdType is configured as 0");
  TestStepAddActionExpected( chActionText, chExpectedText );
  A_DBGR_VariableSet("VsCANR_PnConfig[0].CanTrcvPnFrameIdType","0");
  E_DBGR_VariableCheck("VsCANR_PnConfig[0].CanTrcvPnFrameIdType",0,Equal);

  snprintf( chActionText, elCount(chActionText), "Configure CanTrcvPnFrameDlc variable");
  snprintf( chExpectedText, elCount(chExpectedText), "Verify CanTrcvPnFrameDlc is configured as 8");
  TestStepAddActionExpected( chActionText, chExpectedText );
  A_DBGR_VariableSet("VsCANR_PnConfig[0].CanTrcvPnFrameDlc","8");
  E_DBGR_VariableCheck("VsCANR_PnConfig[0].CanTrcvPnFrameDlc",8,Equal);

  snprintf( chActionText, elCount(chActionText), "Configure CanTrcvPnEnabled variable");
  snprintf( chExpectedText, elCount(chExpectedText), "Verify CanTrcvPnEnabled is configured as 1");
  TestStepAddActionExpected( chActionText, chExpectedText );
  A_DBGR_VariableSet("VsCANR_PnConfig[0].CanTrcvPnEnabled","1");
  E_DBGR_VariableCheck("VsCANR_PnConfig[0].CanTrcvPnEnabled",1,Equal);

  snprintf( chActionText, elCount(chActionText), "Configure CanTrcvChannelId variable");
  snprintf( chExpectedText, elCount(chExpectedText), "Verify CanTrcvChannelId is configured as 0");
  TestStepAddActionExpected( chActionText, chExpectedText );
  A_DBGR_VariableSet("VsCANR_TrcvChannels[0].CanTrcvChannelId","0");
  E_DBGR_VariableCheck("VsCANR_TrcvChannels[0].CanTrcvChannelId",0,Equal);

  snprintf( chActionText, elCount(chActionText), "Configure CanTrcvChannelUsed variable");
  snprintf( chExpectedText, elCount(chExpectedText), "Verify CanTrcvChannelUsed is configured as 1");
  TestStepAddActionExpected( chActionText, chExpectedText );
  A_DBGR_VariableSet("VsCANR_TrcvChannels[0].CanTrcvChannelUsed","1");
  E_DBGR_VariableCheck("VsCANR_TrcvChannels[0].CanTrcvChannelUsed",1,Equal);

  snprintf( chActionText, elCount(chActionText), "Configure CanTrcvPinWakeupEnabled variable");
  snprintf( chExpectedText, elCount(chExpectedText), "Verify CanTrcvPinWakeupEnabled is configured as 0");
  TestStepAddActionExpected( chActionText, chExpectedText );
  A_DBGR_VariableSet("VsCANR_TrcvChannels[0].CanTrcvPinWakeupEnabled","0");
  E_DBGR_VariableCheck("VsCANR_TrcvChannels[0].CanTrcvPinWakeupEnabled",0,Equal);

  snprintf( chActionText, elCount(chActionText), "Configure CanTrcvNumberOfChannels variable");
  snprintf( chExpectedText, elCount(chExpectedText), "Verify CanTrcvNumberOfChannels is configured as 2");
  TestStepAddActionExpected( chActionText, chExpectedText );
  A_DBGR_VariableSet("VsCANR_CanTrcvConfig.CanTrcvNumberOfChannels","2");
  E_DBGR_VariableCheck("VsCANR_CanTrcvConfig.CanTrcvNumberOfChannels",2,Equal);

  snprintf( chActionText, elCount(chActionText), "Flash the Software and ECU is running ");
  snprintf( chExpectedText, elCount(chExpectedText), "ECU should be in running state");
  TestStepAddActionExpected( chActionText, chExpectedText );
  A_DBGR_Go();

  /***************************************************************************************************************/
                                              // Test Step 3  Call the function Test_SetHWIO_PowerDown by setting StartPowerDown to 1 then check transceiver is in the SLEEP mode and PMIC to STANDBY mode
  /***************************************************************************************************************/
  snprintf( chActionText, elCount(chActionText), "Configure StartPowerDown variable to invoke Test_SetHWIO_PowerDown interface");
  snprintf( chExpectedText, elCount(chExpectedText), "Verify StartPowerDown is configured as 1");
  //TestStepAddActionExpected( chActionText, chExpectedText );
  A_DBGR_VariableSet("StartPowerDown","1");
 // E_DBGR_VariableCheck("StartPowerDown",1,Equal);

//  snprintf( chActionText, elCount(chActionText), "Check Trace32 is stopped");
//  snprintf( chExpectedText, elCount(chExpectedText), "Verify Trace32 is stopped");
//  //TestStepAddActionExpected( chActionText, chExpectedText );
//  E_DBGR_CheckState(T32_State_Down);
  snprintf( chActionText, elCount(chActionText), "Check Trace32 is stopped");
  snprintf( chExpectedText, elCount(chExpectedText), "Verify Trace32 is stopped");
 // TestStepAddActionExpected( chActionText, chExpectedText );
  E_DBGR_CheckState(T32_State_Down);

  /***************************************************************************************************************/
                                              // Test Step Verify Transceiver is in sleep or not.
  /***************************************************************************************************************/
  snprintf( chActionText, elCount(chActionText), "Transmit CAN message. ID:0x40000101, PDU info:0x01");
  snprintf( chExpectedText, elCount(chExpectedText), "CAN message transmitted. ID:0x40000101, PDU info:0x01");
  TestStepAddActionExpected( chActionText, chExpectedText );

  E_CAN_WaitForMessageByID(0x00000101,15000,cc_eCAN_ABSENT,"CAN1");

  /***************************************************************************************************************/
                                              // Test Step 4  This step involves sending a CAN wakeup frame with ID 0x123 and 8 bytes of data from Canoe.
  /***************************************************************************************************************/
  snprintf( chActionText, elCount(chActionText), "Transmit CAN message. ID:0x123");
  snprintf( chExpectedText, elCount(chExpectedText), "CAN message transmitted. ID:0x123");
  TestStepAddActionExpected( chActionText, chExpectedText );
  A_CAN_SendMessage(0x123, CANA_Wakeup, 8, 1);
  A_CAN_SendMessage(0x123, CANA_Wakeup, 8, 1);

  /***************************************************************************************************************/
                                              // Test Step 5  Verify Transceiver wakeUp or not.
  /***************************************************************************************************************/
  snprintf( chActionText, elCount(chActionText), "Transmit CAN message. ID:0x40000101, PDU info:0x01");
  snprintf( chExpectedText, elCount(chExpectedText), "CAN message transmitted. ID:0x40000101, PDU info:0x01");
  //TestStepAddActionExpected( chActionText, chExpectedText );

  E_CAN_WaitForMessageByID(0x00000102,15000,cc_eCAN_PRESENT,"CAN1");
}


testcase To_verify_MngCNDD_CanRxInit_Interface_that_the_CAN_controller_for_CANA_CAN2_is_initialized_correctly()
{
      /***************************************************************************************************************/
                                                // Variable Definition
  /***************************************************************************************************************/



  /***************************************************************************************************************/
                                               // Local Values
  /***************************************************************************************************************/



  /***************************************************************************************************************/
                                              // Test Case Info
  /***************************************************************************************************************/
  setWriteDbgLevel(DebugOff);
  snprintf( chTestTitle, elCount(chTestTitle), "To_verify_MngCNDD_CanRxInit_Interface_that_the_CAN_controller_for_CANA_CAN2_is_initialized_correctly_and_messages_are_transmitted_as_expected" );
  snprintf( chTestDescription, elCount(chTestDescription), "Purpose:To check the RX message intialized of CAN2");
  TestCaseAddInfo( chTestTitle, "TC_L30SW_Q-36403648", chTestDescription );

  /***************************************************************************************************************/
                                              // Start of Test Case
  /***************************************************************************************************************/

  /***************************************************************************************************************/
                                              // Test Step 0 PRECONDITIONS
  /***************************************************************************************************************/
  snprintf( chActionText, elCount(chActionText), "Flash the Software and ECU is running ");
  snprintf( chExpectedText, elCount(chExpectedText), "Ecu is should be in running state");
  TestStepAddActionExpected( chActionText, chExpectedText );

  A_DBGR_BreakpointDeleteAll();
  A_DBGR_BreakpointSet("TestCan_Init");
  A_DBGR_R();
  A_DBGR_Go();
  /***************************************************************************************************************/
                                              // Test Step 1 Configure the values for the structure TsCNDD_CanCnfgType for CANA.
  /***************************************************************************************************************/

  snprintf( chActionText, elCount(chActionText), "Set Breakpoint in TestCan_Init ");
  snprintf( chExpectedText, elCount(chExpectedText), "verify is Breakpoint Set TestCan_Init");

  A_DBGR_Go();

  snprintf( chActionText, elCount(chActionText), "verify Breakpoint should hit in TestCan_Init ");
  snprintf( chExpectedText, elCount(chExpectedText), "Breakpoint hit in TestCan_Init function");

  E_DBGR_BreakpointCheckForHalt("TestCan_Init");

  snprintf( chActionText, elCount(chActionText), "Configure CanId values ");
  snprintf( chExpectedText, elCount(chExpectedText), "verify Configure CanId values");
  TestStepAddActionExpected( chActionText, chExpectedText );
  A_DBGR_VariableSet("VaCANR_CanRxMsgs[0].CanId","0x40000456");
  E_DBGR_VariableCheck("VaCANR_CanRxMsgs[0].CanId",0x40000456,Equal);

  snprintf( chActionText, elCount(chActionText), "Configure CanFilterMask values ");
  snprintf( chExpectedText, elCount(chExpectedText), "verify Configure CanFilterMask values");
  TestStepAddActionExpected( chActionText, chExpectedText );
  A_DBGR_VariableSet("VaCANR_CanRxMsgs[0].CanFilterMask","0x7FF");
  E_DBGR_VariableCheck("VaCANR_CanRxMsgs[0].CanFilterMask",0x7FF,Equal);

   snprintf( chActionText, elCount(chActionText), "Configure CanRxMessageIdx values ");
  snprintf( chExpectedText, elCount(chExpectedText), "verify Configure CanRxMessageIdx values");
  TestStepAddActionExpected( chActionText, chExpectedText );
  A_DBGR_VariableSet("VaCANR_CanRxMsgs[0].CanRxMessageIdx","0");
  E_DBGR_VariableCheck("VaCANR_CanRxMsgs[0].CanRxMessageIdx",0,Equal);

  snprintf( chActionText, elCount(chActionText), "Configure CanMessageLen values ");
  snprintf( chExpectedText, elCount(chExpectedText), "verify Configure CanMessageLen values");
  TestStepAddActionExpected( chActionText, chExpectedText );
  A_DBGR_VariableSet("VaCANR_CanRxMsgs[0].CanMessageLen","64");
  E_DBGR_VariableCheck("VaCANR_CanRxMsgs[0].CanMessageLen",64,Equal);

   snprintf( chActionText, elCount(chActionText), "Configure CanIdType values ");
  snprintf( chExpectedText, elCount(chExpectedText), "verify Configure CanIdType values");
  TestStepAddActionExpected( chActionText, chExpectedText );
  A_DBGR_VariableSet("VaCANR_CanRxMsgs[0].CanIdType","2");
  E_DBGR_VariableCheck("VaCANR_CanRxMsgs[0].CanIdType",2,Equal);

  snprintf( chActionText, elCount(chActionText), "Configure CanControllerId values ");
  snprintf( chExpectedText, elCount(chExpectedText), "verify Configure CanControllerId values");
  TestStepAddActionExpected( chActionText, chExpectedText );
  A_DBGR_VariableSet("VaCANR_CanRxMsgs[0].CanControllerId","0");
  E_DBGR_VariableCheck("VaCANR_CanRxMsgs[0].CanControllerId",0,Equal);

   /***************************************************************************************************************/
                                              // Test Step 2 Call the function MngCNDD_CanRxInit with the configured structure. MngCNDD_CanRxInit(&canConfigA);
  /***************************************************************************************************************/
  snprintf( chActionText, elCount(chActionText), "Set Breakpoint in MngCNDD_CanRxInit ");
  snprintf( chExpectedText, elCount(chExpectedText), "verify is Breakpoint Set MngCNDD_CanRxInit");
  TestStepAddActionExpected( chActionText, chExpectedText );

  A_DBGR_BreakpointSet("MngCNDD_CanRxInit");
  A_DBGR_Go();

  snprintf( chActionText, elCount(chActionText), "verify Breakpoint should hit in MngCNDD_CanRxInit ");
  snprintf( chExpectedText, elCount(chExpectedText), "Breakpoint hit in MngCNDD_CanRxInit function");
  E_DBGR_BreakpointCheckForHalt("MngCNDD_CanRxInit");

 /***************************************************************************************************************/
                                              // Test Step 3 Call SetCNDD_e_CanControllerMode with start mode. SetCNDD_e_CanControllerMode(0, 2); // Start mode for CAN controller 0
  /***************************************************************************************************************/
  snprintf( chActionText, elCount(chActionText), "Set Breakpoint in SetCNDD_e_CanControllerMode funtion ");
  snprintf( chExpectedText, elCount(chExpectedText), "Breakpoint is Set in SetCNDD_e_CanControllerMode");
  TestStepAddActionExpected( chActionText, chExpectedText );
  A_DBGR_BreakpointSet("SetCNDD_e_CanControllerMode");
  A_DBGR_Go();

  snprintf( chActionText, elCount(chActionText), " Verify Breakpoint should hit in SetCNDD_e_CanControllerMode ");
  snprintf( chExpectedText, elCount(chExpectedText), "Breakpoint hit in SetCNDD_e_CanControllerMode function");
  E_DBGR_BreakpointCheckForHalt("SetCNDD_e_CanControllerMode");

   /***************************************************************************************************************/
                                              // Test Step 4 set Breakpoint in SetCANR_h_CanIfRxIndication.
  /***************************************************************************************************************/
  snprintf( chActionText, elCount(chActionText), "set Breakpoint inSetCANR_h_CanIfRxIndication callback function ");
  snprintf( chExpectedText, elCount(chExpectedText), "Breakpoint is Set in SetCANR_h_CanIfRxIndication");
  TestStepAddActionExpected( chActionText, chExpectedText );
  A_DBGR_BreakpointSet("SetCANR_h_CanIfRxIndication");
  A_DBGR_Go();
  A_DBGR_Go();

  /***************************************************************************************************************/
                                              // Test Step 5 Verify that the transmitted message with minimum message length using canoe.
  /***************************************************************************************************************/
  snprintf( chActionText, elCount(chActionText), "Transmit CAN message. ID:0x401,PDU info:0x01");
  snprintf( chExpectedText, elCount(chExpectedText), "CAN message transmitted. ID:0x456,PDU info:0x01");
  A_CAN_SendMessage(0x40000456, dat_64byte, 64, 1,cc_eCAN_FD);
   /***************************************************************************************************************/
                                              // Test Step 6 Verify SetCANR_h_CanIfRxIndication callback function invoked with relevant CAN_RECEIVE_MSG_INDEX, CAN_PDU_MESSAGE_ID, CAN_PDU_DATA_LENGTH, CAN_PDU_DATA_POINTER.
  /***************************************************************************************************************/

  snprintf( chActionText, elCount(chActionText), " Verify Breakpoint should hit in SetCANR_h_CanIfRxIndication ");
  snprintf( chExpectedText, elCount(chExpectedText), "Breakpoint hit in SetCANR_h_CanIfRxIndication function");
  //TestStepAddActionExpected( chActionText, chExpectedText );
  E_DBGR_BreakpointCheckForHalt("SetCANR_h_CanIfRxIndication");

  snprintf( chActionText, elCount(chActionText), "verify CanrxmsgIdx");
  snprintf( chExpectedText, elCount(chExpectedText), "CanrxmsgIdx as 0");
  TestStepAddActionExpected( chActionText, chExpectedText );
  E_DBGR_VariableCheck("CanrxmsgIdx",0,Equal);
  snprintf( chActionText, elCount(chActionText), "Verify CanpdumsgId ");
  snprintf( chExpectedText, elCount(chExpectedText), " CanpdumsgId as 0x40000456");
  TestStepAddActionExpected( chActionText, chExpectedText );
  E_DBGR_VariableCheck("CanpdumsgId ",0x40000456,Equal);
   snprintf( chActionText, elCount(chActionText), "Verify Canpdudatalength");
  snprintf( chExpectedText, elCount(chExpectedText), "Canpdudatalength as 64");
  TestStepAddActionExpected( chActionText, chExpectedText );
  E_DBGR_VariableCheck("Canpdudatalength",64,Equal);
}



testcase Verify_MngCNDD_CanTrcvInitialize_interface_negative_scenario_by_sending_different_CANID_Wakeup_frame_for_CANA_CAN2()
{
  /***************************************************************************************************************/
                                                // Variable Definition
  /***************************************************************************************************************/



  /***************************************************************************************************************/
                                               // Local Values
  /***************************************************************************************************************/



  /***************************************************************************************************************/
                                              // Test Case Info
  /***************************************************************************************************************/
  setWriteDbgLevel(DebugOff);
  snprintf( chTestTitle, elCount(chTestTitle), "Verify_MngCNDD_CanTrcvInitialize_interface_negative_scenario_by_sending_different_CANID_Wakeup_frame_for_CANA_CAN2" );
  snprintf( chTestDescription, elCount(chTestDescription), "Purpose:To check the MngCNDD_CanTrcvInitialize interface for CAN2 channel");
  TestCaseAddInfo( chTestTitle, "TC_L30SW_Q-36403649", chTestDescription );

   /***************************************************************************************************************/
                                              // Start of Test Case
  /***************************************************************************************************************/

  /***************************************************************************************************************/
                                              // Test Step 0 PRECONDITIONS
  /***************************************************************************************************************/
  snprintf( chActionText, elCount(chActionText), "Flash the Software and ECU is running ");
  snprintf( chExpectedText, elCount(chExpectedText), "ECU should be in running state");
  TestStepAddActionExpected( chActionText, chExpectedText );

  A_DBGR_BreakpointDeleteAll();
  A_DBGR_BreakpointSet("TestCanTrcv_Init");
  A_DBGR_R();
  A_DBGR_Go();
  /***************************************************************************************************************/
                                              // Test Step 1 Call the function MngCNDD_CanTrcvInitialize to initialize the CAN transceiver.
  /***************************************************************************************************************/
  snprintf( chActionText, elCount(chActionText), "Set Breakpoint TestCanTrcv_Init callback function ");
  snprintf( chExpectedText, elCount(chExpectedText), "Breakpoint is Set in TestCanTrcv_Init");
  //TestStepAddActionExpected( chActionText, chExpectedText );
  A_DBGR_Go();

  snprintf( chActionText, elCount(chActionText), "Verify Breakpoint should hit in TestCanTrcv_Init ");
  snprintf( chExpectedText, elCount(chExpectedText), "Breakpoint hit in TestCanTrcv_Init function");
  //TestStepAddActionExpected( chActionText, chExpectedText );
  E_DBGR_BreakpointCheckForHalt("TestCanTrcv_Init");

  /***************************************************************************************************************/
                                              // Test Step 2 Configure the values for the structure TsCNDD_CanTrcvCnfgType for CAN2 Channel.
  /***************************************************************************************************************/
  snprintf( chActionText, elCount(chActionText), "Set Breakpoint in TestCan_Init ");
  snprintf( chExpectedText, elCount(chExpectedText), "Verify Breakpoint is Set in TestCan_Init");
  TestStepAddActionExpected( chActionText, chExpectedText );
  A_DBGR_BreakpointSet("TestCan_Init");
  A_DBGR_Go();

  snprintf( chActionText, elCount(chActionText), "Verify Breakpoint should hit in TestCan_Init ");
  snprintf( chExpectedText, elCount(chExpectedText), "Breakpoint hit in TestCan_Init function");
 // TestStepAddActionExpected( chActionText, chExpectedText );
  E_DBGR_BreakpointCheckForHalt("TestCan_Init");

  snprintf( chActionText, elCount(chActionText), "Configure CanTrcvPnFrameDataMaskIndex variable");
  snprintf( chExpectedText, elCount(chExpectedText), "Verify CanTrcvPnFrameDataMaskIndex is configured as 0");
  TestStepAddActionExpected( chActionText, chExpectedText );
  A_DBGR_VariableSet("VsCANR_PnFrameData1[0].CanTrcvPnFrameDataMaskIndex","0");
  E_DBGR_VariableCheck("VsCANR_PnFrameData1[0].CanTrcvPnFrameDataMaskIndex",0,Equal);

  snprintf( chActionText, elCount(chActionText), "Configure CanTrcvPnFrameDataMask variable");
  snprintf( chExpectedText, elCount(chExpectedText), "Verify CanTrcvPnFrameDataMask is configured as 1");
  TestStepAddActionExpected( chActionText, chExpectedText );
  A_DBGR_VariableSet("VsCANR_PnFrameData1[0].CanTrcvPnFrameDataMask","1");
  E_DBGR_VariableCheck("VsCANR_PnFrameData1[0].CanTrcvPnFrameDataMask",1,Equal);

  snprintf( chActionText, elCount(chActionText), "Configure CanTrcvPnFrameDataMaskIndex variable");
  snprintf( chExpectedText, elCount(chExpectedText), "Verify CanTrcvPnFrameDataMaskIndex is configured as 7");
  TestStepAddActionExpected( chActionText, chExpectedText );
  A_DBGR_VariableSet("VsCANR_PnFrameData1[7].CanTrcvPnFrameDataMaskIndex","7");
  E_DBGR_VariableCheck("VsCANR_PnFrameData1[7].CanTrcvPnFrameDataMaskIndex",7,Equal);

  snprintf( chActionText, elCount(chActionText), "Configure CanTrcvPnFrameDataMask variable");
  snprintf( chExpectedText, elCount(chExpectedText), "Verify CanTrcvPnFrameDataMask is configured as 8");
  TestStepAddActionExpected( chActionText, chExpectedText );
  A_DBGR_VariableSet("VsCANR_PnFrameData1[7].CanTrcvPnFrameDataMask","8");
  E_DBGR_VariableCheck("VsCANR_PnFrameData1[7].CanTrcvPnFrameDataMask",8,Equal);

  snprintf( chActionText, elCount(chActionText), "Configure CanTrcvPnFrameCanId variable");
  snprintf( chExpectedText, elCount(chExpectedText), "Verify CanTrcvPnFrameCanId is configured as 0x123");
  TestStepAddActionExpected( chActionText, chExpectedText );
  A_DBGR_VariableSet("VsCANR_PnConfig[0].CanTrcvPnFrameCanId","0x123");
  E_DBGR_VariableCheck("VsCANR_PnConfig[0].CanTrcvPnFrameCanId",0x123,Equal);

  snprintf( chActionText, elCount(chActionText), "Configure CanTrcvPnFrameCanIdMask variable");
  snprintf( chExpectedText, elCount(chExpectedText), "Verify CanTrcvPnFrameCanIdMask is configured as 0");
  TestStepAddActionExpected( chActionText, chExpectedText );
  A_DBGR_VariableSet("VsCANR_PnConfig[0].CanTrcvPnFrameCanIdMask","0");
  E_DBGR_VariableCheck("VsCANR_PnConfig[0].CanTrcvPnFrameCanIdMask",0,Equal);

  snprintf( chActionText, elCount(chActionText), "Configure CanTrcvPnFrameIdType variable");
  snprintf( chExpectedText, elCount(chExpectedText), "Verify CanTrcvPnFrameIdType is configured as 0");
  TestStepAddActionExpected( chActionText, chExpectedText );
  A_DBGR_VariableSet("VsCANR_PnConfig[0].CanTrcvPnFrameIdType","0");
  E_DBGR_VariableCheck("VsCANR_PnConfig[0].CanTrcvPnFrameIdType",0,Equal);

  snprintf( chActionText, elCount(chActionText), "Configure CanTrcvPnFrameDlc variable");
  snprintf( chExpectedText, elCount(chExpectedText), "Verify CanTrcvPnFrameDlc is configured as 8");
  TestStepAddActionExpected( chActionText, chExpectedText );
  A_DBGR_VariableSet("VsCANR_PnConfig[0].CanTrcvPnFrameDlc","8");
  E_DBGR_VariableCheck("VsCANR_PnConfig[0].CanTrcvPnFrameDlc",8,Equal);

  snprintf( chActionText, elCount(chActionText), "Configure CanTrcvPnEnabled variable");
  snprintf( chExpectedText, elCount(chExpectedText), "Verify CanTrcvPnEnabled is configured as 1");
  TestStepAddActionExpected( chActionText, chExpectedText );
  A_DBGR_VariableSet("VsCANR_PnConfig[0].CanTrcvPnEnabled","1");
  E_DBGR_VariableCheck("VsCANR_PnConfig[0].CanTrcvPnEnabled",1,Equal);

  snprintf( chActionText, elCount(chActionText), "Configure CanTrcvChannelId variable");
  snprintf( chExpectedText, elCount(chExpectedText), "Verify CanTrcvChannelId is configured as 0");
  TestStepAddActionExpected( chActionText, chExpectedText );
  A_DBGR_VariableSet("VsCANR_TrcvChannels[0].CanTrcvChannelId","0");
  E_DBGR_VariableCheck("VsCANR_TrcvChannels[0].CanTrcvChannelId",0,Equal);

  snprintf( chActionText, elCount(chActionText), "Configure CanTrcvChannelUsed variable");
  snprintf( chExpectedText, elCount(chExpectedText), "Verify CanTrcvChannelUsed is configured as 1");
  TestStepAddActionExpected( chActionText, chExpectedText );
  A_DBGR_VariableSet("VsCANR_TrcvChannels[0].CanTrcvChannelUsed","1");
  E_DBGR_VariableCheck("VsCANR_TrcvChannels[0].CanTrcvChannelUsed",1,Equal);

  snprintf( chActionText, elCount(chActionText), "Configure CanTrcvPinWakeupEnabled variable");
  snprintf( chExpectedText, elCount(chExpectedText), "Verify CanTrcvPinWakeupEnabled is configured as 0");
  TestStepAddActionExpected( chActionText, chExpectedText );
  A_DBGR_VariableSet("VsCANR_TrcvChannels[0].CanTrcvPinWakeupEnabled","0");
  E_DBGR_VariableCheck("VsCANR_TrcvChannels[0].CanTrcvPinWakeupEnabled",0,Equal);

  snprintf( chActionText, elCount(chActionText), "Configure CanTrcvNumberOfChannels variable");
  snprintf( chExpectedText, elCount(chExpectedText), "Verify CanTrcvNumberOfChannels is configured as 2");
  TestStepAddActionExpected( chActionText, chExpectedText );
  A_DBGR_VariableSet("VsCANR_CanTrcvConfig.CanTrcvNumberOfChannels","2");
  E_DBGR_VariableCheck("VsCANR_CanTrcvConfig.CanTrcvNumberOfChannels",2,Equal);

  snprintf( chActionText, elCount(chActionText), "Flash the Software and ECU is running ");
  snprintf( chExpectedText, elCount(chExpectedText), "ECU should be in running state");
  TestStepAddActionExpected( chActionText, chExpectedText );
  A_DBGR_Go();

  /***************************************************************************************************************/
                                              // Test Step 3  Call the function Test_SetHWIO_PowerDown by setting StartPowerDown to 1 then check transceiver is in the SLEEP mode and PMIC to STANDBY mode
  /***************************************************************************************************************/
  snprintf( chActionText, elCount(chActionText), "Configure StartPowerDown variable to invoke Test_SetHWIO_PowerDown interface");
  snprintf( chExpectedText, elCount(chExpectedText), "Verify StartPowerDown is configured as 1");
  //TestStepAddActionExpected( chActionText, chExpectedText );
  A_DBGR_VariableSet("StartPowerDown","1");
 // E_DBGR_VariableCheck("StartPowerDown",1,Equal);

  snprintf( chActionText, elCount(chActionText), "Check Trace32 is stopped");
  snprintf( chExpectedText, elCount(chExpectedText), "Verify Trace32 is stopped");
 // TestStepAddActionExpected( chActionText, chExpectedText );
  E_DBGR_CheckState(T32_State_Down);

  /***************************************************************************************************************/
                                              // Test Step Verify Transceiver is in sleep or not.
  /***************************************************************************************************************/
  snprintf( chActionText, elCount(chActionText), "Transmit CAN message. ID:0x40000101, PDU info:0x01");
  snprintf( chExpectedText, elCount(chExpectedText), "CAN message transmitted. ID:0x40000101, PDU info:0x01");
  TestStepAddActionExpected( chActionText, chExpectedText );

  E_CAN_WaitForMessageByID(0x00000101,15000,cc_eCAN_ABSENT,"CAN1");
  /***************************************************************************************************************/
                                              // Test Step 4  This step involves sending a CAN wakeup frame with ID 0x444 and 8 bytes of data from Canoe.
  /***************************************************************************************************************/
  snprintf( chActionText, elCount(chActionText), "Transmit CAN message. ID:0x444");
  snprintf( chExpectedText, elCount(chExpectedText), "CAN message transmitted. ID:0x444");
  TestStepAddActionExpected( chActionText, chExpectedText );
  A_CAN_SendMessage(0x444, CANA_Wakeup, 8, 2);
  A_CAN_SendMessage(0x444, CANA_Wakeup, 8, 2);

  /***************************************************************************************************************/
                                              // Test Step 5  Verify Transceiver wakeUp or not.
  /***************************************************************************************************************/
  snprintf( chActionText, elCount(chActionText), "Transmit CAN message. ID:0x40000101, PDU info:0x01");
  snprintf( chExpectedText, elCount(chExpectedText), "CAN message transmitted. ID:0x40000101, PDU info:0x01");
  //TestStepAddActionExpected( chActionText, chExpectedText );

  E_CAN_WaitForMessageByID(0x00000101,15000,cc_eCAN_ABSENT,"CAN1");

    /***************************************************************************************************************/
                                              // Test Step 6  This step involves sending a CAN wakeup frame with ID 0x123 and 8 bytes of data from Canoe.
  /***************************************************************************************************************/
  snprintf( chActionText, elCount(chActionText), "Transmit CAN message. ID:0x444");
  snprintf( chExpectedText, elCount(chExpectedText), "CAN message transmitted. ID:0x444");
  TestStepAddActionExpected( chActionText, chExpectedText );
  A_CAN_SendMessage(0x123, CANA_Wakeup, 8, 1);
  A_CAN_SendMessage(0x123, CANA_Wakeup, 8, 1);
}



testcase Verify_MngCNDD_CanTrcvInitialize_interface_for_CAN_Transceiver_Initialization_for_CANB_CAN8()
{
  /***************************************************************************************************************/
                                                // Variable Definition
  /***************************************************************************************************************/



  /***************************************************************************************************************/
                                               // Local Values
  /***************************************************************************************************************/



  /***************************************************************************************************************/
                                              // Test Case Info
  /***************************************************************************************************************/
  setWriteDbgLevel(DebugOff);
  snprintf( chTestTitle, elCount(chTestTitle), "Verify_MngCNDD_CanTrcvInitialize_interface_for_CAN_Transceiver_Initialization_for_CANB_CAN8" );
  snprintf( chTestDescription, elCount(chTestDescription), "Purpose:To check the MngCNDD_CanTrcvInitialize interface for CAN8 channel");
  TestCaseAddInfo( chTestTitle, "TC_L30SW_Q-36403650", chTestDescription );

  /***************************************************************************************************************/
                                              // Test Step 0 PRECONDITIONS
  /***************************************************************************************************************/
  snprintf( chActionText, elCount(chActionText), "Flash the Software and ECU is running ");
  snprintf( chExpectedText, elCount(chExpectedText), "ECU should be in running state");
  //TestStepAddActionExpected( chActionText, chExpectedText );
  A_DBGR_BreakpointDeleteAll();
  A_DBGR_BreakpointSet("TestCanTrcv_Init");

  snprintf( chActionText, elCount(chActionText), "Flash the Software and ECU is running ");
  snprintf( chExpectedText, elCount(chExpectedText), "ECU should be in running state");
  //TestStepAddActionExpected( chActionText, chExpectedText );
  A_DBGR_R();
  A_DBGR_Go();
  /***************************************************************************************************************/
                                              // Test Step 1 Call the function MngCNDD_CanTrcvInitialize to initialize the CAN transceiver.
  /***************************************************************************************************************/
  snprintf( chActionText, elCount(chActionText), "Set Breakpoint TestCanTrcv_Init callback function ");
  snprintf( chExpectedText, elCount(chExpectedText), "Breakpoint is Set in TestCanTrcv_Init");
  //TestStepAddActionExpected( chActionText, chExpectedText );
  A_DBGR_Go();

  snprintf( chActionText, elCount(chActionText), "Verify Breakpoint should hit in TestCanTrcv_Init ");
  snprintf( chExpectedText, elCount(chExpectedText), "Breakpoint hit in TestCanTrcv_Init function");
  //TestStepAddActionExpected( chActionText, chExpectedText );
  E_DBGR_BreakpointCheckForHalt("TestCanTrcv_Init");
  /***************************************************************************************************************/
                                              // Test Step 2 Configure the values for the structure TsCNDD_CanTrcvCnfgType for CAN2 Channel.
  /***************************************************************************************************************/
  snprintf( chActionText, elCount(chActionText), "Set Breakpoint in TestCan_Init ");
  snprintf( chExpectedText, elCount(chExpectedText), "Verify Breakpoint is Set in TestCan_Init");
  TestStepAddActionExpected( chActionText, chExpectedText );
  A_DBGR_BreakpointSet("TestCan_Init");
  A_DBGR_Go();

  snprintf( chActionText, elCount(chActionText), "Verify Breakpoint should hit in TestCan_Init ");
  snprintf( chExpectedText, elCount(chExpectedText), "Breakpoint hit in TestCan_Init function");
 // TestStepAddActionExpected( chActionText, chExpectedText );
  E_DBGR_BreakpointCheckForHalt("TestCan_Init");

  snprintf( chActionText, elCount(chActionText), "Configure CanTrcvPnFrameDataMaskIndex variable");
  snprintf( chExpectedText, elCount(chExpectedText), "verify Configure CanTrcvPnFrameDataMaskIndex as 1");
  TestStepAddActionExpected( chActionText, chExpectedText );
  A_DBGR_VariableSet("VsCANR_PnFrameData2[1].CanTrcvPnFrameDataMaskIndex","1");
  E_DBGR_VariableCheck("VsCANR_PnFrameData2[1].CanTrcvPnFrameDataMaskIndex",1,Equal);

  snprintf( chActionText, elCount(chActionText), "Configure CanTrcvPnFrameDataMask variable");
  snprintf( chExpectedText, elCount(chExpectedText), "verify Configure CanTrcvPnFrameDataMask as 1");
  TestStepAddActionExpected( chActionText, chExpectedText );
  A_DBGR_VariableSet("VsCANR_PnFrameData2[1].CanTrcvPnFrameDataMask","1");
  E_DBGR_VariableCheck("VsCANR_PnFrameData2[1].CanTrcvPnFrameDataMask",1,Equal);

  snprintf( chActionText, elCount(chActionText), "Configure CanTrcvPnFrameCanId variable");
  snprintf( chExpectedText, elCount(chExpectedText), "verify Configure CanTrcvPnFrameCanId as 0x456");
  TestStepAddActionExpected( chActionText, chExpectedText );
  A_DBGR_VariableSet("VsCANR_PnConfig[1].CanTrcvPnFrameCanId","0x456");
  E_DBGR_VariableCheck("VsCANR_PnConfig[1].CanTrcvPnFrameCanId",0x456,Equal);

  snprintf( chActionText, elCount(chActionText), "Configure CanTrcvPnFrameCanIdMask variable");
  snprintf( chExpectedText, elCount(chExpectedText), "verify Configure CanTrcvPnFrameCanIdMask as 0");
  TestStepAddActionExpected( chActionText, chExpectedText );
  A_DBGR_VariableSet("VsCANR_PnConfig[1].CanTrcvPnFrameCanIdMask","0");
  E_DBGR_VariableCheck("VsCANR_PnConfig[1].CanTrcvPnFrameCanIdMask",0,Equal);

  snprintf( chActionText, elCount(chActionText), "Configure CanTrcvPnFrameIdType variable");
  snprintf( chExpectedText, elCount(chExpectedText), "verify Configure CanTrcvPnFrameIdType as 0");
  TestStepAddActionExpected( chActionText, chExpectedText );
  A_DBGR_VariableSet("VsCANR_PnConfig[1].CanTrcvPnFrameIdType","0");
  E_DBGR_VariableCheck("VsCANR_PnConfig[1].CanTrcvPnFrameIdType",0,Equal);

  snprintf( chActionText, elCount(chActionText), "Configure CanTrcvPnFrameDlc variable");
  snprintf( chExpectedText, elCount(chExpectedText), "verify Configure CanTrcvPnFrameDlc as 4");
  TestStepAddActionExpected( chActionText, chExpectedText );
  A_DBGR_VariableSet("VsCANR_PnConfig[1].CanTrcvPnFrameDlc","4");
  E_DBGR_VariableCheck("VsCANR_PnConfig[1].CanTrcvPnFrameDlc",4,Equal);

  snprintf( chActionText, elCount(chActionText), "Configure CanTrcvPnEnabled variable");
  snprintf( chExpectedText, elCount(chExpectedText), "verify Configure CanTrcvPnEnabled as 1");
  TestStepAddActionExpected( chActionText, chExpectedText );
  A_DBGR_VariableSet("VsCANR_PnConfig[1].CanTrcvPnEnabled","1");
  E_DBGR_VariableCheck("VsCANR_PnConfig[1].CanTrcvPnEnabled",1,Equal);

  snprintf( chActionText, elCount(chActionText), "Configure CanTrcvChannelId variable");
  snprintf( chExpectedText, elCount(chExpectedText), "verify Configure CanTrcvChannelId as 0");
  TestStepAddActionExpected( chActionText, chExpectedText );
  A_DBGR_VariableSet("VsCANR_TrcvChannels[1].CanTrcvChannelId","1");
  E_DBGR_VariableCheck("VsCANR_TrcvChannels[1].CanTrcvChannelId",1,Equal);

  snprintf( chActionText, elCount(chActionText), "Configure CanTrcvChannelUsed variable");
  snprintf( chExpectedText, elCount(chExpectedText), "verify Configure CanTrcvChannelUsed as 1");
  TestStepAddActionExpected( chActionText, chExpectedText );
  A_DBGR_VariableSet("VsCANR_TrcvChannels[1].CanTrcvChannelUsed","1");
  E_DBGR_VariableCheck("VsCANR_TrcvChannels[1].CanTrcvChannelUsed",1,Equal);

  snprintf( chActionText, elCount(chActionText), "Configure CanTrcvPinWakeupEnabled variable");
  snprintf( chExpectedText, elCount(chExpectedText), "verify Configure CanTrcvPinWakeupEnabled as 0");
  TestStepAddActionExpected( chActionText, chExpectedText );
  A_DBGR_VariableSet("VsCANR_TrcvChannels[1].CanTrcvPinWakeupEnabled","0");
  E_DBGR_VariableCheck("VsCANR_TrcvChannels[1].CanTrcvPinWakeupEnabled",0,Equal);

  snprintf( chActionText, elCount(chActionText), "Configure CanTrcvNumberOfChannels variable");
  snprintf( chExpectedText, elCount(chExpectedText), "verify Configure CanTrcvNumberOfChannels as 2");
  TestStepAddActionExpected( chActionText, chExpectedText );
  A_DBGR_VariableSet("VsCANR_CanTrcvConfig.CanTrcvNumberOfChannels","2");
  E_DBGR_VariableCheck("VsCANR_CanTrcvConfig.CanTrcvNumberOfChannels",2,Equal);

  snprintf( chActionText, elCount(chActionText), "Flash the Software and ECU is running ");
  snprintf( chExpectedText, elCount(chExpectedText), "ECU should be in running state");
  TestStepAddActionExpected( chActionText, chExpectedText );
  A_DBGR_Go();

  /***************************************************************************************************************/
                                              // Test Step 3  Call the function Test_SetHWIO_PowerDown by setting StartPowerDown to 1 then check transceiver is in the SLEEP mode and PMIC to STANDBY mode
  /***************************************************************************************************************/
  snprintf( chActionText, elCount(chActionText), "Configure StartPowerDown variable to invoke Test_SetHWIO_PowerDown interface");
  snprintf( chExpectedText, elCount(chExpectedText), "Verify StartPowerDown is configured as 1");
  //TestStepAddActionExpected( chActionText, chExpectedText );
  A_DBGR_VariableSet("StartPowerDown","1");
 // E_DBGR_VariableCheck("StartPowerDown",1,Equal);

  snprintf( chActionText, elCount(chActionText), "Check Trace32 is stopped");
  snprintf( chExpectedText, elCount(chExpectedText), "Verify Trace32 is stopped");
 // TestStepAddActionExpected( chActionText, chExpectedText );
  E_DBGR_CheckState(T32_State_Down);
  /***************************************************************************************************************/
                                              // Test Step Verify Transceiver is in sleep or not.
  /***************************************************************************************************************/
  snprintf( chActionText, elCount(chActionText), "Transmit CAN message. ID:0x40000101, PDU info:0x01");
  snprintf( chExpectedText, elCount(chExpectedText), "CAN message transmitted. ID:0x40000101, PDU info:0x01");
  TestStepAddActionExpected( chActionText, chExpectedText );

  E_CAN_WaitForMessageByID(0x00000101,15000,cc_eCAN_ABSENT,"CAN1");
  /***************************************************************************************************************/
                                              // Test Step 4  This step involves sending a CAN wakeup frame with ID 0x456 and 4 bytes of data from Canoe.
  /***************************************************************************************************************/
  snprintf( chActionText, elCount(chActionText), "Transmit CAN message. ID:0x123");
  snprintf( chExpectedText, elCount(chExpectedText), "CAN message transmitted. ID:0x123");
  TestStepAddActionExpected( chActionText, chExpectedText );
  A_CAN_SendMessage(0x456, CANB_Wakeup, 4, 2);
  A_CAN_SendMessage(0x456, CANB_Wakeup, 4, 2);

  /***************************************************************************************************************/
                                              // Test Step 5  Verify Transceiver wakeUp or not.
  /***************************************************************************************************************/
  snprintf( chActionText, elCount(chActionText), "Transmit CAN message. ID:0x40000101, PDU info:0x01");
  snprintf( chExpectedText, elCount(chExpectedText), "CAN message transmitted. ID:0x40000101, PDU info:0x01");
  //TestStepAddActionExpected( chActionText, chExpectedText );

  E_CAN_WaitForMessageByID(0x00000102,15000,cc_eCAN_PRESENT,"CAN2");
}

testcase Verify_MngCNDD_CanTrcvMain_interface_Functionality_for_CANB_CAN8()
{
  /***************************************************************************************************************/
                                                // Variable Definition
  /***************************************************************************************************************/



  /***************************************************************************************************************/
                                               // Local Values
  /***************************************************************************************************************/



  /***************************************************************************************************************/
                                              // Test Case Info
  /***************************************************************************************************************/
  setWriteDbgLevel(DebugOff);
  snprintf( chTestTitle, elCount(chTestTitle), "Verify_MngCNDD_CanTrcvMain_interface_Functionality_for_CANB_CAN8" );
  snprintf( chTestDescription, elCount(chTestDescription), "Purpose:To check the interface MngCNDD_CanTrcvMain for CAN8 ");
  TestCaseAddInfo( chTestTitle, "TC_L30SW_Q-36403709", chTestDescription );

  /***************************************************************************************************************/
                                              // Start of Test Case
  /***************************************************************************************************************/

   /***************************************************************************************************************/
                                              // Test Step 0 PRECONDITIONS
  /***************************************************************************************************************/
  snprintf( chActionText, elCount(chActionText), "Flash the Software and ECU is running ");
  snprintf( chExpectedText, elCount(chExpectedText), "ECU should be in running state");
  //TestStepAddActionExpected( chActionText, chExpectedText );
  A_DBGR_BreakpointDeleteAll();
  A_DBGR_BreakpointSet("SetCNDD_e_CanTrcvOpMode");
  snprintf( chActionText, elCount(chActionText), "Flash the Software and ECU is running ");
  snprintf( chExpectedText, elCount(chExpectedText), "ECU should be in running state");
  A_DBGR_R();
  A_DBGR_Go();
  /***************************************************************************************************************/
                                              // Test Step 1 Call SetCNDD_e_CanTrcvOpMode with stop mode to put CAN controller in normal mode.
  /***************************************************************************************************************/
  snprintf( chActionText, elCount(chActionText), "Set Breakpoint in SetCNDD_e_CanTrcvOpMode ");
  snprintf( chExpectedText, elCount(chExpectedText), "verify is Breakpoint Set SetCNDD_e_CanTrcvOpMode");

  A_DBGR_Go();
  A_DBGR_Go();

  snprintf( chActionText, elCount(chActionText), "verify Breakpoint should hit in SetCNDD_e_CanTrcvOpMode ");
  snprintf( chExpectedText, elCount(chExpectedText), "Breakpoint hit in SetCNDD_e_CanTrcvOpMode function");

  E_DBGR_BreakpointCheckForHalt("SetCNDD_e_CanTrcvOpMode");

  snprintf( chActionText, elCount(chActionText), "Configure Transciver mode");
  snprintf( chExpectedText, elCount(chExpectedText), "verify Configure Transciver mode");
  TestStepAddActionExpected( chActionText, chExpectedText );
  A_DBGR_VariableSet("can_trcv_mode","0");
  E_DBGR_VariableCheck("can_trcv_mode",0,Equal);

  snprintf( chActionText, elCount(chActionText), "Delete all Breakpoints");
  snprintf( chExpectedText, elCount(chExpectedText), "verify Delete all Breakpoints");
  TestStepAddActionExpected( chActionText, chExpectedText );
  A_DBGR_BreakpointDeleteAll();
  A_DBGR_BreakpointSet("MngCNDD_CanTrcvMain");

  /***************************************************************************************************************/
                                              // Test Step 2 Call MngCNDD_CanTrcvMain function in a periodic 5ms or 10ms task. This step involves setting up a periodic task to call MngCNDD_CanTrcvMain every 5ms or 10ms.
  /***************************************************************************************************************/
  snprintf( chActionText, elCount(chActionText), "Set Breakpoint in MngCNDD_CanTrcvMain ");
  snprintf( chExpectedText, elCount(chExpectedText), "verify is Breakpoint Set MngCNDD_CanTrcvMain");

  A_DBGR_Go();

  snprintf( chActionText, elCount(chActionText), "verify Breakpoint should hit in MngCNDD_CanTrcvMain ");
  snprintf( chExpectedText, elCount(chExpectedText), "Breakpoint hit in MngCNDD_CanTrcvMain function");

  E_DBGR_BreakpointCheckForHalt("MngCNDD_CanTrcvMain");

   snprintf( chActionText, elCount(chActionText), "Delete all Breakpoints");
  snprintf( chExpectedText, elCount(chExpectedText), "verify Delete all Breakpoints");
  TestStepAddActionExpected( chActionText, chExpectedText );
  A_DBGR_BreakpointDeleteAll();
  A_DBGR_BreakpointSet("SetCANR_e_CanIfTrcvModeIndication");
   /***************************************************************************************************************/
                                              // Test Step 3 Keep a breakpoint in SetCANR_e_CanIfTrcvModeIndication callback function.
  /***************************************************************************************************************/
  snprintf( chActionText, elCount(chActionText), "Set Breakpoint in SetCANR_e_CanIfTrcvModeIndication ");
  snprintf( chExpectedText, elCount(chExpectedText), "verify is Breakpoint Set SetCANR_e_CanIfTrcvModeIndication");
  //TestStepAddActionExpected( chActionText, chExpectedText );

  snprintf( chActionText, elCount(chActionText), "ECU Running ");
  snprintf( chExpectedText, elCount(chExpectedText), " ECU Running");
  A_DBGR_Go();

  snprintf( chActionText, elCount(chActionText), "verify Breakpoint should hit in SetCANR_e_CanIfTrcvModeIndication ");
  snprintf( chExpectedText, elCount(chExpectedText), "Breakpoint hit in SetCANR_e_CanIfTrcvModeIndication function");
  E_DBGR_BreakpointCheckForHalt("SetCANR_e_CanIfTrcvModeIndication");

  E_DBGR_VariableCheck_until("channelid",1,Equal);



  snprintf( chActionText, elCount(chActionText), "Verify TranscMode");
  snprintf( chExpectedText, elCount(chExpectedText), "TranscMode as 0");
  //TestStepAddActionExpected( chActionText, chExpectedText );
  E_DBGR_VariableCheck("Cantrcvmode",0,Equal);

  snprintf( chActionText, elCount(chActionText), "Delete BP's");
  snprintf( chExpectedText, elCount(chExpectedText), " BP's Deleted");
  TestStepAddActionExpected( chActionText, chExpectedText );
  A_DBGR_BreakpointDeleteAll();

  snprintf( chActionText, elCount(chActionText), "ECU Running ");
  snprintf( chExpectedText, elCount(chExpectedText), " ECU Running");
  //TestStepAddActionExpected( chActionText, chExpectedText );
  A_DBGR_Go();

  snprintf( chActionText, elCount(chActionText), "ECU Running ");
  snprintf( chExpectedText, elCount(chExpectedText), " ECU Running");
  E_DBGR_CheckState(T32_State_Running);
}



testcase Verify_MngCNDD_CanTrcvMain_interface_Functionality_for_CANA_CAN2()
{
  /***************************************************************************************************************/
                                                // Variable Definition
  /***************************************************************************************************************/



  /***************************************************************************************************************/
                                               // Local Values
  /***************************************************************************************************************/



  /***************************************************************************************************************/
                                              // Test Case Info
  /***************************************************************************************************************/
  setWriteDbgLevel(DebugOff);
  snprintf( chTestTitle, elCount(chTestTitle), "Verify_MngCNDD_CanTrcvMain_interface_Functionality_for_CANA_CAN2" );
  snprintf( chTestDescription, elCount(chTestDescription), "Purpose:To check the interface MngCNDD_CanTrcvMain for CAN2 ");
  TestCaseAddInfo( chTestTitle, "TC_L30SW_Q-36403670", chTestDescription );

  /***************************************************************************************************************/
                                              // Start of Test Case
  /***************************************************************************************************************/

   /***************************************************************************************************************/
                                              // Test Step 0 PRECONDITIONS
  /***************************************************************************************************************/
  snprintf( chActionText, elCount(chActionText), "Flash the Software and ECU is running ");
  snprintf( chExpectedText, elCount(chExpectedText), "ECU should be in running state");
  TestStepAddActionExpected( chActionText, chExpectedText );
  A_DBGR_BreakpointDeleteAll();
  A_DBGR_BreakpointSet("SetCNDD_e_CanTrcvOpMode");

  snprintf( chActionText, elCount(chActionText), "Flash the Software and ECU is running ");
  snprintf( chExpectedText, elCount(chExpectedText), "ECU should be in running state");
  A_DBGR_R();
  A_DBGR_Go();
  /***************************************************************************************************************/
                                              // Test Step 1 Call SetCNDD_e_CanTrcvOpMode with stop mode to put CAN controller in normal mode.
  /***************************************************************************************************************/
  snprintf( chActionText, elCount(chActionText), "Set Breakpoint in SetCNDD_e_CanTrcvOpMode ");
  snprintf( chExpectedText, elCount(chExpectedText), "verify is Breakpoint Set SetCNDD_e_CanTrcvOpMode");

  A_DBGR_Go();
  //A_DBGR_Go();

  snprintf( chActionText, elCount(chActionText), "verify Breakpoint should hit in SetCNDD_e_CanTrcvOpMode ");
  snprintf( chExpectedText, elCount(chExpectedText), "Breakpoint hit in SetCNDD_e_CanTrcvOpMode function");

  E_DBGR_BreakpointCheckForHalt("SetCNDD_e_CanTrcvOpMode");

  snprintf( chActionText, elCount(chActionText), "Configure Transciver mode");
  snprintf( chExpectedText, elCount(chExpectedText), "verify Configure Transciver mode");
  TestStepAddActionExpected( chActionText, chExpectedText );
  A_DBGR_VariableSet("can_trcv_mode","0");
  E_DBGR_VariableCheck("can_trcv_mode",0,Equal);

  snprintf( chActionText, elCount(chActionText), "Delete all Breakpoints");
  snprintf( chExpectedText, elCount(chExpectedText), "verify Delete all Breakpoints");
  TestStepAddActionExpected( chActionText, chExpectedText );
  A_DBGR_BreakpointDeleteAll();
  A_DBGR_BreakpointSet("MngCNDD_CanTrcvMain");

  /***************************************************************************************************************/
                                              // Test Step 2 Call MngCNDD_CanTrcvMain function in a periodic 5ms or 10ms task. This step involves setting up a periodic task to call MngCNDD_CanTrcvMain every 5ms or 10ms.
  /***************************************************************************************************************/
  snprintf( chActionText, elCount(chActionText), "Set Breakpoint in MngCNDD_CanTrcvMain ");
  snprintf( chExpectedText, elCount(chExpectedText), "verify is Breakpoint Set MngCNDD_CanTrcvMain");

  A_DBGR_Go();

  snprintf( chActionText, elCount(chActionText), "verify Breakpoint should hit in MngCNDD_CanTrcvMain ");
  snprintf( chExpectedText, elCount(chExpectedText), "Breakpoint hit in MngCNDD_CanTrcvMain function");

  E_DBGR_BreakpointCheckForHalt("MngCNDD_CanTrcvMain");

   snprintf( chActionText, elCount(chActionText), "Delete all Breakpoints");
  snprintf( chExpectedText, elCount(chExpectedText), "verify Delete all Breakpoints");
  TestStepAddActionExpected( chActionText, chExpectedText );
  A_DBGR_BreakpointDeleteAll();
  A_DBGR_BreakpointSet("SetCANR_e_CanIfTrcvModeIndication");
   /***************************************************************************************************************/
                                              // Test Step 3 Keep a breakpoint in SetCANR_e_CanIfTrcvModeIndication callback function.
  /***************************************************************************************************************/
  snprintf( chActionText, elCount(chActionText), "Set Breakpoint in SetCANR_e_CanIfTrcvModeIndication ");
  snprintf( chExpectedText, elCount(chExpectedText), "verify is Breakpoint Set SetCANR_e_CanIfTrcvModeIndication");
  //TestStepAddActionExpected( chActionText, chExpectedText );

//  snprintf( chActionText, elCount(chActionText), "ECU Running ");
//  snprintf( chExpectedText, elCount(chExpectedText), " ECU Running");
//  //TestStepAddActionExpected( chActionText, chExpectedText );
//  A_DBGR_Go();

  snprintf( chActionText, elCount(chActionText), "ECU Running ");
  snprintf( chExpectedText, elCount(chExpectedText), " ECU Running");
  //TestStepAddActionExpected( chActionText, chExpectedText );
  A_DBGR_Go();

  snprintf( chActionText, elCount(chActionText), "verify Breakpoint should hit in SetCANR_e_CanIfTrcvModeIndication ");
  snprintf( chExpectedText, elCount(chExpectedText), "Breakpoint hit in SetCANR_e_CanIfTrcvModeIndication function");

  E_DBGR_BreakpointCheckForHalt("SetCANR_e_CanIfTrcvModeIndication");

  snprintf( chActionText, elCount(chActionText), "Verify ChannelId ");
  snprintf( chExpectedText, elCount(chExpectedText), " ChannelId as 0");
  TestStepAddActionExpected( chActionText, chExpectedText );
  E_DBGR_VariableCheck("ChannelId ",0,Equal);
  snprintf( chActionText, elCount(chActionText), "Verify TranscMode");
  snprintf( chExpectedText, elCount(chExpectedText), "TranscMode as 0");
  TestStepAddActionExpected( chActionText, chExpectedText );
  E_DBGR_VariableCheck("Cantrcvmode",0,Equal);

  snprintf( chActionText, elCount(chActionText), "Delete BP's");
  snprintf( chExpectedText, elCount(chExpectedText), " BP's Deleted");
  TestStepAddActionExpected( chActionText, chExpectedText );
  A_DBGR_BreakpointDeleteAll();

  snprintf( chActionText, elCount(chActionText), "ECU Running ");
  snprintf( chExpectedText, elCount(chExpectedText), " ECU Running");
  //TestStepAddActionExpected( chActionText, chExpectedText );
  A_DBGR_Go();

  snprintf( chActionText, elCount(chActionText), "ECU Running ");
  snprintf( chExpectedText, elCount(chExpectedText), " ECU Running");
  E_DBGR_CheckState(T32_State_Running);
}




testcase Verify_the_interface_GetCNDD_Cnt_CanTxBufMax_Maximum_Tx_Buffer_Fill_Level_for_CANA_CAN2()
{
  /***************************************************************************************************************/
                                                // Variable Definition
  /***************************************************************************************************************/



  /***************************************************************************************************************/
                                               // Local Values
  /***************************************************************************************************************/



  /***************************************************************************************************************/
                                              // Test Case Info
  /***************************************************************************************************************/
  setWriteDbgLevel(DebugOff);
  snprintf( chTestTitle, elCount(chTestTitle), "Verify_the_interface_GetCNDD_Cnt_CanTxBufMax_Maximum_Tx_Buffer_Fill_Level_for_CANA_CAN2" );
  snprintf( chTestDescription, elCount(chTestDescription), "Purpose:To check the GetCNDD_Cnt_CanTxBufMax interface CAN2");
  TestCaseAddInfo( chTestTitle, "TC_L30SW_Q-36403630", chTestDescription );

  /***************************************************************************************************************/
                                              // Start of Test Case
  /***************************************************************************************************************/

  /***************************************************************************************************************/
                                              // Test Step 0 PRECONDITIONS
  /***************************************************************************************************************/
  snprintf( chActionText, elCount(chActionText), "Flash the Software and ECU is running ");
  snprintf( chExpectedText, elCount(chExpectedText), "Ecu is should be in running state");
  TestStepAddActionExpected( chActionText, chExpectedText );

  A_DBGR_BreakpointDeleteAll();
  A_DBGR_R();
  A_DBGR_Go();
  A_DBGR_Go();
  /***************************************************************************************************************/
                                              // Test Step 1 Define PDU info and call DsblCNDD_CanInterrupts.
  /***************************************************************************************************************/
  snprintf( chActionText, elCount(chActionText), "Configure disable variable to invoke DsblCNDD_CanInterrupts interface");
  snprintf( chExpectedText, elCount(chExpectedText), "verify Configure disable value as 1");
  //TestStepAddActionExpected( chActionText, chExpectedText );
  A_DBGR_VariableSet("disable","1");
  E_DBGR_VariableCheck("disable",1,Equal);

  /***************************************************************************************************************/
                                              // Test Step 2 Keep a breakpoint in GetCNDD_Cnt_CanTxBufMax.
  /***************************************************************************************************************/
  snprintf( chActionText, elCount(chActionText), "set Breakpoint GetCNDD_Cnt_CanTxBufMax callback function ");
  snprintf( chExpectedText, elCount(chExpectedText), "Breakpoint is Set in GetCNDD_Cnt_CanTxBufMax");
  TestStepAddActionExpected( chActionText, chExpectedText );
  A_DBGR_BreakpointSet("GetCNDD_Cnt_CanTxBufMax");
  E_DBGR_BreakpointCheckForHalt("GetCNDD_Cnt_CanTxBufMax");

  snprintf( chActionText, elCount(chActionText), "Flash the Software and ECU is running ");
  snprintf( chExpectedText, elCount(chExpectedText), "Ecu is should be in running state");
  TestStepAddActionExpected( chActionText, chExpectedText );
  A_DBGR_BreakpointDeleteAll();
  A_DBGR_Go();

   /***************************************************************************************************************/
                                              // Test Step 3 GetCNDD_Cnt_CanTxBufMax should report the maximum number of CAN messages.
  /***************************************************************************************************************/
  snprintf( chActionText, elCount(chActionText), "Read CAN_0_TX_BUFFER_MAX_LEVEL for GetCNDD_Cnt_CanTxBufMax");
  snprintf( chExpectedText, elCount(chExpectedText), "verify CAN_0_TX_BUFFER_MAX_LEVEL for GetCNDD_Cnt_CanTxBufMax");
 // TestStepAddActionExpected( chActionText, chExpectedText );
  E_DBGR_VariableCheck("CAN_0_TX_BUFFER_MAX_LEVEL",0,Greater);
}



testcase Verify_the_interface_GetCNDD_Cnt_CanTxBufMax_Maximum_Tx_Buffer_Fill_Level_for_CANB_CAN8()
{
    /***************************************************************************************************************/
                                                // Variable Definition
  /***************************************************************************************************************/



  /***************************************************************************************************************/
                                               // Local Values
  /***************************************************************************************************************/



  /***************************************************************************************************************/
                                              // Test Case Info
  /***************************************************************************************************************/
  setWriteDbgLevel(DebugOff);
  snprintf( chTestTitle, elCount(chTestTitle), "Verify_the_interface_GetCNDD_Cnt_CanTxBufMax_Maximum_Tx_Buffer_Fill_Level_for_CANB_CAN8" );
  snprintf( chTestDescription, elCount(chTestDescription), "Purpose:To check the GetCNDD_Cnt_CanTxBufMax interface CAN8");
  TestCaseAddInfo( chTestTitle, "TC_L30SW_Q-36403631", chTestDescription );

  /***************************************************************************************************************/
                                              // Start of Test Case
  /***************************************************************************************************************/

  /***************************************************************************************************************/
                                              // Test Step 0 PRECONDITIONS
  /***************************************************************************************************************/
  snprintf( chActionText, elCount(chActionText), "Flash the Software and ECU is running ");
  snprintf( chExpectedText, elCount(chExpectedText), "Ecu is should be in running state");
  TestStepAddActionExpected( chActionText, chExpectedText );

  A_DBGR_BreakpointDeleteAll();
  A_DBGR_R();
  A_DBGR_Go();
  A_DBGR_Go();
  /***************************************************************************************************************/
                                              // Test Step 1 Define PDU info and call DsblCNDD_CanInterrupts.
  /***************************************************************************************************************/
  snprintf( chActionText, elCount(chActionText), "Configure disable variable to invoke DsblCNDD_CanInterrupts interface");
  snprintf( chExpectedText, elCount(chExpectedText), "verify Configure disable value as 1");
  //TestStepAddActionExpected( chActionText, chExpectedText );
  A_DBGR_VariableSet("disable","1");
  E_DBGR_VariableCheck("disable",1,Equal);

  /***************************************************************************************************************/
                                              // Test Step 2 Keep a breakpoint in GetCNDD_Cnt_CanTxBufMax.
  /***************************************************************************************************************/
  snprintf( chActionText, elCount(chActionText), "set Breakpoint GetCNDD_Cnt_CanTxBufMax callback function ");
  snprintf( chExpectedText, elCount(chExpectedText), "Breakpoint is Set in GetCNDD_Cnt_CanTxBufMax");
  TestStepAddActionExpected( chActionText, chExpectedText );
  A_DBGR_BreakpointSet("GetCNDD_Cnt_CanTxBufMax");
  E_DBGR_BreakpointCheckForHalt("GetCNDD_Cnt_CanTxBufMax");

  snprintf( chActionText, elCount(chActionText), "Flash the Software and ECU is running ");
  snprintf( chExpectedText, elCount(chExpectedText), "Ecu is should be in running state");
  TestStepAddActionExpected( chActionText, chExpectedText );
  A_DBGR_BreakpointDeleteAll();
  A_DBGR_Go();

   /***************************************************************************************************************/
                                              // Test Step 3 GetCNDD_Cnt_CanTxBufMax should report the maximum number of CAN messages.
  /***************************************************************************************************************/
  snprintf( chActionText, elCount(chActionText), "Msg should not in trace ");
  snprintf( chExpectedText, elCount(chExpectedText), "Msg should not in trace");
  E_CAN_WaitForMessageByID(0x00000100,25000,cc_eCAN_ABSENT,"CAN1");

//  snprintf( chActionText, elCount(chActionText), "waiting for TX Buf");
//  snprintf( chExpectedText, elCount(chExpectedText), "waiting for TX Buf");
//  A_GENERIC_SetTimeout(25000,"waiting for TX Buf ");

  snprintf( chActionText, elCount(chActionText), "Read CAN_1_TX_BUFFER_MAX_LEVEL for GetCNDD_Cnt_CanTxBufMax");
  snprintf( chExpectedText, elCount(chExpectedText), "verify CAN_1_TX_BUFFER_MAX_LEVEL for GetCNDD_Cnt_CanTxBufMax");
  TestStepAddActionExpected( chActionText, chExpectedText );
  E_DBGR_VariableCheck("CAN_1_TX_BUFFER_MAX_LEVEL",0,Greater);
}







testcase Verify_the_interface_GetCNDD_Cnt_CanRxBufMax_Maximum_RX_Buffer_Fill_Level_for_CANA_CAN2()
{
  /***************************************************************************************************************/
                                                // Variable Definition
  /***************************************************************************************************************/



  /***************************************************************************************************************/
                                               // Local Values
  /***************************************************************************************************************/



  /***************************************************************************************************************/
                                              // Test Case Info
  /***************************************************************************************************************/
  setWriteDbgLevel(DebugOff);
  snprintf( chTestTitle, elCount(chTestTitle), "Verify_the_interface_GetCNDD_Cnt_CanRxBufMax_Maximum_RX_Buffer_Fill_Level_for_CANA_CAN2" );
  snprintf( chTestDescription, elCount(chTestDescription), "Purpose:To check the interface GetCNDD_Cnt_CanRxBufMax CAN2 RX  ");
  TestCaseAddInfo( chTestTitle, "TC_L30SW_Q-36403621", chTestDescription );

  /***************************************************************************************************************/
                                              // Start of Test Case
  /***************************************************************************************************************/

  /***************************************************************************************************************/
                                              // Test Step 0 PRECONDITIONS
  /***************************************************************************************************************/
   snprintf( chActionText, elCount(chActionText), "Flash the Software and ECU is running ");
  snprintf( chExpectedText, elCount(chExpectedText), "Ecu is should be in running state");
  TestStepAddActionExpected( chActionText, chExpectedText );

  A_DBGR_BreakpointDeleteAll();
  A_DBGR_R();
  A_DBGR_Go();
  A_DBGR_Go();
  /***************************************************************************************************************/
             // Test Step 1 Disable MngCNDD_CanMainRead function.
  /***************************************************************************************************************/
  snprintf( chActionText, elCount(chActionText), "Configure RX_BUF = 1 values ");
  snprintf( chExpectedText, elCount(chExpectedText), "verify Configure RX_BUF = 1 values");
  //TestStepAddActionExpected( chActionText, chExpectedText );
  A_DBGR_VariableSet("RX_BUF","1");

  /***************************************************************************************************************/
              // Test Step 2 Transmite message  using canoe.
  /***************************************************************************************************************/
  snprintf( chActionText, elCount(chActionText), "Transmit CAN message. ID:0x00000401,PDU info:0x01");
  snprintf( chExpectedText, elCount(chExpectedText), "CAN message transmitted. ID:0x00000401,PDU info:0x01");
  A_CAN_SendMessage(0x00000401, dat_tcno, 1, 1);

  snprintf( chActionText, elCount(chActionText), "verify CAN_0_RX_BUFFER_MAX_LEVEL");
  snprintf( chExpectedText, elCount(chExpectedText), "CAN_0_RX_BUFFER_MAX_LEVEL");
  //TestStepAddActionExpected( chActionText, chExpectedText );

  A_DBGR_VariableSet("CAN_0_RX_BUFFER_MAX_LEVEL","0");
  E_DBGR_VariableCheck("CAN_0_RX_BUFFER_MAX_LEVEL",1,Equal);

}



testcase Verify_the_interface_GetCNDD_Cnt_CanRxBufMax_Maximum_RX_Buffer_Fill_Level_for_CANB_CAN8()
{
  /***************************************************************************************************************/
                                                // Variable Definition
  /***************************************************************************************************************/



  /***************************************************************************************************************/
                                               // Local Values
  /***************************************************************************************************************/



  /***************************************************************************************************************/
                                              // Test Case Info
  /***************************************************************************************************************/
  setWriteDbgLevel(DebugOff);
  snprintf( chTestTitle, elCount(chTestTitle), "Verify_the_interface_GetCNDD_Cnt_CanRxBufMax_Maximum_RX_Buffer_Fill_Level_for_CANB_CAN8" );
  snprintf( chTestDescription, elCount(chTestDescription), "Purpose:To check the interface GetCNDD_Cnt_CanRxBufMax CAN8 RX  ");
  TestCaseAddInfo( chTestTitle, "TC_L30SW_Q-36403622", chTestDescription );

  /***************************************************************************************************************/
                                              // Start of Test Case
  /***************************************************************************************************************/

  /***************************************************************************************************************/
                                              // Test Step 0 PRECONDITIONS
  /***************************************************************************************************************/
  snprintf( chActionText, elCount(chActionText), "Flash the Software and ECU is running ");
  snprintf( chExpectedText, elCount(chExpectedText), "Ecu is should be in running state");
  TestStepAddActionExpected( chActionText, chExpectedText );
  A_DBGR_BreakpointDeleteAll();
  A_DBGR_BreakpointSet("TestCan_Init");

  A_DBGR_R();
  A_DBGR_Go();
  /***************************************************************************************************************/
                                              // Test Step 1 Configure the values for the structure TsCNDD_CanCnfgType for CANB.
  /***************************************************************************************************************/

  snprintf( chActionText, elCount(chActionText), "Set Breakpoint in TestCan_Init ");
  snprintf( chExpectedText, elCount(chExpectedText), "verify is Breakpoint Set TestCan_Init");
  //TestStepAddActionExpected( chActionText, chExpectedText );
  A_DBGR_Go();

  snprintf( chActionText, elCount(chActionText), "verify Breakpoint should hit in TestCan_Init ");
  snprintf( chExpectedText, elCount(chExpectedText), "Breakpoint hit in TestCan_Init function");

  E_DBGR_BreakpointCheckForHalt("TestCan_Init");

  snprintf( chActionText, elCount(chActionText), "Configure CanId values ");
  snprintf( chExpectedText, elCount(chExpectedText), "verify Configure CanId values");
  TestStepAddActionExpected( chActionText, chExpectedText );
  A_DBGR_VariableSet("VaCANR_CanRxMsgs[0].CanId","0x456");
  E_DBGR_VariableCheck("VaCANR_CanRxMsgs[0].CanId",0x456,Equal);

  snprintf( chActionText, elCount(chActionText), "Configure CanFilterMask values ");
  snprintf( chExpectedText, elCount(chExpectedText), "verify Configure CanFilterMask values");
  TestStepAddActionExpected( chActionText, chExpectedText );
  A_DBGR_VariableSet("VaCANR_CanRxMsgs[0].CanFilterMask","2047");
  E_DBGR_VariableCheck("VaCANR_CanRxMsgs[0].CanFilterMask",2047,Equal);

   snprintf( chActionText, elCount(chActionText), "Configure CanRxMessageIdx values ");
  snprintf( chExpectedText, elCount(chExpectedText), "verify Configure CanRxMessageIdx values");
  TestStepAddActionExpected( chActionText, chExpectedText );
  A_DBGR_VariableSet("VaCANR_CanRxMsgs[0].CanRxMessageIdx","0");
  E_DBGR_VariableCheck("VaCANR_CanRxMsgs[0].CanRxMessageIdx",0,Equal);

   snprintf( chActionText, elCount(chActionText), "Configure CanMessageLen values ");
  snprintf( chExpectedText, elCount(chExpectedText), "verify Configure CanMessageLen values");
  TestStepAddActionExpected( chActionText, chExpectedText );
  A_DBGR_VariableSet("VaCANR_CanRxMsgs[0].CanMessageLen","1");
  E_DBGR_VariableCheck("VaCANR_CanRxMsgs[0].CanMessageLen",1,Equal);

   snprintf( chActionText, elCount(chActionText), "Configure CanIdType values ");
  snprintf( chExpectedText, elCount(chExpectedText), "verify Configure CanIdType values");
  TestStepAddActionExpected( chActionText, chExpectedText );
  A_DBGR_VariableSet("VaCANR_CanRxMsgs[0].CanIdType","2");
  E_DBGR_VariableCheck("VaCANR_CanRxMsgs[0].CanIdType",2,Equal);

  snprintf( chActionText, elCount(chActionText), "Configure CanControllerId values ");
  snprintf( chExpectedText, elCount(chExpectedText), "verify Configure CanControllerId values");
  TestStepAddActionExpected( chActionText, chExpectedText );
  A_DBGR_VariableSet("VaCANR_CanRxMsgs[0].CanControllerId","1");
  E_DBGR_VariableCheck("VaCANR_CanRxMsgs[0].CanControllerId",1,Equal);

  snprintf( chActionText, elCount(chActionText), "Flash the Software and ECU is running ");
  snprintf( chExpectedText, elCount(chExpectedText), "Ecu is should be in running state");
  TestStepAddActionExpected( chActionText, chExpectedText );
  A_DBGR_Go();

  /***************************************************************************************************************/
             // Test Step 1 Disable MngCNDD_CanMainRead function.
  /***************************************************************************************************************/
  snprintf( chActionText, elCount(chActionText), "Configure RX_BUF = 1 values ");
  snprintf( chExpectedText, elCount(chExpectedText), "verify Configure RX_BUF = 1 values");
  //TestStepAddActionExpected( chActionText, chExpectedText );
  A_DBGR_VariableSet("RX_BUF","1");

  /***************************************************************************************************************/
              // Test Step 2 Transmite message  using canoe.
  /***************************************************************************************************************/
  snprintf( chActionText, elCount(chActionText), "Transmit CAN message. ID:0x00000456,PDU info:0x01");
  snprintf( chExpectedText, elCount(chExpectedText), "CAN message transmitted. ID:0x00000456,PDU info:0x01");
  //TestStepAddActionExpected( chActionText, chExpectedText );
  A_CAN_SendMessage(0x00000456, dat_tcno, 1, 2);

  snprintf( chActionText, elCount(chActionText), "verify CAN_1_RX_BUFFER_MAX_LEVEL");
  snprintf( chExpectedText, elCount(chExpectedText), "CAN_1_RX_BUFFER_MAX_LEVEL");
  //TestStepAddActionExpected( chActionText, chExpectedText );

  A_DBGR_VariableSet("CAN_1_RX_BUFFER_MAX_LEVEL","0");
  E_DBGR_VariableCheck("CAN_1_RX_BUFFER_MAX_LEVEL",1,Equal);

}



testcase Verify_the_interface_GetCNDD_Cnt_CanRxBufMax_by_initializing_3_msgs_and_verify_RX_Buffer_Fill_Level_for_CANB_CAN8()
{
  /***************************************************************************************************************/
                                                // Variable Definition
  /***************************************************************************************************************/



  /***************************************************************************************************************/
                                               // Local Values
  /***************************************************************************************************************/



  /***************************************************************************************************************/
                                              // Test Case Info
  /***************************************************************************************************************/
  setWriteDbgLevel(DebugOff);
  snprintf( chTestTitle, elCount(chTestTitle), "Verify_the_interface_GetCNDD_Cnt_CanRxBufMax_by_initializing_3_msgs_and_verify_RX_Buffer_Fill_Level_for_CANB_CAN8" );
  snprintf( chTestDescription, elCount(chTestDescription), "Purpose:To check the interface GetCNDD_Cnt_CanRxBufMax CAN8 RX  ");
  TestCaseAddInfo( chTestTitle, "TC_L30SW_Q-36403623", chTestDescription );

  /***************************************************************************************************************/
                                              // Start of Test Case
  /***************************************************************************************************************/

  /***************************************************************************************************************/
                                              // Test Step 0 PRECONDITIONS
  /***************************************************************************************************************/
   snprintf( chActionText, elCount(chActionText), "Flash the Software and ECU is running ");
  snprintf( chExpectedText, elCount(chExpectedText), "Ecu is should be in running state");
  TestStepAddActionExpected( chActionText, chExpectedText );

  A_DBGR_BreakpointDeleteAll();
  A_DBGR_R();
  A_DBGR_Go();
  A_DBGR_Go();
  /***************************************************************************************************************/
             // Test Step 1 Disable MngCNDD_CanMainRead function.
  /***************************************************************************************************************/
  snprintf( chActionText, elCount(chActionText), "Configure RX_BUF = 1 values ");
  snprintf( chExpectedText, elCount(chExpectedText), "verify Configure RX_BUF = 1 values");
  //TestStepAddActionExpected( chActionText, chExpectedText );
  A_DBGR_VariableSet("RX_BUF","1");

  /***************************************************************************************************************/
              // Test Step 2 Transmite message  using canoe.
  /***************************************************************************************************************/
  snprintf( chActionText, elCount(chActionText), "Transmit CAN message. ID:0x400002D8,PDU info:0x01");
  snprintf( chExpectedText, elCount(chExpectedText), "CAN message transmitted. ID:0x400002D8,PDU info:0x01");
  A_CAN_SendMessage(0x000002D8, dat_64byte, 8, 2);

  snprintf( chActionText, elCount(chActionText), "Transmit CAN message. ID:0x400002D8,PDU info:0x01");
  snprintf( chExpectedText, elCount(chExpectedText), "CAN message transmitted. ID:0x400002D8,PDU info:0x01");
  A_CAN_SendMessage(0x000002D8, dat_64byte, 8, 2);

  snprintf( chActionText, elCount(chActionText), "Transmit CAN message. ID:0x400002D8,PDU info:0x01");
  snprintf( chExpectedText, elCount(chExpectedText), "CAN message transmitted. ID:0x400002D8,PDU info:0x01");
  A_CAN_SendMessage(0x000002D8, dat_64byte, 8, 2);

  snprintf( chActionText, elCount(chActionText), "verify CAN_1_RX_BUFFER_MAX_LEVEL");
  snprintf( chExpectedText, elCount(chExpectedText), "CAN_1_RX_BUFFER_MAX_LEVEL");
  //TestStepAddActionExpected( chActionText, chExpectedText );

  A_DBGR_VariableSet("CAN_1_RX_BUFFER_MAX_LEVEL","0");
  E_DBGR_VariableCheck("CAN_1_RX_BUFFER_MAX_LEVEL",3,Equal);

}



testcase Verify_the_interface_GetCNDD_Cnt_CanRxBufMax_by_initializing_3_msgs_and_verify_RX_Buffer_Fill_Level_for_CANA_CAN2()
{
  /***************************************************************************************************************/
                                                // Variable Definition
  /***************************************************************************************************************/



  /***************************************************************************************************************/
                                               // Local Values
  /***************************************************************************************************************/



  /***************************************************************************************************************/
                                              // Test Case Info
  /***************************************************************************************************************/
  setWriteDbgLevel(DebugOff);
  snprintf( chTestTitle, elCount(chTestTitle), "Verify_the_interface_GetCNDD_Cnt_CanRxBufMax_by_initializing_3_msgs_and_verify_RX_Buffer_Fill_Level_for_CANA_CAN2" );
  snprintf( chTestDescription, elCount(chTestDescription), "Purpose:To check the interface GetCNDD_Cnt_CanRxBufMax CAN2 RX  ");
  TestCaseAddInfo( chTestTitle, "TC_L30SW_Q-36403628", chTestDescription );

  /***************************************************************************************************************/
                                              // Start of Test Case
  /***************************************************************************************************************/

  /***************************************************************************************************************/
                                              // Test Step 0 PRECONDITIONS
  /***************************************************************************************************************/
   snprintf( chActionText, elCount(chActionText), "Flash the Software and ECU is running ");
  snprintf( chExpectedText, elCount(chExpectedText), "Ecu is should be in running state");
  TestStepAddActionExpected( chActionText, chExpectedText );

  A_DBGR_BreakpointDeleteAll();
  A_DBGR_R();
  A_DBGR_Go();
  A_DBGR_Go();
  /***************************************************************************************************************/
             // Test Step 1 Disable MngCNDD_CanMainRead function.
  /***************************************************************************************************************/
  snprintf( chActionText, elCount(chActionText), "Configure RX_BUF = 1 values ");
  snprintf( chExpectedText, elCount(chExpectedText), "verify Configure RX_BUF = 1 values");
  //TestStepAddActionExpected( chActionText, chExpectedText );
  A_DBGR_VariableSet("RX_BUF","1");

  /***************************************************************************************************************/
              // Test Step 2 Transmite message  using canoe.
  /***************************************************************************************************************/
  snprintf( chActionText, elCount(chActionText), "Transmit CAN message. ID:0x40000140,PDU info:0x01");
  snprintf( chExpectedText, elCount(chExpectedText), "CAN message transmitted. ID:0x40000140,PDU info:0x01");
  A_CAN_SendMessage(0x00000140, dat_64byte, 8, 1,cc_eCAN_FD);

  snprintf( chActionText, elCount(chActionText), "Transmit CAN message. ID:0x40000140,PDU info:0x01");
  snprintf( chExpectedText, elCount(chExpectedText), "CAN message transmitted. ID:0x40000140,PDU info:0x01");
  A_CAN_SendMessage(0x00000140, dat_64byte, 8, 1,cc_eCAN_FD);

  snprintf( chActionText, elCount(chActionText), "Transmit CAN message. ID:0x40000140,PDU info:0x01");
  snprintf( chExpectedText, elCount(chExpectedText), "CAN message transmitted. ID:0x40000140,PDU info:0x01");
  A_CAN_SendMessage(0x00000140, dat_64byte, 8, 1,cc_eCAN_FD);

  snprintf( chActionText, elCount(chActionText), "verify CAN_0_RX_BUFFER_MAX_LEVEL");
  snprintf( chExpectedText, elCount(chExpectedText), "CAN_0_RX_BUFFER_MAX_LEVEL");
  //TestStepAddActionExpected( chActionText, chExpectedText );

  A_DBGR_VariableSet("CAN_0_RX_BUFFER_MAX_LEVEL","0");
  E_DBGR_VariableCheck("CAN_0_RX_BUFFER_MAX_LEVEL",3,Equal);

}



testcase Verify_the_interface_GetCNDD_Cnt_CanRxBufMax_by_initializing_64_OPEN_mask_for_SID_and_verify_RX_Buffer_Fill_Level_for_CANA_CAN2()
{
  /***************************************************************************************************************/
                                                // Variable Definition
  /***************************************************************************************************************/



  /***************************************************************************************************************/
                                               // Local Values
  /***************************************************************************************************************/



  /***************************************************************************************************************/
                                              // Test Case Info
  /***************************************************************************************************************/
  setWriteDbgLevel(DebugOff);
  snprintf( chTestTitle, elCount(chTestTitle), "Verify_the_interface_GetCNDD_Cnt_CanRxBufMax_by_initializing_64_OPEN_mask_for_SID_and_verify_RX_Buffer_Fill_Level_for_CANA_CAN2" );
  snprintf( chTestDescription, elCount(chTestDescription), "Purpose:To check the interface GetCNDD_Cnt_CanRxBufMax CAN2 RX  ");
  TestCaseAddInfo( chTestTitle, "TC_L30SW_Q-36403625", chTestDescription );

  /***************************************************************************************************************/
                                              // Start of Test Case
  /***************************************************************************************************************/

  /***************************************************************************************************************/
                                              // Test Step 0 PRECONDITIONS
  /***************************************************************************************************************/
   snprintf( chActionText, elCount(chActionText), "Flash the Software and ECU is running ");
  snprintf( chExpectedText, elCount(chExpectedText), "Ecu is should be in running state");
  TestStepAddActionExpected( chActionText, chExpectedText );

  A_DBGR_BreakpointDeleteAll();
  A_DBGR_R();
  A_DBGR_Go();
  A_DBGR_Go();
  /***************************************************************************************************************/
             // Test Step 1 Disable MngCNDD_CanMainRead function.
  /***************************************************************************************************************/
  snprintf( chActionText, elCount(chActionText), "Configure RX_BUF = 1 values ");
  snprintf( chExpectedText, elCount(chExpectedText), "verify Configure RX_BUF = 1 values");
  //TestStepAddActionExpected( chActionText, chExpectedText );
  A_DBGR_VariableSet("RX_BUF","1");

  /***************************************************************************************************************/
              // Test Step 2 Transmite message  using canoe.
  /***************************************************************************************************************/

  for ( i = 0; i < 64; i++) {
    // Prepare the action and expected text for logging or validation
    snprintf(chActionText, elCount(chActionText), "Transmit CAN message. ID:0x40000140");
    snprintf(chExpectedText, elCount(chExpectedText), "CAN message transmitted. ID:0x40000140");

    // Send the CAN message
    A_CAN_SendMessage(0x00000140, dat_64byte, 8, 1,cc_eCAN_FD);
  }

  A_DBGR_VariableSet("CAN_0_RX_BUFFER_MAX_LEVEL","0");
  E_DBGR_VariableCheck("CAN_0_RX_BUFFER_MAX_LEVEL",64,Equal);

}



testcase Verify_the_interface_GetCNDD_Cnt_CanRxBufMax_by_initializing_64_OPEN_mask_for_EID_and_verify_RX_Buffer_Fill_Level_for_CANA_CAN2()
{
  /***************************************************************************************************************/
                                                // Variable Definition
  /***************************************************************************************************************/



  /***************************************************************************************************************/
                                               // Local Values
  /***************************************************************************************************************/



  /***************************************************************************************************************/
                                              // Test Case Info
  /***************************************************************************************************************/
  setWriteDbgLevel(DebugOff);
  snprintf( chTestTitle, elCount(chTestTitle), "Verify_the_interface_GetCNDD_Cnt_CanRxBufMax_by_initializing_64_OPEN_mask_for_EID_and_verify_RX_Buffer_Fill_Level_for_CANA_CAN2" );
  snprintf( chTestDescription, elCount(chTestDescription), "Purpose:To check the interface GetCNDD_Cnt_CanRxBufMax CAN2 RX  ");
  TestCaseAddInfo( chTestTitle, "TC_L30SW_Q-36403626", chTestDescription );

  /***************************************************************************************************************/
                                              // Start of Test Case
  /***************************************************************************************************************/

  /***************************************************************************************************************/
                                              // Test Step 0 PRECONDITIONS
  /***************************************************************************************************************/
  snprintf( chActionText, elCount(chActionText), "Flash the Software and ECU is running ");
  snprintf( chExpectedText, elCount(chExpectedText), "Ecu is should be in running state");
  TestStepAddActionExpected( chActionText, chExpectedText );
  A_DBGR_BreakpointDeleteAll();
  A_DBGR_BreakpointSet("TestCan_Init");

  A_DBGR_R();
  A_DBGR_Go();
  /***************************************************************************************************************/
                                              // Test Step 1 Configure the values for the structure TsCNDD_CanCnfgType for CANB.
  /***************************************************************************************************************/

  snprintf( chActionText, elCount(chActionText), "Set Breakpoint in TestCan_Init ");
  snprintf( chExpectedText, elCount(chExpectedText), "verify is Breakpoint Set TestCan_Init");
  //TestStepAddActionExpected( chActionText, chExpectedText );
  A_DBGR_Go();

  snprintf( chActionText, elCount(chActionText), "verify Breakpoint should hit in TestCan_Init ");
  snprintf( chExpectedText, elCount(chExpectedText), "Breakpoint hit in TestCan_Init function");
  //TestStepAddActionExpected( chActionText, chExpectedText );
  E_DBGR_BreakpointCheckForHalt("TestCan_Init");


  snprintf( chActionText, elCount(chActionText), "Configure CanId values ");
  snprintf( chExpectedText, elCount(chExpectedText), "verify Configure CanId values");
  TestStepAddActionExpected( chActionText, chExpectedText );
  //TestStepAddActionExpected( chActionText, chExpectedText );
  A_DBGR_VariableSet("VaCANR_CanRxMsgs[0].CanId","0x00008000");
  E_DBGR_VariableCheck("VaCANR_CanRxMsgs[1].CanId",0x301,Equal);

  snprintf( chActionText, elCount(chActionText), "Configure CanFilterMask values ");
  snprintf( chExpectedText, elCount(chExpectedText), "verify Configure CanFilterMask values");
  TestStepAddActionExpected( chActionText, chExpectedText );
  A_DBGR_VariableSet("VaCANR_CanRxMsgs[0].CanFilterMask","0x1FFFF000");
  E_DBGR_VariableCheck("VaCANR_CanRxMsgs[0].CanFilterMask",0x1FFFF000,Equal);

   snprintf( chActionText, elCount(chActionText), "Configure CanRxMessageIdx values ");
  snprintf( chExpectedText, elCount(chExpectedText), "verify Configure CanRxMessageIdx values");
  TestStepAddActionExpected( chActionText, chExpectedText );
  A_DBGR_VariableSet("VaCANR_CanRxMsgs[0].CanRxMessageIdx","0");
  E_DBGR_VariableCheck("VaCANR_CanRxMsgs[0].CanRxMessageIdx",0,Equal);

   snprintf( chActionText, elCount(chActionText), "Configure CanMessageLen values ");
  snprintf( chExpectedText, elCount(chExpectedText), "verify Configure CanMessageLen values");
  TestStepAddActionExpected( chActionText, chExpectedText );
  A_DBGR_VariableSet("VaCANR_CanRxMsgs[0].CanMessageLen","1");
  E_DBGR_VariableCheck("VaCANR_CanRxMsgs[0].CanMessageLen",1,Equal);

   snprintf( chActionText, elCount(chActionText), "Configure CanIdType values ");
  snprintf( chExpectedText, elCount(chExpectedText), "verify Configure CanIdType values");
  TestStepAddActionExpected( chActionText, chExpectedText );
  A_DBGR_VariableSet("VaCANR_CanRxMsgs[0].CanIdType","0");
  E_DBGR_VariableCheck("VaCANR_CanRxMsgs[0].CanIdType",0,Equal);

  snprintf( chActionText, elCount(chActionText), "Configure CanControllerId values ");
  snprintf( chExpectedText, elCount(chExpectedText), "verify Configure CanControllerId values");
  TestStepAddActionExpected( chActionText, chExpectedText );
  A_DBGR_VariableSet("VaCANR_CanRxMsgs[0].CanControllerId","0");
  E_DBGR_VariableCheck("VaCANR_CanRxMsgs[0].CanControllerId",0,Equal);

  snprintf( chActionText, elCount(chActionText), "Flash the Software and ECU is running ");
  snprintf( chExpectedText, elCount(chExpectedText), "Ecu is should be in running state");
  TestStepAddActionExpected( chActionText, chExpectedText );
  A_DBGR_Go();

  /***************************************************************************************************************/
             // Test Step 1 Disable MngCNDD_CanMainRead function.
  /***************************************************************************************************************/
  snprintf( chActionText, elCount(chActionText), "Configure RX_BUF = 1 values ");
  snprintf( chExpectedText, elCount(chExpectedText), "verify Configure RX_BUF = 1 values");
  //TestStepAddActionExpected( chActionText, chExpectedText );
  A_DBGR_VariableSet("RX_BUF","1");

  /***************************************************************************************************************/
              // Test Step 2 Transmite message  using canoe.
  /***************************************************************************************************************/

  for ( i = 0; i < 64; i++) {
    // Prepare the action and expected text for logging or validation
    snprintf(chActionText, elCount(chActionText), "Transmit CAN message. ID:0x80007000");
    snprintf(chExpectedText, elCount(chExpectedText), "CAN message transmitted. ID:0x80007000");

    // Send the CAN message
    A_CAN_SendMessage(0x8000x, dat_64byte, 1, 1);
  }

  A_DBGR_VariableSet("CAN_0_RX_BUFFER_MAX_LEVEL","0");
  E_DBGR_VariableCheck("CAN_0_RX_BUFFER_MAX_LEVEL",64,Equal);

}



testcase Verify_the_interface_GetCNDD_Cnt_CanRxBufMax_by_initializing_64_OPEN_mask_for_SID_and_verify_RX_Buffer_Fill_Level_for_CANB_CAN8()
{
  /***************************************************************************************************************/
                                                // Variable Definition
  /***************************************************************************************************************/



  /***************************************************************************************************************/
                                               // Local Values
  /***************************************************************************************************************/



  /***************************************************************************************************************/
                                              // Test Case Info
  /***************************************************************************************************************/
  setWriteDbgLevel(DebugOff);
  snprintf( chTestTitle, elCount(chTestTitle), "Verify_the_interface_GetCNDD_Cnt_CanRxBufMax_by_initializing_64_OPEN_mask_for_SID_and_verify_RX_Buffer_Fill_Level_for_CANB_CAN8" );
  snprintf( chTestDescription, elCount(chTestDescription), "Purpose:To check the interface GetCNDD_Cnt_CanRxBufMax CAN8 RX  ");
  TestCaseAddInfo( chTestTitle, "TC_L30SW_Q-36403705", chTestDescription );

  /***************************************************************************************************************/
                                              // Start of Test Case
  /***************************************************************************************************************/

  /***************************************************************************************************************/
                                              // Test Step 0 PRECONDITIONS
  /***************************************************************************************************************/
   snprintf( chActionText, elCount(chActionText), "Flash the Software and ECU is running ");
  snprintf( chExpectedText, elCount(chExpectedText), "Ecu is should be in running state");
  TestStepAddActionExpected( chActionText, chExpectedText );

  A_DBGR_BreakpointDeleteAll();
  A_DBGR_R();
  A_DBGR_Go();
  A_DBGR_Go();
  /***************************************************************************************************************/
             // Test Step 1 Disable MngCNDD_CanMainRead function.
  /***************************************************************************************************************/
  snprintf( chActionText, elCount(chActionText), "Configure RX_BUF = 1 values ");
  snprintf( chExpectedText, elCount(chExpectedText), "verify Configure RX_BUF = 1 values");
  //TestStepAddActionExpected( chActionText, chExpectedText );
  A_DBGR_VariableSet("RX_BUF","1");

  /***************************************************************************************************************/
              // Test Step 2 Transmite message  using canoe.
  /***************************************************************************************************************/

  for ( i = 0; i < 64; i++) {
    // Prepare the action and expected text for logging or validation
    snprintf(chActionText, elCount(chActionText), "Transmit CAN message. ID:0x40000140");
    snprintf(chExpectedText, elCount(chExpectedText), "CAN message transmitted. ID:0x40000140");

    // Send the CAN message
    A_CAN_SendMessage(0x00000140, dat_64byte, 8, 2);
  }

  A_DBGR_VariableSet("CAN_1_RX_BUFFER_MAX_LEVEL","0");
  E_DBGR_VariableCheck("CAN_1_RX_BUFFER_MAX_LEVEL",64,Equal);

}



testcase Verify_the_interface_GetCNDD_Cnt_CanRxBufMax_by_initializing_64_OPEN_mask_for_EID_and_verify_RX_Buffer_Fill_Level_for_CANB_CAN8()
{
  /***************************************************************************************************************/
                                                // Variable Definition
  /***************************************************************************************************************/



  /***************************************************************************************************************/
                                               // Local Values
  /***************************************************************************************************************/



  /***************************************************************************************************************/
                                              // Test Case Info
  /***************************************************************************************************************/
  setWriteDbgLevel(DebugOff);
  snprintf( chTestTitle, elCount(chTestTitle), "Verify_the_interface_GetCNDD_Cnt_CanRxBufMax_by_initializing_64_OPEN_mask_for_EID_and_verify_RX_Buffer_Fill_Level_for_CANB_CAN8" );
  snprintf( chTestDescription, elCount(chTestDescription), "Purpose:To check the interface GetCNDD_Cnt_CanRxBufMax CAN8 RX  ");
  TestCaseAddInfo( chTestTitle, "TC_L30SW_Q-36403706", chTestDescription );

  /***************************************************************************************************************/
                                              // Start of Test Case
  /***************************************************************************************************************/

  /***************************************************************************************************************/
                                              // Test Step 0 PRECONDITIONS
  /***************************************************************************************************************/
  snprintf( chActionText, elCount(chActionText), "Flash the Software and ECU is running ");
  snprintf( chExpectedText, elCount(chExpectedText), "Ecu is should be in running state");
  TestStepAddActionExpected( chActionText, chExpectedText );
  A_DBGR_BreakpointDeleteAll();
  A_DBGR_BreakpointSet("TestCan_Init");

  A_DBGR_R();
  A_DBGR_Go();
  /***************************************************************************************************************/
                                              // Test Step 1 Configure the values for the structure TsCNDD_CanCnfgType for CANB.
  /***************************************************************************************************************/

  snprintf( chActionText, elCount(chActionText), "Set Breakpoint in TestCan_Init ");
  snprintf( chExpectedText, elCount(chExpectedText), "verify is Breakpoint Set TestCan_Init");
  //TestStepAddActionExpected( chActionText, chExpectedText );
  A_DBGR_Go();

  snprintf( chActionText, elCount(chActionText), "verify Breakpoint should hit in TestCan_Init ");
  snprintf( chExpectedText, elCount(chExpectedText), "Breakpoint hit in TestCan_Init function");
  //TestStepAddActionExpected( chActionText, chExpectedText );
  E_DBGR_BreakpointCheckForHalt("TestCan_Init");


  snprintf( chActionText, elCount(chActionText), "Configure CanId values ");
  snprintf( chExpectedText, elCount(chExpectedText), "verify Configure CanId values");
  TestStepAddActionExpected( chActionText, chExpectedText );
  //TestStepAddActionExpected( chActionText, chExpectedText );
  A_DBGR_VariableSet("VaCANR_CanRxMsgs[0].CanId","0x00008000");
  E_DBGR_VariableCheck("VaCANR_CanRxMsgs[1].CanId",0x301,Equal);

  snprintf( chActionText, elCount(chActionText), "Configure CanFilterMask values ");
  snprintf( chExpectedText, elCount(chExpectedText), "verify Configure CanFilterMask values");
  TestStepAddActionExpected( chActionText, chExpectedText );
  A_DBGR_VariableSet("VaCANR_CanRxMsgs[0].CanFilterMask","0x1FFFF000");
  E_DBGR_VariableCheck("VaCANR_CanRxMsgs[0].CanFilterMask",0x1FFFF000,Equal);

   snprintf( chActionText, elCount(chActionText), "Configure CanRxMessageIdx values ");
  snprintf( chExpectedText, elCount(chExpectedText), "verify Configure CanRxMessageIdx values");
  TestStepAddActionExpected( chActionText, chExpectedText );
  A_DBGR_VariableSet("VaCANR_CanRxMsgs[0].CanRxMessageIdx","0");
  E_DBGR_VariableCheck("VaCANR_CanRxMsgs[0].CanRxMessageIdx",0,Equal);

   snprintf( chActionText, elCount(chActionText), "Configure CanMessageLen values ");
  snprintf( chExpectedText, elCount(chExpectedText), "verify Configure CanMessageLen values");
  TestStepAddActionExpected( chActionText, chExpectedText );
  A_DBGR_VariableSet("VaCANR_CanRxMsgs[0].CanMessageLen","1");
  E_DBGR_VariableCheck("VaCANR_CanRxMsgs[0].CanMessageLen",1,Equal);

   snprintf( chActionText, elCount(chActionText), "Configure CanIdType values ");
  snprintf( chExpectedText, elCount(chExpectedText), "verify Configure CanIdType values");
  TestStepAddActionExpected( chActionText, chExpectedText );
  A_DBGR_VariableSet("VaCANR_CanRxMsgs[0].CanIdType","0");
  E_DBGR_VariableCheck("VaCANR_CanRxMsgs[0].CanIdType",0,Equal);

  snprintf( chActionText, elCount(chActionText), "Configure CanControllerId values ");
  snprintf( chExpectedText, elCount(chExpectedText), "verify Configure CanControllerId values");
  TestStepAddActionExpected( chActionText, chExpectedText );
  A_DBGR_VariableSet("VaCANR_CanRxMsgs[0].CanControllerId","1");
  E_DBGR_VariableCheck("VaCANR_CanRxMsgs[0].CanControllerId",1,Equal);

  snprintf( chActionText, elCount(chActionText), "Flash the Software and ECU is running ");
  snprintf( chExpectedText, elCount(chExpectedText), "Ecu is should be in running state");
  TestStepAddActionExpected( chActionText, chExpectedText );
  A_DBGR_Go();

  /***************************************************************************************************************/
             // Test Step 1 Disable MngCNDD_CanMainRead function.
  /***************************************************************************************************************/
  snprintf( chActionText, elCount(chActionText), "Configure RX_BUF = 1 values ");
  snprintf( chExpectedText, elCount(chExpectedText), "verify Configure RX_BUF = 1 values");
  //TestStepAddActionExpected( chActionText, chExpectedText );
  A_DBGR_VariableSet("RX_BUF","1");

  /***************************************************************************************************************/
              // Test Step 2 Transmite message  using canoe.
  /***************************************************************************************************************/

  for ( i = 0; i < 64; i++) {
    // Prepare the action and expected text for logging or validation
    snprintf(chActionText, elCount(chActionText), "Transmit CAN message. ID:0x80007000");
    snprintf(chExpectedText, elCount(chExpectedText), "CAN message transmitted. ID:0x80007000");

    // Send the CAN message
    A_CAN_SendMessage(0x8000x, dat_64byte, 1, 2);
  }

  A_DBGR_VariableSet("CAN_1_RX_BUFFER_MAX_LEVEL","0");
  E_DBGR_VariableCheck("CAN_1_RX_BUFFER_MAX_LEVEL",64,Equal);

}



testcase Verify_the_interface_GetCNDD_Cnt_CanRxBufMax_by_initializing_64_msgs_and_verify_RX_Buffer_Fill_Level_for_CANB_CAN8()
{
  /***************************************************************************************************************/
                                                // Variable Definition
  /***************************************************************************************************************/



  /***************************************************************************************************************/
                                               // Local Values
  /***************************************************************************************************************/



  /***************************************************************************************************************/
                                              // Test Case Info
  /***************************************************************************************************************/
  setWriteDbgLevel(DebugOff);
  snprintf( chTestTitle, elCount(chTestTitle), "Verify_the_interface_GetCNDD_Cnt_CanRxBufMax_by_initializing_64_msgs_and_verify_RX_Buffer_Fill_Level_for_CANB_CAN8" );
  snprintf( chTestDescription, elCount(chTestDescription), "Purpose:To check the interface GetCNDD_Cnt_CanRxBufMax CAN8 RX  ");
  TestCaseAddInfo( chTestTitle, "TC_L30SW_Q-36403629", chTestDescription );

  /***************************************************************************************************************/
                                              // Start of Test Case
  /***************************************************************************************************************/

  /***************************************************************************************************************/
                                              // Test Step 0 PRECONDITIONS
  /***************************************************************************************************************/
  snprintf( chActionText, elCount(chActionText), "Flash the Software and ECU is running ");
  snprintf( chExpectedText, elCount(chExpectedText), "Ecu is should be in running state");
  TestStepAddActionExpected( chActionText, chExpectedText );
  A_DBGR_BreakpointDeleteAll();
  A_DBGR_BreakpointSet("TestCan_Init");

  A_DBGR_R();
  A_DBGR_Go();
  /***************************************************************************************************************/
                                              // Test Step 1 Configure the values for the structure TsCNDD_CanCnfgType for CANB.
  /***************************************************************************************************************/

  snprintf( chActionText, elCount(chActionText), "Set Breakpoint in TestCan_Init ");
  snprintf( chExpectedText, elCount(chExpectedText), "verify is Breakpoint Set TestCan_Init");
  //TestStepAddActionExpected( chActionText, chExpectedText );
  A_DBGR_Go();

  snprintf( chActionText, elCount(chActionText), "verify Breakpoint should hit in TestCan_Init ");
  snprintf( chExpectedText, elCount(chExpectedText), "Breakpoint hit in TestCan_Init function");
  //TestStepAddActionExpected( chActionText, chExpectedText );
  E_DBGR_BreakpointCheckForHalt("TestCan_Init");


  snprintf( chActionText, elCount(chActionText), "Configure CanId values ");
  snprintf( chExpectedText, elCount(chExpectedText), "verify Configure CanId values");
  TestStepAddActionExpected( chActionText, chExpectedText );
  //TestStepAddActionExpected( chActionText, chExpectedText );
  A_DBGR_VariableSet("VaCANR_CanRxMsgs[0].CanId","0x00008000");
  E_DBGR_VariableCheck("VaCANR_CanRxMsgs[1].CanId",0x301,Equal);

  snprintf( chActionText, elCount(chActionText), "Configure CanFilterMask values ");
  snprintf( chExpectedText, elCount(chExpectedText), "verify Configure CanFilterMask values");
  TestStepAddActionExpected( chActionText, chExpectedText );
  A_DBGR_VariableSet("VaCANR_CanRxMsgs[0].CanFilterMask","0x1FFFF000");
  E_DBGR_VariableCheck("VaCANR_CanRxMsgs[0].CanFilterMask",0x1FFFF000,Equal);

   snprintf( chActionText, elCount(chActionText), "Configure CanRxMessageIdx values ");
  snprintf( chExpectedText, elCount(chExpectedText), "verify Configure CanRxMessageIdx values");
  TestStepAddActionExpected( chActionText, chExpectedText );
  A_DBGR_VariableSet("VaCANR_CanRxMsgs[0].CanRxMessageIdx","0");
  E_DBGR_VariableCheck("VaCANR_CanRxMsgs[0].CanRxMessageIdx",0,Equal);

   snprintf( chActionText, elCount(chActionText), "Configure CanMessageLen values ");
  snprintf( chExpectedText, elCount(chExpectedText), "verify Configure CanMessageLen values");
  TestStepAddActionExpected( chActionText, chExpectedText );
  A_DBGR_VariableSet("VaCANR_CanRxMsgs[0].CanMessageLen","1");
  E_DBGR_VariableCheck("VaCANR_CanRxMsgs[0].CanMessageLen",1,Equal);

   snprintf( chActionText, elCount(chActionText), "Configure CanIdType values ");
  snprintf( chExpectedText, elCount(chExpectedText), "verify Configure CanIdType values");
  TestStepAddActionExpected( chActionText, chExpectedText );
  A_DBGR_VariableSet("VaCANR_CanRxMsgs[0].CanIdType","0");
  E_DBGR_VariableCheck("VaCANR_CanRxMsgs[0].CanIdType",0,Equal);

  snprintf( chActionText, elCount(chActionText), "Configure CanControllerId values ");
  snprintf( chExpectedText, elCount(chExpectedText), "verify Configure CanControllerId values");
  TestStepAddActionExpected( chActionText, chExpectedText );
  A_DBGR_VariableSet("VaCANR_CanRxMsgs[0].CanControllerId","1");
  E_DBGR_VariableCheck("VaCANR_CanRxMsgs[0].CanControllerId",1,Equal);

  snprintf( chActionText, elCount(chActionText), "Flash the Software and ECU is running ");
  snprintf( chExpectedText, elCount(chExpectedText), "Ecu is should be in running state");
  TestStepAddActionExpected( chActionText, chExpectedText );
  A_DBGR_Go();

  /***************************************************************************************************************/
             // Test Step 1 Disable MngCNDD_CanMainRead function.
  /***************************************************************************************************************/
  snprintf( chActionText, elCount(chActionText), "Configure RX_BUF = 1 values ");
  snprintf( chExpectedText, elCount(chExpectedText), "verify Configure RX_BUF = 1 values");
  //TestStepAddActionExpected( chActionText, chExpectedText );
  A_DBGR_VariableSet("RX_BUF","1");

  /***************************************************************************************************************/
              // Test Step 2 Transmite message  using canoe.
  /***************************************************************************************************************/

  for ( i = 0; i < 64; i++) {
    // Prepare the action and expected text for logging or validation
    snprintf(chActionText, elCount(chActionText), "Transmit CAN message. ID:0x80007000");
    snprintf(chExpectedText, elCount(chExpectedText), "CAN message transmitted. ID:0x80007000");

    // Send the CAN message
    A_CAN_SendMessage(0x8000x, dat_64byte, 1, 2);
  }

  A_DBGR_VariableSet("CAN_1_RX_BUFFER_MAX_LEVEL","0");
  E_DBGR_VariableCheck("CAN_1_RX_BUFFER_MAX_LEVEL",64,Equal);

}



testcase Verify_the_interface_GetCNDD_Cnt_CanRxBufMax_by_initializing_64_FULL_CAN_and_verify_RX_Buffer_Fill_Level_for_CANA_CAN2()
{
  /***************************************************************************************************************/
                                                // Variable Definition
  /***************************************************************************************************************/



  /***************************************************************************************************************/
                                               // Local Values
  /***************************************************************************************************************/



  /***************************************************************************************************************/
                                              // Test Case Info
  /***************************************************************************************************************/
  setWriteDbgLevel(DebugOff);
  snprintf( chTestTitle, elCount(chTestTitle), "Verify_the_interface_GetCNDD_Cnt_CanRxBufMax_by_initializing_64_FULL_CAN_and_verify_RX_Buffer_Fill_Level_for_CANA_CAN2" );
  snprintf( chTestDescription, elCount(chTestDescription), "Purpose:To check the interface GetCNDD_Cnt_CanRxBufMax CAN2 RX  ");
  TestCaseAddInfo( chTestTitle, "TC_L30SW_Q-36403624", chTestDescription );

  /***************************************************************************************************************/
                                              // Start of Test Case
  /***************************************************************************************************************/

  /***************************************************************************************************************/
                                              // Test Step 0 PRECONDITIONS
  /***************************************************************************************************************/
   snprintf( chActionText, elCount(chActionText), "Flash the Software and ECU is running ");
  snprintf( chExpectedText, elCount(chExpectedText), "Ecu is should be in running state");
  TestStepAddActionExpected( chActionText, chExpectedText );

  A_DBGR_BreakpointDeleteAll();
  A_DBGR_BreakpointSet("TestCan_Init");
  A_DBGR_R();
  A_DBGR_Go();
    /***************************************************************************************************************/
             // Test Step 1 Configure RX msgs
  /***************************************************************************************************************/
  snprintf( chActionText, elCount(chActionText), "Set Breakpoint in TestCan_Init ");
  snprintf( chExpectedText, elCount(chExpectedText), "verify is Breakpoint Set TestCan_Init");

  A_DBGR_Go();

  snprintf( chActionText, elCount(chActionText), "verify Breakpoint should hit in TestCan_Init ");
  snprintf( chExpectedText, elCount(chExpectedText), "Breakpoint hit in TestCan_Init function");

  E_DBGR_BreakpointCheckForHalt("TestCan_Init");

  for ( i = 0; i < 64; i++) {

    snprintf(chActionText, elCount(chActionText), "Configure CanControllerId values for all messages %d",i);
    snprintf(chExpectedText, elCount(chExpectedText), "Verify Configure CanControllerId values for all messages");
    TestStepAddActionExpected(chActionText, chExpectedText);
    // Construct the variable name dynamically
    snprintf(variableName, elCount(variableName), "VaCANR_CanRxMsgs[%d].CanControllerId", i);

    // Set CanControllerId to 0 for the current message
    A_DBGR_VariableSet(variableName, "0");

    // Verify that CanControllerId has been set to 0 for the current message
    E_DBGR_VariableCheck(variableName, 0, Equal);
  }

  snprintf( chActionText, elCount(chActionText), "Flash the Software and ECU is running ");
  snprintf( chExpectedText, elCount(chExpectedText), "Ecu is should be in running state");
  TestStepAddActionExpected( chActionText, chExpectedText );
  A_DBGR_Go();

  /***************************************************************************************************************/
             // Test Step 2 Disable MngCNDD_CanMainRead function.
  /***************************************************************************************************************/
  snprintf( chActionText, elCount(chActionText), "Configure RX_BUF = 1 values ");
  snprintf( chExpectedText, elCount(chExpectedText), "verify Configure RX_BUF = 1 values");
  //TestStepAddActionExpected( chActionText, chExpectedText );
  A_DBGR_VariableSet("RX_BUF","1");

  /***************************************************************************************************************/
              // Test Step 2 Transmite message  using canoe.
  /***************************************************************************************************************/
  for ( i = 0; i < 64; i++) {
    // Prepare the action and expected text for logging or validation
    snprintf(chActionText, elCount(chActionText), "Transmit CAN message. ID:0x80007000");
    snprintf(chExpectedText, elCount(chExpectedText), "CAN message transmitted. ID[%d]: 0x%08X", i, CANID[i]);

    // Send the CAN message
    A_CAN_SendMessage(CANID[i], dat_64byte, 8, 1,cc_eCAN_FD);
  }
  snprintf( chActionText, elCount(chActionText), "verify CAN_0_RX_BUFFER_MAX_LEVEL");
  snprintf( chExpectedText, elCount(chExpectedText), "CAN_0_RX_BUFFER_MAX_LEVEL");
  //TestStepAddActionExpected( chActionText, chExpectedText );

  A_DBGR_VariableSet("CAN_0_RX_BUFFER_MAX_LEVEL","0");
  E_DBGR_VariableCheck("CAN_0_RX_BUFFER_MAX_LEVEL",64,Equal);

}



testcase Verify_the_interface_GetCNDD_Cnt_CanRxBufMax_by_initializing_192_msgs_for_64_FUL_SID_64_OPEN_SID_64_EID_RX_Buffer_for_CANA_CAN2()
{
  /***************************************************************************************************************/
                                                // Variable Definition
  /***************************************************************************************************************/



  /***************************************************************************************************************/
                                               // Local Values
  /***************************************************************************************************************/



  /***************************************************************************************************************/
                                              // Test Case Info
  /***************************************************************************************************************/
  setWriteDbgLevel(DebugOff);
  snprintf( chTestTitle, elCount(chTestTitle), "Verify_the_interface_GetCNDD_Cnt_CanRxBufMax_by_initializing_192_msgs_for_64_FUL_SID_64_OPEN_SID_64_EID_RX_Buffer_for_CANA_CAN2" );
  snprintf( chTestDescription, elCount(chTestDescription), "Purpose:To check the interface GetCNDD_Cnt_CanRxBufMax CAN2 RX  ");
  TestCaseAddInfo( chTestTitle, "TC_L30SW_Q-36403627", chTestDescription );

  /***************************************************************************************************************/
                                              // Start of Test Case
  /***************************************************************************************************************/

  /***************************************************************************************************************/
                                              // Test Step 0 PRECONDITIONS
  /***************************************************************************************************************/
   snprintf( chActionText, elCount(chActionText), "Flash the Software and ECU is running ");
  snprintf( chExpectedText, elCount(chExpectedText), "Ecu is should be in running state");
  TestStepAddActionExpected( chActionText, chExpectedText );

  A_DBGR_BreakpointDeleteAll();
  A_DBGR_BreakpointSet("TestCan_Init");
  A_DBGR_R();
  A_DBGR_Go();
    /***************************************************************************************************************/
             // Test Step 1 Configure RX msgs
  /***************************************************************************************************************/
  snprintf( chActionText, elCount(chActionText), "Set Breakpoint in TestCan_Init ");
  snprintf( chExpectedText, elCount(chExpectedText), "verify is Breakpoint Set TestCan_Init");

  A_DBGR_Go();

  snprintf( chActionText, elCount(chActionText), "verify Breakpoint should hit in TestCan_Init ");
  snprintf( chExpectedText, elCount(chExpectedText), "Breakpoint hit in TestCan_Init function");

  E_DBGR_BreakpointCheckForHalt("TestCan_Init");

  for ( i = 0; i < 64; i++) {

    snprintf(chActionText, elCount(chActionText), "Configure CanControllerId values for all messages %d",i);
    snprintf(chExpectedText, elCount(chExpectedText), "Verify Configure CanControllerId values for all messages");
    TestStepAddActionExpected(chActionText, chExpectedText);
    // Construct the variable name dynamically
    snprintf(variableName, elCount(variableName), "VaCANR_CanRxMsgs[%d].CanControllerId", i);

    // Set CanControllerId to 0 for the current message
    A_DBGR_VariableSet(variableName, "0");

    // Verify that CanControllerId has been set to 0 for the current message
    E_DBGR_VariableCheck(variableName, 0, Equal);
  }

  snprintf( chActionText, elCount(chActionText), "Configure CanId values ");
  snprintf( chExpectedText, elCount(chExpectedText), "verify Configure CanId values");
  TestStepAddActionExpected( chActionText, chExpectedText );
  //TestStepAddActionExpected( chActionText, chExpectedText );
  A_DBGR_VariableSet("VaCANR_CanRxMsgs[64].CanId","0x00008000");
  E_DBGR_VariableCheck("VaCANR_CanRxMsgs[1].CanId",0x301,Equal);

  snprintf( chActionText, elCount(chActionText), "Configure CanFilterMask values ");
  snprintf( chExpectedText, elCount(chExpectedText), "verify Configure CanFilterMask values");
  TestStepAddActionExpected( chActionText, chExpectedText );
  A_DBGR_VariableSet("VaCANR_CanRxMsgs[64].CanFilterMask","0x1FFFF000");
  E_DBGR_VariableCheck("VaCANR_CanRxMsgs[64].CanFilterMask",0x1FFFF000,Equal);

  snprintf( chActionText, elCount(chActionText), "Configure CanRxMessageIdx values ");
  snprintf( chExpectedText, elCount(chExpectedText), "verify Configure CanRxMessageIdx values");
  TestStepAddActionExpected( chActionText, chExpectedText );
  A_DBGR_VariableSet("VaCANR_CanRxMsgs[64].CanRxMessageIdx","0");
  E_DBGR_VariableCheck("VaCANR_CanRxMsgs[64].CanRxMessageIdx",0,Equal);

  snprintf( chActionText, elCount(chActionText), "Configure CanMessageLen values ");
  snprintf( chExpectedText, elCount(chExpectedText), "verify Configure CanMessageLen values");
  TestStepAddActionExpected( chActionText, chExpectedText );
  A_DBGR_VariableSet("VaCANR_CanRxMsgs[64].CanMessageLen","1");
  E_DBGR_VariableCheck("VaCANR_CanRxMsgs[64].CanMessageLen",1,Equal);

  snprintf( chActionText, elCount(chActionText), "Configure CanIdType values ");
  snprintf( chExpectedText, elCount(chExpectedText), "verify Configure CanIdType values");
  TestStepAddActionExpected( chActionText, chExpectedText );
  A_DBGR_VariableSet("VaCANR_CanRxMsgs[64].CanIdType","0");
  E_DBGR_VariableCheck("VaCANR_CanRxMsgs[64].CanIdType",0,Equal);

  snprintf( chActionText, elCount(chActionText), "Configure CanControllerId values ");
  snprintf( chExpectedText, elCount(chExpectedText), "verify Configure CanControllerId values");
  TestStepAddActionExpected( chActionText, chExpectedText );
  A_DBGR_VariableSet("VaCANR_CanRxMsgs[64].CanControllerId","0");
  E_DBGR_VariableCheck("VaCANR_CanRxMsgs[64].CanControllerId",0,Equal);

  snprintf( chActionText, elCount(chActionText), "Flash the Software and ECU is running ");
  snprintf( chExpectedText, elCount(chExpectedText), "Ecu is should be in running state");
  TestStepAddActionExpected( chActionText, chExpectedText );
  A_DBGR_Go();

  /***************************************************************************************************************/
             // Test Step 2 Disable MngCNDD_CanMainRead function.
  /***************************************************************************************************************/
  snprintf( chActionText, elCount(chActionText), "Configure RX_BUF = 1 values ");
  snprintf( chExpectedText, elCount(chExpectedText), "verify Configure RX_BUF = 1 values");
  //TestStepAddActionExpected( chActionText, chExpectedText );
  A_DBGR_VariableSet("RX_BUF","1");

  /***************************************************************************************************************/
              // Test Step 2 Transmite message  using canoe.
  /***************************************************************************************************************/
  for ( i = 0; i < 64; i++) {
    // Prepare the action and expected text for logging or validation
    snprintf(chActionText, elCount(chActionText), "Transmit CAN message. ID:0x80007000");
    snprintf(chExpectedText, elCount(chExpectedText), "CAN message transmitted. ID[%d]: 0x%08X", i, CANID[i]);

    // Send the CAN message
    A_CAN_SendMessage(CANID[i], dat_64byte, 8, 1,cc_eCAN_FD);
  }

  for ( i = 0; i < 64; i++) {
    // Prepare the action and expected text for logging or validation
    snprintf(chActionText, elCount(chActionText), "Transmit CAN message. ID:0x40000140");
    snprintf(chExpectedText, elCount(chExpectedText), "CAN message transmitted. ID:0x40000140");

    // Send the CAN message
    A_CAN_SendMessage(0x00000140, dat_64byte, 8, 1,cc_eCAN_FD);
  }

  for ( i = 0; i < 64; i++) {
    // Prepare the action and expected text for logging or validation
    snprintf(chActionText, elCount(chActionText), "Transmit CAN message. ID:0x80007000");
    snprintf(chExpectedText, elCount(chExpectedText), "CAN message transmitted. ID:0x80007000");

    // Send the CAN message
    A_CAN_SendMessage(0x8000x, dat_64byte, 1, 1);
  }
  snprintf( chActionText, elCount(chActionText), "verify CAN_0_RX_BUFFER_MAX_LEVEL");
  snprintf( chExpectedText, elCount(chExpectedText), "CAN_0_RX_BUFFER_MAX_LEVEL");
  //TestStepAddActionExpected( chActionText, chExpectedText );

  A_DBGR_VariableSet("CAN_0_RX_BUFFER_MAX_LEVEL","0");
  E_DBGR_VariableCheck("CAN_0_RX_BUFFER_MAX_LEVEL",192,Equal);

}



testcase Verify_the_interface_GetCNDD_Cnt_CanRxBufMax_by_initializing_64_FULL_CAN_and_verify_RX_Buffer_Fill_Level_for_CANB_CAN8()
{
  /***************************************************************************************************************/
                                                // Variable Definition
  /***************************************************************************************************************/



  /***************************************************************************************************************/
                                               // Local Values
  /***************************************************************************************************************/



  /***************************************************************************************************************/
                                              // Test Case Info
  /***************************************************************************************************************/
  setWriteDbgLevel(DebugOff);
  snprintf( chTestTitle, elCount(chTestTitle), "Verify_the_interface_GetCNDD_Cnt_CanRxBufMax_by_initializing_64_FULL_CAN_and_verify_RX_Buffer_Fill_Level_for_CANB_CAN8" );
  snprintf( chTestDescription, elCount(chTestDescription), "Purpose:To check the interface GetCNDD_Cnt_CanRxBufMax CAN8 RX  ");
  TestCaseAddInfo( chTestTitle, "TC_L30SW_Q-36403704", chTestDescription );

  /***************************************************************************************************************/
                                              // Start of Test Case
  /***************************************************************************************************************/

  /***************************************************************************************************************/
                                              // Test Step 0 PRECONDITIONS
  /***************************************************************************************************************/
   snprintf( chActionText, elCount(chActionText), "Flash the Software and ECU is running ");
  snprintf( chExpectedText, elCount(chExpectedText), "Ecu is should be in running state");
  TestStepAddActionExpected( chActionText, chExpectedText );

  A_DBGR_BreakpointDeleteAll();
  A_DBGR_BreakpointSet("TestCan_Init");
  A_DBGR_R();
  A_DBGR_Go();
    /***************************************************************************************************************/
             // Test Step 1 Configure RX msgs
  /***************************************************************************************************************/
  snprintf( chActionText, elCount(chActionText), "Set Breakpoint in TestCan_Init ");
  snprintf( chExpectedText, elCount(chExpectedText), "verify is Breakpoint Set TestCan_Init");

  A_DBGR_Go();

  snprintf( chActionText, elCount(chActionText), "verify Breakpoint should hit in TestCan_Init ");
  snprintf( chExpectedText, elCount(chExpectedText), "Breakpoint hit in TestCan_Init function");

  E_DBGR_BreakpointCheckForHalt("TestCan_Init");
  for ( i = 0; i < 3; i++) {

    snprintf(chActionText, elCount(chActionText), "Configure CanId values for all messages %d",i);
    snprintf(chExpectedText, elCount(chExpectedText), "Verify Configure CanId values for all messages");
    TestStepAddActionExpected(chActionText, chExpectedText);
       // Construct the variable name dynamically
    snprintf(variableName, elCount(variableName), "VaCANR_CanRxMsgs[%d].CanId", i);

    // Convert the CANID_B value to a string
    snprintf(canIdValue, elCount(canIdValue), "0x%08X", CANID_B[i]);

    // Set CanId for the current message
    A_DBGR_VariableSet(variableName, canIdValue); // Verify that CanId has been set to 0 for the current message
    E_DBGR_VariableCheck(variableName, CANID_B[i], Equal);
  }
  i =0;

  for ( i = 0; i < 64; i++) {

    snprintf(chActionText, elCount(chActionText), "Configure CanControllerId values for all messages %d",i);
    snprintf(chExpectedText, elCount(chExpectedText), "Verify Configure CanControllerId values for all messages");
    TestStepAddActionExpected(chActionText, chExpectedText);
    // Construct the variable name dynamically
    snprintf(variableName, elCount(variableName), "VaCANR_CanRxMsgs[%d].CanControllerId", i);

    // Set CanControllerId to 0 for the current message
    A_DBGR_VariableSet(variableName, "1");

    // Verify that CanControllerId has been set to 0 for the current message
    E_DBGR_VariableCheck(variableName, 1, Equal);
  }

  snprintf( chActionText, elCount(chActionText), "Flash the Software and ECU is running ");
  snprintf( chExpectedText, elCount(chExpectedText), "Ecu is should be in running state");
  TestStepAddActionExpected( chActionText, chExpectedText );
  A_DBGR_Go();

  /***************************************************************************************************************/
             // Test Step 2 Disable MngCNDD_CanMainRead function.
  /***************************************************************************************************************/
  snprintf( chActionText, elCount(chActionText), "Configure RX_BUF = 1 values ");
  snprintf( chExpectedText, elCount(chExpectedText), "verify Configure RX_BUF = 1 values");
  //TestStepAddActionExpected( chActionText, chExpectedText );
  A_DBGR_VariableSet("RX_BUF","1");

  /***************************************************************************************************************/
              // Test Step 2 Transmite message  using canoe.
  /***************************************************************************************************************/
  for ( i = 0; i < 64; i++) {
    // Prepare the action and expected text for logging or validation
    snprintf(chActionText, elCount(chActionText), "Transmit CAN message. ID:0x80007000");
    snprintf(chExpectedText, elCount(chExpectedText), "CAN message transmitted. ID[%d]: 0x%08X", i, CANID[i]);
    // Send the CAN message
    A_CAN_SendMessage(CANID[i], dat_64byte, 8, 2);

  }
  snprintf( chActionText, elCount(chActionText), "verify CAN_1_RX_BUFFER_MAX_LEVEL");
  snprintf( chExpectedText, elCount(chExpectedText), "CAN_1_RX_BUFFER_MAX_LEVEL");
  //TestStepAddActionExpected( chActionText, chExpectedText );

  A_DBGR_VariableSet("CAN_1_RX_BUFFER_MAX_LEVEL","0");
  E_DBGR_VariableCheck("CAN_1_RX_BUFFER_MAX_LEVEL",64,Equal);

}



testcase Verify_the_interface_GetCNDD_Cnt_CanRxBufMax_by_initializing_192_msgs_for_64_FUL_SID_64_OPEN_SID_64_EID_RX_Buffer_for_CANB_CAN8()
{
  /***************************************************************************************************************/
                                                // Variable Definition
  /***************************************************************************************************************/



  /***************************************************************************************************************/
                                               // Local Values
  /***************************************************************************************************************/



  /***************************************************************************************************************/
                                              // Test Case Info
  /***************************************************************************************************************/
  setWriteDbgLevel(DebugOff);
  snprintf( chTestTitle, elCount(chTestTitle), "Verify_the_interface_GetCNDD_Cnt_CanRxBufMax_by_initializing_64_FULL_CAN_and_verify_RX_Buffer_Fill_Level_for_CANB_CAN8" );
  snprintf( chTestDescription, elCount(chTestDescription), "Purpose:To check the interface GetCNDD_Cnt_CanRxBufMax CAN8 RX  ");
  TestCaseAddInfo( chTestTitle, "TC_L30SW_Q-36403704", chTestDescription );

  /***************************************************************************************************************/
                                              // Start of Test Case
  /***************************************************************************************************************/

  /***************************************************************************************************************/
                                              // Test Step 0 PRECONDITIONS
  /***************************************************************************************************************/
   snprintf( chActionText, elCount(chActionText), "Flash the Software and ECU is running ");
  snprintf( chExpectedText, elCount(chExpectedText), "Ecu is should be in running state");
  TestStepAddActionExpected( chActionText, chExpectedText );

  A_DBGR_BreakpointDeleteAll();
  A_DBGR_BreakpointSet("TestCan_Init");
  A_DBGR_R();
  A_DBGR_Go();
    /***************************************************************************************************************/
             // Test Step 1 Configure RX msgs
  /***************************************************************************************************************/
  snprintf( chActionText, elCount(chActionText), "Set Breakpoint in TestCan_Init ");
  snprintf( chExpectedText, elCount(chExpectedText), "verify is Breakpoint Set TestCan_Init");

  A_DBGR_Go();

  snprintf( chActionText, elCount(chActionText), "verify Breakpoint should hit in TestCan_Init ");
  snprintf( chExpectedText, elCount(chExpectedText), "Breakpoint hit in TestCan_Init function");

  E_DBGR_BreakpointCheckForHalt("TestCan_Init");
  for ( i = 0; i < 3; i++) {

    snprintf(chActionText, elCount(chActionText), "Configure CanId values for all messages %d",i);
    snprintf(chExpectedText, elCount(chExpectedText), "Verify Configure CanId values for all messages");
    TestStepAddActionExpected(chActionText, chExpectedText);
       // Construct the variable name dynamically
    snprintf(variableName, elCount(variableName), "VaCANR_CanRxMsgs[%d].CanId", i);

    // Convert the CANID_B value to a string
    snprintf(canIdValue, elCount(canIdValue), "0x%08X", CANID_B[i]);

    // Set CanId for the current message
    A_DBGR_VariableSet(variableName, canIdValue); // Verify that CanId has been set to 0 for the current message
    E_DBGR_VariableCheck(variableName, CANID_B[i], Equal);
  }
  i =0;

  for ( i = 0; i < 64; i++) {

    snprintf(chActionText, elCount(chActionText), "Configure CanControllerId values for all messages %d",i);
    snprintf(chExpectedText, elCount(chExpectedText), "Verify Configure CanControllerId values for all messages");
    TestStepAddActionExpected(chActionText, chExpectedText);
    // Construct the variable name dynamically
    snprintf(variableName, elCount(variableName), "VaCANR_CanRxMsgs[%d].CanControllerId", i);

    // Set CanControllerId to 0 for the current message
    A_DBGR_VariableSet(variableName, "1");

    // Verify that CanControllerId has been set to 0 for the current message
    E_DBGR_VariableCheck(variableName, 1, Equal);
  }

  snprintf( chActionText, elCount(chActionText), "Configure CanId values ");
  snprintf( chExpectedText, elCount(chExpectedText), "verify Configure CanId values");
  TestStepAddActionExpected( chActionText, chExpectedText );
  //TestStepAddActionExpected( chActionText, chExpectedText );
  A_DBGR_VariableSet("VaCANR_CanRxMsgs[64].CanId","0x00008000");
  E_DBGR_VariableCheck("VaCANR_CanRxMsgs[1].CanId",0x00000301,Equal);

  snprintf( chActionText, elCount(chActionText), "Configure CanFilterMask values ");
  snprintf( chExpectedText, elCount(chExpectedText), "verify Configure CanFilterMask values");
  TestStepAddActionExpected( chActionText, chExpectedText );
  A_DBGR_VariableSet("VaCANR_CanRxMsgs[64].CanFilterMask","0x1FFFF000");
  E_DBGR_VariableCheck("VaCANR_CanRxMsgs[64].CanFilterMask",0x1FFFF000,Equal);

  snprintf( chActionText, elCount(chActionText), "Configure CanRxMessageIdx values ");
  snprintf( chExpectedText, elCount(chExpectedText), "verify Configure CanRxMessageIdx values");
  TestStepAddActionExpected( chActionText, chExpectedText );
  A_DBGR_VariableSet("VaCANR_CanRxMsgs[64].CanRxMessageIdx","0");
  E_DBGR_VariableCheck("VaCANR_CanRxMsgs[64].CanRxMessageIdx",0,Equal);

  snprintf( chActionText, elCount(chActionText), "Configure CanMessageLen values ");
  snprintf( chExpectedText, elCount(chExpectedText), "verify Configure CanMessageLen values");
  TestStepAddActionExpected( chActionText, chExpectedText );
  A_DBGR_VariableSet("VaCANR_CanRxMsgs[64].CanMessageLen","1");
  E_DBGR_VariableCheck("VaCANR_CanRxMsgs[64].CanMessageLen",1,Equal);

  snprintf( chActionText, elCount(chActionText), "Configure CanIdType values ");
  snprintf( chExpectedText, elCount(chExpectedText), "verify Configure CanIdType values");
  TestStepAddActionExpected( chActionText, chExpectedText );
  A_DBGR_VariableSet("VaCANR_CanRxMsgs[64].CanIdType","0");
  E_DBGR_VariableCheck("VaCANR_CanRxMsgs[64].CanIdType",0,Equal);

  snprintf( chActionText, elCount(chActionText), "Configure CanControllerId values ");
  snprintf( chExpectedText, elCount(chExpectedText), "verify Configure CanControllerId values");
  TestStepAddActionExpected( chActionText, chExpectedText );
  A_DBGR_VariableSet("VaCANR_CanRxMsgs[64].CanControllerId","1");
  E_DBGR_VariableCheck("VaCANR_CanRxMsgs[64].CanControllerId",1,Equal);


  snprintf( chActionText, elCount(chActionText), "Flash the Software and ECU is running ");
  snprintf( chExpectedText, elCount(chExpectedText), "Ecu is should be in running state");
  TestStepAddActionExpected( chActionText, chExpectedText );
  A_DBGR_Go();

  /***************************************************************************************************************/
             // Test Step 2 Disable MngCNDD_CanMainRead function.
  /***************************************************************************************************************/
  snprintf( chActionText, elCount(chActionText), "Configure RX_BUF = 1 values ");
  snprintf( chExpectedText, elCount(chExpectedText), "verify Configure RX_BUF = 1 values");
  //TestStepAddActionExpected( chActionText, chExpectedText );
  A_DBGR_VariableSet("RX_BUF","1");

  /***************************************************************************************************************/
              // Test Step 2 Transmite message  using canoe.
  /***************************************************************************************************************/
  for ( i = 0; i < 64; i++) {
    // Prepare the action and expected text for logging or validation
    snprintf(chActionText, elCount(chActionText), "Transmit CAN message. ID:0x80007000");
    snprintf(chExpectedText, elCount(chExpectedText), "CAN message transmitted. ID[%d]: 0x%08X", i, CANID[i]);
    // Send the CAN message
    A_CAN_SendMessage(CANID[i], dat_64byte, 8, 2);

  }

  for ( i = 0; i < 64; i++) {
    // Prepare the action and expected text for logging or validation
    snprintf(chActionText, elCount(chActionText), "Transmit CAN message. ID:0x40000140");
    snprintf(chExpectedText, elCount(chExpectedText), "CAN message transmitted. ID:0x40000140");

    // Send the CAN message
    A_CAN_SendMessage(0x00000140, dat_64byte, 8, 2);
  }

  for ( i = 0; i < 64; i++) {
    // Prepare the action and expected text for logging or validation
    snprintf(chActionText, elCount(chActionText), "Transmit CAN message. ID:0x80007000");
    snprintf(chExpectedText, elCount(chExpectedText), "CAN message transmitted. ID:0x80007000");

    // Send the CAN message
    A_CAN_SendMessage(0x800x, dat_64byte, 8, 2);
  }

  snprintf( chActionText, elCount(chActionText), "verify CAN_1_RX_BUFFER_MAX_LEVEL");
  snprintf( chExpectedText, elCount(chExpectedText), "CAN_1_RX_BUFFER_MAX_LEVEL");
  //TestStepAddActionExpected( chActionText, chExpectedText );

  A_DBGR_VariableSet("CAN_1_RX_BUFFER_MAX_LEVEL","0");
  E_DBGR_VariableCheck("CAN_1_RX_BUFFER_MAX_LEVEL",192,Equal);

}



testcase Verify_that_the_GetCNDD_e_CanTrcvSpcfcFlts_function_correctly_reports_CAN_TXD_line_stuck_dominant_error_status_for_CANA_CAN2()
{
  /***************************************************************************************************************/
                                                // Variable Definition
  /***************************************************************************************************************/



  /***************************************************************************************************************/
                                               // Local Values
  /***************************************************************************************************************/



  /***************************************************************************************************************/
                                              // Test Case Info
  /***************************************************************************************************************/
  setWriteDbgLevel(DebugOff);
  snprintf( chTestTitle, elCount(chTestTitle), "Verify_that_the_GetCNDD_e_CanTrcvSpcfcFlts_function_correctly_reports_CAN_TXD_line_stuck_dominant_error_status_for_CANA_CAN2" );
  snprintf( chTestDescription, elCount(chTestDescription), "Purpose:To check GetCNDD_e_CanTrcvSpcfcFlts ");
  TestCaseAddInfo( chTestTitle, "TC_L30SW_Q-36403685", chTestDescription );

  /***************************************************************************************************************/
                                              // Start of Test Case
  /***************************************************************************************************************/

  /***************************************************************************************************************/
                                              // Test Step 0 PRECONDITIONS
  /***************************************************************************************************************/
   snprintf( chActionText, elCount(chActionText), "Flash the Software and ECU is running ");
  snprintf( chExpectedText, elCount(chExpectedText), "Ecu is should be in running state");
  TestStepAddActionExpected( chActionText, chExpectedText );

  A_DBGR_BreakpointDeleteAll();
  A_DBGR_BreakpointSet("TestCantrcv_GetCanTrcvSpcfcFlts\\2");
  A_DBGR_R();
  A_DBGR_Go();

  /***************************************************************************************************************/
                                              // Test Step 1 Call TestCantrcv_GetCanTrcvSpcfcFlts with channel ID as 0
  /***************************************************************************************************************/
  snprintf( chActionText, elCount(chActionText), "Set Breakpoint in TestCantrcv_GetCanTrcvSpcfcFlts\\2 ");
  snprintf( chExpectedText, elCount(chExpectedText), "verify is Breakpoint Set TestCantrcv_GetCanTrcvSpcfcFlts\\2");

  A_DBGR_Go();

  snprintf( chActionText, elCount(chActionText), "verify Breakpoint should hit in TestCantrcv_GetCanTrcvSpcfcFlts\\2 ");
  snprintf( chExpectedText, elCount(chExpectedText), "Breakpoint hit in TestCantrcv_GetCanTrcvSpcfcFlts\\2 function");

  E_DBGR_BreakpointCheckForHalt("TestCantrcv_GetCanTrcvSpcfcFlts\\2");

  snprintf( chActionText, elCount(chActionText), "Flash the Software and ECU is running ");
  snprintf( chExpectedText, elCount(chExpectedText), "Ecu is should be in running state");
  TestStepAddActionExpected( chActionText, chExpectedText );
  A_DBGR_BreakpointDeleteAll();
  /***************************************************************************************************************/
                                              // Test Step 2 Set CheckCanTrcvSpcFaults value as 1
  /***************************************************************************************************************/

  snprintf( chActionText, elCount(chActionText), "Configure CheckCanTrcvSpcFaults values ");
  snprintf( chExpectedText, elCount(chExpectedText), "verify Configure CheckCanTrcvSpcFaults values");
  //TestStepAddActionExpected( chActionText, chExpectedText );
  A_DBGR_VariableSet("CheckCanTrcvSpcFaults","1");

  snprintf( chActionText, elCount(chActionText), "Configure CheckCanTrcvSpcFaults values ");
  snprintf( chExpectedText, elCount(chExpectedText), "verify Configure CheckCanTrcvSpcFaults values");
  //TestStepAddActionExpected( chActionText, chExpectedText );
  E_DBGR_VariableCheck("CheckCanTrcvSpcFaults",1,Equal);

   /***************************************************************************************************************/
                                              // Test Step 3 Call GetCNDD_e_CanTrcvSpcfcFlts and verify channel ID as 0
  /***************************************************************************************************************/

  snprintf( chActionText, elCount(chActionText), "Set Breakpoint in GetCNDD_e_CanTrcvSpcfcFlts ");
  snprintf( chExpectedText, elCount(chExpectedText), "verify is Breakpoint Set GetCNDD_e_CanTrcvSpcfcFlts");
  TestStepAddActionExpected( chActionText, chExpectedText );
  A_DBGR_BreakpointSet("GetCNDD_e_CanTrcvSpcfcFlts");

  snprintf( chActionText, elCount(chActionText), "Flash the Software and ECU is running ");
  snprintf( chExpectedText, elCount(chExpectedText), "Ecu is should be in running state");
  //TestStepAddActionExpected( chActionText, chExpectedText );
  A_DBGR_Go();

  snprintf( chActionText, elCount(chActionText), "verify Breakpoint should hit in GetCNDD_e_CanTrcvSpcfcFlts ");
  snprintf( chExpectedText, elCount(chExpectedText), "Breakpoint hit in GetCNDD_e_CanTrcvSpcfcFlts function");

  E_DBGR_BreakpointCheckForHalt("GetCNDD_e_CanTrcvSpcfcFlts");

  snprintf( chActionText, elCount(chActionText), "Flash the Software and ECU is running ");
  snprintf( chExpectedText, elCount(chExpectedText), "Ecu is should be in running state");
  TestStepAddActionExpected( chActionText, chExpectedText );
  A_DBGR_BreakpointDeleteAll();

  snprintf( chActionText, elCount(chActionText), "Configure Channel_ID values ");
  snprintf( chExpectedText, elCount(chExpectedText), "verify Configure Channel_ID values");
  //TestStepAddActionExpected( chActionText, chExpectedText );
  A_DBGR_VariableSet("Channel_ID","0");
  E_DBGR_VariableCheck("Channel_ID",0,Equal);

  /***************************************************************************************************************/
                                              // Test Step 4 Simulate CAN_bus_stuck_dominant_error
  /***************************************************************************************************************/

  snprintf( chActionText, elCount(chActionText), "Configure CanTrcvFaultStatus[0].trcvSpcfcFlt.canDomFltSts values ");
  snprintf( chExpectedText, elCount(chExpectedText), "verify Configure CanTrcvFaultStatus[0].trcvSpcfcFlt.canDomFltSts values");
  TestStepAddActionExpected( chActionText, chExpectedText );
  A_DBGR_VariableSet("CanTrcvFaultStatus[0].trcvSpcfcFlt.TXDDOMFltSts","1");
  E_DBGR_VariableCheck("CanTrcvFaultStatus[0].trcvSpcfcFlt.TXDDOMFltSts",1,Equal);

  snprintf( chActionText, elCount(chActionText), "Set Breakpoint in TestCantrcv_GetCanTrcvSpcfcFlts\\2 ");
  snprintf( chExpectedText, elCount(chExpectedText), "verify is Breakpoint Set TestCantrcv_GetCanTrcvSpcfcFlts\\2");
  TestStepAddActionExpected( chActionText, chExpectedText );
  A_DBGR_BreakpointSet("TestCantrcv_GetCanTrcvSpcfcFlts\\2");
  A_DBGR_Go();

  snprintf( chActionText, elCount(chActionText), "verify Breakpoint should hit in TestCantrcv_GetCanTrcvSpcfcFlts\\2 ");
  snprintf( chExpectedText, elCount(chExpectedText), "Breakpoint hit in TestCantrcv_GetCanTrcvSpcfcFlts\\2 function");

  E_DBGR_BreakpointCheckForHalt("TestCantrcv_GetCanTrcvSpcfcFlts\\2");

//  snprintf( chActionText, elCount(chActionText), "Flash the Software and ECU is running ");
//  snprintf( chExpectedText, elCount(chExpectedText), "Ecu is should be in running state");
//  TestStepAddActionExpected( chActionText, chExpectedText );
//  A_DBGR_Go();

  /***************************************************************************************************************/
                                              // Test Step 5 verify that value which represents CanTrcv_FaultStatus
  /***************************************************************************************************************/
  snprintf( chActionText, elCount(chActionText), "Configure CanTrcv_FaultStatus values ");
  snprintf( chExpectedText, elCount(chExpectedText), "verify Configure CanTrcv_FaultStatus values");
  TestStepAddActionExpected( chActionText, chExpectedText );
  E_DBGR_VariableCheck("CanTrcv_FaultStatus",1024,Equal);


}





testcase Verify_that_the_GetCNDD_e_CanTrcvSpcfcFlts_function_correctly_reports_the_VSUP_under_voltage_fault_for_CANA_CAN2()
{
  /***************************************************************************************************************/
                                                // Variable Definition
  /***************************************************************************************************************/



  /***************************************************************************************************************/
                                               // Local Values
  /***************************************************************************************************************/



  /***************************************************************************************************************/
                                              // Test Case Info
  /***************************************************************************************************************/
  setWriteDbgLevel(DebugOff);
  snprintf( chTestTitle, elCount(chTestTitle), "Verify_that_the_GetCNDD_e_CanTrcvSpcfcFlts_function_correctly_reports_the_VSUP_under_voltage_fault_for_CANA_CAN2" );
  snprintf( chTestDescription, elCount(chTestDescription), "Purpose:To check GetCNDD_e_CanTrcvSpcfcFlts ");
  TestCaseAddInfo( chTestTitle, "TC_L30SW_Q-36403678", chTestDescription );

  /***************************************************************************************************************/
                                              // Start of Test Case
  /***************************************************************************************************************/

  /***************************************************************************************************************/
                                              // Test Step 0 PRECONDITIONS
  /***************************************************************************************************************/
   snprintf( chActionText, elCount(chActionText), "Flash the Software and ECU is running ");
  snprintf( chExpectedText, elCount(chExpectedText), "Ecu is should be in running state");
  TestStepAddActionExpected( chActionText, chExpectedText );

  A_DBGR_BreakpointDeleteAll();
  A_DBGR_BreakpointSet("TestCantrcv_GetCanTrcvSpcfcFlts\\2");
  A_DBGR_R();
  A_DBGR_Go();

  /***************************************************************************************************************/
                                              // Test Step 1 Call TestCantrcv_GetCanTrcvSpcfcFlts with channel ID as 0
  /***************************************************************************************************************/
  snprintf( chActionText, elCount(chActionText), "Set Breakpoint in TestCantrcv_GetCanTrcvSpcfcFlts\\2 ");
  snprintf( chExpectedText, elCount(chExpectedText), "verify is Breakpoint Set TestCantrcv_GetCanTrcvSpcfcFlts\\2");

  A_DBGR_Go();

  snprintf( chActionText, elCount(chActionText), "verify Breakpoint should hit in TestCantrcv_GetCanTrcvSpcfcFlts\\2 ");
  snprintf( chExpectedText, elCount(chExpectedText), "Breakpoint hit in TestCantrcv_GetCanTrcvSpcfcFlts\\2 function");

  E_DBGR_BreakpointCheckForHalt("TestCantrcv_GetCanTrcvSpcfcFlts\\2");

  snprintf( chActionText, elCount(chActionText), "Flash the Software and ECU is running ");
  snprintf( chExpectedText, elCount(chExpectedText), "Ecu is should be in running state");
  TestStepAddActionExpected( chActionText, chExpectedText );
  A_DBGR_BreakpointDeleteAll();
  /***************************************************************************************************************/
                                              // Test Step 2 Set CheckCanTrcvSpcFaults value as 1
  /***************************************************************************************************************/

  snprintf( chActionText, elCount(chActionText), "Configure CheckCanTrcvSpcFaults values ");
  snprintf( chExpectedText, elCount(chExpectedText), "verify Configure CheckCanTrcvSpcFaults values");
 // TestStepAddActionExpected( chActionText, chExpectedText );
  A_DBGR_VariableSet("CheckCanTrcvSpcFaults","1");

  snprintf( chActionText, elCount(chActionText), "Configure CheckCanTrcvSpcFaults values ");
  snprintf( chExpectedText, elCount(chExpectedText), "verify Configure CheckCanTrcvSpcFaults values");
  //TestStepAddActionExpected( chActionText, chExpectedText );
  E_DBGR_VariableCheck("CheckCanTrcvSpcFaults",1,Equal);

   /***************************************************************************************************************/
                                              // Test Step 3 Call GetCNDD_e_CanTrcvSpcfcFlts and verify channel ID as 0
  /***************************************************************************************************************/

  snprintf( chActionText, elCount(chActionText), "Set Breakpoint in GetCNDD_e_CanTrcvSpcfcFlts ");
  snprintf( chExpectedText, elCount(chExpectedText), "verify is Breakpoint Set GetCNDD_e_CanTrcvSpcfcFlts");
  TestStepAddActionExpected( chActionText, chExpectedText );
  A_DBGR_BreakpointSet("GetCNDD_e_CanTrcvSpcfcFlts");

  snprintf( chActionText, elCount(chActionText), "Flash the Software and ECU is running ");
  snprintf( chExpectedText, elCount(chExpectedText), "Ecu is should be in running state");
  //TestStepAddActionExpected( chActionText, chExpectedText );
  A_DBGR_Go();

  snprintf( chActionText, elCount(chActionText), "verify Breakpoint should hit in GetCNDD_e_CanTrcvSpcfcFlts ");
  snprintf( chExpectedText, elCount(chExpectedText), "Breakpoint hit in GetCNDD_e_CanTrcvSpcfcFlts function");

  E_DBGR_BreakpointCheckForHalt("GetCNDD_e_CanTrcvSpcfcFlts");

  snprintf( chActionText, elCount(chActionText), "Flash the Software and ECU is running ");
  snprintf( chExpectedText, elCount(chExpectedText), "Ecu is should be in running state");
  TestStepAddActionExpected( chActionText, chExpectedText );
  A_DBGR_BreakpointDeleteAll();

  snprintf( chActionText, elCount(chActionText), "Configure Channel_ID values ");
  snprintf( chExpectedText, elCount(chExpectedText), "verify Configure Channel_ID values");
  //TestStepAddActionExpected( chActionText, chExpectedText );
  A_DBGR_VariableSet("Channel_ID","0");
  E_DBGR_VariableCheck("Channel_ID",0,Equal);

  /***************************************************************************************************************/
                                              // Test Step 4 Simulate  VSUP under voltage fault
  /***************************************************************************************************************/

  snprintf( chActionText, elCount(chActionText), "Configure CanTrcvFaultStatus[0].trcvSpcfcFlt.uVsupFltSts values ");
  snprintf( chExpectedText, elCount(chExpectedText), "verify Configure CanTrcvFaultStatus[0].trcvSpcfcFlt.uVsupFltSts values");
  TestStepAddActionExpected( chActionText, chExpectedText );
  A_DBGR_VariableSet("CanTrcvFaultStatus[0].trcvSpcfcFlt.uVccFltSts","1");
  E_DBGR_VariableCheck("CanTrcvFaultStatus[0].trcvSpcfcFlt.uVccFltSts",1,Equal);

  snprintf( chActionText, elCount(chActionText), "Set Breakpoint in TestCantrcv_GetCanTrcvSpcfcFlts\\2 ");
  snprintf( chExpectedText, elCount(chExpectedText), "verify is Breakpoint Set TestCantrcv_GetCanTrcvSpcfcFlts\\2");
  TestStepAddActionExpected( chActionText, chExpectedText );
  A_DBGR_BreakpointSet("TestCantrcv_GetCanTrcvSpcfcFlts\\2");
  A_DBGR_Go();

  snprintf( chActionText, elCount(chActionText), "verify Breakpoint should hit in TestCantrcv_GetCanTrcvSpcfcFlts\\2 ");
  snprintf( chExpectedText, elCount(chExpectedText), "Breakpoint hit in TestCantrcv_GetCanTrcvSpcfcFlts\\2 function");

  E_DBGR_BreakpointCheckForHalt("TestCantrcv_GetCanTrcvSpcfcFlts\\2");



  /***************************************************************************************************************/
                                              // Test Step 5 verify that value which represents CanTrcv_FaultStatus
  /***************************************************************************************************************/
  snprintf( chActionText, elCount(chActionText), "Configure CanTrcv_FaultStatus values ");
  snprintf( chExpectedText, elCount(chExpectedText), "verify Configure CanTrcv_FaultStatus values");
  TestStepAddActionExpected( chActionText, chExpectedText );
  E_DBGR_VariableCheck("CanTrcv_FaultStatus",8192,Equal);

}



testcase Verify_that_the_GetCNDD_e_CanTrcvSpcfcFlts_function_correctly_reports_the_VSUP_under_voltage_fault_for_CANB_CAN8()
{
  /***************************************************************************************************************/
                                                // Variable Definition
  /***************************************************************************************************************/



  /***************************************************************************************************************/
                                               // Local Values
  /***************************************************************************************************************/



  /***************************************************************************************************************/
                                              // Test Case Info
  /***************************************************************************************************************/
  setWriteDbgLevel(DebugOff);
  snprintf( chTestTitle, elCount(chTestTitle), "Verify_that_the_GetCNDD_e_CanTrcvSpcfcFlts_function_correctly_reports_the_VSUP_under_voltage_fault_for_CANB_CAN8" );
  snprintf( chTestDescription, elCount(chTestDescription), "Purpose:To check GetCNDD_e_CanTrcvSpcfcFlts ");
  TestCaseAddInfo( chTestTitle, "TC_L30SW_Q-36403679", chTestDescription );

  /***************************************************************************************************************/
                                              // Start of Test Case
  /***************************************************************************************************************/

  /***************************************************************************************************************/
                                              // Test Step 0 PRECONDITIONS
  /***************************************************************************************************************/
   snprintf( chActionText, elCount(chActionText), "Flash the Software and ECU is running ");
  snprintf( chExpectedText, elCount(chExpectedText), "Ecu is should be in running state");
  TestStepAddActionExpected( chActionText, chExpectedText );

  A_DBGR_BreakpointDeleteAll();
  A_DBGR_BreakpointSet("TestCantrcv_GetCanTrcvSpcfcFlts\\2");
  A_DBGR_R();
  A_DBGR_Go();

  /***************************************************************************************************************/
                                              // Test Step 1 Call TestCantrcv_GetCanTrcvSpcfcFlts with channel ID as 1
  /***************************************************************************************************************/
  snprintf( chActionText, elCount(chActionText), "Set Breakpoint in TestCantrcv_GetCanTrcvSpcfcFlts\\2 ");
  snprintf( chExpectedText, elCount(chExpectedText), "verify is Breakpoint Set TestCantrcv_GetCanTrcvSpcfcFlts\\2");

  A_DBGR_Go();

  snprintf( chActionText, elCount(chActionText), "verify Breakpoint should hit in TestCantrcv_GetCanTrcvSpcfcFlts\\2 ");
  snprintf( chExpectedText, elCount(chExpectedText), "Breakpoint hit in TestCantrcv_GetCanTrcvSpcfcFlts\\2 function");

  E_DBGR_BreakpointCheckForHalt("TestCantrcv_GetCanTrcvSpcfcFlts\\2");

  snprintf( chActionText, elCount(chActionText), "Flash the Software and ECU is running ");
  snprintf( chExpectedText, elCount(chExpectedText), "Ecu is should be in running state");
  TestStepAddActionExpected( chActionText, chExpectedText );
  A_DBGR_BreakpointDeleteAll();

  snprintf( chActionText, elCount(chActionText), "Configure Channel_ID values ");
  snprintf( chExpectedText, elCount(chExpectedText), "verify Configure Channel_ID values");
  //TestStepAddActionExpected( chActionText, chExpectedText );
  A_DBGR_VariableSet("Channel_ID","1");

  snprintf( chActionText, elCount(chActionText), "Configure Channel_ID values ");
  snprintf( chExpectedText, elCount(chExpectedText), "verify Configure Channel_ID values");
  //TestStepAddActionExpected( chActionText, chExpectedText );
  E_DBGR_VariableCheck("Channel_ID",1,Equal);


  /***************************************************************************************************************/
                                              // Test Step 2 Set CheckCanTrcvSpcFaults value as 1
  /***************************************************************************************************************/

  snprintf( chActionText, elCount(chActionText), "Configure CheckCanTrcvSpcFaults values ");
  snprintf( chExpectedText, elCount(chExpectedText), "verify Configure CheckCanTrcvSpcFaults values");
  TestStepAddActionExpected( chActionText, chExpectedText );
  A_DBGR_VariableSet("CheckCanTrcvSpcFaults","1");

  snprintf( chActionText, elCount(chActionText), "Configure CheckCanTrcvSpcFaults values ");
  snprintf( chExpectedText, elCount(chExpectedText), "verify Configure CheckCanTrcvSpcFaults values");
  //TestStepAddActionExpected( chActionText, chExpectedText );
  E_DBGR_VariableCheck("CheckCanTrcvSpcFaults",1,Equal);

   /***************************************************************************************************************/
                                              // Test Step 3 Call GetCNDD_e_CanTrcvSpcfcFlts and verify channel ID as 1
  /***************************************************************************************************************/

  snprintf( chActionText, elCount(chActionText), "Set Breakpoint in GetCNDD_e_CanTrcvSpcfcFlts ");
  snprintf( chExpectedText, elCount(chExpectedText), "verify is Breakpoint Set GetCNDD_e_CanTrcvSpcfcFlts");
  TestStepAddActionExpected( chActionText, chExpectedText );
  A_DBGR_BreakpointSet("GetCNDD_e_CanTrcvSpcfcFlts");

  snprintf( chActionText, elCount(chActionText), "Flash the Software and ECU is running ");
  snprintf( chExpectedText, elCount(chExpectedText), "Ecu is should be in running state");
  //TestStepAddActionExpected( chActionText, chExpectedText );
  A_DBGR_Go();

  snprintf( chActionText, elCount(chActionText), "verify Breakpoint should hit in GetCNDD_e_CanTrcvSpcfcFlts ");
  snprintf( chExpectedText, elCount(chExpectedText), "Breakpoint hit in GetCNDD_e_CanTrcvSpcfcFlts function");

  E_DBGR_BreakpointCheckForHalt("GetCNDD_e_CanTrcvSpcfcFlts");

  snprintf( chActionText, elCount(chActionText), "Flash the Software and ECU is running ");
  snprintf( chExpectedText, elCount(chExpectedText), "Ecu is should be in running state");
  TestStepAddActionExpected( chActionText, chExpectedText );
  A_DBGR_BreakpointDeleteAll();

  snprintf( chActionText, elCount(chActionText), "Configure Channel_ID values ");
  snprintf( chExpectedText, elCount(chExpectedText), "verify Configure Channel_ID values");
  //TestStepAddActionExpected( chActionText, chExpectedText );
  A_DBGR_VariableSet("Channel_ID","1");
  E_DBGR_VariableCheck("Channel_ID",1,Equal);

  /***************************************************************************************************************/
                                              // Test Step 4 Simulate  VSUP under voltage fault
  /***************************************************************************************************************/

  snprintf( chActionText, elCount(chActionText), "Configure CanTrcvFaultStatus[1].trcvSpcfcFlt.uVsupFltSts values ");
  snprintf( chExpectedText, elCount(chExpectedText), "verify Configure CanTrcvFaultStatus[1].trcvSpcfcFlt.uVsupFltSts values");
  TestStepAddActionExpected( chActionText, chExpectedText );
  A_DBGR_VariableSet("CanTrcvFaultStatus[1].trcvSpcfcFlt.uVccFltSts","1");
  E_DBGR_VariableCheck("CanTrcvFaultStatus[1].trcvSpcfcFlt.uVccFltSts",1,Equal);

    snprintf( chActionText, elCount(chActionText), "Set Breakpoint in TestCantrcv_GetCanTrcvSpcfcFlts\\2 ");
  snprintf( chExpectedText, elCount(chExpectedText), "verify is Breakpoint Set TestCantrcv_GetCanTrcvSpcfcFlts\\2");
  TestStepAddActionExpected( chActionText, chExpectedText );
  A_DBGR_BreakpointSet("TestCantrcv_GetCanTrcvSpcfcFlts\\2");
  A_DBGR_Go();

  snprintf( chActionText, elCount(chActionText), "verify Breakpoint should hit in TestCantrcv_GetCanTrcvSpcfcFlts\\2 ");
  snprintf( chExpectedText, elCount(chExpectedText), "Breakpoint hit in TestCantrcv_GetCanTrcvSpcfcFlts\\2 function");

  E_DBGR_BreakpointCheckForHalt("TestCantrcv_GetCanTrcvSpcfcFlts\\2");


  /***************************************************************************************************************/
                                              // Test Step 5 verify that value which represents CanTrcv_FaultStatus
  /***************************************************************************************************************/
  snprintf( chActionText, elCount(chActionText), "Configure CanTrcv_FaultStatus values ");
  snprintf( chExpectedText, elCount(chExpectedText), "verify Configure CanTrcv_FaultStatus values");
  TestStepAddActionExpected( chActionText, chExpectedText );
  E_DBGR_VariableCheck("CanTrcv_FaultStatus",8192,Equal);
}



testcase Verify_that_the_GetCNDD_e_CanTrcvSpcfcFlts_function_correctly_reports_wake_error_status_conditions_for_CANA_CAN2()
{
  /***************************************************************************************************************/
                                                // Variable Definition
  /***************************************************************************************************************/



  /***************************************************************************************************************/
                                               // Local Values
  /***************************************************************************************************************/



  /***************************************************************************************************************/
                                              // Test Case Info
  /***************************************************************************************************************/
  setWriteDbgLevel(DebugOff);
  snprintf( chTestTitle, elCount(chTestTitle), "Verify_that_the_GetCNDD_e_CanTrcvSpcfcFlts_function_correctly_reports_wake_error_status_conditions_for_CANA_CAN2" );
  snprintf( chTestDescription, elCount(chTestDescription), "Purpose:To check GetCNDD_e_CanTrcvSpcfcFlts ");
  TestCaseAddInfo( chTestTitle, "TC_L30SW_Q-36403680", chTestDescription );

  /***************************************************************************************************************/
                                              // Start of Test Case
  /***************************************************************************************************************/

  /***************************************************************************************************************/
                                              // Test Step 0 PRECONDITIONS
  /***************************************************************************************************************/
   snprintf( chActionText, elCount(chActionText), "Flash the Software and ECU is running ");
  snprintf( chExpectedText, elCount(chExpectedText), "Ecu is should be in running state");
  TestStepAddActionExpected( chActionText, chExpectedText );

  A_DBGR_BreakpointDeleteAll();
  A_DBGR_BreakpointSet("TestCantrcv_GetCanTrcvSpcfcFlts\\2");
  A_DBGR_R();
  A_DBGR_Go();

  /***************************************************************************************************************/
                                              // Test Step 1 Call TestCantrcv_GetCanTrcvSpcfcFlts with channel ID as 0
  /***************************************************************************************************************/
  snprintf( chActionText, elCount(chActionText), "Set Breakpoint in TestCantrcv_GetCanTrcvSpcfcFlts\\2 ");
  snprintf( chExpectedText, elCount(chExpectedText), "verify is Breakpoint Set TestCantrcv_GetCanTrcvSpcfcFlts\\2");

  A_DBGR_Go();

  snprintf( chActionText, elCount(chActionText), "verify Breakpoint should hit in TestCantrcv_GetCanTrcvSpcfcFlts\\2 ");
  snprintf( chExpectedText, elCount(chExpectedText), "Breakpoint hit in TestCantrcv_GetCanTrcvSpcfcFlts\\2 function");

  E_DBGR_BreakpointCheckForHalt("TestCantrcv_GetCanTrcvSpcfcFlts\\2");

  snprintf( chActionText, elCount(chActionText), "Flash the Software and ECU is running ");
  snprintf( chExpectedText, elCount(chExpectedText), "Ecu is should be in running state");
  TestStepAddActionExpected( chActionText, chExpectedText );
  A_DBGR_BreakpointDeleteAll();
  /***************************************************************************************************************/
                                              // Test Step 2 Set CheckCanTrcvSpcFaults value as 1
  /***************************************************************************************************************/

  snprintf( chActionText, elCount(chActionText), "Configure CheckCanTrcvSpcFaults values ");
  snprintf( chExpectedText, elCount(chExpectedText), "verify Configure CheckCanTrcvSpcFaults values");
  //TestStepAddActionExpected( chActionText, chExpectedText );
  A_DBGR_VariableSet("CheckCanTrcvSpcFaults","1");

  snprintf( chActionText, elCount(chActionText), "Configure CheckCanTrcvSpcFaults values ");
  snprintf( chExpectedText, elCount(chExpectedText), "verify Configure CheckCanTrcvSpcFaults values");
  //TestStepAddActionExpected( chActionText, chExpectedText );
  E_DBGR_VariableCheck("CheckCanTrcvSpcFaults",1,Equal);

   /***************************************************************************************************************/
                                              // Test Step 3 Call GetCNDD_e_CanTrcvSpcfcFlts and verify channel ID as 0
  /***************************************************************************************************************/

  snprintf( chActionText, elCount(chActionText), "Set Breakpoint in GetCNDD_e_CanTrcvSpcfcFlts ");
  snprintf( chExpectedText, elCount(chExpectedText), "verify is Breakpoint Set GetCNDD_e_CanTrcvSpcfcFlts");
  TestStepAddActionExpected( chActionText, chExpectedText );
  A_DBGR_BreakpointSet("GetCNDD_e_CanTrcvSpcfcFlts");

  snprintf( chActionText, elCount(chActionText), "Flash the Software and ECU is running ");
  snprintf( chExpectedText, elCount(chExpectedText), "Ecu is should be in running state");
  //TestStepAddActionExpected( chActionText, chExpectedText );
  A_DBGR_Go();

  snprintf( chActionText, elCount(chActionText), "verify Breakpoint should hit in GetCNDD_e_CanTrcvSpcfcFlts ");
  snprintf( chExpectedText, elCount(chExpectedText), "Breakpoint hit in GetCNDD_e_CanTrcvSpcfcFlts function");

  E_DBGR_BreakpointCheckForHalt("GetCNDD_e_CanTrcvSpcfcFlts");

  snprintf( chActionText, elCount(chActionText), "Flash the Software and ECU is running ");
  snprintf( chExpectedText, elCount(chExpectedText), "Ecu is should be in running state");
  TestStepAddActionExpected( chActionText, chExpectedText );
  A_DBGR_BreakpointDeleteAll();

  snprintf( chActionText, elCount(chActionText), "Configure Channel_ID values ");
  snprintf( chExpectedText, elCount(chExpectedText), "verify Configure Channel_ID values");
  //TestStepAddActionExpected( chActionText, chExpectedText );
  A_DBGR_VariableSet("Channel_ID","0");
  E_DBGR_VariableCheck("Channel_ID",0,Equal);

  /***************************************************************************************************************/
                                              // Test Step 4 Simulate  wake error status
  /***************************************************************************************************************/

  snprintf( chActionText, elCount(chActionText), "Configure CanTrcvFaultStatus[0].trcvSpcfcFlt.wkErrFltSts values ");
  snprintf( chExpectedText, elCount(chExpectedText), "verify Configure CanTrcvFaultStatus[0].trcvSpcfcFlt.wkErrFltSts values");
  TestStepAddActionExpected( chActionText, chExpectedText );
  A_DBGR_VariableSet("CanTrcvFaultStatus[0].trcvSpcfcFlt.wkErrFltSts","1");
  E_DBGR_VariableCheck("CanTrcvFaultStatus[0].trcvSpcfcFlt.wkErrFltSts",1,Equal);

  snprintf( chActionText, elCount(chActionText), "Set Breakpoint in TestCantrcv_GetCanTrcvSpcfcFlts\\2 ");
  snprintf( chExpectedText, elCount(chExpectedText), "verify is Breakpoint Set TestCantrcv_GetCanTrcvSpcfcFlts\\2");
  TestStepAddActionExpected( chActionText, chExpectedText );
  A_DBGR_BreakpointSet("TestCantrcv_GetCanTrcvSpcfcFlts\\2");
  A_DBGR_Go();

  snprintf( chActionText, elCount(chActionText), "verify Breakpoint should hit in TestCantrcv_GetCanTrcvSpcfcFlts\\2 ");
  snprintf( chExpectedText, elCount(chExpectedText), "Breakpoint hit in TestCantrcv_GetCanTrcvSpcfcFlts\\2 function");

  E_DBGR_BreakpointCheckForHalt("TestCantrcv_GetCanTrcvSpcfcFlts\\2");

  /***************************************************************************************************************/
                                              // Test Step 5 verify that value which represents CanTrcv_FaultStatus
  /***************************************************************************************************************/
  snprintf( chActionText, elCount(chActionText), "Configure CanTrcv_FaultStatus values ");
  snprintf( chExpectedText, elCount(chExpectedText), "verify Configure CanTrcv_FaultStatus values");
  TestStepAddActionExpected( chActionText, chExpectedText );
  E_DBGR_VariableCheck("CanTrcv_FaultStatus",32,Equal);

}



testcase Verify_that_the_GetCNDD_e_CanTrcvSpcfcFlts_function_correctly_reports_wake_error_status_conditions_for_CANB_CAN8()
{
   /***************************************************************************************************************/
                                                // Variable Definition
  /***************************************************************************************************************/



  /***************************************************************************************************************/
                                               // Local Values
  /***************************************************************************************************************/



  /***************************************************************************************************************/
                                              // Test Case Info
  /***************************************************************************************************************/
  setWriteDbgLevel(DebugOff);
  snprintf( chTestTitle, elCount(chTestTitle), "Verify_that_the_GetCNDD_e_CanTrcvSpcfcFlts_function_correctly_reports_wake_error_status_conditions_for_CANB_CAN8" );
  snprintf( chTestDescription, elCount(chTestDescription), "Purpose:To check GetCNDD_e_CanTrcvSpcfcFlts ");
  TestCaseAddInfo( chTestTitle, "TC_L30SW_Q-36403708", chTestDescription );

  /***************************************************************************************************************/
                                              // Start of Test Case
  /***************************************************************************************************************/

  /***************************************************************************************************************/
                                              // Test Step 0 PRECONDITIONS
  /***************************************************************************************************************/
   snprintf( chActionText, elCount(chActionText), "Flash the Software and ECU is running ");
  snprintf( chExpectedText, elCount(chExpectedText), "Ecu is should be in running state");
  TestStepAddActionExpected( chActionText, chExpectedText );

  A_DBGR_BreakpointDeleteAll();
  A_DBGR_BreakpointSet("TestCantrcv_GetCanTrcvSpcfcFlts\\2");
  A_DBGR_R();
  A_DBGR_Go();

  /***************************************************************************************************************/
                                              // Test Step 1 Call TestCantrcv_GetCanTrcvSpcfcFlts with channel ID as 1
  /***************************************************************************************************************/
  snprintf( chActionText, elCount(chActionText), "Set Breakpoint in TestCantrcv_GetCanTrcvSpcfcFlts\\2 ");
  snprintf( chExpectedText, elCount(chExpectedText), "verify is Breakpoint Set TestCantrcv_GetCanTrcvSpcfcFlts\\2");

  A_DBGR_Go();

  snprintf( chActionText, elCount(chActionText), "verify Breakpoint should hit in TestCantrcv_GetCanTrcvSpcfcFlts\\2 ");
  snprintf( chExpectedText, elCount(chExpectedText), "Breakpoint hit in TestCantrcv_GetCanTrcvSpcfcFlts\\2 function");

  E_DBGR_BreakpointCheckForHalt("TestCantrcv_GetCanTrcvSpcfcFlts\\2");

  snprintf( chActionText, elCount(chActionText), "Flash the Software and ECU is running ");
  snprintf( chExpectedText, elCount(chExpectedText), "Ecu is should be in running state");
  TestStepAddActionExpected( chActionText, chExpectedText );
  A_DBGR_BreakpointDeleteAll();

  snprintf( chActionText, elCount(chActionText), "Configure Channel_ID values ");
  snprintf( chExpectedText, elCount(chExpectedText), "verify Configure Channel_ID values");
 // TestStepAddActionExpected( chActionText, chExpectedText );
  A_DBGR_VariableSet("Channel_ID","1");

  snprintf( chActionText, elCount(chActionText), "Configure Channel_ID values ");
  snprintf( chExpectedText, elCount(chExpectedText), "verify Configure Channel_ID values");
  //TestStepAddActionExpected( chActionText, chExpectedText );
  E_DBGR_VariableCheck("Channel_ID",1,Equal);


  /***************************************************************************************************************/
                                              // Test Step 2 Set CheckCanTrcvSpcFaults value as 1
  /***************************************************************************************************************/

  snprintf( chActionText, elCount(chActionText), "Configure CheckCanTrcvSpcFaults values ");
  snprintf( chExpectedText, elCount(chExpectedText), "verify Configure CheckCanTrcvSpcFaults values");
  TestStepAddActionExpected( chActionText, chExpectedText );
  A_DBGR_VariableSet("CheckCanTrcvSpcFaults","1");

  snprintf( chActionText, elCount(chActionText), "Configure CheckCanTrcvSpcFaults values ");
  snprintf( chExpectedText, elCount(chExpectedText), "verify Configure CheckCanTrcvSpcFaults values");
  //TestStepAddActionExpected( chActionText, chExpectedText );
  E_DBGR_VariableCheck("CheckCanTrcvSpcFaults",1,Equal);

   /***************************************************************************************************************/
                                              // Test Step 3 Call GetCNDD_e_CanTrcvSpcfcFlts and verify channel ID as 1
  /***************************************************************************************************************/

  snprintf( chActionText, elCount(chActionText), "Set Breakpoint in GetCNDD_e_CanTrcvSpcfcFlts ");
  snprintf( chExpectedText, elCount(chExpectedText), "verify is Breakpoint Set GetCNDD_e_CanTrcvSpcfcFlts");
  TestStepAddActionExpected( chActionText, chExpectedText );
  A_DBGR_BreakpointSet("GetCNDD_e_CanTrcvSpcfcFlts");

  snprintf( chActionText, elCount(chActionText), "Flash the Software and ECU is running ");
  snprintf( chExpectedText, elCount(chExpectedText), "Ecu is should be in running state");
  //TestStepAddActionExpected( chActionText, chExpectedText );
  A_DBGR_Go();

  snprintf( chActionText, elCount(chActionText), "verify Breakpoint should hit in GetCNDD_e_CanTrcvSpcfcFlts ");
  snprintf( chExpectedText, elCount(chExpectedText), "Breakpoint hit in GetCNDD_e_CanTrcvSpcfcFlts function");

  E_DBGR_BreakpointCheckForHalt("GetCNDD_e_CanTrcvSpcfcFlts");

  snprintf( chActionText, elCount(chActionText), "Flash the Software and ECU is running ");
  snprintf( chExpectedText, elCount(chExpectedText), "Ecu is should be in running state");
  TestStepAddActionExpected( chActionText, chExpectedText );
  A_DBGR_BreakpointDeleteAll();

  snprintf( chActionText, elCount(chActionText), "Configure Channel_ID values ");
  snprintf( chExpectedText, elCount(chExpectedText), "verify Configure Channel_ID values");
  //TestStepAddActionExpected( chActionText, chExpectedText );
  A_DBGR_VariableSet("Channel_ID","1");
  E_DBGR_VariableCheck("Channel_ID",1,Equal);

  /***************************************************************************************************************/
                                              // Test Step 4 Simulate  wake error status
  /***************************************************************************************************************/

  snprintf( chActionText, elCount(chActionText), "Configure CanTrcvFaultStatus[1].trcvSpcfcFlt.wkErrFltSts values ");
  snprintf( chExpectedText, elCount(chExpectedText), "verify Configure CanTrcvFaultStatus[1].trcvSpcfcFlt.wkErrFltSts values");
  TestStepAddActionExpected( chActionText, chExpectedText );
  A_DBGR_VariableSet("CanTrcvFaultStatus[1].trcvSpcfcFlt.wkErrFltSts","1");
  E_DBGR_VariableCheck("CanTrcvFaultStatus[1].trcvSpcfcFlt.wkErrFltSts",1,Equal);

   snprintf( chActionText, elCount(chActionText), "Set Breakpoint in TestCantrcv_GetCanTrcvSpcfcFlts\\2 ");
  snprintf( chExpectedText, elCount(chExpectedText), "verify is Breakpoint Set TestCantrcv_GetCanTrcvSpcfcFlts\\2");
  TestStepAddActionExpected( chActionText, chExpectedText );
  A_DBGR_BreakpointSet("TestCantrcv_GetCanTrcvSpcfcFlts\\2");
  A_DBGR_Go();

  snprintf( chActionText, elCount(chActionText), "verify Breakpoint should hit in TestCantrcv_GetCanTrcvSpcfcFlts\\2 ");
  snprintf( chExpectedText, elCount(chExpectedText), "Breakpoint hit in TestCantrcv_GetCanTrcvSpcfcFlts\\2 function");

  E_DBGR_BreakpointCheckForHalt("TestCantrcv_GetCanTrcvSpcfcFlts\\2");
  /***************************************************************************************************************/
                                              // Test Step 5 verify that value which represents CanTrcv_FaultStatus
  /***************************************************************************************************************/
  snprintf( chActionText, elCount(chActionText), "Configure CanTrcv_FaultStatus values ");
  snprintf( chExpectedText, elCount(chExpectedText), "verify Configure CanTrcv_FaultStatus values");
  TestStepAddActionExpected( chActionText, chExpectedText );
  E_DBGR_VariableCheck("CanTrcv_FaultStatus",32,Equal);

}



testcase Verify_that_the_GetCNDD_e_CanTrcvSpcfcFlts_function_correctly_reports_multiple_fault_conditions_for_CANA_CAN2()
{
  /***************************************************************************************************************/
                                                // Variable Definition
  /***************************************************************************************************************/



  /***************************************************************************************************************/
                                               // Local Values
  /***************************************************************************************************************/



  /***************************************************************************************************************/
                                              // Test Case Info
  /***************************************************************************************************************/
  setWriteDbgLevel(DebugOff);
  snprintf( chTestTitle, elCount(chTestTitle), "Verify_that_the_GetCNDD_e_CanTrcvSpcfcFlts_function_correctly_reports_multiple_fault_conditions_for_CANA_CAN2" );
  snprintf( chTestDescription, elCount(chTestDescription), "Purpose:To check GetCNDD_e_CanTrcvSpcfcFlts ");
  TestCaseAddInfo( chTestTitle, "TC_L30SW_Q-36403681", chTestDescription );

  /***************************************************************************************************************/
                                              // Start of Test Case
  /***************************************************************************************************************/

  /***************************************************************************************************************/
                                              // Test Step 0 PRECONDITIONS
  /***************************************************************************************************************/
   snprintf( chActionText, elCount(chActionText), "Flash the Software and ECU is running ");
  snprintf( chExpectedText, elCount(chExpectedText), "Ecu is should be in running state");
  TestStepAddActionExpected( chActionText, chExpectedText );

  A_DBGR_BreakpointDeleteAll();
  A_DBGR_BreakpointSet("TestCantrcv_GetCanTrcvSpcfcFlts\\2");
  A_DBGR_R();
  A_DBGR_Go();

  /***************************************************************************************************************/
                                              // Test Step 1 Call TestCantrcv_GetCanTrcvSpcfcFlts with channel ID as 0
  /***************************************************************************************************************/
  snprintf( chActionText, elCount(chActionText), "Set Breakpoint in TestCantrcv_GetCanTrcvSpcfcFlts\\2 ");
  snprintf( chExpectedText, elCount(chExpectedText), "verify is Breakpoint Set TestCantrcv_GetCanTrcvSpcfcFlts\\2");

  A_DBGR_Go();

  snprintf( chActionText, elCount(chActionText), "verify Breakpoint should hit in TestCantrcv_GetCanTrcvSpcfcFlts\\2 ");
  snprintf( chExpectedText, elCount(chExpectedText), "Breakpoint hit in TestCantrcv_GetCanTrcvSpcfcFlts\\2 function");

  E_DBGR_BreakpointCheckForHalt("TestCantrcv_GetCanTrcvSpcfcFlts\\2");

  snprintf( chActionText, elCount(chActionText), "Flash the Software and ECU is running ");
  snprintf( chExpectedText, elCount(chExpectedText), "Ecu is should be in running state");
  TestStepAddActionExpected( chActionText, chExpectedText );
  A_DBGR_BreakpointDeleteAll();
  /***************************************************************************************************************/
                                              // Test Step 2 Set CheckCanTrcvSpcFaults value as 1
  /***************************************************************************************************************/

  snprintf( chActionText, elCount(chActionText), "Configure CheckCanTrcvSpcFaults values ");
  snprintf( chExpectedText, elCount(chExpectedText), "verify Configure CheckCanTrcvSpcFaults values");
  //TestStepAddActionExpected( chActionText, chExpectedText );
  A_DBGR_VariableSet("CheckCanTrcvSpcFaults","1");

  snprintf( chActionText, elCount(chActionText), "Configure CheckCanTrcvSpcFaults values ");
  snprintf( chExpectedText, elCount(chExpectedText), "verify Configure CheckCanTrcvSpcFaults values");
  //TestStepAddActionExpected( chActionText, chExpectedText );
  E_DBGR_VariableCheck("CheckCanTrcvSpcFaults",1,Equal);

   /***************************************************************************************************************/
                                              // Test Step 3 Call GetCNDD_e_CanTrcvSpcfcFlts and verify channel ID as 0
  /***************************************************************************************************************/

  snprintf( chActionText, elCount(chActionText), "Set Breakpoint in GetCNDD_e_CanTrcvSpcfcFlts ");
  snprintf( chExpectedText, elCount(chExpectedText), "verify is Breakpoint Set GetCNDD_e_CanTrcvSpcfcFlts");
  TestStepAddActionExpected( chActionText, chExpectedText );
  A_DBGR_BreakpointSet("GetCNDD_e_CanTrcvSpcfcFlts");

  snprintf( chActionText, elCount(chActionText), "Flash the Software and ECU is running ");
  snprintf( chExpectedText, elCount(chExpectedText), "Ecu is should be in running state");
  //TestStepAddActionExpected( chActionText, chExpectedText );
  A_DBGR_Go();

  snprintf( chActionText, elCount(chActionText), "verify Breakpoint should hit in GetCNDD_e_CanTrcvSpcfcFlts ");
  snprintf( chExpectedText, elCount(chExpectedText), "Breakpoint hit in GetCNDD_e_CanTrcvSpcfcFlts function");

  E_DBGR_BreakpointCheckForHalt("GetCNDD_e_CanTrcvSpcfcFlts");

  snprintf( chActionText, elCount(chActionText), "Flash the Software and ECU is running ");
  snprintf( chExpectedText, elCount(chExpectedText), "Ecu is should be in running state");
  TestStepAddActionExpected( chActionText, chExpectedText );
  A_DBGR_BreakpointDeleteAll();

  snprintf( chActionText, elCount(chActionText), "Configure Channel_ID values ");
  snprintf( chExpectedText, elCount(chExpectedText), "verify Configure Channel_ID values");
 // TestStepAddActionExpected( chActionText, chExpectedText );
  A_DBGR_VariableSet("Channel_ID","0");
  E_DBGR_VariableCheck("Channel_ID",0,Equal);

  /***************************************************************************************************************/
                                              // Test Step 4 Simulate Multiple Faults
  /***************************************************************************************************************/

  snprintf( chActionText, elCount(chActionText), "Configure CanTrcvFaultStatus[0].trcvSpcfcFlt.uVsupFltSts values ");
  snprintf( chExpectedText, elCount(chExpectedText), "verify Configure CanTrcvFaultStatus[0].trcvSpcfcFlt.uVsupFltSts values");
  TestStepAddActionExpected( chActionText, chExpectedText );
  A_DBGR_VariableSet("CanTrcvFaultStatus[0].trcvSpcfcFlt.uVccFltSts","1");
  E_DBGR_VariableCheck("CanTrcvFaultStatus[0].trcvSpcfcFlt.uVccFltSts",1,Equal);

  snprintf( chActionText, elCount(chActionText), "Configure CanTrcvFaultStatus[0].trcvSpcfcFlt.wkErrFltSts values ");
  snprintf( chExpectedText, elCount(chExpectedText), "verify Configure CanTrcvFaultStatus[0].trcvSpcfcFlt.wkErrFltSts values");
  TestStepAddActionExpected( chActionText, chExpectedText );
  A_DBGR_VariableSet("CanTrcvFaultStatus[0].trcvSpcfcFlt.TXDDOMFltSts","1");
  E_DBGR_VariableCheck("CanTrcvFaultStatus[0].trcvSpcfcFlt.TXDDOMFltSts",1,Equal);

  snprintf( chActionText, elCount(chActionText), "Set Breakpoint in TestCantrcv_GetCanTrcvSpcfcFlts\\2 ");
  snprintf( chExpectedText, elCount(chExpectedText), "verify is Breakpoint Set TestCantrcv_GetCanTrcvSpcfcFlts\\2");
  TestStepAddActionExpected( chActionText, chExpectedText );
  A_DBGR_BreakpointSet("TestCantrcv_GetCanTrcvSpcfcFlts\\2");
  A_DBGR_Go();

  snprintf( chActionText, elCount(chActionText), "verify Breakpoint should hit in TestCantrcv_GetCanTrcvSpcfcFlts\\2 ");
  snprintf( chExpectedText, elCount(chExpectedText), "Breakpoint hit in TestCantrcv_GetCanTrcvSpcfcFlts\\2 function");

  E_DBGR_BreakpointCheckForHalt("TestCantrcv_GetCanTrcvSpcfcFlts\\2");

  /***************************************************************************************************************/
                                              // Test Step 5 verify that value which represents CanTrcv_FaultStatus
  /***************************************************************************************************************/
  snprintf( chActionText, elCount(chActionText), "Configure CanTrcv_FaultStatus values ");
  snprintf( chExpectedText, elCount(chExpectedText), "verify Configure CanTrcv_FaultStatus values");
  TestStepAddActionExpected( chActionText, chExpectedText );
  E_DBGR_VariableCheck("CanTrcv_FaultStatus",9216,Equal);

}



testcase Verify_that_the_GetCNDD_e_CanTrcvSpcfcFlts_function_correctly_reports_multiple_fault_conditions_for_CANB_CAN8()
{
  /***************************************************************************************************************/
                                                // Variable Definition
  /***************************************************************************************************************/



  /***************************************************************************************************************/
                                               // Local Values
  /***************************************************************************************************************/



  /***************************************************************************************************************/
                                              // Test Case Info
  /***************************************************************************************************************/
  setWriteDbgLevel(DebugOff);
  snprintf( chTestTitle, elCount(chTestTitle), "Verify_that_the_GetCNDD_e_CanTrcvSpcfcFlts_function_correctly_reports_multiple_fault_conditions_for_CANB_CAN8" );
  snprintf( chTestDescription, elCount(chTestDescription), "Purpose:To check GetCNDD_e_CanTrcvSpcfcFlts ");
  TestCaseAddInfo( chTestTitle, "TC_L30SW_Q-36403682", chTestDescription );

  /***************************************************************************************************************/
                                              // Start of Test Case
  /***************************************************************************************************************/

  /***************************************************************************************************************/
                                              // Test Step 0 PRECONDITIONS
  /***************************************************************************************************************/
   snprintf( chActionText, elCount(chActionText), "Flash the Software and ECU is running ");
  snprintf( chExpectedText, elCount(chExpectedText), "Ecu is should be in running state");
  TestStepAddActionExpected( chActionText, chExpectedText );

  A_DBGR_BreakpointDeleteAll();
  A_DBGR_BreakpointSet("TestCantrcv_GetCanTrcvSpcfcFlts\\2");
  A_DBGR_R();
  A_DBGR_Go();

  /***************************************************************************************************************/
                                              // Test Step 1 Call TestCantrcv_GetCanTrcvSpcfcFlts with channel ID as 1
  /***************************************************************************************************************/
  snprintf( chActionText, elCount(chActionText), "Set Breakpoint in TestCantrcv_GetCanTrcvSpcfcFlts\\2 ");
  snprintf( chExpectedText, elCount(chExpectedText), "verify is Breakpoint Set TestCantrcv_GetCanTrcvSpcfcFlts\\2");

  A_DBGR_Go();

  snprintf( chActionText, elCount(chActionText), "verify Breakpoint should hit in TestCantrcv_GetCanTrcvSpcfcFlts\\2 ");
  snprintf( chExpectedText, elCount(chExpectedText), "Breakpoint hit in TestCantrcv_GetCanTrcvSpcfcFlts\\2 function");

  E_DBGR_BreakpointCheckForHalt("TestCantrcv_GetCanTrcvSpcfcFlts\\2");

  snprintf( chActionText, elCount(chActionText), "Flash the Software and ECU is running ");
  snprintf( chExpectedText, elCount(chExpectedText), "Ecu is should be in running state");
  TestStepAddActionExpected( chActionText, chExpectedText );
  A_DBGR_BreakpointDeleteAll();

  snprintf( chActionText, elCount(chActionText), "Configure Channel_ID values ");
  snprintf( chExpectedText, elCount(chExpectedText), "verify Configure Channel_ID values");
 // TestStepAddActionExpected( chActionText, chExpectedText );
  A_DBGR_VariableSet("Channel_ID","1");

  snprintf( chActionText, elCount(chActionText), "Configure Channel_ID values ");
  snprintf( chExpectedText, elCount(chExpectedText), "verify Configure Channel_ID values");
  //TestStepAddActionExpected( chActionText, chExpectedText );
  E_DBGR_VariableCheck("Channel_ID",1,Equal);


  /***************************************************************************************************************/
                                              // Test Step 2 Set CheckCanTrcvSpcFaults value as 1
  /***************************************************************************************************************/

  snprintf( chActionText, elCount(chActionText), "Configure CheckCanTrcvSpcFaults values ");
  snprintf( chExpectedText, elCount(chExpectedText), "verify Configure CheckCanTrcvSpcFaults values");
  TestStepAddActionExpected( chActionText, chExpectedText );
  A_DBGR_VariableSet("CheckCanTrcvSpcFaults","1");

  snprintf( chActionText, elCount(chActionText), "Configure CheckCanTrcvSpcFaults values ");
  snprintf( chExpectedText, elCount(chExpectedText), "verify Configure CheckCanTrcvSpcFaults values");
  //TestStepAddActionExpected( chActionText, chExpectedText );
  E_DBGR_VariableCheck("CheckCanTrcvSpcFaults",1,Equal);

   /***************************************************************************************************************/
                                              // Test Step 3 Call GetCNDD_e_CanTrcvSpcfcFlts and verify channel ID as 1
  /***************************************************************************************************************/

  snprintf( chActionText, elCount(chActionText), "Set Breakpoint in GetCNDD_e_CanTrcvSpcfcFlts ");
  snprintf( chExpectedText, elCount(chExpectedText), "verify is Breakpoint Set GetCNDD_e_CanTrcvSpcfcFlts");
  TestStepAddActionExpected( chActionText, chExpectedText );
  A_DBGR_BreakpointSet("GetCNDD_e_CanTrcvSpcfcFlts");

  snprintf( chActionText, elCount(chActionText), "Flash the Software and ECU is running ");
  snprintf( chExpectedText, elCount(chExpectedText), "Ecu is should be in running state");
  //TestStepAddActionExpected( chActionText, chExpectedText );
  A_DBGR_Go();

  snprintf( chActionText, elCount(chActionText), "verify Breakpoint should hit in GetCNDD_e_CanTrcvSpcfcFlts ");
  snprintf( chExpectedText, elCount(chExpectedText), "Breakpoint hit in GetCNDD_e_CanTrcvSpcfcFlts function");

  E_DBGR_BreakpointCheckForHalt("GetCNDD_e_CanTrcvSpcfcFlts");

  snprintf( chActionText, elCount(chActionText), "Flash the Software and ECU is running ");
  snprintf( chExpectedText, elCount(chExpectedText), "Ecu is should be in running state");
  TestStepAddActionExpected( chActionText, chExpectedText );
  A_DBGR_BreakpointDeleteAll();

  snprintf( chActionText, elCount(chActionText), "Configure Channel_ID values ");
  snprintf( chExpectedText, elCount(chExpectedText), "verify Configure Channel_ID values");
  //TestStepAddActionExpected( chActionText, chExpectedText );
  A_DBGR_VariableSet("Channel_ID","1");
  E_DBGR_VariableCheck("Channel_ID",1,Equal);

  /***************************************************************************************************************/
                                              // Test Step 4 Simulate Multiple Faults
  /***************************************************************************************************************/

  snprintf( chActionText, elCount(chActionText), "Configure CanTrcvFaultStatus[1].trcvSpcfcFlt.uVsupFltSts values ");
  snprintf( chExpectedText, elCount(chExpectedText), "verify Configure CanTrcvFaultStatus[1].trcvSpcfcFlt.uVsupFltSts values");
  TestStepAddActionExpected( chActionText, chExpectedText );
  A_DBGR_VariableSet("CanTrcvFaultStatus[1].trcvSpcfcFlt.uVccFltSts","1");
  E_DBGR_VariableCheck("CanTrcvFaultStatus[1].trcvSpcfcFlt.uVccFltSts",1,Equal);

  snprintf( chActionText, elCount(chActionText), "Configure CanTrcvFaultStatus[1].trcvSpcfcFlt.wkErrFltSts values ");
  snprintf( chExpectedText, elCount(chExpectedText), "verify Configure CanTrcvFaultStatus[1].trcvSpcfcFlt.wkErrFltSts values");
  TestStepAddActionExpected( chActionText, chExpectedText );
  A_DBGR_VariableSet("CanTrcvFaultStatus[1].trcvSpcfcFlt.TXDDOMFltSts","1");
  E_DBGR_VariableCheck("CanTrcvFaultStatus[1].trcvSpcfcFlt.TXDDOMFltSts",1,Equal);

    snprintf( chActionText, elCount(chActionText), "Set Breakpoint in TestCantrcv_GetCanTrcvSpcfcFlts\\2 ");
  snprintf( chExpectedText, elCount(chExpectedText), "verify is Breakpoint Set TestCantrcv_GetCanTrcvSpcfcFlts\\2");
  TestStepAddActionExpected( chActionText, chExpectedText );
  A_DBGR_BreakpointSet("TestCantrcv_GetCanTrcvSpcfcFlts\\2");
  A_DBGR_Go();

  snprintf( chActionText, elCount(chActionText), "verify Breakpoint should hit in TestCantrcv_GetCanTrcvSpcfcFlts\\2 ");
  snprintf( chExpectedText, elCount(chExpectedText), "Breakpoint hit in TestCantrcv_GetCanTrcvSpcfcFlts\\2 function");

  E_DBGR_BreakpointCheckForHalt("TestCantrcv_GetCanTrcvSpcfcFlts\\2");

  /***************************************************************************************************************/
                                              // Test Step 5 verify that value which represents CanTrcv_FaultStatus
  /***************************************************************************************************************/
  snprintf( chActionText, elCount(chActionText), "Configure CanTrcv_FaultStatus values ");
  snprintf( chExpectedText, elCount(chExpectedText), "verify Configure CanTrcv_FaultStatus values");
  TestStepAddActionExpected( chActionText, chExpectedText );
  E_DBGR_VariableCheck("CanTrcv_FaultStatus",9216,Equal);

}



testcase Verify_that_the_GetCNDD_e_CanTrcvSpcfcFlts_function_correctly_reports_CAN_TXD_line_stuck_dominant_error_status_for_CANB_CAN8()
{
  /***************************************************************************************************************/
                                                // Variable Definition
  /***************************************************************************************************************/



  /***************************************************************************************************************/
                                               // Local Values
  /***************************************************************************************************************/



  /***************************************************************************************************************/
                                              // Test Case Info
  /***************************************************************************************************************/
  setWriteDbgLevel(DebugOff);
  snprintf( chTestTitle, elCount(chTestTitle), "Verify_that_the_GetCNDD_e_CanTrcvSpcfcFlts_function_correctly_reports_CAN_TXD_line_stuck_dominant_error_status_for_CANB_CAN8" );
  snprintf( chTestDescription, elCount(chTestDescription), "Purpose:To check GetCNDD_e_CanTrcvSpcfcFlts ");
  TestCaseAddInfo( chTestTitle, "TC_L30SW_Q-36403686", chTestDescription );

  /***************************************************************************************************************/
                                              // Start of Test Case
  /***************************************************************************************************************/

  /***************************************************************************************************************/
                                              // Test Step 0 PRECONDITIONS
  /***************************************************************************************************************/
   snprintf( chActionText, elCount(chActionText), "Flash the Software and ECU is running ");
  snprintf( chExpectedText, elCount(chExpectedText), "Ecu is should be in running state");
  TestStepAddActionExpected( chActionText, chExpectedText );

  A_DBGR_BreakpointDeleteAll();
  A_DBGR_BreakpointSet("TestCantrcv_GetCanTrcvSpcfcFlts\\2");
  A_DBGR_R();
  A_DBGR_Go();

  /***************************************************************************************************************/
                                              // Test Step 1 Call TestCantrcv_GetCanTrcvSpcfcFlts with channel ID as 1
  /***************************************************************************************************************/
  snprintf( chActionText, elCount(chActionText), "Set Breakpoint in TestCantrcv_GetCanTrcvSpcfcFlts\\2 ");
  snprintf( chExpectedText, elCount(chExpectedText), "verify is Breakpoint Set TestCantrcv_GetCanTrcvSpcfcFlts\\2");

  A_DBGR_Go();

  snprintf( chActionText, elCount(chActionText), "verify Breakpoint should hit in TestCantrcv_GetCanTrcvSpcfcFlts\\2 ");
  snprintf( chExpectedText, elCount(chExpectedText), "Breakpoint hit in TestCantrcv_GetCanTrcvSpcfcFlts\\2 function");

  E_DBGR_BreakpointCheckForHalt("TestCantrcv_GetCanTrcvSpcfcFlts\\2");

  snprintf( chActionText, elCount(chActionText), "Flash the Software and ECU is running ");
  snprintf( chExpectedText, elCount(chExpectedText), "Ecu is should be in running state");
  TestStepAddActionExpected( chActionText, chExpectedText );
  A_DBGR_BreakpointDeleteAll();

  snprintf( chActionText, elCount(chActionText), "Configure Channel_ID values ");
  snprintf( chExpectedText, elCount(chExpectedText), "verify Configure Channel_ID values");
  //TestStepAddActionExpected( chActionText, chExpectedText );
  A_DBGR_VariableSet("Channel_ID","1");

  snprintf( chActionText, elCount(chActionText), "Configure Channel_ID values ");
  snprintf( chExpectedText, elCount(chExpectedText), "verify Configure Channel_ID values");
  //TestStepAddActionExpected( chActionText, chExpectedText );
  E_DBGR_VariableCheck("Channel_ID",1,Equal);


  /***************************************************************************************************************/
                                              // Test Step 2 Set CheckCanTrcvSpcFaults value as 1
  /***************************************************************************************************************/

  snprintf( chActionText, elCount(chActionText), "Configure CheckCanTrcvSpcFaults values ");
  snprintf( chExpectedText, elCount(chExpectedText), "verify Configure CheckCanTrcvSpcFaults values");
  TestStepAddActionExpected( chActionText, chExpectedText );
  A_DBGR_VariableSet("CheckCanTrcvSpcFaults","1");

  snprintf( chActionText, elCount(chActionText), "Configure CheckCanTrcvSpcFaults values ");
  snprintf( chExpectedText, elCount(chExpectedText), "verify Configure CheckCanTrcvSpcFaults values");
  //TestStepAddActionExpected( chActionText, chExpectedText );
  E_DBGR_VariableCheck("CheckCanTrcvSpcFaults",1,Equal);

   /***************************************************************************************************************/
                                              // Test Step 3 Call GetCNDD_e_CanTrcvSpcfcFlts and verify channel ID as 1
  /***************************************************************************************************************/

  snprintf( chActionText, elCount(chActionText), "Set Breakpoint in GetCNDD_e_CanTrcvSpcfcFlts ");
  snprintf( chExpectedText, elCount(chExpectedText), "verify is Breakpoint Set GetCNDD_e_CanTrcvSpcfcFlts");
  TestStepAddActionExpected( chActionText, chExpectedText );
  A_DBGR_BreakpointSet("GetCNDD_e_CanTrcvSpcfcFlts");

  snprintf( chActionText, elCount(chActionText), "Flash the Software and ECU is running ");
  snprintf( chExpectedText, elCount(chExpectedText), "Ecu is should be in running state");
  //TestStepAddActionExpected( chActionText, chExpectedText );
  A_DBGR_Go();

  snprintf( chActionText, elCount(chActionText), "verify Breakpoint should hit in GetCNDD_e_CanTrcvSpcfcFlts ");
  snprintf( chExpectedText, elCount(chExpectedText), "Breakpoint hit in GetCNDD_e_CanTrcvSpcfcFlts function");

  E_DBGR_BreakpointCheckForHalt("GetCNDD_e_CanTrcvSpcfcFlts");

  snprintf( chActionText, elCount(chActionText), "Flash the Software and ECU is running ");
  snprintf( chExpectedText, elCount(chExpectedText), "Ecu is should be in running state");
  TestStepAddActionExpected( chActionText, chExpectedText );
  A_DBGR_BreakpointDeleteAll();


  snprintf( chActionText, elCount(chActionText), "Configure Channel_ID values ");
  snprintf( chExpectedText, elCount(chExpectedText), "verify Configure Channel_ID values");
  //TestStepAddActionExpected( chActionText, chExpectedText );
  A_DBGR_VariableSet("Channel_ID","1");
  E_DBGR_VariableCheck("Channel_ID",1,Equal);

  /***************************************************************************************************************/
                                              // Test Step 4 Simulate CAN_bus_stuck_dominant_error
  /***************************************************************************************************************/

  snprintf( chActionText, elCount(chActionText), "Configure CanTrcvFaultStatus[1].trcvSpcfcFlt.canDomFltSts values ");
  snprintf( chExpectedText, elCount(chExpectedText), "verify Configure CanTrcvFaultStatus[1].trcvSpcfcFlt.canDomFltSts values");
  TestStepAddActionExpected( chActionText, chExpectedText );
  A_DBGR_VariableSet("CanTrcvFaultStatus[1].trcvSpcfcFlt.TXDDOMFltSts","1");
  E_DBGR_VariableCheck("CanTrcvFaultStatus[1].trcvSpcfcFlt.TXDDOMFltSts",1,Equal);

  snprintf( chActionText, elCount(chActionText), "Set Breakpoint in TestCantrcv_GetCanTrcvSpcfcFlts\\2 ");
  snprintf( chExpectedText, elCount(chExpectedText), "verify is Breakpoint Set TestCantrcv_GetCanTrcvSpcfcFlts\\2");
  TestStepAddActionExpected( chActionText, chExpectedText );
  A_DBGR_BreakpointSet("TestCantrcv_GetCanTrcvSpcfcFlts\\2");
  A_DBGR_Go();

  snprintf( chActionText, elCount(chActionText), "verify Breakpoint should hit in TestCantrcv_GetCanTrcvSpcfcFlts\\2 ");
  snprintf( chExpectedText, elCount(chExpectedText), "Breakpoint hit in TestCantrcv_GetCanTrcvSpcfcFlts\\2 function");

  E_DBGR_BreakpointCheckForHalt("TestCantrcv_GetCanTrcvSpcfcFlts\\2");

  /***************************************************************************************************************/
                                              // Test Step 5 verify that value which represents CanTrcv_FaultStatus
  /***************************************************************************************************************/
  snprintf( chActionText, elCount(chActionText), "Configure CanTrcv_FaultStatus values ");
  snprintf( chExpectedText, elCount(chExpectedText), "verify Configure CanTrcv_FaultStatus values");
  TestStepAddActionExpected( chActionText, chExpectedText );
  E_DBGR_VariableCheck("CanTrcv_FaultStatus",1024,Equal);


}
testcase Verify_that_the_GetCNDD_e_CanTrcvSpcfcFlts_function_correctly_reports_A_dominant_state_on_the_CAN_bus_lasting_for_CANA_CAN2()
{
   /***************************************************************************************************************/
                                                // Variable Definition
  /***************************************************************************************************************/



  /***************************************************************************************************************/
                                               // Local Values
  /***************************************************************************************************************/



  /***************************************************************************************************************/
                                              // Test Case Info
  /***************************************************************************************************************/
  setWriteDbgLevel(DebugOff);
  snprintf( chTestTitle, elCount(chTestTitle), "Verify_that_the_GetCNDD_e_CanTrcvSpcfcFlts_function_correctly_reports_A_dominant_state_on_the_CAN_bus_lasting_for_CANA_CAN2" );
  snprintf( chTestDescription, elCount(chTestDescription), "Purpose:To check GetCNDD_e_CanTrcvSpcfcFlts ");
  TestCaseAddInfo( chTestTitle, "TC_L30SW_Q-36403693", chTestDescription );

  /***************************************************************************************************************/
                                              // Start of Test Case
  /***************************************************************************************************************/

  /***************************************************************************************************************/
                                              // Test Step 0 PRECONDITIONS
  /***************************************************************************************************************/
   snprintf( chActionText, elCount(chActionText), "Flash the Software and ECU is running ");
  snprintf( chExpectedText, elCount(chExpectedText), "Ecu is should be in running state");
  TestStepAddActionExpected( chActionText, chExpectedText );

  A_DBGR_BreakpointDeleteAll();
  A_DBGR_BreakpointSet("TestCantrcv_GetCanTrcvSpcfcFlts\\2");
  A_DBGR_R();
  A_DBGR_Go();

  /***************************************************************************************************************/
                                              // Test Step 1 Call TestCantrcv_GetCanTrcvSpcfcFlts with channel ID as 1
  /***************************************************************************************************************/
  snprintf( chActionText, elCount(chActionText), "Set Breakpoint in TestCantrcv_GetCanTrcvSpcfcFlts\\2 ");
  snprintf( chExpectedText, elCount(chExpectedText), "verify is Breakpoint Set TestCantrcv_GetCanTrcvSpcfcFlts\\2");

  A_DBGR_Go();

  snprintf( chActionText, elCount(chActionText), "verify Breakpoint should hit in TestCantrcv_GetCanTrcvSpcfcFlts\\2 ");
  snprintf( chExpectedText, elCount(chExpectedText), "Breakpoint hit in TestCantrcv_GetCanTrcvSpcfcFlts\\2 function");

  E_DBGR_BreakpointCheckForHalt("TestCantrcv_GetCanTrcvSpcfcFlts\\2");

   snprintf( chActionText, elCount(chActionText), "Flash the Software and ECU is running ");
  snprintf( chExpectedText, elCount(chExpectedText), "Ecu is should be in running state");
  TestStepAddActionExpected( chActionText, chExpectedText );

  A_DBGR_BreakpointDeleteAll();

  snprintf( chActionText, elCount(chActionText), "Configure Channel_ID values ");
  snprintf( chExpectedText, elCount(chExpectedText), "verify Configure Channel_ID values");
  //TestStepAddActionExpected( chActionText, chExpectedText );
  A_DBGR_VariableSet("Channel_ID","1");

  snprintf( chActionText, elCount(chActionText), "Configure Channel_ID values ");
  snprintf( chExpectedText, elCount(chExpectedText), "verify Configure Channel_ID values");
  //TestStepAddActionExpected( chActionText, chExpectedText );
  E_DBGR_VariableCheck("Channel_ID",1,Equal);


  /***************************************************************************************************************/
                                              // Test Step 2 Set CheckCanTrcvSpcFaults value as 1
  /***************************************************************************************************************/

  snprintf( chActionText, elCount(chActionText), "Configure CheckCanTrcvSpcFaults values ");
  snprintf( chExpectedText, elCount(chExpectedText), "verify Configure CheckCanTrcvSpcFaults values");
  TestStepAddActionExpected( chActionText, chExpectedText );
  A_DBGR_VariableSet("CheckCanTrcvSpcFaults","1");

  snprintf( chActionText, elCount(chActionText), "Configure CheckCanTrcvSpcFaults values ");
  snprintf( chExpectedText, elCount(chExpectedText), "verify Configure CheckCanTrcvSpcFaults values");
  //TestStepAddActionExpected( chActionText, chExpectedText );
  E_DBGR_VariableCheck("CheckCanTrcvSpcFaults",1,Equal);

   /***************************************************************************************************************/
                                              // Test Step 3 Call GetCNDD_e_CanTrcvSpcfcFlts and verify channel ID as 1
  /***************************************************************************************************************/

  snprintf( chActionText, elCount(chActionText), "Set Breakpoint in GetCNDD_e_CanTrcvSpcfcFlts ");
  snprintf( chExpectedText, elCount(chExpectedText), "verify is Breakpoint Set GetCNDD_e_CanTrcvSpcfcFlts");
  TestStepAddActionExpected( chActionText, chExpectedText );
  A_DBGR_BreakpointSet("GetCNDD_e_CanTrcvSpcfcFlts");

  snprintf( chActionText, elCount(chActionText), "Flash the Software and ECU is running ");
  snprintf( chExpectedText, elCount(chExpectedText), "Ecu is should be in running state");
  //TestStepAddActionExpected( chActionText, chExpectedText );
  A_DBGR_Go();

  snprintf( chActionText, elCount(chActionText), "verify Breakpoint should hit in GetCNDD_e_CanTrcvSpcfcFlts ");
  snprintf( chExpectedText, elCount(chExpectedText), "Breakpoint hit in GetCNDD_e_CanTrcvSpcfcFlts function");

  E_DBGR_BreakpointCheckForHalt("GetCNDD_e_CanTrcvSpcfcFlts");

   snprintf( chActionText, elCount(chActionText), "Flash the Software and ECU is running ");
  snprintf( chExpectedText, elCount(chExpectedText), "Ecu is should be in running state");
  TestStepAddActionExpected( chActionText, chExpectedText );

  A_DBGR_BreakpointDeleteAll();

  snprintf( chActionText, elCount(chActionText), "Configure Channel_ID values ");
  snprintf( chExpectedText, elCount(chExpectedText), "verify Configure Channel_ID values");
  //TestStepAddActionExpected( chActionText, chExpectedText );
  A_DBGR_VariableSet("Channel_ID","1");
  E_DBGR_VariableCheck("Channel_ID",1,Equal);

  /***************************************************************************************************************/
                                              // Test Step 4 Simulate  thermal_shutdown_status
  /***************************************************************************************************************/

  snprintf( chActionText, elCount(chActionText), "Configure CanTrcvFaultStatus[1].trcvSpcfcFlt.tsdFltSts values ");
  snprintf( chExpectedText, elCount(chExpectedText), "verify Configure CanTrcvFaultStatus[1].trcvSpcfcFlt.tsdFltSts values");
  TestStepAddActionExpected( chActionText, chExpectedText );
  A_DBGR_VariableSet("CanTrcvFaultStatus[1].trcvSpcfcFlt.BUSDOMSFltSts","1");
  E_DBGR_VariableCheck("CanTrcvFaultStatus[1].trcvSpcfcFlt.BUSDOMSFltSts",1,Equal);

  snprintf( chActionText, elCount(chActionText), "Set Breakpoint in TestCantrcv_GetCanTrcvSpcfcFlts\\2 ");
  snprintf( chExpectedText, elCount(chExpectedText), "verify is Breakpoint Set TestCantrcv_GetCanTrcvSpcfcFlts\\2");
  TestStepAddActionExpected( chActionText, chExpectedText );
  A_DBGR_BreakpointSet("TestCantrcv_GetCanTrcvSpcfcFlts\\2");
  A_DBGR_Go();

  snprintf( chActionText, elCount(chActionText), "verify Breakpoint should hit in TestCantrcv_GetCanTrcvSpcfcFlts\\2 ");
  snprintf( chExpectedText, elCount(chExpectedText), "Breakpoint hit in TestCantrcv_GetCanTrcvSpcfcFlts\\2 function");

  E_DBGR_BreakpointCheckForHalt("TestCantrcv_GetCanTrcvSpcfcFlts\\2");

  /***************************************************************************************************************/
                                              // Test Step 5 verify that value which represents CanTrcv_FaultStatus
  /***************************************************************************************************************/
  snprintf( chActionText, elCount(chActionText), "Configure CanTrcv_FaultStatus values ");
  snprintf( chExpectedText, elCount(chExpectedText), "verify Configure CanTrcv_FaultStatus values");
  TestStepAddActionExpected( chActionText, chExpectedText );
  E_DBGR_VariableCheck("CanTrcv_FaultStatus",2048,Equal);
}


testcase Verify_that_the_GetCNDD_e_CanTrcvSpcfcFlts_function_correctly_reports_partial_networking_frame_detection_error_for_CANA_CAN2()
{
  /***************************************************************************************************************/
                                                // Variable Definition
  /***************************************************************************************************************/



  /***************************************************************************************************************/
                                               // Local Values
  /***************************************************************************************************************/



  /***************************************************************************************************************/
                                              // Test Case Info
  /***************************************************************************************************************/
  setWriteDbgLevel(DebugOff);
  snprintf( chTestTitle, elCount(chTestTitle), "Verify_that_the_GetCNDD_e_CanTrcvSpcfcFlts_function_correctly_reports_partial_networking_frame_detection_error_for_CANA_CAN2" );
  snprintf( chTestDescription, elCount(chTestDescription), "Purpose:To check GetCNDD_e_CanTrcvSpcfcFlts ");
  TestCaseAddInfo( chTestTitle, "TC_L30SW_Q-36403687", chTestDescription );

  /***************************************************************************************************************/
                                              // Start of Test Case
  /***************************************************************************************************************/

  /***************************************************************************************************************/
                                              // Test Step 0 PRECONDITIONS
  /***************************************************************************************************************/
   snprintf( chActionText, elCount(chActionText), "Flash the Software and ECU is running ");
  snprintf( chExpectedText, elCount(chExpectedText), "Ecu is should be in running state");
  TestStepAddActionExpected( chActionText, chExpectedText );

  A_DBGR_BreakpointDeleteAll();
  A_DBGR_BreakpointSet("TestCantrcv_GetCanTrcvSpcfcFlts\\2");
  A_DBGR_R();
  A_DBGR_Go();

  /***************************************************************************************************************/
                                              // Test Step 1 Call TestCantrcv_GetCanTrcvSpcfcFlts with channel ID as 0
  /***************************************************************************************************************/
  snprintf( chActionText, elCount(chActionText), "Set Breakpoint in TestCantrcv_GetCanTrcvSpcfcFlts\\2 ");
  snprintf( chExpectedText, elCount(chExpectedText), "verify is Breakpoint Set TestCantrcv_GetCanTrcvSpcfcFlts\\2");

  A_DBGR_Go();

  snprintf( chActionText, elCount(chActionText), "verify Breakpoint should hit in TestCantrcv_GetCanTrcvSpcfcFlts\\2 ");
  snprintf( chExpectedText, elCount(chExpectedText), "Breakpoint hit in TestCantrcv_GetCanTrcvSpcfcFlts\\2 function");

  E_DBGR_BreakpointCheckForHalt("TestCantrcv_GetCanTrcvSpcfcFlts\\2");

    snprintf( chActionText, elCount(chActionText), "Flash the Software and ECU is running ");
  snprintf( chExpectedText, elCount(chExpectedText), "Ecu is should be in running state");
  TestStepAddActionExpected( chActionText, chExpectedText );
  A_DBGR_BreakpointDeleteAll();
  /***************************************************************************************************************/
                                              // Test Step 2 Set CheckCanTrcvSpcFaults value as 1
  /***************************************************************************************************************/

  snprintf( chActionText, elCount(chActionText), "Configure CheckCanTrcvSpcFaults values ");
  snprintf( chExpectedText, elCount(chExpectedText), "verify Configure CheckCanTrcvSpcFaults values");
 // TestStepAddActionExpected( chActionText, chExpectedText );
  A_DBGR_VariableSet("CheckCanTrcvSpcFaults","1");

  snprintf( chActionText, elCount(chActionText), "Configure CheckCanTrcvSpcFaults values ");
  snprintf( chExpectedText, elCount(chExpectedText), "verify Configure CheckCanTrcvSpcFaults values");
  //TestStepAddActionExpected( chActionText, chExpectedText );
  E_DBGR_VariableCheck("CheckCanTrcvSpcFaults",1,Equal);

   /***************************************************************************************************************/
                                              // Test Step 3 Call GetCNDD_e_CanTrcvSpcfcFlts and verify channel ID as 0
  /***************************************************************************************************************/

  snprintf( chActionText, elCount(chActionText), "Set Breakpoint in GetCNDD_e_CanTrcvSpcfcFlts ");
  snprintf( chExpectedText, elCount(chExpectedText), "verify is Breakpoint Set GetCNDD_e_CanTrcvSpcfcFlts");
  TestStepAddActionExpected( chActionText, chExpectedText );
  A_DBGR_BreakpointSet("GetCNDD_e_CanTrcvSpcfcFlts");

  snprintf( chActionText, elCount(chActionText), "Flash the Software and ECU is running ");
  snprintf( chExpectedText, elCount(chExpectedText), "Ecu is should be in running state");
  //TestStepAddActionExpected( chActionText, chExpectedText );
  A_DBGR_Go();

  snprintf( chActionText, elCount(chActionText), "verify Breakpoint should hit in GetCNDD_e_CanTrcvSpcfcFlts ");
  snprintf( chExpectedText, elCount(chExpectedText), "Breakpoint hit in GetCNDD_e_CanTrcvSpcfcFlts function");

  E_DBGR_BreakpointCheckForHalt("GetCNDD_e_CanTrcvSpcfcFlts");

    snprintf( chActionText, elCount(chActionText), "Flash the Software and ECU is running ");
  snprintf( chExpectedText, elCount(chExpectedText), "Ecu is should be in running state");
  TestStepAddActionExpected( chActionText, chExpectedText );
  A_DBGR_BreakpointDeleteAll();

  snprintf( chActionText, elCount(chActionText), "Configure Channel_ID values ");
  snprintf( chExpectedText, elCount(chExpectedText), "verify Configure Channel_ID values");
  //TestStepAddActionExpected( chActionText, chExpectedText );
  A_DBGR_VariableSet("Channel_ID","0");
  E_DBGR_VariableCheck("Channel_ID",0,Equal);

  /***************************************************************************************************************/
                                      // Test Step 4 Simulate Framer error counter overflow
  /***************************************************************************************************************/

  snprintf( chActionText, elCount(chActionText), "Configure CanTrcvFaultStatus[0].trcvSpcfcFlt.frameOvfFltSts values ");
  snprintf( chExpectedText, elCount(chExpectedText), "verify Configure CanTrcvFaultStatus[0].trcvSpcfcFlt.frameOvfFltSts values");
  TestStepAddActionExpected( chActionText, chExpectedText );
  A_DBGR_VariableSet("CanTrcvFaultStatus[0].trcvSpcfcFlt.pnfderFltSts","1");
  E_DBGR_VariableCheck("CanTrcvFaultStatus[0].trcvSpcfcFlt.pnfderFltSts",1,Equal);

  snprintf( chActionText, elCount(chActionText), "Set Breakpoint in TestCantrcv_GetCanTrcvSpcfcFlts\\2 ");
  snprintf( chExpectedText, elCount(chExpectedText), "verify is Breakpoint Set TestCantrcv_GetCanTrcvSpcfcFlts\\2");
  TestStepAddActionExpected( chActionText, chExpectedText );
  A_DBGR_BreakpointSet("TestCantrcv_GetCanTrcvSpcfcFlts\\2");
  A_DBGR_Go();

  snprintf( chActionText, elCount(chActionText), "verify Breakpoint should hit in TestCantrcv_GetCanTrcvSpcfcFlts\\2 ");
  snprintf( chExpectedText, elCount(chExpectedText), "Breakpoint hit in TestCantrcv_GetCanTrcvSpcfcFlts\\2 function");

  E_DBGR_BreakpointCheckForHalt("TestCantrcv_GetCanTrcvSpcfcFlts\\2");

  /***************************************************************************************************************/
                                              // Test Step 5 verify that value which represents CanTrcv_FaultStatus
  /***************************************************************************************************************/
  snprintf( chActionText, elCount(chActionText), "Configure CanTrcv_FaultStatus values ");
  snprintf( chExpectedText, elCount(chExpectedText), "verify Configure CanTrcv_FaultStatus values");
  TestStepAddActionExpected( chActionText, chExpectedText );
  E_DBGR_VariableCheck("CanTrcv_FaultStatus",512,Equal);


}



testcase Verify_that_the_GetCNDD_e_CanTrcvSpcfcFlts_function_correctly_reports_partial_networking_frame_detection_error_for_CANB_CAN8()
{
  /***************************************************************************************************************/
                                                // Variable Definition
  /***************************************************************************************************************/



  /***************************************************************************************************************/
                                               // Local Values
  /***************************************************************************************************************/



  /***************************************************************************************************************/
                                              // Test Case Info
  /***************************************************************************************************************/
  setWriteDbgLevel(DebugOff);
  snprintf( chTestTitle, elCount(chTestTitle), "Verify_that_the_GetCNDD_e_CanTrcvSpcfcFlts_function_correctly_reports_partial_networking_frame_detection_error_for_CANB_CAN8" );
  snprintf( chTestDescription, elCount(chTestDescription), "Purpose:To check GetCNDD_e_CanTrcvSpcfcFlts ");
  TestCaseAddInfo( chTestTitle, "TC_L30SW_Q-36403688", chTestDescription );

  /***************************************************************************************************************/
                                              // Start of Test Case
  /***************************************************************************************************************/

  /***************************************************************************************************************/
                                              // Test Step 0 PRECONDITIONS
  /***************************************************************************************************************/
   snprintf( chActionText, elCount(chActionText), "Flash the Software and ECU is running ");
  snprintf( chExpectedText, elCount(chExpectedText), "Ecu is should be in running state");
  TestStepAddActionExpected( chActionText, chExpectedText );

  A_DBGR_BreakpointDeleteAll();
  A_DBGR_BreakpointSet("TestCantrcv_GetCanTrcvSpcfcFlts\\2");
  A_DBGR_R();
  A_DBGR_Go();

  /***************************************************************************************************************/
                                              // Test Step 1 Call TestCantrcv_GetCanTrcvSpcfcFlts with channel ID as 1
  /***************************************************************************************************************/
  snprintf( chActionText, elCount(chActionText), "Set Breakpoint in TestCantrcv_GetCanTrcvSpcfcFlts\\2 ");
  snprintf( chExpectedText, elCount(chExpectedText), "verify is Breakpoint Set TestCantrcv_GetCanTrcvSpcfcFlts\\2");

  A_DBGR_Go();

  snprintf( chActionText, elCount(chActionText), "verify Breakpoint should hit in TestCantrcv_GetCanTrcvSpcfcFlts\\2 ");
  snprintf( chExpectedText, elCount(chExpectedText), "Breakpoint hit in TestCantrcv_GetCanTrcvSpcfcFlts\\2 function");

  E_DBGR_BreakpointCheckForHalt("TestCantrcv_GetCanTrcvSpcfcFlts\\2");

  snprintf( chActionText, elCount(chActionText), "Configure Channel_ID values ");
  snprintf( chExpectedText, elCount(chExpectedText), "verify Configure Channel_ID values");
  TestStepAddActionExpected( chActionText, chExpectedText );
  A_DBGR_VariableSet("Channel_ID","1");

  snprintf( chActionText, elCount(chActionText), "Configure Channel_ID values ");
  snprintf( chExpectedText, elCount(chExpectedText), "verify Configure Channel_ID values");
  //TestStepAddActionExpected( chActionText, chExpectedText );
  E_DBGR_VariableCheck("Channel_ID",1,Equal);

  snprintf( chActionText, elCount(chActionText), "Flash the Software and ECU is running ");
  snprintf( chExpectedText, elCount(chExpectedText), "Ecu is should be in running state");
  TestStepAddActionExpected( chActionText, chExpectedText );

  A_DBGR_BreakpointDeleteAll();
  /***************************************************************************************************************/
                                              // Test Step 2 Set CheckCanTrcvSpcFaults value as 1
  /***************************************************************************************************************/

  snprintf( chActionText, elCount(chActionText), "Configure CheckCanTrcvSpcFaults values ");
  snprintf( chExpectedText, elCount(chExpectedText), "verify Configure CheckCanTrcvSpcFaults values");
  //TestStepAddActionExpected( chActionText, chExpectedText );
  A_DBGR_VariableSet("CheckCanTrcvSpcFaults","1");

  snprintf( chActionText, elCount(chActionText), "Configure CheckCanTrcvSpcFaults values ");
  snprintf( chExpectedText, elCount(chExpectedText), "verify Configure CheckCanTrcvSpcFaults values");
  //TestStepAddActionExpected( chActionText, chExpectedText );
  E_DBGR_VariableCheck("CheckCanTrcvSpcFaults",1,Equal);

   /***************************************************************************************************************/
                                              // Test Step 3 Call GetCNDD_e_CanTrcvSpcfcFlts and verify channel ID as 1
  /***************************************************************************************************************/

  snprintf( chActionText, elCount(chActionText), "Set Breakpoint in GetCNDD_e_CanTrcvSpcfcFlts ");
  snprintf( chExpectedText, elCount(chExpectedText), "verify is Breakpoint Set GetCNDD_e_CanTrcvSpcfcFlts");
  TestStepAddActionExpected( chActionText, chExpectedText );
  A_DBGR_BreakpointSet("GetCNDD_e_CanTrcvSpcfcFlts");

  snprintf( chActionText, elCount(chActionText), "Flash the Software and ECU is running ");
  snprintf( chExpectedText, elCount(chExpectedText), "Ecu is should be in running state");
  //TestStepAddActionExpected( chActionText, chExpectedText );
  A_DBGR_Go();

  snprintf( chActionText, elCount(chActionText), "verify Breakpoint should hit in GetCNDD_e_CanTrcvSpcfcFlts ");
  snprintf( chExpectedText, elCount(chExpectedText), "Breakpoint hit in GetCNDD_e_CanTrcvSpcfcFlts function");

  E_DBGR_BreakpointCheckForHalt("GetCNDD_e_CanTrcvSpcfcFlts");

  snprintf( chActionText, elCount(chActionText), "Configure Channel_ID values ");
  snprintf( chExpectedText, elCount(chExpectedText), "verify Configure Channel_ID values");
  TestStepAddActionExpected( chActionText, chExpectedText );
  A_DBGR_VariableSet("Channel_ID","1");
  E_DBGR_VariableCheck("Channel_ID",1,Equal);

  /***************************************************************************************************************/
                                            // Test Step 4 Simulate Framer error counter overflow
  /***************************************************************************************************************/

  snprintf( chActionText, elCount(chActionText), "Configure CanTrcvFaultStatus[1].trcvSpcfcFlt.frameOvfFltSts values ");
  snprintf( chExpectedText, elCount(chExpectedText), "verify Configure CanTrcvFaultStatus[1].trcvSpcfcFlt.frameOvfFltSts values");
  TestStepAddActionExpected( chActionText, chExpectedText );
  A_DBGR_VariableSet("CanTrcvFaultStatus[1].trcvSpcfcFlt.pnfderFltSts","1");
  E_DBGR_VariableCheck("CanTrcvFaultStatus[1].trcvSpcfcFlt.pnfderFltSts",1,Equal);

   snprintf( chActionText, elCount(chActionText), "Flash the Software and ECU is running ");
  snprintf( chExpectedText, elCount(chExpectedText), "Ecu is should be in running state");
  TestStepAddActionExpected( chActionText, chExpectedText );
  A_DBGR_BreakpointDeleteAll();
  A_DBGR_BreakpointSet("TestCantrcv_GetCanTrcvSpcfcFlts\\2");

  snprintf( chActionText, elCount(chActionText), "Set Breakpoint in TestCantrcv_GetCanTrcvSpcfcFlts\\2 ");
  snprintf( chExpectedText, elCount(chExpectedText), "verify is Breakpoint Set TestCantrcv_GetCanTrcvSpcfcFlts\\2");
  //TestStepAddActionExpected( chActionText, chExpectedText );
  A_DBGR_Go();

  snprintf( chActionText, elCount(chActionText), "verify Breakpoint should hit in TestCantrcv_GetCanTrcvSpcfcFlts\\2 ");
  snprintf( chExpectedText, elCount(chExpectedText), "Breakpoint hit in TestCantrcv_GetCanTrcvSpcfcFlts\\2 function");

  E_DBGR_BreakpointCheckForHalt("TestCantrcv_GetCanTrcvSpcfcFlts\\2");
  /***************************************************************************************************************/
                                              // Test Step 5 verify that value which represents CanTrcv_FaultStatus
  /***************************************************************************************************************/
  snprintf( chActionText, elCount(chActionText), "Configure CanTrcv_FaultStatus values ");
  snprintf( chExpectedText, elCount(chExpectedText), "verify Configure CanTrcv_FaultStatus values");
  TestStepAddActionExpected( chActionText, chExpectedText );
  E_DBGR_VariableCheck("CanTrcv_FaultStatus",512,Equal);
}



testcase Verify_that_the_GetCNDD_e_CanTrcvSpcfcFlts_function_correctly_reports_Vio_under_voltage_status_conditions_for_CANA_CAN2()
{
  /***************************************************************************************************************/
                                                // Variable Definition
  /***************************************************************************************************************/



  /***************************************************************************************************************/
                                               // Local Values
  /***************************************************************************************************************/



  /***************************************************************************************************************/
                                              // Test Case Info
  /***************************************************************************************************************/
  setWriteDbgLevel(DebugOff);
  snprintf( chTestTitle, elCount(chTestTitle), "Verify_that_the_GetCNDD_e_CanTrcvSpcfcFlts_function_correctly_reports_Vio_under_voltage_status_conditions_for_CANA_CAN2" );
  snprintf( chTestDescription, elCount(chTestDescription), "Purpose:To check GetCNDD_e_CanTrcvSpcfcFlts ");
  TestCaseAddInfo( chTestTitle, "TC_L30SW_Q-36403689", chTestDescription );

  /***************************************************************************************************************/
                                              // Start of Test Case
  /***************************************************************************************************************/

  /***************************************************************************************************************/
                                              // Test Step 0 PRECONDITIONS
  /***************************************************************************************************************/
   snprintf( chActionText, elCount(chActionText), "Flash the Software and ECU is running ");
  snprintf( chExpectedText, elCount(chExpectedText), "Ecu is should be in running state");
  TestStepAddActionExpected( chActionText, chExpectedText );

  A_DBGR_BreakpointDeleteAll();
  A_DBGR_BreakpointSet("TestCantrcv_GetCanTrcvSpcfcFlts\\2");
  A_DBGR_R();
  A_DBGR_Go();

  /***************************************************************************************************************/
                                              // Test Step 1 Call TestCantrcv_GetCanTrcvSpcfcFlts with channel ID as 0
  /***************************************************************************************************************/
  snprintf( chActionText, elCount(chActionText), "Set Breakpoint in TestCantrcv_GetCanTrcvSpcfcFlts\\2 ");
  snprintf( chExpectedText, elCount(chExpectedText), "verify is Breakpoint Set TestCantrcv_GetCanTrcvSpcfcFlts\\2");

  A_DBGR_Go();

  snprintf( chActionText, elCount(chActionText), "verify Breakpoint should hit in TestCantrcv_GetCanTrcvSpcfcFlts\\2 ");
  snprintf( chExpectedText, elCount(chExpectedText), "Breakpoint hit in TestCantrcv_GetCanTrcvSpcfcFlts\\2 function");

  E_DBGR_BreakpointCheckForHalt("TestCantrcv_GetCanTrcvSpcfcFlts\\2");

  /***************************************************************************************************************/
                                              // Test Step 2 Set CheckCanTrcvSpcFaults value as 1
  /***************************************************************************************************************/

  snprintf( chActionText, elCount(chActionText), "Configure CheckCanTrcvSpcFaults values ");
  snprintf( chExpectedText, elCount(chExpectedText), "verify Configure CheckCanTrcvSpcFaults values");
  TestStepAddActionExpected( chActionText, chExpectedText );
  A_DBGR_VariableSet("CheckCanTrcvSpcFaults","1");

  snprintf( chActionText, elCount(chActionText), "Configure CheckCanTrcvSpcFaults values ");
  snprintf( chExpectedText, elCount(chExpectedText), "verify Configure CheckCanTrcvSpcFaults values");
  //TestStepAddActionExpected( chActionText, chExpectedText );
  E_DBGR_VariableCheck("CheckCanTrcvSpcFaults",1,Equal);

  snprintf( chActionText, elCount(chActionText), "Flash the Software and ECU is running ");
  snprintf( chExpectedText, elCount(chExpectedText), "Ecu is should be in running state");
  TestStepAddActionExpected( chActionText, chExpectedText );
  A_DBGR_BreakpointDeleteAll();
  A_DBGR_BreakpointSet("GetCNDD_e_CanTrcvSpcfcFlts");
   /***************************************************************************************************************/
                                              // Test Step 3 Call GetCNDD_e_CanTrcvSpcfcFlts and verify channel ID as 0
  /***************************************************************************************************************/

  snprintf( chActionText, elCount(chActionText), "Set Breakpoint in GetCNDD_e_CanTrcvSpcfcFlts ");
  snprintf( chExpectedText, elCount(chExpectedText), "verify is Breakpoint Set GetCNDD_e_CanTrcvSpcfcFlts");
  //TestStepAddActionExpected( chActionText, chExpectedText );

  snprintf( chActionText, elCount(chActionText), "Flash the Software and ECU is running ");
  snprintf( chExpectedText, elCount(chExpectedText), "Ecu is should be in running state");
  //TestStepAddActionExpected( chActionText, chExpectedText );
  A_DBGR_Go();

  snprintf( chActionText, elCount(chActionText), "verify Breakpoint should hit in GetCNDD_e_CanTrcvSpcfcFlts ");
  snprintf( chExpectedText, elCount(chExpectedText), "Breakpoint hit in GetCNDD_e_CanTrcvSpcfcFlts function");

  E_DBGR_BreakpointCheckForHalt("GetCNDD_e_CanTrcvSpcfcFlts");

   snprintf( chActionText, elCount(chActionText), "Flash the Software and ECU is running ");
  snprintf( chExpectedText, elCount(chExpectedText), "Ecu is should be in running state");
  TestStepAddActionExpected( chActionText, chExpectedText );

  A_DBGR_BreakpointDeleteAll();

  snprintf( chActionText, elCount(chActionText), "Configure Channel_ID values ");
  snprintf( chExpectedText, elCount(chExpectedText), "verify Configure Channel_ID values");
  //TestStepAddActionExpected( chActionText, chExpectedText );
  A_DBGR_VariableSet("Channel_ID","0");
  E_DBGR_VariableCheck("Channel_ID",0,Equal);

  /***************************************************************************************************************/
                                   // Test Step 4 Simulate Vio_under_voltage
  /***************************************************************************************************************/

  snprintf( chActionText, elCount(chActionText), "Configure CanTrcvFaultStatus[0].trcvSpcfcFlt.uVioFltSts values ");
  snprintf( chExpectedText, elCount(chExpectedText), "verify Configure CanTrcvFaultStatus[0].trcvSpcfcFlt.uVioFltSts values");
  TestStepAddActionExpected( chActionText, chExpectedText );
  A_DBGR_VariableSet("CanTrcvFaultStatus[0].trcvSpcfcFlt.uVioFltSts","1");
  E_DBGR_VariableCheck("CanTrcvFaultStatus[0].trcvSpcfcFlt.uVioFltSts",1,Equal);

  snprintf( chActionText, elCount(chActionText), "Set Breakpoint in TestCantrcv_GetCanTrcvSpcfcFlts\\2 ");
  snprintf( chExpectedText, elCount(chExpectedText), "verify is Breakpoint Set TestCantrcv_GetCanTrcvSpcfcFlts\\2");
  TestStepAddActionExpected( chActionText, chExpectedText );
  A_DBGR_BreakpointSet("TestCantrcv_GetCanTrcvSpcfcFlts\\2");
  A_DBGR_Go();

  snprintf( chActionText, elCount(chActionText), "verify Breakpoint should hit in TestCantrcv_GetCanTrcvSpcfcFlts\\2 ");
  snprintf( chExpectedText, elCount(chExpectedText), "Breakpoint hit in TestCantrcv_GetCanTrcvSpcfcFlts\\2 function");

  E_DBGR_BreakpointCheckForHalt("TestCantrcv_GetCanTrcvSpcfcFlts\\2");

  /***************************************************************************************************************/
                                              // Test Step 5 verify that value which represents CanTrcv_FaultStatus
  /***************************************************************************************************************/
  snprintf( chActionText, elCount(chActionText), "Configure CanTrcv_FaultStatus values ");
  snprintf( chExpectedText, elCount(chExpectedText), "verify Configure CanTrcv_FaultStatus values");
  TestStepAddActionExpected( chActionText, chExpectedText );
  E_DBGR_VariableCheck("CanTrcv_FaultStatus",4096,Equal);


}



testcase Verify_that_the_GetCNDD_e_CanTrcvSpcfcFlts_function_correctly_reports_Vio_under_voltage_status_conditions_for_CANB_CAN8()
{
  /***************************************************************************************************************/
                                                // Variable Definition
  /***************************************************************************************************************/



  /***************************************************************************************************************/
                                               // Local Values
  /***************************************************************************************************************/



  /***************************************************************************************************************/
                                              // Test Case Info
  /***************************************************************************************************************/
  setWriteDbgLevel(DebugOff);
  snprintf( chTestTitle, elCount(chTestTitle), "Verify_that_the_GetCNDD_e_CanTrcvSpcfcFlts_function_correctly_reports_Vio_under_voltage_status_conditions_for_CANB_CAN8" );
  snprintf( chTestDescription, elCount(chTestDescription), "Purpose:To check GetCNDD_e_CanTrcvSpcfcFlts ");
  TestCaseAddInfo( chTestTitle, "TC_L30SW_Q-36403690", chTestDescription );

  /***************************************************************************************************************/
                                              // Start of Test Case
  /***************************************************************************************************************/

  /***************************************************************************************************************/
                                              // Test Step 0 PRECONDITIONS
  /***************************************************************************************************************/
   snprintf( chActionText, elCount(chActionText), "Flash the Software and ECU is running ");
  snprintf( chExpectedText, elCount(chExpectedText), "Ecu is should be in running state");
  TestStepAddActionExpected( chActionText, chExpectedText );

  A_DBGR_BreakpointDeleteAll();
  A_DBGR_BreakpointSet("TestCantrcv_GetCanTrcvSpcfcFlts\\2");
  A_DBGR_R();
  A_DBGR_Go();

  /***************************************************************************************************************/
                                              // Test Step 1 Call TestCantrcv_GetCanTrcvSpcfcFlts with channel ID as 1
  /***************************************************************************************************************/
  snprintf( chActionText, elCount(chActionText), "Set Breakpoint in TestCantrcv_GetCanTrcvSpcfcFlts\\2 ");
  snprintf( chExpectedText, elCount(chExpectedText), "verify is Breakpoint Set TestCantrcv_GetCanTrcvSpcfcFlts\\2");

  A_DBGR_Go();

  snprintf( chActionText, elCount(chActionText), "verify Breakpoint should hit in TestCantrcv_GetCanTrcvSpcfcFlts\\2 ");
  snprintf( chExpectedText, elCount(chExpectedText), "Breakpoint hit in TestCantrcv_GetCanTrcvSpcfcFlts\\2 function");

  E_DBGR_BreakpointCheckForHalt("TestCantrcv_GetCanTrcvSpcfcFlts\\2");

  snprintf( chActionText, elCount(chActionText), "Configure Channel_ID values ");
  snprintf( chExpectedText, elCount(chExpectedText), "verify Configure Channel_ID values");
  TestStepAddActionExpected( chActionText, chExpectedText );
  A_DBGR_VariableSet("Channel_ID","1");

  snprintf( chActionText, elCount(chActionText), "Configure Channel_ID values ");
  snprintf( chExpectedText, elCount(chExpectedText), "verify Configure Channel_ID values");
  //TestStepAddActionExpected( chActionText, chExpectedText );
  E_DBGR_VariableCheck("Channel_ID",1,Equal);

   snprintf( chActionText, elCount(chActionText), "Flash the Software and ECU is running ");
  snprintf( chExpectedText, elCount(chExpectedText), "Ecu is should be in running state");
  TestStepAddActionExpected( chActionText, chExpectedText );

  A_DBGR_BreakpointDeleteAll();

  /***************************************************************************************************************/
                                              // Test Step 2 Set CheckCanTrcvSpcFaults value as 1
  /***************************************************************************************************************/

  snprintf( chActionText, elCount(chActionText), "Configure CheckCanTrcvSpcFaults values ");
  snprintf( chExpectedText, elCount(chExpectedText), "verify Configure CheckCanTrcvSpcFaults values");
  //TestStepAddActionExpected( chActionText, chExpectedText );
  A_DBGR_VariableSet("CheckCanTrcvSpcFaults","1");

  snprintf( chActionText, elCount(chActionText), "Configure CheckCanTrcvSpcFaults values ");
  snprintf( chExpectedText, elCount(chExpectedText), "verify Configure CheckCanTrcvSpcFaults values");
  //TestStepAddActionExpected( chActionText, chExpectedText );
  E_DBGR_VariableCheck("CheckCanTrcvSpcFaults",1,Equal);

   /***************************************************************************************************************/
                                              // Test Step 3 Call GetCNDD_e_CanTrcvSpcfcFlts and verify channel ID as 1
  /***************************************************************************************************************/

  snprintf( chActionText, elCount(chActionText), "Set Breakpoint in GetCNDD_e_CanTrcvSpcfcFlts ");
  snprintf( chExpectedText, elCount(chExpectedText), "verify is Breakpoint Set GetCNDD_e_CanTrcvSpcfcFlts");
  TestStepAddActionExpected( chActionText, chExpectedText );
  A_DBGR_BreakpointSet("GetCNDD_e_CanTrcvSpcfcFlts");

  snprintf( chActionText, elCount(chActionText), "Flash the Software and ECU is running ");
  snprintf( chExpectedText, elCount(chExpectedText), "Ecu is should be in running state");
  //TestStepAddActionExpected( chActionText, chExpectedText );
  A_DBGR_Go();

  snprintf( chActionText, elCount(chActionText), "verify Breakpoint should hit in GetCNDD_e_CanTrcvSpcfcFlts ");
  snprintf( chExpectedText, elCount(chExpectedText), "Breakpoint hit in GetCNDD_e_CanTrcvSpcfcFlts function");

  E_DBGR_BreakpointCheckForHalt("GetCNDD_e_CanTrcvSpcfcFlts");

  snprintf( chActionText, elCount(chActionText), "Flash the Software and ECU is running ");
  snprintf( chExpectedText, elCount(chExpectedText), "Ecu is should be in running state");
  TestStepAddActionExpected( chActionText, chExpectedText );

  A_DBGR_BreakpointDeleteAll();

  snprintf( chActionText, elCount(chActionText), "Configure Channel_ID values ");
  snprintf( chExpectedText, elCount(chExpectedText), "verify Configure Channel_ID values");
  //TestStepAddActionExpected( chActionText, chExpectedText );
  A_DBGR_VariableSet("Channel_ID","1");
  E_DBGR_VariableCheck("Channel_ID",1,Equal);

  /***************************************************************************************************************/
                                             // Test Step 4 Simulate  Vio under voltage
  /***************************************************************************************************************/

  snprintf( chActionText, elCount(chActionText), "Configure CanTrcvFaultStatus[1].trcvSpcfcFlt.frameOvfFltSts values ");
  snprintf( chExpectedText, elCount(chExpectedText), "verify Configure CanTrcvFaultStatus[1].trcvSpcfcFlt.frameOvfFltSts values");
  TestStepAddActionExpected( chActionText, chExpectedText );
  A_DBGR_VariableSet("CanTrcvFaultStatus[1].trcvSpcfcFlt.uVioFltSts","1");
  E_DBGR_VariableCheck("CanTrcvFaultStatus[1].trcvSpcfcFlt.uVioFltSts",1,Equal);

  snprintf( chActionText, elCount(chActionText), "Set Breakpoint in TestCantrcv_GetCanTrcvSpcfcFlts\\2 ");
  snprintf( chExpectedText, elCount(chExpectedText), "verify is Breakpoint Set TestCantrcv_GetCanTrcvSpcfcFlts\\2");
  TestStepAddActionExpected( chActionText, chExpectedText );
  A_DBGR_BreakpointSet("TestCantrcv_GetCanTrcvSpcfcFlts\\2");
  A_DBGR_Go();

  snprintf( chActionText, elCount(chActionText), "verify Breakpoint should hit in TestCantrcv_GetCanTrcvSpcfcFlts\\2 ");
  snprintf( chExpectedText, elCount(chExpectedText), "Breakpoint hit in TestCantrcv_GetCanTrcvSpcfcFlts\\2 function");

  E_DBGR_BreakpointCheckForHalt("TestCantrcv_GetCanTrcvSpcfcFlts\\2");

  /***************************************************************************************************************/
                                              // Test Step 5 verify that value which represents CanTrcv_FaultStatus
  /***************************************************************************************************************/
  snprintf( chActionText, elCount(chActionText), "Configure CanTrcv_FaultStatus values ");
  snprintf( chExpectedText, elCount(chExpectedText), "verify Configure CanTrcv_FaultStatus values");
  TestStepAddActionExpected( chActionText, chExpectedText );
  E_DBGR_VariableCheck("CanTrcv_FaultStatus",4096,Equal);
}



testcase Verify_that_the_GetCNDD_e_CanTrcvSpcfcFlts_function_correctly_reports_Vcc_under_voltage_status_conditions_for_CANA_CAN2()
{
  /***************************************************************************************************************/
                                                // Variable Definition
  /***************************************************************************************************************/



  /***************************************************************************************************************/
                                               // Local Values
  /***************************************************************************************************************/



  /***************************************************************************************************************/
                                              // Test Case Info
  /***************************************************************************************************************/
  setWriteDbgLevel(DebugOff);
  snprintf( chTestTitle, elCount(chTestTitle), "Verify_that_the_GetCNDD_e_CanTrcvSpcfcFlts_function_correctly_reports_Vcc_under_voltage_status_conditions_for_CANA_CAN2" );
  snprintf( chTestDescription, elCount(chTestDescription), "Purpose:To check GetCNDD_e_CanTrcvSpcfcFlts ");
  TestCaseAddInfo( chTestTitle, "TC_L30SW_Q-36403691", chTestDescription );

  /***************************************************************************************************************/
                                              // Start of Test Case
  /***************************************************************************************************************/

  /***************************************************************************************************************/
                                              // Test Step 0 PRECONDITIONS
  /***************************************************************************************************************/
   snprintf( chActionText, elCount(chActionText), "Flash the Software and ECU is running ");
  snprintf( chExpectedText, elCount(chExpectedText), "Ecu is should be in running state");
  TestStepAddActionExpected( chActionText, chExpectedText );

  A_DBGR_BreakpointDeleteAll();
  A_DBGR_BreakpointSet("TestCantrcv_GetCanTrcvSpcfcFlts\\2");
  A_DBGR_R();
  A_DBGR_Go();

  /***************************************************************************************************************/
                                              // Test Step 1 Call TestCantrcv_GetCanTrcvSpcfcFlts with channel ID as 0
  /***************************************************************************************************************/
  snprintf( chActionText, elCount(chActionText), "Set Breakpoint in TestCantrcv_GetCanTrcvSpcfcFlts\\2 ");
  snprintf( chExpectedText, elCount(chExpectedText), "verify is Breakpoint Set TestCantrcv_GetCanTrcvSpcfcFlts\\2");

  A_DBGR_Go();

  snprintf( chActionText, elCount(chActionText), "verify Breakpoint should hit in TestCantrcv_GetCanTrcvSpcfcFlts\\2 ");
  snprintf( chExpectedText, elCount(chExpectedText), "Breakpoint hit in TestCantrcv_GetCanTrcvSpcfcFlts\\2 function");

  E_DBGR_BreakpointCheckForHalt("TestCantrcv_GetCanTrcvSpcfcFlts\\2");

   snprintf( chActionText, elCount(chActionText), "Flash the Software and ECU is running ");
  snprintf( chExpectedText, elCount(chExpectedText), "Ecu is should be in running state");
  TestStepAddActionExpected( chActionText, chExpectedText );

  A_DBGR_BreakpointDeleteAll();
  /***************************************************************************************************************/
                                              // Test Step 2 Set CheckCanTrcvSpcFaults value as 1
  /***************************************************************************************************************/

  snprintf( chActionText, elCount(chActionText), "Configure CheckCanTrcvSpcFaults values ");
  snprintf( chExpectedText, elCount(chExpectedText), "verify Configure CheckCanTrcvSpcFaults values");
  //TestStepAddActionExpected( chActionText, chExpectedText );
  A_DBGR_VariableSet("CheckCanTrcvSpcFaults","1");

  snprintf( chActionText, elCount(chActionText), "Configure CheckCanTrcvSpcFaults values ");
  snprintf( chExpectedText, elCount(chExpectedText), "verify Configure CheckCanTrcvSpcFaults values");
  //TestStepAddActionExpected( chActionText, chExpectedText );
  E_DBGR_VariableCheck("CheckCanTrcvSpcFaults",1,Equal);

   /***************************************************************************************************************/
                                              // Test Step 3 Call GetCNDD_e_CanTrcvSpcfcFlts and verify channel ID as 0
  /***************************************************************************************************************/

  snprintf( chActionText, elCount(chActionText), "Set Breakpoint in GetCNDD_e_CanTrcvSpcfcFlts ");
  snprintf( chExpectedText, elCount(chExpectedText), "verify is Breakpoint Set GetCNDD_e_CanTrcvSpcfcFlts");
  TestStepAddActionExpected( chActionText, chExpectedText );
  A_DBGR_BreakpointSet("GetCNDD_e_CanTrcvSpcfcFlts");

  snprintf( chActionText, elCount(chActionText), "Flash the Software and ECU is running ");
  snprintf( chExpectedText, elCount(chExpectedText), "Ecu is should be in running state");
  //TestStepAddActionExpected( chActionText, chExpectedText );
  A_DBGR_Go();

  snprintf( chActionText, elCount(chActionText), "verify Breakpoint should hit in GetCNDD_e_CanTrcvSpcfcFlts ");
  snprintf( chExpectedText, elCount(chExpectedText), "Breakpoint hit in GetCNDD_e_CanTrcvSpcfcFlts function");

  E_DBGR_BreakpointCheckForHalt("GetCNDD_e_CanTrcvSpcfcFlts");

  snprintf( chActionText, elCount(chActionText), "Configure Channel_ID values ");
  snprintf( chExpectedText, elCount(chExpectedText), "verify Configure Channel_ID values");
  TestStepAddActionExpected( chActionText, chExpectedText );
  A_DBGR_VariableSet("Channel_ID","0");
  E_DBGR_VariableCheck("Channel_ID",0,Equal);

  snprintf( chActionText, elCount(chActionText), "Flash the Software and ECU is running ");
  snprintf( chExpectedText, elCount(chExpectedText), "Ecu is should be in running state");
  TestStepAddActionExpected( chActionText, chExpectedText );

  A_DBGR_BreakpointDeleteAll();
  /***************************************************************************************************************/
                                             // Test Step 4 Simulate Vcc under voltage
  /***************************************************************************************************************/

  snprintf( chActionText, elCount(chActionText), "Configure CanTrcvFaultStatus[0].trcvSpcfcFlt.uVccFltSts values ");
  snprintf( chExpectedText, elCount(chExpectedText), "verify Configure CanTrcvFaultStatus[0].trcvSpcfcFlt.uVccFltSts values");
  //TestStepAddActionExpected( chActionText, chExpectedText );
  A_DBGR_VariableSet("CanTrcvFaultStatus[0].trcvSpcfcFlt.uVccFltSts","1");
  E_DBGR_VariableCheck("CanTrcvFaultStatus[0].trcvSpcfcFlt.uVccFltSts",1,Equal);

  snprintf( chActionText, elCount(chActionText), "Set Breakpoint in TestCantrcv_GetCanTrcvSpcfcFlts\\2 ");
  snprintf( chExpectedText, elCount(chExpectedText), "verify is Breakpoint Set TestCantrcv_GetCanTrcvSpcfcFlts\\2");
  TestStepAddActionExpected( chActionText, chExpectedText );
  A_DBGR_BreakpointSet("TestCantrcv_GetCanTrcvSpcfcFlts\\2");
  A_DBGR_Go();

  snprintf( chActionText, elCount(chActionText), "verify Breakpoint should hit in TestCantrcv_GetCanTrcvSpcfcFlts\\2 ");
  snprintf( chExpectedText, elCount(chExpectedText), "Breakpoint hit in TestCantrcv_GetCanTrcvSpcfcFlts\\2 function");

  E_DBGR_BreakpointCheckForHalt("TestCantrcv_GetCanTrcvSpcfcFlts\\2");

  /***************************************************************************************************************/
                                              // Test Step 5 verify that value which represents CanTrcv_FaultStatus
  /***************************************************************************************************************/
  snprintf( chActionText, elCount(chActionText), "Configure CanTrcv_FaultStatus values ");
  snprintf( chExpectedText, elCount(chExpectedText), "verify Configure CanTrcv_FaultStatus values");
  TestStepAddActionExpected( chActionText, chExpectedText );
  E_DBGR_VariableCheck("CanTrcv_FaultStatus",8192,Equal);


}



testcase Verify_that_the_GetCNDD_e_CanTrcvSpcfcFlts_function_correctly_reports_Vcc_under_voltage_status_conditions_for_CANB_CAN8()
{
  /***************************************************************************************************************/
                                                // Variable Definition
  /***************************************************************************************************************/



  /***************************************************************************************************************/
                                               // Local Values
  /***************************************************************************************************************/



  /***************************************************************************************************************/
                                              // Test Case Info
  /***************************************************************************************************************/
  setWriteDbgLevel(DebugOff);
  snprintf( chTestTitle, elCount(chTestTitle), "Verify_that_the_GetCNDD_e_CanTrcvSpcfcFlts_function_correctly_reports_Vio_under_voltage_status_conditions_for_CANB_CAN8" );
  snprintf( chTestDescription, elCount(chTestDescription), "Purpose:To check GetCNDD_e_CanTrcvSpcfcFlts ");
  TestCaseAddInfo( chTestTitle, "TC_L30SW_Q-36403690", chTestDescription );

  /***************************************************************************************************************/
                                              // Start of Test Case
  /***************************************************************************************************************/

  /***************************************************************************************************************/
                                              // Test Step 0 PRECONDITIONS
  /***************************************************************************************************************/
   snprintf( chActionText, elCount(chActionText), "Flash the Software and ECU is running ");
  snprintf( chExpectedText, elCount(chExpectedText), "Ecu is should be in running state");
  TestStepAddActionExpected( chActionText, chExpectedText );

  A_DBGR_BreakpointDeleteAll();
  A_DBGR_BreakpointSet("TestCantrcv_GetCanTrcvSpcfcFlts\\2");
  A_DBGR_R();
  A_DBGR_Go();

  /***************************************************************************************************************/
                                              // Test Step 1 Call TestCantrcv_GetCanTrcvSpcfcFlts with channel ID as 1
  /***************************************************************************************************************/
  snprintf( chActionText, elCount(chActionText), "Set Breakpoint in TestCantrcv_GetCanTrcvSpcfcFlts\\2 ");
  snprintf( chExpectedText, elCount(chExpectedText), "verify is Breakpoint Set TestCantrcv_GetCanTrcvSpcfcFlts\\2");

  A_DBGR_Go();

  snprintf( chActionText, elCount(chActionText), "verify Breakpoint should hit in TestCantrcv_GetCanTrcvSpcfcFlts\\2 ");
  snprintf( chExpectedText, elCount(chExpectedText), "Breakpoint hit in TestCantrcv_GetCanTrcvSpcfcFlts\\2 function");

  E_DBGR_BreakpointCheckForHalt("TestCantrcv_GetCanTrcvSpcfcFlts\\2");

  snprintf( chActionText, elCount(chActionText), "Configure Channel_ID values ");
  snprintf( chExpectedText, elCount(chExpectedText), "verify Configure Channel_ID values");
  TestStepAddActionExpected( chActionText, chExpectedText );
  A_DBGR_VariableSet("Channel_ID","1");

  snprintf( chActionText, elCount(chActionText), "Configure Channel_ID values ");
  snprintf( chExpectedText, elCount(chExpectedText), "verify Configure Channel_ID values");
  //TestStepAddActionExpected( chActionText, chExpectedText );
  E_DBGR_VariableCheck("Channel_ID",1,Equal);


  /***************************************************************************************************************/
                                              // Test Step 2 Set CheckCanTrcvSpcFaults value as 1
  /***************************************************************************************************************/

  snprintf( chActionText, elCount(chActionText), "Configure CheckCanTrcvSpcFaults values ");
  snprintf( chExpectedText, elCount(chExpectedText), "verify Configure CheckCanTrcvSpcFaults values");
  TestStepAddActionExpected( chActionText, chExpectedText );
  A_DBGR_VariableSet("CheckCanTrcvSpcFaults","1");

  snprintf( chActionText, elCount(chActionText), "Configure CheckCanTrcvSpcFaults values ");
  snprintf( chExpectedText, elCount(chExpectedText), "verify Configure CheckCanTrcvSpcFaults values");
  //TestStepAddActionExpected( chActionText, chExpectedText );
  E_DBGR_VariableCheck("CheckCanTrcvSpcFaults",1,Equal);

  snprintf( chActionText, elCount(chActionText), "Flash the Software and ECU is running ");
  snprintf( chExpectedText, elCount(chExpectedText), "Ecu is should be in running state");
  TestStepAddActionExpected( chActionText, chExpectedText );

  A_DBGR_BreakpointDeleteAll();
  A_DBGR_BreakpointSet("GetCNDD_e_CanTrcvSpcfcFlts");
   /***************************************************************************************************************/
                                              // Test Step 3 Call GetCNDD_e_CanTrcvSpcfcFlts and verify channel ID as 1
  /***************************************************************************************************************/

  snprintf( chActionText, elCount(chActionText), "Set Breakpoint in GetCNDD_e_CanTrcvSpcfcFlts ");
  snprintf( chExpectedText, elCount(chExpectedText), "verify is Breakpoint Set GetCNDD_e_CanTrcvSpcfcFlts");
  //TestStepAddActionExpected( chActionText, chExpectedText );

  snprintf( chActionText, elCount(chActionText), "Flash the Software and ECU is running ");
  snprintf( chExpectedText, elCount(chExpectedText), "Ecu is should be in running state");
  //TestStepAddActionExpected( chActionText, chExpectedText );
  A_DBGR_Go();

  snprintf( chActionText, elCount(chActionText), "verify Breakpoint should hit in GetCNDD_e_CanTrcvSpcfcFlts ");
  snprintf( chExpectedText, elCount(chExpectedText), "Breakpoint hit in GetCNDD_e_CanTrcvSpcfcFlts function");

  E_DBGR_BreakpointCheckForHalt("GetCNDD_e_CanTrcvSpcfcFlts");

  snprintf( chActionText, elCount(chActionText), "Flash the Software and ECU is running ");
  snprintf( chExpectedText, elCount(chExpectedText), "Ecu is should be in running state");
  TestStepAddActionExpected( chActionText, chExpectedText );
  A_DBGR_BreakpointDeleteAll();

  snprintf( chActionText, elCount(chActionText), "Configure Channel_ID values ");
  snprintf( chExpectedText, elCount(chExpectedText), "verify Configure Channel_ID values");
  //TestStepAddActionExpected( chActionText, chExpectedText );
  A_DBGR_VariableSet("Channel_ID","1");
  E_DBGR_VariableCheck("Channel_ID",1,Equal);

  /***************************************************************************************************************/
                                              // Test Step 4 Simulate  Vcc under voltage
  /***************************************************************************************************************/

  snprintf( chActionText, elCount(chActionText), "Configure CanTrcvFaultStatus[1].trcvSpcfcFlt.uVccFltSts values ");
  snprintf( chExpectedText, elCount(chExpectedText), "verify Configure CanTrcvFaultStatus[1].trcvSpcfcFlt.uVccFltSts values");
  TestStepAddActionExpected( chActionText, chExpectedText );
  A_DBGR_VariableSet("CanTrcvFaultStatus[1].trcvSpcfcFlt.uVccFltSts","1");
  E_DBGR_VariableCheck("CanTrcvFaultStatus[1].trcvSpcfcFlt.uVccFltSts",1,Equal);

  snprintf( chActionText, elCount(chActionText), "Set Breakpoint in TestCantrcv_GetCanTrcvSpcfcFlts\\2 ");
  snprintf( chExpectedText, elCount(chExpectedText), "verify is Breakpoint Set TestCantrcv_GetCanTrcvSpcfcFlts\\2");
  TestStepAddActionExpected( chActionText, chExpectedText );
  A_DBGR_BreakpointSet("TestCantrcv_GetCanTrcvSpcfcFlts\\2");
  A_DBGR_Go();

  snprintf( chActionText, elCount(chActionText), "verify Breakpoint should hit in TestCantrcv_GetCanTrcvSpcfcFlts\\2 ");
  snprintf( chExpectedText, elCount(chExpectedText), "Breakpoint hit in TestCantrcv_GetCanTrcvSpcfcFlts\\2 function");

  E_DBGR_BreakpointCheckForHalt("TestCantrcv_GetCanTrcvSpcfcFlts\\2");

  /***************************************************************************************************************/
                                              // Test Step 5 verify that value which represents CanTrcv_FaultStatus
  /***************************************************************************************************************/
  snprintf( chActionText, elCount(chActionText), "Configure CanTrcv_FaultStatus values ");
  snprintf( chExpectedText, elCount(chExpectedText), "verify Configure CanTrcv_FaultStatus values");
  TestStepAddActionExpected( chActionText, chExpectedText );
  E_DBGR_VariableCheck("CanTrcv_FaultStatus",8192,Equal);
}

testcase Verify_that_the_GetCNDD_e_CanTrcvSpcfcFlts_function_correctly_reports_A_dominant_state_on_the_CAN_bus_lasting_for_CANA_CAN()
{
  /***************************************************************************************************************/
                                                // Variable Definition
  /***************************************************************************************************************/



  /***************************************************************************************************************/
                                               // Local Values
  /***************************************************************************************************************/



  /***************************************************************************************************************/
                                              // Test Case Info
  /***************************************************************************************************************/
  setWriteDbgLevel(DebugOff);
  snprintf( chTestTitle, elCount(chTestTitle), "Verify_that_the_GetCNDD_e_CanTrcvSpcfcFlts_function_correctly_reports_A_dominant_state_on_the_CAN_bus_lasting_for_CANA_CAN2" );
  snprintf( chTestDescription, elCount(chTestDescription), "Purpose:To check GetCNDD_e_CanTrcvSpcfcFlts ");
  TestCaseAddInfo( chTestTitle, "TC_L30SW_Q-36403693", chTestDescription );

  /***************************************************************************************************************/
                                              // Start of Test Case
  /***************************************************************************************************************/

  /***************************************************************************************************************/
                                              // Test Step 0 PRECONDITIONS
  /***************************************************************************************************************/
   snprintf( chActionText, elCount(chActionText), "Flash the Software and ECU is running ");
  snprintf( chExpectedText, elCount(chExpectedText), "Ecu is should be in running state");
  TestStepAddActionExpected( chActionText, chExpectedText );

  A_DBGR_BreakpointDeleteAll();
  A_DBGR_BreakpointSet("TestCantrcv_GetCanTrcvSpcfcFlts\\2");
  A_DBGR_R();
  A_DBGR_Go();

  /***************************************************************************************************************/
                                              // Test Step 1 Call TestCantrcv_GetCanTrcvSpcfcFlts with channel ID as 1
  /***************************************************************************************************************/
  snprintf( chActionText, elCount(chActionText), "Set Breakpoint in TestCantrcv_GetCanTrcvSpcfcFlts\\2 ");
  snprintf( chExpectedText, elCount(chExpectedText), "verify is Breakpoint Set TestCantrcv_GetCanTrcvSpcfcFlts\\2");

  A_DBGR_Go();

  snprintf( chActionText, elCount(chActionText), "verify Breakpoint should hit in TestCantrcv_GetCanTrcvSpcfcFlts\\2 ");
  snprintf( chExpectedText, elCount(chExpectedText), "Breakpoint hit in TestCantrcv_GetCanTrcvSpcfcFlts\\2 function");

  E_DBGR_BreakpointCheckForHalt("TestCantrcv_GetCanTrcvSpcfcFlts\\2");

   snprintf( chActionText, elCount(chActionText), "Flash the Software and ECU is running ");
  snprintf( chExpectedText, elCount(chExpectedText), "Ecu is should be in running state");
  TestStepAddActionExpected( chActionText, chExpectedText );

  A_DBGR_BreakpointDeleteAll();

  snprintf( chActionText, elCount(chActionText), "Configure Channel_ID values ");
  snprintf( chExpectedText, elCount(chExpectedText), "verify Configure Channel_ID values");
  //TestStepAddActionExpected( chActionText, chExpectedText );
  A_DBGR_VariableSet("Channel_ID","1");

  snprintf( chActionText, elCount(chActionText), "Configure Channel_ID values ");
  snprintf( chExpectedText, elCount(chExpectedText), "verify Configure Channel_ID values");
  //TestStepAddActionExpected( chActionText, chExpectedText );
  E_DBGR_VariableCheck("Channel_ID",1,Equal);


  /***************************************************************************************************************/
                                              // Test Step 2 Set CheckCanTrcvSpcFaults value as 1
  /***************************************************************************************************************/

  snprintf( chActionText, elCount(chActionText), "Configure CheckCanTrcvSpcFaults values ");
  snprintf( chExpectedText, elCount(chExpectedText), "verify Configure CheckCanTrcvSpcFaults values");
  TestStepAddActionExpected( chActionText, chExpectedText );
  A_DBGR_VariableSet("CheckCanTrcvSpcFaults","1");

  snprintf( chActionText, elCount(chActionText), "Configure CheckCanTrcvSpcFaults values ");
  snprintf( chExpectedText, elCount(chExpectedText), "verify Configure CheckCanTrcvSpcFaults values");
  //TestStepAddActionExpected( chActionText, chExpectedText );
  E_DBGR_VariableCheck("CheckCanTrcvSpcFaults",1,Equal);

   /***************************************************************************************************************/
                                              // Test Step 3 Call GetCNDD_e_CanTrcvSpcfcFlts and verify channel ID as 1
  /***************************************************************************************************************/

  snprintf( chActionText, elCount(chActionText), "Set Breakpoint in GetCNDD_e_CanTrcvSpcfcFlts ");
  snprintf( chExpectedText, elCount(chExpectedText), "verify is Breakpoint Set GetCNDD_e_CanTrcvSpcfcFlts");
  TestStepAddActionExpected( chActionText, chExpectedText );
  A_DBGR_BreakpointSet("GetCNDD_e_CanTrcvSpcfcFlts");

  snprintf( chActionText, elCount(chActionText), "Flash the Software and ECU is running ");
  snprintf( chExpectedText, elCount(chExpectedText), "Ecu is should be in running state");
  //TestStepAddActionExpected( chActionText, chExpectedText );
  A_DBGR_Go();

  snprintf( chActionText, elCount(chActionText), "verify Breakpoint should hit in GetCNDD_e_CanTrcvSpcfcFlts ");
  snprintf( chExpectedText, elCount(chExpectedText), "Breakpoint hit in GetCNDD_e_CanTrcvSpcfcFlts function");

  E_DBGR_BreakpointCheckForHalt("GetCNDD_e_CanTrcvSpcfcFlts");

   snprintf( chActionText, elCount(chActionText), "Flash the Software and ECU is running ");
  snprintf( chExpectedText, elCount(chExpectedText), "Ecu is should be in running state");
  TestStepAddActionExpected( chActionText, chExpectedText );

  A_DBGR_BreakpointDeleteAll();

  snprintf( chActionText, elCount(chActionText), "Configure Channel_ID values ");
  snprintf( chExpectedText, elCount(chExpectedText), "verify Configure Channel_ID values");
  //TestStepAddActionExpected( chActionText, chExpectedText );
  A_DBGR_VariableSet("Channel_ID","1");
  E_DBGR_VariableCheck("Channel_ID",1,Equal);

  /***************************************************************************************************************/
                                              // Test Step 4 Simulate  thermal_shutdown_status
  /***************************************************************************************************************/

  snprintf( chActionText, elCount(chActionText), "Configure CanTrcvFaultStatus[1].trcvSpcfcFlt.tsdFltSts values ");
  snprintf( chExpectedText, elCount(chExpectedText), "verify Configure CanTrcvFaultStatus[1].trcvSpcfcFlt.tsdFltSts values");
  TestStepAddActionExpected( chActionText, chExpectedText );
  A_DBGR_VariableSet("CanTrcvFaultStatus[1].trcvSpcfcFlt.BUSDOMSFltSts","1");
  E_DBGR_VariableCheck("CanTrcvFaultStatus[1].trcvSpcfcFlt.BUSDOMSFltSts",1,Equal);

  snprintf( chActionText, elCount(chActionText), "Set Breakpoint in TestCantrcv_GetCanTrcvSpcfcFlts\\2 ");
  snprintf( chExpectedText, elCount(chExpectedText), "verify is Breakpoint Set TestCantrcv_GetCanTrcvSpcfcFlts\\2");
  TestStepAddActionExpected( chActionText, chExpectedText );
  A_DBGR_BreakpointSet("TestCantrcv_GetCanTrcvSpcfcFlts\\2");
  A_DBGR_Go();

  snprintf( chActionText, elCount(chActionText), "verify Breakpoint should hit in TestCantrcv_GetCanTrcvSpcfcFlts\\2 ");
  snprintf( chExpectedText, elCount(chExpectedText), "Breakpoint hit in TestCantrcv_GetCanTrcvSpcfcFlts\\2 function");

  E_DBGR_BreakpointCheckForHalt("TestCantrcv_GetCanTrcvSpcfcFlts\\2");

  /***************************************************************************************************************/
                                              // Test Step 5 verify that value which represents CanTrcv_FaultStatus
  /***************************************************************************************************************/
  snprintf( chActionText, elCount(chActionText), "Configure CanTrcv_FaultStatus values ");
  snprintf( chExpectedText, elCount(chExpectedText), "verify Configure CanTrcv_FaultStatus values");
  TestStepAddActionExpected( chActionText, chExpectedText );
  E_DBGR_VariableCheck("CanTrcv_FaultStatus",2048,Equal);
}




testcase Verify_that_the_GetCNDD_e_CanTrcvSpcfcFlts_function_correctly_reports_A_dominant_state_on_the_CAN_bus_lasting_for_CANB_CAN8()
{
  /***************************************************************************************************************/
                                                // Variable Definition
  /***************************************************************************************************************/



  /***************************************************************************************************************/
                                               // Local Values
  /***************************************************************************************************************/



  /***************************************************************************************************************/
                                              // Test Case Info
  /***************************************************************************************************************/
  setWriteDbgLevel(DebugOff);
  snprintf( chTestTitle, elCount(chTestTitle), "Verify_that_the_GetCNDD_e_CanTrcvSpcfcFlts_function_correctly_reports_A_dominant_state_on_the_CAN_bus_lasting_for_CANB_CAN8" );
  snprintf( chTestDescription, elCount(chTestDescription), "Purpose:To check GetCNDD_e_CanTrcvSpcfcFlts ");
  TestCaseAddInfo( chTestTitle, "TC_L30SW_Q-36403694", chTestDescription );

  /***************************************************************************************************************/
                                              // Start of Test Case
  /***************************************************************************************************************/

  /***************************************************************************************************************/
                                              // Test Step 0 PRECONDITIONS
  /***************************************************************************************************************/
   snprintf( chActionText, elCount(chActionText), "Flash the Software and ECU is running ");
  snprintf( chExpectedText, elCount(chExpectedText), "Ecu is should be in running state");
  TestStepAddActionExpected( chActionText, chExpectedText );

  A_DBGR_BreakpointDeleteAll();
  A_DBGR_BreakpointSet("TestCantrcv_GetCanTrcvSpcfcFlts\\2");
  A_DBGR_R();
  A_DBGR_Go();

  /***************************************************************************************************************/
                                              // Test Step 1 Call TestCantrcv_GetCanTrcvSpcfcFlts with channel ID as 1
  /***************************************************************************************************************/
  snprintf( chActionText, elCount(chActionText), "Set Breakpoint in TestCantrcv_GetCanTrcvSpcfcFlts\\2 ");
  snprintf( chExpectedText, elCount(chExpectedText), "verify is Breakpoint Set TestCantrcv_GetCanTrcvSpcfcFlts\\2");

  A_DBGR_Go();

  snprintf( chActionText, elCount(chActionText), "verify Breakpoint should hit in TestCantrcv_GetCanTrcvSpcfcFlts\\2 ");
  snprintf( chExpectedText, elCount(chExpectedText), "Breakpoint hit in TestCantrcv_GetCanTrcvSpcfcFlts\\2 function");

  E_DBGR_BreakpointCheckForHalt("TestCantrcv_GetCanTrcvSpcfcFlts\\2");

   snprintf( chActionText, elCount(chActionText), "Flash the Software and ECU is running ");
  snprintf( chExpectedText, elCount(chExpectedText), "Ecu is should be in running state");
  TestStepAddActionExpected( chActionText, chExpectedText );

  A_DBGR_BreakpointDeleteAll();

  snprintf( chActionText, elCount(chActionText), "Configure Channel_ID values ");
  snprintf( chExpectedText, elCount(chExpectedText), "verify Configure Channel_ID values");
  //TestStepAddActionExpected( chActionText, chExpectedText );
  A_DBGR_VariableSet("Channel_ID","1");

  snprintf( chActionText, elCount(chActionText), "Configure Channel_ID values ");
  snprintf( chExpectedText, elCount(chExpectedText), "verify Configure Channel_ID values");
  //TestStepAddActionExpected( chActionText, chExpectedText );
  E_DBGR_VariableCheck("Channel_ID",1,Equal);


  /***************************************************************************************************************/
                                              // Test Step 2 Set CheckCanTrcvSpcFaults value as 1
  /***************************************************************************************************************/

  snprintf( chActionText, elCount(chActionText), "Configure CheckCanTrcvSpcFaults values ");
  snprintf( chExpectedText, elCount(chExpectedText), "verify Configure CheckCanTrcvSpcFaults values");
  TestStepAddActionExpected( chActionText, chExpectedText );
  A_DBGR_VariableSet("CheckCanTrcvSpcFaults","1");

  snprintf( chActionText, elCount(chActionText), "Configure CheckCanTrcvSpcFaults values ");
  snprintf( chExpectedText, elCount(chExpectedText), "verify Configure CheckCanTrcvSpcFaults values");
  //TestStepAddActionExpected( chActionText, chExpectedText );
  E_DBGR_VariableCheck("CheckCanTrcvSpcFaults",1,Equal);

   /***************************************************************************************************************/
                                              // Test Step 3 Call GetCNDD_e_CanTrcvSpcfcFlts and verify channel ID as 1
  /***************************************************************************************************************/

  snprintf( chActionText, elCount(chActionText), "Set Breakpoint in GetCNDD_e_CanTrcvSpcfcFlts ");
  snprintf( chExpectedText, elCount(chExpectedText), "verify is Breakpoint Set GetCNDD_e_CanTrcvSpcfcFlts");
  TestStepAddActionExpected( chActionText, chExpectedText );
  A_DBGR_BreakpointSet("GetCNDD_e_CanTrcvSpcfcFlts");

  snprintf( chActionText, elCount(chActionText), "Flash the Software and ECU is running ");
  snprintf( chExpectedText, elCount(chExpectedText), "Ecu is should be in running state");
  //TestStepAddActionExpected( chActionText, chExpectedText );
  A_DBGR_Go();

  snprintf( chActionText, elCount(chActionText), "verify Breakpoint should hit in GetCNDD_e_CanTrcvSpcfcFlts ");
  snprintf( chExpectedText, elCount(chExpectedText), "Breakpoint hit in GetCNDD_e_CanTrcvSpcfcFlts function");

  E_DBGR_BreakpointCheckForHalt("GetCNDD_e_CanTrcvSpcfcFlts");

   snprintf( chActionText, elCount(chActionText), "Flash the Software and ECU is running ");
  snprintf( chExpectedText, elCount(chExpectedText), "Ecu is should be in running state");
  TestStepAddActionExpected( chActionText, chExpectedText );

  A_DBGR_BreakpointDeleteAll();

  snprintf( chActionText, elCount(chActionText), "Configure Channel_ID values ");
  snprintf( chExpectedText, elCount(chExpectedText), "verify Configure Channel_ID values");
  //TestStepAddActionExpected( chActionText, chExpectedText );
  A_DBGR_VariableSet("Channel_ID","1");
  E_DBGR_VariableCheck("Channel_ID",1,Equal);

  /***************************************************************************************************************/
                                              // Test Step 4 Simulate  thermal_shutdown_status
  /***************************************************************************************************************/

  snprintf( chActionText, elCount(chActionText), "Configure CanTrcvFaultStatus[1].trcvSpcfcFlt.tsdFltSts values ");
  snprintf( chExpectedText, elCount(chExpectedText), "verify Configure CanTrcvFaultStatus[1].trcvSpcfcFlt.tsdFltSts values");
  TestStepAddActionExpected( chActionText, chExpectedText );
  A_DBGR_VariableSet("CanTrcvFaultStatus[1].trcvSpcfcFlt.BUSDOMSFltSts","1");
  E_DBGR_VariableCheck("CanTrcvFaultStatus[1].trcvSpcfcFlt.BUSDOMSFltSts",1,Equal);

  snprintf( chActionText, elCount(chActionText), "Set Breakpoint in TestCantrcv_GetCanTrcvSpcfcFlts\\2 ");
  snprintf( chExpectedText, elCount(chExpectedText), "verify is Breakpoint Set TestCantrcv_GetCanTrcvSpcfcFlts\\2");
  TestStepAddActionExpected( chActionText, chExpectedText );
  A_DBGR_BreakpointSet("TestCantrcv_GetCanTrcvSpcfcFlts\\2");
  A_DBGR_Go();

  snprintf( chActionText, elCount(chActionText), "verify Breakpoint should hit in TestCantrcv_GetCanTrcvSpcfcFlts\\2 ");
  snprintf( chExpectedText, elCount(chExpectedText), "Breakpoint hit in TestCantrcv_GetCanTrcvSpcfcFlts\\2 function");

  E_DBGR_BreakpointCheckForHalt("TestCantrcv_GetCanTrcvSpcfcFlts\\2");

  /***************************************************************************************************************/
                                              // Test Step 5 verify that value which represents CanTrcv_FaultStatus
  /***************************************************************************************************************/
  snprintf( chActionText, elCount(chActionText), "Configure CanTrcv_FaultStatus values ");
  snprintf( chExpectedText, elCount(chExpectedText), "verify Configure CanTrcv_FaultStatus values");
  TestStepAddActionExpected( chActionText, chExpectedText );
  E_DBGR_VariableCheck("CanTrcv_FaultStatus",2048,Equal);
}



testcase Verify_that_the_GetCNDD_e_CanTrcvSpcfcFlts_function_correctly_reports_over_temperature_warning_status_for_CANA_CAN2()
{
  /***************************************************************************************************************/
                                                // Variable Definition
  /***************************************************************************************************************/



  /***************************************************************************************************************/
                                               // Local Values
  /***************************************************************************************************************/



  /***************************************************************************************************************/
                                              // Test Case Info
  /***************************************************************************************************************/
  setWriteDbgLevel(DebugOff);
  snprintf( chTestTitle, elCount(chTestTitle), "Verify_that_the_GetCNDD_e_CanTrcvSpcfcFlts_function_correctly_reports_over_temperature_warning_status_for_CANA_CAN2" );
  snprintf( chTestDescription, elCount(chTestDescription), "Purpose:To check GetCNDD_e_CanTrcvSpcfcFlts ");
  TestCaseAddInfo( chTestTitle, "TC_L30SW_Q-36403696", chTestDescription );

  /***************************************************************************************************************/
                                              // Start of Test Case
  /***************************************************************************************************************/

  /***************************************************************************************************************/
                                              // Test Step 0 PRECONDITIONS
  /***************************************************************************************************************/
   snprintf( chActionText, elCount(chActionText), "Flash the Software and ECU is running ");
  snprintf( chExpectedText, elCount(chExpectedText), "Ecu is should be in running state");
  TestStepAddActionExpected( chActionText, chExpectedText );

  A_DBGR_BreakpointDeleteAll();
  A_DBGR_BreakpointSet("TestCantrcv_GetCanTrcvSpcfcFlts\\2");
  A_DBGR_R();
  A_DBGR_Go();

  /***************************************************************************************************************/
                                              // Test Step 1 Call TestCantrcv_GetCanTrcvSpcfcFlts with channel ID as 0
  /***************************************************************************************************************/
  snprintf( chActionText, elCount(chActionText), "Set Breakpoint in TestCantrcv_GetCanTrcvSpcfcFlts\\2 ");
  snprintf( chExpectedText, elCount(chExpectedText), "verify is Breakpoint Set TestCantrcv_GetCanTrcvSpcfcFlts\\2");

  A_DBGR_Go();

  snprintf( chActionText, elCount(chActionText), "verify Breakpoint should hit in TestCantrcv_GetCanTrcvSpcfcFlts\\2 ");
  snprintf( chExpectedText, elCount(chExpectedText), "Breakpoint hit in TestCantrcv_GetCanTrcvSpcfcFlts\\2 function");

  E_DBGR_BreakpointCheckForHalt("TestCantrcv_GetCanTrcvSpcfcFlts\\2");

   snprintf( chActionText, elCount(chActionText), "Flash the Software and ECU is running ");
  snprintf( chExpectedText, elCount(chExpectedText), "Ecu is should be in running state");
  TestStepAddActionExpected( chActionText, chExpectedText );

  A_DBGR_BreakpointDeleteAll();
  /***************************************************************************************************************/
                                              // Test Step 2 Set CheckCanTrcvSpcFaults value as 1
  /***************************************************************************************************************/

  snprintf( chActionText, elCount(chActionText), "Configure CheckCanTrcvSpcFaults values ");
  snprintf( chExpectedText, elCount(chExpectedText), "verify Configure CheckCanTrcvSpcFaults values");
  //TestStepAddActionExpected( chActionText, chExpectedText );
  A_DBGR_VariableSet("CheckCanTrcvSpcFaults","1");

  snprintf( chActionText, elCount(chActionText), "Configure CheckCanTrcvSpcFaults values ");
  snprintf( chExpectedText, elCount(chExpectedText), "verify Configure CheckCanTrcvSpcFaults values");
  //TestStepAddActionExpected( chActionText, chExpectedText );
  E_DBGR_VariableCheck("CheckCanTrcvSpcFaults",1,Equal);

   /***************************************************************************************************************/
                                              // Test Step 3 Call GetCNDD_e_CanTrcvSpcfcFlts and verify channel ID as 0
  /***************************************************************************************************************/

  snprintf( chActionText, elCount(chActionText), "Set Breakpoint in GetCNDD_e_CanTrcvSpcfcFlts ");
  snprintf( chExpectedText, elCount(chExpectedText), "verify is Breakpoint Set GetCNDD_e_CanTrcvSpcfcFlts");
  TestStepAddActionExpected( chActionText, chExpectedText );
  A_DBGR_BreakpointSet("GetCNDD_e_CanTrcvSpcfcFlts");

  snprintf( chActionText, elCount(chActionText), "Flash the Software and ECU is running ");
  snprintf( chExpectedText, elCount(chExpectedText), "Ecu is should be in running state");
  //TestStepAddActionExpected( chActionText, chExpectedText );
  A_DBGR_Go();

  snprintf( chActionText, elCount(chActionText), "verify Breakpoint should hit in GetCNDD_e_CanTrcvSpcfcFlts ");
  snprintf( chExpectedText, elCount(chExpectedText), "Breakpoint hit in GetCNDD_e_CanTrcvSpcfcFlts function");

  E_DBGR_BreakpointCheckForHalt("GetCNDD_e_CanTrcvSpcfcFlts");


   snprintf( chActionText, elCount(chActionText), "Flash the Software and ECU is running ");
  snprintf( chExpectedText, elCount(chExpectedText), "Ecu is should be in running state");
  TestStepAddActionExpected( chActionText, chExpectedText );

  A_DBGR_BreakpointDeleteAll();

  snprintf( chActionText, elCount(chActionText), "Configure Channel_ID values ");
  snprintf( chExpectedText, elCount(chExpectedText), "verify Configure Channel_ID values");
  //TestStepAddActionExpected( chActionText, chExpectedText );
  A_DBGR_VariableSet("Channel_ID","0");
  E_DBGR_VariableCheck("Channel_ID",0,Equal);

  /***************************************************************************************************************/
                                              // Test Step 4 Simulate thermal_shutdown_status
  /***************************************************************************************************************/

  snprintf( chActionText, elCount(chActionText), "Configure CanTrcvFaultStatus[0].trcvSpcfcFlt.tsdwFltSts values ");
  snprintf( chExpectedText, elCount(chExpectedText), "verify Configure CanTrcvFaultStatus[0].trcvSpcfcFlt.tsdwFltSts values");
  TestStepAddActionExpected( chActionText, chExpectedText );
  A_DBGR_VariableSet("CanTrcvFaultStatus[0].trcvSpcfcFlt.otFltSts","1");
  E_DBGR_VariableCheck("CanTrcvFaultStatus[0].trcvSpcfcFlt.otFltSts",1,Equal);

  snprintf( chActionText, elCount(chActionText), "Set Breakpoint in TestCantrcv_GetCanTrcvSpcfcFlts\\2 ");
  snprintf( chExpectedText, elCount(chExpectedText), "verify is Breakpoint Set TestCantrcv_GetCanTrcvSpcfcFlts\\2");
  TestStepAddActionExpected( chActionText, chExpectedText );
  A_DBGR_BreakpointSet("TestCantrcv_GetCanTrcvSpcfcFlts\\2");
  A_DBGR_Go();

  snprintf( chActionText, elCount(chActionText), "verify Breakpoint should hit in TestCantrcv_GetCanTrcvSpcfcFlts\\2 ");
  snprintf( chExpectedText, elCount(chExpectedText), "Breakpoint hit in TestCantrcv_GetCanTrcvSpcfcFlts\\2 function");

  E_DBGR_BreakpointCheckForHalt("TestCantrcv_GetCanTrcvSpcfcFlts\\2");

  /***************************************************************************************************************/
                                              // Test Step 5 verify that value which represents CanTrcv_FaultStatus
  /***************************************************************************************************************/
  snprintf( chActionText, elCount(chActionText), "Configure CanTrcv_FaultStatus values ");
  snprintf( chExpectedText, elCount(chExpectedText), "verify Configure CanTrcv_FaultStatus values");
  TestStepAddActionExpected( chActionText, chExpectedText );
  E_DBGR_VariableCheck("CanTrcv_FaultStatus",16384,Equal);

}



testcase Verify_that_the_GetCNDD_e_CanTrcvSpcfcFlts_function_correctly_reports_over_temperature_warning_status_for_CANB_CAN8()
{
  /***************************************************************************************************************/
                                                // Variable Definition
  /***************************************************************************************************************/



  /***************************************************************************************************************/
                                               // Local Values
  /***************************************************************************************************************/



  /***************************************************************************************************************/
                                              // Test Case Info
  /***************************************************************************************************************/
  setWriteDbgLevel(DebugOff);
  snprintf( chTestTitle, elCount(chTestTitle), "Verify_that_the_GetCNDD_e_CanTrcvSpcfcFlts_function_correctly_reports_over_temperature_warning_status_for_CANB_CAN8" );
  snprintf( chTestDescription, elCount(chTestDescription), "Purpose:To check GetCNDD_e_CanTrcvSpcfcFlts ");
  TestCaseAddInfo( chTestTitle, "TC_L30SW_Q-36403697", chTestDescription );

  /***************************************************************************************************************/
                                              // Start of Test Case
  /***************************************************************************************************************/

  /***************************************************************************************************************/
                                              // Test Step 0 PRECONDITIONS
  /***************************************************************************************************************/
   snprintf( chActionText, elCount(chActionText), "Flash the Software and ECU is running ");
  snprintf( chExpectedText, elCount(chExpectedText), "Ecu is should be in running state");
  TestStepAddActionExpected( chActionText, chExpectedText );

  A_DBGR_BreakpointDeleteAll();
  A_DBGR_BreakpointSet("TestCantrcv_GetCanTrcvSpcfcFlts\\2");
  A_DBGR_R();
  A_DBGR_Go();

  /***************************************************************************************************************/
                                              // Test Step 1 Call TestCantrcv_GetCanTrcvSpcfcFlts with channel ID as 1
  /***************************************************************************************************************/
  snprintf( chActionText, elCount(chActionText), "Set Breakpoint in TestCantrcv_GetCanTrcvSpcfcFlts\\2 ");
  snprintf( chExpectedText, elCount(chExpectedText), "verify is Breakpoint Set TestCantrcv_GetCanTrcvSpcfcFlts\\2");

  A_DBGR_Go();

  snprintf( chActionText, elCount(chActionText), "verify Breakpoint should hit in TestCantrcv_GetCanTrcvSpcfcFlts\\2 ");
  snprintf( chExpectedText, elCount(chExpectedText), "Breakpoint hit in TestCantrcv_GetCanTrcvSpcfcFlts\\2 function");

  E_DBGR_BreakpointCheckForHalt("TestCantrcv_GetCanTrcvSpcfcFlts\\2");

   snprintf( chActionText, elCount(chActionText), "Flash the Software and ECU is running ");
  snprintf( chExpectedText, elCount(chExpectedText), "Ecu is should be in running state");
  TestStepAddActionExpected( chActionText, chExpectedText );

  A_DBGR_BreakpointDeleteAll();

  snprintf( chActionText, elCount(chActionText), "Configure Channel_ID values ");
  snprintf( chExpectedText, elCount(chExpectedText), "verify Configure Channel_ID values");
  //TestStepAddActionExpected( chActionText, chExpectedText );
  A_DBGR_VariableSet("Channel_ID","1");

  snprintf( chActionText, elCount(chActionText), "Configure Channel_ID values ");
  snprintf( chExpectedText, elCount(chExpectedText), "verify Configure Channel_ID values");
  //TestStepAddActionExpected( chActionText, chExpectedText );
  E_DBGR_VariableCheck("Channel_ID",1,Equal);


  /***************************************************************************************************************/
                                              // Test Step 2 Set CheckCanTrcvSpcFaults value as 1
  /***************************************************************************************************************/

  snprintf( chActionText, elCount(chActionText), "Configure CheckCanTrcvSpcFaults values ");
  snprintf( chExpectedText, elCount(chExpectedText), "verify Configure CheckCanTrcvSpcFaults values");
  TestStepAddActionExpected( chActionText, chExpectedText );
  A_DBGR_VariableSet("CheckCanTrcvSpcFaults","1");

  snprintf( chActionText, elCount(chActionText), "Configure CheckCanTrcvSpcFaults values ");
  snprintf( chExpectedText, elCount(chExpectedText), "verify Configure CheckCanTrcvSpcFaults values");
  //TestStepAddActionExpected( chActionText, chExpectedText );
  E_DBGR_VariableCheck("CheckCanTrcvSpcFaults",1,Equal);

   /***************************************************************************************************************/
                                              // Test Step 3 Call GetCNDD_e_CanTrcvSpcfcFlts and verify channel ID as 1
  /***************************************************************************************************************/

  snprintf( chActionText, elCount(chActionText), "Set Breakpoint in GetCNDD_e_CanTrcvSpcfcFlts ");
  snprintf( chExpectedText, elCount(chExpectedText), "verify is Breakpoint Set GetCNDD_e_CanTrcvSpcfcFlts");
  TestStepAddActionExpected( chActionText, chExpectedText );
  A_DBGR_BreakpointSet("GetCNDD_e_CanTrcvSpcfcFlts");

  snprintf( chActionText, elCount(chActionText), "Flash the Software and ECU is running ");
  snprintf( chExpectedText, elCount(chExpectedText), "Ecu is should be in running state");
  //TestStepAddActionExpected( chActionText, chExpectedText );
  A_DBGR_Go();

  snprintf( chActionText, elCount(chActionText), "verify Breakpoint should hit in GetCNDD_e_CanTrcvSpcfcFlts ");
  snprintf( chExpectedText, elCount(chExpectedText), "Breakpoint hit in GetCNDD_e_CanTrcvSpcfcFlts function");

  E_DBGR_BreakpointCheckForHalt("GetCNDD_e_CanTrcvSpcfcFlts");

   snprintf( chActionText, elCount(chActionText), "Flash the Software and ECU is running ");
  snprintf( chExpectedText, elCount(chExpectedText), "Ecu is should be in running state");
  TestStepAddActionExpected( chActionText, chExpectedText );

  A_DBGR_BreakpointDeleteAll();

  snprintf( chActionText, elCount(chActionText), "Configure Channel_ID values ");
  snprintf( chExpectedText, elCount(chExpectedText), "verify Configure Channel_ID values");
  //TestStepAddActionExpected( chActionText, chExpectedText );
  A_DBGR_VariableSet("Channel_ID","1");
  E_DBGR_VariableCheck("Channel_ID",1,Equal);

  /***************************************************************************************************************/
                                              // Test Step 4 Simulate  thermal_shudown_warning_status
  /***************************************************************************************************************/

  snprintf( chActionText, elCount(chActionText), "Configure CanTrcvFaultStatus[1].trcvSpcfcFlt.tsdwFltSts values ");
  snprintf( chExpectedText, elCount(chExpectedText), "verify Configure CanTrcvFaultStatus[1].trcvSpcfcFlt.tsdwFltSts values");
  TestStepAddActionExpected( chActionText, chExpectedText );
  A_DBGR_VariableSet("CanTrcvFaultStatus[1].trcvSpcfcFlt.otFltSts","1");
  E_DBGR_VariableCheck("CanTrcvFaultStatus[1].trcvSpcfcFlt.otFltSts",1,Equal);

  snprintf( chActionText, elCount(chActionText), "Set Breakpoint in TestCantrcv_GetCanTrcvSpcfcFlts\\2 ");
  snprintf( chExpectedText, elCount(chExpectedText), "verify is Breakpoint Set TestCantrcv_GetCanTrcvSpcfcFlts\\2");
  TestStepAddActionExpected( chActionText, chExpectedText );
  A_DBGR_BreakpointSet("TestCantrcv_GetCanTrcvSpcfcFlts\\2");
  A_DBGR_Go();

  snprintf( chActionText, elCount(chActionText), "verify Breakpoint should hit in TestCantrcv_GetCanTrcvSpcfcFlts\\2 ");
  snprintf( chExpectedText, elCount(chExpectedText), "Breakpoint hit in TestCantrcv_GetCanTrcvSpcfcFlts\\2 function");

  E_DBGR_BreakpointCheckForHalt("TestCantrcv_GetCanTrcvSpcfcFlts\\2");

  /***************************************************************************************************************/
                                              // Test Step 5 verify that value which represents CanTrcv_FaultStatus
  /***************************************************************************************************************/
  snprintf( chActionText, elCount(chActionText), "Configure CanTrcv_FaultStatus values ");
  snprintf( chExpectedText, elCount(chExpectedText), "verify Configure CanTrcv_FaultStatus values");
  TestStepAddActionExpected( chActionText, chExpectedText );
  E_DBGR_VariableCheck("CanTrcv_FaultStatus",16384,Equal);
}



testcase Verify_that_the_GetCNDD_e_CanTrcvSpcfcFlts_function_correctly_reports_spi_error_status_conditions_for_CANA_CAN2()
{
  /***************************************************************************************************************/
                                                // Variable Definition
  /***************************************************************************************************************/



  /***************************************************************************************************************/
                                               // Local Values
  /***************************************************************************************************************/



  /***************************************************************************************************************/
                                              // Test Case Info
  /***************************************************************************************************************/
  setWriteDbgLevel(DebugOff);
  snprintf( chTestTitle, elCount(chTestTitle), "Verify_that_the_GetCNDD_e_CanTrcvSpcfcFlts_function_correctly_reports_spi_error_status_conditions_for_CANA_CAN2" );
  snprintf( chTestDescription, elCount(chTestDescription), "Purpose:To check GetCNDD_e_CanTrcvSpcfcFlts ");
  TestCaseAddInfo( chTestTitle, "TC_L30SW_Q-36403698", chTestDescription );

  /***************************************************************************************************************/
                                              // Start of Test Case
  /***************************************************************************************************************/

  /***************************************************************************************************************/
                                              // Test Step 0 PRECONDITIONS
  /***************************************************************************************************************/
   snprintf( chActionText, elCount(chActionText), "Flash the Software and ECU is running ");
  snprintf( chExpectedText, elCount(chExpectedText), "Ecu is should be in running state");
  TestStepAddActionExpected( chActionText, chExpectedText );

  A_DBGR_BreakpointDeleteAll();
  A_DBGR_BreakpointSet("TestCantrcv_GetCanTrcvSpcfcFlts\\2");
  A_DBGR_R();
  A_DBGR_Go();

  /***************************************************************************************************************/
                                              // Test Step 1 Call TestCantrcv_GetCanTrcvSpcfcFlts with channel ID as 0
  /***************************************************************************************************************/
  snprintf( chActionText, elCount(chActionText), "Set Breakpoint in TestCantrcv_GetCanTrcvSpcfcFlts\\2 ");
  snprintf( chExpectedText, elCount(chExpectedText), "verify is Breakpoint Set TestCantrcv_GetCanTrcvSpcfcFlts\\2");

  A_DBGR_Go();

  snprintf( chActionText, elCount(chActionText), "verify Breakpoint should hit in TestCantrcv_GetCanTrcvSpcfcFlts\\2 ");
  snprintf( chExpectedText, elCount(chExpectedText), "Breakpoint hit in TestCantrcv_GetCanTrcvSpcfcFlts\\2 function");

  E_DBGR_BreakpointCheckForHalt("TestCantrcv_GetCanTrcvSpcfcFlts\\2");

   snprintf( chActionText, elCount(chActionText), "Flash the Software and ECU is running ");
  snprintf( chExpectedText, elCount(chExpectedText), "Ecu is should be in running state");
  TestStepAddActionExpected( chActionText, chExpectedText );

  A_DBGR_BreakpointDeleteAll();
  /***************************************************************************************************************/
                                              // Test Step 2 Set CheckCanTrcvSpcFaults value as 1
  /***************************************************************************************************************/

  snprintf( chActionText, elCount(chActionText), "Configure CheckCanTrcvSpcFaults values ");
  snprintf( chExpectedText, elCount(chExpectedText), "verify Configure CheckCanTrcvSpcFaults values");
  //TestStepAddActionExpected( chActionText, chExpectedText );
  A_DBGR_VariableSet("CheckCanTrcvSpcFaults","1");

  snprintf( chActionText, elCount(chActionText), "Configure CheckCanTrcvSpcFaults values ");
  snprintf( chExpectedText, elCount(chExpectedText), "verify Configure CheckCanTrcvSpcFaults values");
  //TestStepAddActionExpected( chActionText, chExpectedText );
  E_DBGR_VariableCheck("CheckCanTrcvSpcFaults",1,Equal);

   /***************************************************************************************************************/
                                              // Test Step 3 Call GetCNDD_e_CanTrcvSpcfcFlts and verify channel ID as 0
  /***************************************************************************************************************/

  snprintf( chActionText, elCount(chActionText), "Set Breakpoint in GetCNDD_e_CanTrcvSpcfcFlts ");
  snprintf( chExpectedText, elCount(chExpectedText), "verify is Breakpoint Set GetCNDD_e_CanTrcvSpcfcFlts");
  TestStepAddActionExpected( chActionText, chExpectedText );
  A_DBGR_BreakpointSet("GetCNDD_e_CanTrcvSpcfcFlts");

  snprintf( chActionText, elCount(chActionText), "Flash the Software and ECU is running ");
  snprintf( chExpectedText, elCount(chExpectedText), "Ecu is should be in running state");
  //TestStepAddActionExpected( chActionText, chExpectedText );
  A_DBGR_Go();

  snprintf( chActionText, elCount(chActionText), "verify Breakpoint should hit in GetCNDD_e_CanTrcvSpcfcFlts ");
  snprintf( chExpectedText, elCount(chExpectedText), "Breakpoint hit in GetCNDD_e_CanTrcvSpcfcFlts function");

  E_DBGR_BreakpointCheckForHalt("GetCNDD_e_CanTrcvSpcfcFlts");

   snprintf( chActionText, elCount(chActionText), "Flash the Software and ECU is running ");
  snprintf( chExpectedText, elCount(chExpectedText), "Ecu is should be in running state");
  TestStepAddActionExpected( chActionText, chExpectedText );

  A_DBGR_BreakpointDeleteAll();

  snprintf( chActionText, elCount(chActionText), "Configure Channel_ID values ");
  snprintf( chExpectedText, elCount(chExpectedText), "verify Configure Channel_ID values");
  //TestStepAddActionExpected( chActionText, chExpectedText );
  A_DBGR_VariableSet("Channel_ID","0");
  E_DBGR_VariableCheck("Channel_ID",0,Equal);

  /***************************************************************************************************************/
                                              // Test Step 4 Simulate spi_error_status
  /***************************************************************************************************************/

  snprintf( chActionText, elCount(chActionText), "Configure CanTrcvFaultStatus[0].trcvSpcfcFlt.spiErrFltSts values ");
  snprintf( chExpectedText, elCount(chExpectedText), "verify Configure CanTrcvFaultStatus[0].trcvSpcfcFlt.spiErrFltSts values");
  TestStepAddActionExpected( chActionText, chExpectedText );
  A_DBGR_VariableSet("CanTrcvFaultStatus[0].trcvSpcfcFlt.spiifFltSts","1");
  E_DBGR_VariableCheck("CanTrcvFaultStatus[0].trcvSpcfcFlt.spiifFltSts",1,Equal);

  snprintf( chActionText, elCount(chActionText), "Set Breakpoint in TestCantrcv_GetCanTrcvSpcfcFlts\\2 ");
  snprintf( chExpectedText, elCount(chExpectedText), "verify is Breakpoint Set TestCantrcv_GetCanTrcvSpcfcFlts\\2");
  TestStepAddActionExpected( chActionText, chExpectedText );
  A_DBGR_BreakpointSet("TestCantrcv_GetCanTrcvSpcfcFlts\\2");
  A_DBGR_Go();

  snprintf( chActionText, elCount(chActionText), "verify Breakpoint should hit in TestCantrcv_GetCanTrcvSpcfcFlts\\2 ");
  snprintf( chExpectedText, elCount(chExpectedText), "Breakpoint hit in TestCantrcv_GetCanTrcvSpcfcFlts\\2 function");

  E_DBGR_BreakpointCheckForHalt("TestCantrcv_GetCanTrcvSpcfcFlts\\2");

  /***************************************************************************************************************/
                                              // Test Step 5 verify that value which represents CanTrcv_FaultStatus
  /***************************************************************************************************************/
  snprintf( chActionText, elCount(chActionText), "Configure CanTrcv_FaultStatus values ");
  snprintf( chExpectedText, elCount(chExpectedText), "verify Configure CanTrcv_FaultStatus values");
  TestStepAddActionExpected( chActionText, chExpectedText );
  E_DBGR_VariableCheck("CanTrcv_FaultStatus",32768,Equal);

}



testcase Verify_that_the_GetCNDD_e_CanTrcvSpcfcFlts_function_correctly_reports_spi_error_status_conditions_for_CANB_CAN8()
{
  /***************************************************************************************************************/
                                                // Variable Definition
  /***************************************************************************************************************/



  /***************************************************************************************************************/
                                               // Local Values
  /***************************************************************************************************************/



  /***************************************************************************************************************/
                                              // Test Case Info
  /***************************************************************************************************************/
  setWriteDbgLevel(DebugOff);
  snprintf( chTestTitle, elCount(chTestTitle), "Verify_that_the_GetCNDD_e_CanTrcvSpcfcFlts_function_correctly_reports_spi_error_status_conditions_for_CANB_CAN8" );
  snprintf( chTestDescription, elCount(chTestDescription), "Purpose:To check GetCNDD_e_CanTrcvSpcfcFlts ");
  TestCaseAddInfo( chTestTitle, "TC_L30SW_Q-36403699", chTestDescription );

  /***************************************************************************************************************/
                                              // Start of Test Case
  /***************************************************************************************************************/

  /***************************************************************************************************************/
                                              // Test Step 0 PRECONDITIONS
  /***************************************************************************************************************/
   snprintf( chActionText, elCount(chActionText), "Flash the Software and ECU is running ");
  snprintf( chExpectedText, elCount(chExpectedText), "Ecu is should be in running state");
  TestStepAddActionExpected( chActionText, chExpectedText );

  A_DBGR_BreakpointDeleteAll();
  A_DBGR_BreakpointSet("TestCantrcv_GetCanTrcvSpcfcFlts\\2");
  A_DBGR_R();
  A_DBGR_Go();

  /***************************************************************************************************************/
                                              // Test Step 1 Call TestCantrcv_GetCanTrcvSpcfcFlts with channel ID as 1
  /***************************************************************************************************************/
  snprintf( chActionText, elCount(chActionText), "Set Breakpoint in TestCantrcv_GetCanTrcvSpcfcFlts\\2 ");
  snprintf( chExpectedText, elCount(chExpectedText), "verify is Breakpoint Set TestCantrcv_GetCanTrcvSpcfcFlts\\2");

  A_DBGR_Go();

  snprintf( chActionText, elCount(chActionText), "verify Breakpoint should hit in TestCantrcv_GetCanTrcvSpcfcFlts\\2 ");
  snprintf( chExpectedText, elCount(chExpectedText), "Breakpoint hit in TestCantrcv_GetCanTrcvSpcfcFlts\\2 function");

  E_DBGR_BreakpointCheckForHalt("TestCantrcv_GetCanTrcvSpcfcFlts\\2");

   snprintf( chActionText, elCount(chActionText), "Flash the Software and ECU is running ");
  snprintf( chExpectedText, elCount(chExpectedText), "Ecu is should be in running state");
  TestStepAddActionExpected( chActionText, chExpectedText );

  A_DBGR_BreakpointDeleteAll();

  snprintf( chActionText, elCount(chActionText), "Configure Channel_ID values ");
  snprintf( chExpectedText, elCount(chExpectedText), "verify Configure Channel_ID values");
  //TestStepAddActionExpected( chActionText, chExpectedText );
  A_DBGR_VariableSet("Channel_ID","1");

  snprintf( chActionText, elCount(chActionText), "Configure Channel_ID values ");
  snprintf( chExpectedText, elCount(chExpectedText), "verify Configure Channel_ID values");
  //TestStepAddActionExpected( chActionText, chExpectedText );
  E_DBGR_VariableCheck("Channel_ID",1,Equal);


  /***************************************************************************************************************/
                                              // Test Step 2 Set CheckCanTrcvSpcFaults value as 1
  /***************************************************************************************************************/

  snprintf( chActionText, elCount(chActionText), "Configure CheckCanTrcvSpcFaults values ");
  snprintf( chExpectedText, elCount(chExpectedText), "verify Configure CheckCanTrcvSpcFaults values");
  TestStepAddActionExpected( chActionText, chExpectedText );
  A_DBGR_VariableSet("CheckCanTrcvSpcFaults","1");

  snprintf( chActionText, elCount(chActionText), "Configure CheckCanTrcvSpcFaults values ");
  snprintf( chExpectedText, elCount(chExpectedText), "verify Configure CheckCanTrcvSpcFaults values");
  //TestStepAddActionExpected( chActionText, chExpectedText );
  E_DBGR_VariableCheck("CheckCanTrcvSpcFaults",1,Equal);

   /***************************************************************************************************************/
                                              // Test Step 3 Call GetCNDD_e_CanTrcvSpcfcFlts and verify channel ID as 1
  /***************************************************************************************************************/

  snprintf( chActionText, elCount(chActionText), "Set Breakpoint in GetCNDD_e_CanTrcvSpcfcFlts ");
  snprintf( chExpectedText, elCount(chExpectedText), "verify is Breakpoint Set GetCNDD_e_CanTrcvSpcfcFlts");
  TestStepAddActionExpected( chActionText, chExpectedText );
  A_DBGR_BreakpointSet("GetCNDD_e_CanTrcvSpcfcFlts");

  snprintf( chActionText, elCount(chActionText), "Flash the Software and ECU is running ");
  snprintf( chExpectedText, elCount(chExpectedText), "Ecu is should be in running state");
  //TestStepAddActionExpected( chActionText, chExpectedText );
  A_DBGR_Go();

  snprintf( chActionText, elCount(chActionText), "verify Breakpoint should hit in GetCNDD_e_CanTrcvSpcfcFlts ");
  snprintf( chExpectedText, elCount(chExpectedText), "Breakpoint hit in GetCNDD_e_CanTrcvSpcfcFlts function");

  E_DBGR_BreakpointCheckForHalt("GetCNDD_e_CanTrcvSpcfcFlts");

   snprintf( chActionText, elCount(chActionText), "Flash the Software and ECU is running ");
  snprintf( chExpectedText, elCount(chExpectedText), "Ecu is should be in running state");
  TestStepAddActionExpected( chActionText, chExpectedText );

  A_DBGR_BreakpointDeleteAll();

  snprintf( chActionText, elCount(chActionText), "Configure Channel_ID values ");
  snprintf( chExpectedText, elCount(chExpectedText), "verify Configure Channel_ID values");
  //TestStepAddActionExpected( chActionText, chExpectedText );
  A_DBGR_VariableSet("Channel_ID","1");
  E_DBGR_VariableCheck("Channel_ID",1,Equal);

  /***************************************************************************************************************/
                                              // Test Step 4 Simulate spi_error_status
  /***************************************************************************************************************/

  snprintf( chActionText, elCount(chActionText), "Configure CanTrcvFaultStatus[1].trcvSpcfcFlt.spiErrFltSts values ");
  snprintf( chExpectedText, elCount(chExpectedText), "verify Configure CanTrcvFaultStatus[1].trcvSpcfcFlt.spiErrFltSts values");
  TestStepAddActionExpected( chActionText, chExpectedText );
  A_DBGR_VariableSet("CanTrcvFaultStatus[1].trcvSpcfcFlt.spiifFltSts","1");
  E_DBGR_VariableCheck("CanTrcvFaultStatus[1].trcvSpcfcFlt.spiifFltSts",1,Equal);

  snprintf( chActionText, elCount(chActionText), "Set Breakpoint in TestCantrcv_GetCanTrcvSpcfcFlts\\2 ");
  snprintf( chExpectedText, elCount(chExpectedText), "verify is Breakpoint Set TestCantrcv_GetCanTrcvSpcfcFlts\\2");
  TestStepAddActionExpected( chActionText, chExpectedText );
  A_DBGR_BreakpointSet("TestCantrcv_GetCanTrcvSpcfcFlts\\2");
  A_DBGR_Go();

  snprintf( chActionText, elCount(chActionText), "verify Breakpoint should hit in TestCantrcv_GetCanTrcvSpcfcFlts\\2 ");
  snprintf( chExpectedText, elCount(chExpectedText), "Breakpoint hit in TestCantrcv_GetCanTrcvSpcfcFlts\\2 function");

  E_DBGR_BreakpointCheckForHalt("TestCantrcv_GetCanTrcvSpcfcFlts\\2");

  /***************************************************************************************************************/
                                              // Test Step 5 verify that value which represents CanTrcv_FaultStatus
  /***************************************************************************************************************/
  snprintf( chActionText, elCount(chActionText), "Configure CanTrcv_FaultStatus values ");
  snprintf( chExpectedText, elCount(chExpectedText), "verify Configure CanTrcv_FaultStatus values");
  TestStepAddActionExpected( chActionText, chExpectedText );
  E_DBGR_VariableCheck("CanTrcv_FaultStatus",32768,Equal);
}



testcase Verify_that_the_GetCNDD_e_CanTrcvSpcfcFlts_function_correctly_reports_selective_waker_error_status_conditions_for_CANA_CAN2()
{
   /***************************************************************************************************************/
                                                // Variable Definition
  /***************************************************************************************************************/



  /***************************************************************************************************************/
                                               // Local Values
  /***************************************************************************************************************/



  /***************************************************************************************************************/
                                              // Test Case Info
  /***************************************************************************************************************/
  setWriteDbgLevel(DebugOff);
  snprintf( chTestTitle, elCount(chTestTitle), "Verify_that_the_GetCNDD_e_CanTrcvSpcfcFlts_function_correctly_reports_selective_waker_error_status_conditions_for_CANA_CAN2" );
  snprintf( chTestDescription, elCount(chTestDescription), "Purpose:To check GetCNDD_e_CanTrcvSpcfcFlts ");
  TestCaseAddInfo( chTestTitle, "TC_L30SW_Q-36403700", chTestDescription );

  /***************************************************************************************************************/
                                              // Start of Test Case
  /***************************************************************************************************************/

  /***************************************************************************************************************/
                                              // Test Step 0 PRECONDITIONS
  /***************************************************************************************************************/
   snprintf( chActionText, elCount(chActionText), "Flash the Software and ECU is running ");
  snprintf( chExpectedText, elCount(chExpectedText), "Ecu is should be in running state");
  TestStepAddActionExpected( chActionText, chExpectedText );

  A_DBGR_BreakpointDeleteAll();
  A_DBGR_BreakpointSet("TestCantrcv_GetCanTrcvSpcfcFlts\\2");
  A_DBGR_R();
  A_DBGR_Go();

  /***************************************************************************************************************/
                                              // Test Step 1 Call TestCantrcv_GetCanTrcvSpcfcFlts with channel ID as 0
  /***************************************************************************************************************/
  snprintf( chActionText, elCount(chActionText), "Set Breakpoint in TestCantrcv_GetCanTrcvSpcfcFlts\\2 ");
  snprintf( chExpectedText, elCount(chExpectedText), "verify is Breakpoint Set TestCantrcv_GetCanTrcvSpcfcFlts\\2");

  A_DBGR_Go();

  snprintf( chActionText, elCount(chActionText), "verify Breakpoint should hit in TestCantrcv_GetCanTrcvSpcfcFlts\\2 ");
  snprintf( chExpectedText, elCount(chExpectedText), "Breakpoint hit in TestCantrcv_GetCanTrcvSpcfcFlts\\2 function");

  E_DBGR_BreakpointCheckForHalt("TestCantrcv_GetCanTrcvSpcfcFlts\\2");

   snprintf( chActionText, elCount(chActionText), "Flash the Software and ECU is running ");
  snprintf( chExpectedText, elCount(chExpectedText), "Ecu is should be in running state");
  TestStepAddActionExpected( chActionText, chExpectedText );

  A_DBGR_BreakpointDeleteAll();
  /***************************************************************************************************************/
                                              // Test Step 2 Set CheckCanTrcvSpcFaults value as 1
  /***************************************************************************************************************/

  snprintf( chActionText, elCount(chActionText), "Configure CheckCanTrcvSpcFaults values ");
  snprintf( chExpectedText, elCount(chExpectedText), "verify Configure CheckCanTrcvSpcFaults values");
  //TestStepAddActionExpected( chActionText, chExpectedText );
  A_DBGR_VariableSet("CheckCanTrcvSpcFaults","1");

  snprintf( chActionText, elCount(chActionText), "Configure CheckCanTrcvSpcFaults values ");
  snprintf( chExpectedText, elCount(chExpectedText), "verify Configure CheckCanTrcvSpcFaults values");
  //TestStepAddActionExpected( chActionText, chExpectedText );
  E_DBGR_VariableCheck("CheckCanTrcvSpcFaults",1,Equal);

   /***************************************************************************************************************/
                                              // Test Step 3 Call GetCNDD_e_CanTrcvSpcfcFlts and verify channel ID as 0
  /***************************************************************************************************************/

  snprintf( chActionText, elCount(chActionText), "Set Breakpoint in GetCNDD_e_CanTrcvSpcfcFlts ");
  snprintf( chExpectedText, elCount(chExpectedText), "verify is Breakpoint Set GetCNDD_e_CanTrcvSpcfcFlts");
  TestStepAddActionExpected( chActionText, chExpectedText );
  A_DBGR_BreakpointSet("GetCNDD_e_CanTrcvSpcfcFlts");

  snprintf( chActionText, elCount(chActionText), "Flash the Software and ECU is running ");
  snprintf( chExpectedText, elCount(chExpectedText), "Ecu is should be in running state");
  //TestStepAddActionExpected( chActionText, chExpectedText );
  A_DBGR_Go();

  snprintf( chActionText, elCount(chActionText), "verify Breakpoint should hit in GetCNDD_e_CanTrcvSpcfcFlts ");
  snprintf( chExpectedText, elCount(chExpectedText), "Breakpoint hit in GetCNDD_e_CanTrcvSpcfcFlts function");

  E_DBGR_BreakpointCheckForHalt("GetCNDD_e_CanTrcvSpcfcFlts");

   snprintf( chActionText, elCount(chActionText), "Flash the Software and ECU is running ");
  snprintf( chExpectedText, elCount(chExpectedText), "Ecu is should be in running state");
  TestStepAddActionExpected( chActionText, chExpectedText );

  A_DBGR_BreakpointDeleteAll();

  snprintf( chActionText, elCount(chActionText), "Configure Channel_ID values ");
  snprintf( chExpectedText, elCount(chExpectedText), "verify Configure Channel_ID values");
  //TestStepAddActionExpected( chActionText, chExpectedText );
  A_DBGR_VariableSet("Channel_ID","0");
  E_DBGR_VariableCheck("Channel_ID",0,Equal);

  /***************************************************************************************************************/
                                              // Test Step 4 Simulate selective_waker_error_status
  /***************************************************************************************************************/

  snprintf( chActionText, elCount(chActionText), "Configure CanTrcvFaultStatus[0].trcvSpcfcFlt.swErrFltSts values ");
  snprintf( chExpectedText, elCount(chExpectedText), "verify Configure CanTrcvFaultStatus[0].trcvSpcfcFlt.swErrFltSts values");
  TestStepAddActionExpected( chActionText, chExpectedText );
  A_DBGR_VariableSet("CanTrcvFaultStatus[0].trcvSpcfcFlt.swErrFltSts","1");
  E_DBGR_VariableCheck("CanTrcvFaultStatus[0].trcvSpcfcFlt.swErrFltSts",1,Equal);

  snprintf( chActionText, elCount(chActionText), "Set Breakpoint in TestCantrcv_GetCanTrcvSpcfcFlts\\2 ");
  snprintf( chExpectedText, elCount(chExpectedText), "verify is Breakpoint Set TestCantrcv_GetCanTrcvSpcfcFlts\\2");
  TestStepAddActionExpected( chActionText, chExpectedText );
  A_DBGR_BreakpointSet("TestCantrcv_GetCanTrcvSpcfcFlts\\2");
  A_DBGR_Go();

  snprintf( chActionText, elCount(chActionText), "verify Breakpoint should hit in TestCantrcv_GetCanTrcvSpcfcFlts\\2 ");
  snprintf( chExpectedText, elCount(chExpectedText), "Breakpoint hit in TestCantrcv_GetCanTrcvSpcfcFlts\\2 function");

  E_DBGR_BreakpointCheckForHalt("TestCantrcv_GetCanTrcvSpcfcFlts\\2");

  /***************************************************************************************************************/
                                              // Test Step 5 verify that value which represents CanTrcv_FaultStatus
  /***************************************************************************************************************/
  snprintf( chActionText, elCount(chActionText), "Configure CanTrcv_FaultStatus values ");
  snprintf( chExpectedText, elCount(chExpectedText), "verify Configure CanTrcv_FaultStatus values");
  TestStepAddActionExpected( chActionText, chExpectedText );
  E_DBGR_VariableCheck("CanTrcv_FaultStatus",16384,Equal);

}



testcase Verify_that_the_GetCNDD_e_CanTrcvSpcfcFlts_function_correctly_reports_selective_waker_error_status_conditions_for_CANB_CAN8()
{
  /***************************************************************************************************************/
                                                // Variable Definition
  /***************************************************************************************************************/



  /***************************************************************************************************************/
                                               // Local Values
  /***************************************************************************************************************/



  /***************************************************************************************************************/
                                              // Test Case Info
  /***************************************************************************************************************/
  setWriteDbgLevel(DebugOff);
  snprintf( chTestTitle, elCount(chTestTitle), "Verify_that_the_GetCNDD_e_CanTrcvSpcfcFlts_function_correctly_reports_spi_error_status_conditions_for_CANB_CAN8" );
  snprintf( chTestDescription, elCount(chTestDescription), "Purpose:To check GetCNDD_e_CanTrcvSpcfcFlts ");
  TestCaseAddInfo( chTestTitle, "TC_L30SW_Q-36403701", chTestDescription );

  /***************************************************************************************************************/
                                              // Start of Test Case
  /***************************************************************************************************************/

  /***************************************************************************************************************/
                                              // Test Step 0 PRECONDITIONS
  /***************************************************************************************************************/
   snprintf( chActionText, elCount(chActionText), "Flash the Software and ECU is running ");
  snprintf( chExpectedText, elCount(chExpectedText), "Ecu is should be in running state");
  TestStepAddActionExpected( chActionText, chExpectedText );

  A_DBGR_BreakpointDeleteAll();
  A_DBGR_BreakpointSet("TestCantrcv_GetCanTrcvSpcfcFlts\\2");
  A_DBGR_R();
  A_DBGR_Go();

  /***************************************************************************************************************/
                                              // Test Step 1 Call TestCantrcv_GetCanTrcvSpcfcFlts with channel ID as 1
  /***************************************************************************************************************/
  snprintf( chActionText, elCount(chActionText), "Set Breakpoint in TestCantrcv_GetCanTrcvSpcfcFlts\\2 ");
  snprintf( chExpectedText, elCount(chExpectedText), "verify is Breakpoint Set TestCantrcv_GetCanTrcvSpcfcFlts\\2");

  A_DBGR_Go();

  snprintf( chActionText, elCount(chActionText), "verify Breakpoint should hit in TestCantrcv_GetCanTrcvSpcfcFlts\\2 ");
  snprintf( chExpectedText, elCount(chExpectedText), "Breakpoint hit in TestCantrcv_GetCanTrcvSpcfcFlts\\2 function");

  E_DBGR_BreakpointCheckForHalt("TestCantrcv_GetCanTrcvSpcfcFlts\\2");

   snprintf( chActionText, elCount(chActionText), "Flash the Software and ECU is running ");
  snprintf( chExpectedText, elCount(chExpectedText), "Ecu is should be in running state");
  TestStepAddActionExpected( chActionText, chExpectedText );

  A_DBGR_BreakpointDeleteAll();

  snprintf( chActionText, elCount(chActionText), "Configure Channel_ID values ");
  snprintf( chExpectedText, elCount(chExpectedText), "verify Configure Channel_ID values");
  //TestStepAddActionExpected( chActionText, chExpectedText );
  A_DBGR_VariableSet("Channel_ID","1");

  snprintf( chActionText, elCount(chActionText), "Configure Channel_ID values ");
  snprintf( chExpectedText, elCount(chExpectedText), "verify Configure Channel_ID values");
  //TestStepAddActionExpected( chActionText, chExpectedText );
  E_DBGR_VariableCheck("Channel_ID",1,Equal);


  /***************************************************************************************************************/
                                              // Test Step 2 Set CheckCanTrcvSpcFaults value as 1
  /***************************************************************************************************************/

  snprintf( chActionText, elCount(chActionText), "Configure CheckCanTrcvSpcFaults values ");
  snprintf( chExpectedText, elCount(chExpectedText), "verify Configure CheckCanTrcvSpcFaults values");
  TestStepAddActionExpected( chActionText, chExpectedText );
  A_DBGR_VariableSet("CheckCanTrcvSpcFaults","1");

  snprintf( chActionText, elCount(chActionText), "Configure CheckCanTrcvSpcFaults values ");
  snprintf( chExpectedText, elCount(chExpectedText), "verify Configure CheckCanTrcvSpcFaults values");
  //TestStepAddActionExpected( chActionText, chExpectedText );
  E_DBGR_VariableCheck("CheckCanTrcvSpcFaults",1,Equal);

   /***************************************************************************************************************/
                                              // Test Step 3 Call GetCNDD_e_CanTrcvSpcfcFlts and verify channel ID as 1
  /***************************************************************************************************************/

  snprintf( chActionText, elCount(chActionText), "Set Breakpoint in GetCNDD_e_CanTrcvSpcfcFlts ");
  snprintf( chExpectedText, elCount(chExpectedText), "verify is Breakpoint Set GetCNDD_e_CanTrcvSpcfcFlts");
  TestStepAddActionExpected( chActionText, chExpectedText );
  A_DBGR_BreakpointSet("GetCNDD_e_CanTrcvSpcfcFlts");

  snprintf( chActionText, elCount(chActionText), "Flash the Software and ECU is running ");
  snprintf( chExpectedText, elCount(chExpectedText), "Ecu is should be in running state");
  //TestStepAddActionExpected( chActionText, chExpectedText );
  A_DBGR_Go();

  snprintf( chActionText, elCount(chActionText), "verify Breakpoint should hit in GetCNDD_e_CanTrcvSpcfcFlts ");
  snprintf( chExpectedText, elCount(chExpectedText), "Breakpoint hit in GetCNDD_e_CanTrcvSpcfcFlts function");

  E_DBGR_BreakpointCheckForHalt("GetCNDD_e_CanTrcvSpcfcFlts");

   snprintf( chActionText, elCount(chActionText), "Flash the Software and ECU is running ");
  snprintf( chExpectedText, elCount(chExpectedText), "Ecu is should be in running state");
  TestStepAddActionExpected( chActionText, chExpectedText );

  A_DBGR_BreakpointDeleteAll();

  snprintf( chActionText, elCount(chActionText), "Configure Channel_ID values ");
  snprintf( chExpectedText, elCount(chExpectedText), "verify Configure Channel_ID values");
  //TestStepAddActionExpected( chActionText, chExpectedText );
  A_DBGR_VariableSet("Channel_ID","1");
  E_DBGR_VariableCheck("Channel_ID",1,Equal);

  /***************************************************************************************************************/
                                              // Test Step 4 Simulate selective_waker_error_status
  /***************************************************************************************************************/

  snprintf( chActionText, elCount(chActionText), "Configure CanTrcvFaultStatus[1].trcvSpcfcFlt.swErrFltSts values ");
  snprintf( chExpectedText, elCount(chExpectedText), "verify Configure CanTrcvFaultStatus[1].trcvSpcfcFlt.swErrFltSts values");
  TestStepAddActionExpected( chActionText, chExpectedText );
  A_DBGR_VariableSet("CanTrcvFaultStatus[1].trcvSpcfcFlt.swErrFltSts","1");
  E_DBGR_VariableCheck("CanTrcvFaultStatus[1].trcvSpcfcFlt.swErrFltSts",1,Equal);

  snprintf( chActionText, elCount(chActionText), "Set Breakpoint in TestCantrcv_GetCanTrcvSpcfcFlts\\2 ");
  snprintf( chExpectedText, elCount(chExpectedText), "verify is Breakpoint Set TestCantrcv_GetCanTrcvSpcfcFlts\\2");
  TestStepAddActionExpected( chActionText, chExpectedText );
  A_DBGR_BreakpointSet("TestCantrcv_GetCanTrcvSpcfcFlts\\2");
  A_DBGR_Go();

  snprintf( chActionText, elCount(chActionText), "verify Breakpoint should hit in TestCantrcv_GetCanTrcvSpcfcFlts\\2 ");
  snprintf( chExpectedText, elCount(chExpectedText), "Breakpoint hit in TestCantrcv_GetCanTrcvSpcfcFlts\\2 function");

  E_DBGR_BreakpointCheckForHalt("TestCantrcv_GetCanTrcvSpcfcFlts\\2");

  /***************************************************************************************************************/
                                              // Test Step 5 verify that value which represents CanTrcv_FaultStatus
  /***************************************************************************************************************/
  snprintf( chActionText, elCount(chActionText), "Configure CanTrcv_FaultStatus values ");
  snprintf( chExpectedText, elCount(chExpectedText), "verify Configure CanTrcv_FaultStatus values");
  TestStepAddActionExpected( chActionText, chExpectedText );
  E_DBGR_VariableCheck("CanTrcv_FaultStatus",16384,Equal);
}



testcase Verify_that_the_GetCNDD_e_CanTrcvSpcfcFlts_function_correctly_reports_CRC_Eeprom_status_conditions_for_CANA_CAN2()
{
   /***************************************************************************************************************/
                                                // Variable Definition
  /***************************************************************************************************************/



  /***************************************************************************************************************/
                                               // Local Values
  /***************************************************************************************************************/



  /***************************************************************************************************************/
                                              // Test Case Info
  /***************************************************************************************************************/
  setWriteDbgLevel(DebugOff);
  snprintf( chTestTitle, elCount(chTestTitle), "Verify_that_the_GetCNDD_e_CanTrcvSpcfcFlts_function_correctly_reports_CRC_Eeprom_status_conditions_for_CANA_CAN2" );
  snprintf( chTestDescription, elCount(chTestDescription), "Purpose:To check GetCNDD_e_CanTrcvSpcfcFlts ");
  TestCaseAddInfo( chTestTitle, "TC_L30SW_Q-36403702", chTestDescription );

  /***************************************************************************************************************/
                                              // Start of Test Case
  /***************************************************************************************************************/

  /***************************************************************************************************************/
                                              // Test Step 0 PRECONDITIONS
  /***************************************************************************************************************/
   snprintf( chActionText, elCount(chActionText), "Flash the Software and ECU is running ");
  snprintf( chExpectedText, elCount(chExpectedText), "Ecu is should be in running state");
  TestStepAddActionExpected( chActionText, chExpectedText );

  A_DBGR_BreakpointDeleteAll();
  A_DBGR_BreakpointSet("TestCantrcv_GetCanTrcvSpcfcFlts\\2");
  A_DBGR_R();
  A_DBGR_Go();

  /***************************************************************************************************************/
                                              // Test Step 1 Call TestCantrcv_GetCanTrcvSpcfcFlts with channel ID as 0
  /***************************************************************************************************************/
  snprintf( chActionText, elCount(chActionText), "Set Breakpoint in TestCantrcv_GetCanTrcvSpcfcFlts\\2 ");
  snprintf( chExpectedText, elCount(chExpectedText), "verify is Breakpoint Set TestCantrcv_GetCanTrcvSpcfcFlts\\2");

  A_DBGR_Go();

  snprintf( chActionText, elCount(chActionText), "verify Breakpoint should hit in TestCantrcv_GetCanTrcvSpcfcFlts\\2 ");
  snprintf( chExpectedText, elCount(chExpectedText), "Breakpoint hit in TestCantrcv_GetCanTrcvSpcfcFlts\\2 function");

  E_DBGR_BreakpointCheckForHalt("TestCantrcv_GetCanTrcvSpcfcFlts\\2");

   snprintf( chActionText, elCount(chActionText), "Flash the Software and ECU is running ");
  snprintf( chExpectedText, elCount(chExpectedText), "Ecu is should be in running state");
  TestStepAddActionExpected( chActionText, chExpectedText );

  A_DBGR_BreakpointDeleteAll();
  /***************************************************************************************************************/
                                              // Test Step 2 Set CheckCanTrcvSpcFaults value as 1
  /***************************************************************************************************************/

  snprintf( chActionText, elCount(chActionText), "Configure CheckCanTrcvSpcFaults values ");
  snprintf( chExpectedText, elCount(chExpectedText), "verify Configure CheckCanTrcvSpcFaults values");
  //TestStepAddActionExpected( chActionText, chExpectedText );
  A_DBGR_VariableSet("CheckCanTrcvSpcFaults","1");

  snprintf( chActionText, elCount(chActionText), "Configure CheckCanTrcvSpcFaults values ");
  snprintf( chExpectedText, elCount(chExpectedText), "verify Configure CheckCanTrcvSpcFaults values");
  //TestStepAddActionExpected( chActionText, chExpectedText );
  E_DBGR_VariableCheck("CheckCanTrcvSpcFaults",1,Equal);

   /***************************************************************************************************************/
                                              // Test Step 3 Call GetCNDD_e_CanTrcvSpcfcFlts and verify channel ID as 0
  /***************************************************************************************************************/

  snprintf( chActionText, elCount(chActionText), "Set Breakpoint in GetCNDD_e_CanTrcvSpcfcFlts ");
  snprintf( chExpectedText, elCount(chExpectedText), "verify is Breakpoint Set GetCNDD_e_CanTrcvSpcfcFlts");
  TestStepAddActionExpected( chActionText, chExpectedText );
  A_DBGR_BreakpointSet("GetCNDD_e_CanTrcvSpcfcFlts");

  snprintf( chActionText, elCount(chActionText), "Flash the Software and ECU is running ");
  snprintf( chExpectedText, elCount(chExpectedText), "Ecu is should be in running state");
  //TestStepAddActionExpected( chActionText, chExpectedText );
  A_DBGR_Go();

  snprintf( chActionText, elCount(chActionText), "verify Breakpoint should hit in GetCNDD_e_CanTrcvSpcfcFlts ");
  snprintf( chExpectedText, elCount(chExpectedText), "Breakpoint hit in GetCNDD_e_CanTrcvSpcfcFlts function");

  E_DBGR_BreakpointCheckForHalt("GetCNDD_e_CanTrcvSpcfcFlts");

   snprintf( chActionText, elCount(chActionText), "Flash the Software and ECU is running ");
  snprintf( chExpectedText, elCount(chExpectedText), "Ecu is should be in running state");
  TestStepAddActionExpected( chActionText, chExpectedText );

  A_DBGR_BreakpointDeleteAll();

  snprintf( chActionText, elCount(chActionText), "Configure Channel_ID values ");
  snprintf( chExpectedText, elCount(chExpectedText), "verify Configure Channel_ID values");
  //TestStepAddActionExpected( chActionText, chExpectedText );
  A_DBGR_VariableSet("Channel_ID","0");
  E_DBGR_VariableCheck("Channel_ID",0,Equal);

  /***************************************************************************************************************/
                                              // Test Step 4 Simulate CRC_Eeprom_status
  /***************************************************************************************************************/

  snprintf( chActionText, elCount(chActionText), "Configure CanTrcvFaultStatus[0].trcvSpcfcFlt.CrcEepromFltSts values ");
  snprintf( chExpectedText, elCount(chExpectedText), "verify Configure CanTrcvFaultStatus[0].trcvSpcfcFlt.CrcEepromFltSts values");
  TestStepAddActionExpected( chActionText, chExpectedText );
  A_DBGR_VariableSet("CanTrcvFaultStatus[0].trcvSpcfcFlt.CrcEepromFltSts","1");
  E_DBGR_VariableCheck("CanTrcvFaultStatus[0].trcvSpcfcFlt.CrcEepromFltSts",1,Equal);

  snprintf( chActionText, elCount(chActionText), "Set Breakpoint in TestCantrcv_GetCanTrcvSpcfcFlts\\2 ");
  snprintf( chExpectedText, elCount(chExpectedText), "verify is Breakpoint Set TestCantrcv_GetCanTrcvSpcfcFlts\\2");
  TestStepAddActionExpected( chActionText, chExpectedText );
  A_DBGR_BreakpointSet("TestCantrcv_GetCanTrcvSpcfcFlts\\2");
  A_DBGR_Go();

  snprintf( chActionText, elCount(chActionText), "verify Breakpoint should hit in TestCantrcv_GetCanTrcvSpcfcFlts\\2 ");
  snprintf( chExpectedText, elCount(chExpectedText), "Breakpoint hit in TestCantrcv_GetCanTrcvSpcfcFlts\\2 function");

  E_DBGR_BreakpointCheckForHalt("TestCantrcv_GetCanTrcvSpcfcFlts\\2");

  /***************************************************************************************************************/
                                              // Test Step 5 verify that value which represents CanTrcv_FaultStatus
  /***************************************************************************************************************/
  snprintf( chActionText, elCount(chActionText), "Configure CanTrcv_FaultStatus values ");
  snprintf( chExpectedText, elCount(chExpectedText), "verify Configure CanTrcv_FaultStatus values");
  TestStepAddActionExpected( chActionText, chExpectedText );
  E_DBGR_VariableCheck("CanTrcv_FaultStatus",32768,Equal);

}



testcase Verify_that_the_GetCNDD_e_CanTrcvSpcfcFlts_function_correctly_reports_CRC_Eeprom_status_conditions_for_CANB_CAN8()
{
   /***************************************************************************************************************/
                                                // Variable Definition
  /***************************************************************************************************************/



  /***************************************************************************************************************/
                                               // Local Values
  /***************************************************************************************************************/



  /***************************************************************************************************************/
                                              // Test Case Info
  /***************************************************************************************************************/
  setWriteDbgLevel(DebugOff);
  snprintf( chTestTitle, elCount(chTestTitle), "Verify_that_the_GetCNDD_e_CanTrcvSpcfcFlts_function_correctly_reports_CRC_Eeprom_status_conditions_for_CANB_CAN8" );
  snprintf( chTestDescription, elCount(chTestDescription), "Purpose:To check GetCNDD_e_CanTrcvSpcfcFlts ");
  TestCaseAddInfo( chTestTitle, "TC_L30SW_Q-36403703", chTestDescription );

  /***************************************************************************************************************/
                                              // Start of Test Case
  /***************************************************************************************************************/

  /***************************************************************************************************************/
                                              // Test Step 0 PRECONDITIONS
  /***************************************************************************************************************/
   snprintf( chActionText, elCount(chActionText), "Flash the Software and ECU is running ");
  snprintf( chExpectedText, elCount(chExpectedText), "Ecu is should be in running state");
  TestStepAddActionExpected( chActionText, chExpectedText );

  A_DBGR_BreakpointDeleteAll();
  A_DBGR_BreakpointSet("TestCantrcv_GetCanTrcvSpcfcFlts\\2");
  A_DBGR_R();
  A_DBGR_Go();

  /***************************************************************************************************************/
                                              // Test Step 1 Call TestCantrcv_GetCanTrcvSpcfcFlts with channel ID as 1
  /***************************************************************************************************************/
  snprintf( chActionText, elCount(chActionText), "Set Breakpoint in TestCantrcv_GetCanTrcvSpcfcFlts\\2 ");
  snprintf( chExpectedText, elCount(chExpectedText), "verify is Breakpoint Set TestCantrcv_GetCanTrcvSpcfcFlts\\2");

  A_DBGR_Go();

  snprintf( chActionText, elCount(chActionText), "verify Breakpoint should hit in TestCantrcv_GetCanTrcvSpcfcFlts\\2 ");
  snprintf( chExpectedText, elCount(chExpectedText), "Breakpoint hit in TestCantrcv_GetCanTrcvSpcfcFlts\\2 function");

  E_DBGR_BreakpointCheckForHalt("TestCantrcv_GetCanTrcvSpcfcFlts\\2");

   snprintf( chActionText, elCount(chActionText), "Flash the Software and ECU is running ");
  snprintf( chExpectedText, elCount(chExpectedText), "Ecu is should be in running state");
  TestStepAddActionExpected( chActionText, chExpectedText );

  A_DBGR_BreakpointDeleteAll();

  snprintf( chActionText, elCount(chActionText), "Configure Channel_ID values ");
  snprintf( chExpectedText, elCount(chExpectedText), "verify Configure Channel_ID values");
  //TestStepAddActionExpected( chActionText, chExpectedText );
  A_DBGR_VariableSet("Channel_ID","1");

  snprintf( chActionText, elCount(chActionText), "Configure Channel_ID values ");
  snprintf( chExpectedText, elCount(chExpectedText), "verify Configure Channel_ID values");
  //TestStepAddActionExpected( chActionText, chExpectedText );
  E_DBGR_VariableCheck("Channel_ID",1,Equal);


  /***************************************************************************************************************/
                                              // Test Step 2 Set CheckCanTrcvSpcFaults value as 1
  /***************************************************************************************************************/

  snprintf( chActionText, elCount(chActionText), "Configure CheckCanTrcvSpcFaults values ");
  snprintf( chExpectedText, elCount(chExpectedText), "verify Configure CheckCanTrcvSpcFaults values");
  TestStepAddActionExpected( chActionText, chExpectedText );
  A_DBGR_VariableSet("CheckCanTrcvSpcFaults","1");

  snprintf( chActionText, elCount(chActionText), "Configure CheckCanTrcvSpcFaults values ");
  snprintf( chExpectedText, elCount(chExpectedText), "verify Configure CheckCanTrcvSpcFaults values");
  //TestStepAddActionExpected( chActionText, chExpectedText );
  E_DBGR_VariableCheck("CheckCanTrcvSpcFaults",1,Equal);

   /***************************************************************************************************************/
                                              // Test Step 3 Call GetCNDD_e_CanTrcvSpcfcFlts and verify channel ID as 1
  /***************************************************************************************************************/

  snprintf( chActionText, elCount(chActionText), "Set Breakpoint in GetCNDD_e_CanTrcvSpcfcFlts ");
  snprintf( chExpectedText, elCount(chExpectedText), "verify is Breakpoint Set GetCNDD_e_CanTrcvSpcfcFlts");
  TestStepAddActionExpected( chActionText, chExpectedText );
  A_DBGR_BreakpointSet("GetCNDD_e_CanTrcvSpcfcFlts");

  snprintf( chActionText, elCount(chActionText), "Flash the Software and ECU is running ");
  snprintf( chExpectedText, elCount(chExpectedText), "Ecu is should be in running state");
  //TestStepAddActionExpected( chActionText, chExpectedText );
  A_DBGR_Go();

  snprintf( chActionText, elCount(chActionText), "verify Breakpoint should hit in GetCNDD_e_CanTrcvSpcfcFlts ");
  snprintf( chExpectedText, elCount(chExpectedText), "Breakpoint hit in GetCNDD_e_CanTrcvSpcfcFlts function");

  E_DBGR_BreakpointCheckForHalt("GetCNDD_e_CanTrcvSpcfcFlts");

   snprintf( chActionText, elCount(chActionText), "Flash the Software and ECU is running ");
  snprintf( chExpectedText, elCount(chExpectedText), "Ecu is should be in running state");
  TestStepAddActionExpected( chActionText, chExpectedText );

  A_DBGR_BreakpointDeleteAll();

  snprintf( chActionText, elCount(chActionText), "Configure Channel_ID values ");
  snprintf( chExpectedText, elCount(chExpectedText), "verify Configure Channel_ID values");
  //TestStepAddActionExpected( chActionText, chExpectedText );
  A_DBGR_VariableSet("Channel_ID","1");
  E_DBGR_VariableCheck("Channel_ID",1,Equal);

  /***************************************************************************************************************/
                                              // Test Step 4 Simulate CRC_Eeprom_status
  /***************************************************************************************************************/

  snprintf( chActionText, elCount(chActionText), "Configure CanTrcvFaultStatus[1].trcvSpcfcFlt.swErrFltSts values ");
  snprintf( chExpectedText, elCount(chExpectedText), "verify Configure CanTrcvFaultStatus[1].trcvSpcfcFlt.swErrFltSts values");
  TestStepAddActionExpected( chActionText, chExpectedText );
  A_DBGR_VariableSet("CanTrcvFaultStatus[1].trcvSpcfcFlt.CrcEepromFltSts","1");
  E_DBGR_VariableCheck("CanTrcvFaultStatus[1].trcvSpcfcFlt.CrcEepromFltSts",1,Equal);

  snprintf( chActionText, elCount(chActionText), "Set Breakpoint in TestCantrcv_GetCanTrcvSpcfcFlts\\2 ");
  snprintf( chExpectedText, elCount(chExpectedText), "verify is Breakpoint Set TestCantrcv_GetCanTrcvSpcfcFlts\\2");
  TestStepAddActionExpected( chActionText, chExpectedText );
  A_DBGR_BreakpointSet("TestCantrcv_GetCanTrcvSpcfcFlts\\2");
  A_DBGR_Go();

  snprintf( chActionText, elCount(chActionText), "verify Breakpoint should hit in TestCantrcv_GetCanTrcvSpcfcFlts\\2 ");
  snprintf( chExpectedText, elCount(chExpectedText), "Breakpoint hit in TestCantrcv_GetCanTrcvSpcfcFlts\\2 function");

  E_DBGR_BreakpointCheckForHalt("TestCantrcv_GetCanTrcvSpcfcFlts\\2");

  /***************************************************************************************************************/
                                              // Test Step 5 verify that value which represents CanTrcv_FaultStatus
  /***************************************************************************************************************/
  snprintf( chActionText, elCount(chActionText), "Configure CanTrcv_FaultStatus values ");
  snprintf( chExpectedText, elCount(chExpectedText), "verify Configure CanTrcv_FaultStatus values");
  TestStepAddActionExpected( chActionText, chExpectedText );
  E_DBGR_VariableCheck("CanTrcv_FaultStatus",32768,Equal);
}



testcase Verify_that_the_fault_status_is_reset_after_a_controller_reset_for_CANA_CAN2()
{
   /***************************************************************************************************************/
                                                // Variable Definition
  /***************************************************************************************************************/



  /***************************************************************************************************************/
                                               // Local Values
  /***************************************************************************************************************/



  /***************************************************************************************************************/
                                              // Test Case Info
  /***************************************************************************************************************/
  setWriteDbgLevel(DebugOff);
  snprintf( chTestTitle, elCount(chTestTitle), "Verify_that_the_fault_status_is_reset_after_a_controller_reset_for_CANA_CAN2" );
  snprintf( chTestDescription, elCount(chTestDescription), "Purpose:To check GetCNDD_e_CanTrcvSpcfcFlts ");
  TestCaseAddInfo( chTestTitle, "TC_L30SW_Q-36403683", chTestDescription );

  /***************************************************************************************************************/
                                              // Start of Test Case
  /***************************************************************************************************************/

  /***************************************************************************************************************/
                                              // Test Step 0 PRECONDITIONS
  /***************************************************************************************************************/
   snprintf( chActionText, elCount(chActionText), "Flash the Software and ECU is running ");
  snprintf( chExpectedText, elCount(chExpectedText), "Ecu is should be in running state");
  TestStepAddActionExpected( chActionText, chExpectedText );

  A_DBGR_BreakpointDeleteAll();
  A_DBGR_BreakpointSet("TestCantrcv_GetCanTrcvSpcfcFlts\\2");
  A_DBGR_R();
  A_DBGR_Go();

  /***************************************************************************************************************/
                                              // Test Step 1 Call TestCantrcv_GetCanTrcvSpcfcFlts with channel ID as 0
  /***************************************************************************************************************/
  snprintf( chActionText, elCount(chActionText), "Set Breakpoint in TestCantrcv_GetCanTrcvSpcfcFlts\\2 ");
  snprintf( chExpectedText, elCount(chExpectedText), "verify is Breakpoint Set TestCantrcv_GetCanTrcvSpcfcFlts\\2");

  A_DBGR_Go();

  snprintf( chActionText, elCount(chActionText), "verify Breakpoint should hit in TestCantrcv_GetCanTrcvSpcfcFlts\\2 ");
  snprintf( chExpectedText, elCount(chExpectedText), "Breakpoint hit in TestCantrcv_GetCanTrcvSpcfcFlts\\2 function");

  E_DBGR_BreakpointCheckForHalt("TestCantrcv_GetCanTrcvSpcfcFlts\\2");

   snprintf( chActionText, elCount(chActionText), "Flash the Software and ECU is running ");
  snprintf( chExpectedText, elCount(chExpectedText), "Ecu is should be in running state");
  TestStepAddActionExpected( chActionText, chExpectedText );

  A_DBGR_BreakpointDeleteAll();
  /***************************************************************************************************************/
                                              // Test Step 2 Set CheckCanTrcvSpcFaults value as 1
  /***************************************************************************************************************/

  snprintf( chActionText, elCount(chActionText), "Configure CheckCanTrcvSpcFaults values ");
  snprintf( chExpectedText, elCount(chExpectedText), "verify Configure CheckCanTrcvSpcFaults values");
  //TestStepAddActionExpected( chActionText, chExpectedText );
  A_DBGR_VariableSet("CheckCanTrcvSpcFaults","1");

  snprintf( chActionText, elCount(chActionText), "Configure CheckCanTrcvSpcFaults values ");
  snprintf( chExpectedText, elCount(chExpectedText), "verify Configure CheckCanTrcvSpcFaults values");
  //TestStepAddActionExpected( chActionText, chExpectedText );
  E_DBGR_VariableCheck("CheckCanTrcvSpcFaults",1,Equal);

   /***************************************************************************************************************/
                                              // Test Step 3 Call GetCNDD_e_CanTrcvSpcfcFlts and verify channel ID as 0
  /***************************************************************************************************************/

  snprintf( chActionText, elCount(chActionText), "Set Breakpoint in GetCNDD_e_CanTrcvSpcfcFlts ");
  snprintf( chExpectedText, elCount(chExpectedText), "verify is Breakpoint Set GetCNDD_e_CanTrcvSpcfcFlts");
  TestStepAddActionExpected( chActionText, chExpectedText );
  A_DBGR_BreakpointSet("GetCNDD_e_CanTrcvSpcfcFlts");

  snprintf( chActionText, elCount(chActionText), "Flash the Software and ECU is running ");
  snprintf( chExpectedText, elCount(chExpectedText), "Ecu is should be in running state");
  //TestStepAddActionExpected( chActionText, chExpectedText );
  A_DBGR_Go();

  snprintf( chActionText, elCount(chActionText), "verify Breakpoint should hit in GetCNDD_e_CanTrcvSpcfcFlts ");
  snprintf( chExpectedText, elCount(chExpectedText), "Breakpoint hit in GetCNDD_e_CanTrcvSpcfcFlts function");

  E_DBGR_BreakpointCheckForHalt("GetCNDD_e_CanTrcvSpcfcFlts");

   snprintf( chActionText, elCount(chActionText), "Flash the Software and ECU is running ");
  snprintf( chExpectedText, elCount(chExpectedText), "Ecu is should be in running state");
  TestStepAddActionExpected( chActionText, chExpectedText );

  A_DBGR_BreakpointDeleteAll();

  snprintf( chActionText, elCount(chActionText), "Configure Channel_ID values ");
  snprintf( chExpectedText, elCount(chExpectedText), "verify Configure Channel_ID values");
  //TestStepAddActionExpected( chActionText, chExpectedText );
  A_DBGR_VariableSet("Channel_ID","0");
  E_DBGR_VariableCheck("Channel_ID",0,Equal);

  /***************************************************************************************************************/
                                              // Test Step 4 Simulate CRC_Eeprom_status
  /***************************************************************************************************************/

  snprintf( chActionText, elCount(chActionText), "Configure CanTrcvFaultStatus[0].trcvSpcfcFlt.CrcEepromFltSts values ");
  snprintf( chExpectedText, elCount(chExpectedText), "verify Configure CanTrcvFaultStatus[0].trcvSpcfcFlt.CrcEepromFltSts values");
  TestStepAddActionExpected( chActionText, chExpectedText );
  A_DBGR_VariableSet("CanTrcvFaultStatus[0].trcvSpcfcFlt.spiifFltSts","1");
  E_DBGR_VariableCheck("CanTrcvFaultStatus[0].trcvSpcfcFlt.spiifFltSts",1,Equal);

  snprintf( chActionText, elCount(chActionText), "Flash the Software and ECU is running ");
  snprintf( chExpectedText, elCount(chExpectedText), "Ecu is should be in running state");
  TestStepAddActionExpected( chActionText, chExpectedText );
  A_DBGR_Go();

  /***************************************************************************************************************/
                                              // Test Step 5 verify that value which represents CanTrcv_FaultStatus
  /***************************************************************************************************************/
  snprintf( chActionText, elCount(chActionText), "Configure CanTrcv_FaultStatus values ");
  snprintf( chExpectedText, elCount(chExpectedText), "verify Configure CanTrcv_FaultStatus values");
  //TestStepAddActionExpected( chActionText, chExpectedText );
  E_DBGR_VariableCheck("CanTrcv_FaultStatus",32768,Equal);

  /***************************************************************************************************************/
                                              // Test Step 6 Reset the CanTrcv_FaultStatus
  /***************************************************************************************************************/

  snprintf( chActionText, elCount(chActionText), "Configure CanTrcv_FaultStatus values ");
  snprintf( chExpectedText, elCount(chExpectedText), "verify Configure CanTrcv_FaultStatus values");
  TestStepAddActionExpected( chActionText, chExpectedText );
  E_DBGR_VariableCheck("CanTrcvFaultStatus[0].trcvFltSts",0,Equal);


}



testcase Verify_that_the_fault_status_is_reset_after_a_controller_reset_for_CANB_CAN8()
{
    /***************************************************************************************************************/
                                                // Variable Definition
  /***************************************************************************************************************/



  /***************************************************************************************************************/
                                               // Local Values
  /***************************************************************************************************************/



  /***************************************************************************************************************/
                                              // Test Case Info
  /***************************************************************************************************************/
  setWriteDbgLevel(DebugOff);
  snprintf( chTestTitle, elCount(chTestTitle), "Verify_that_the_fault_status_is_reset_after_a_controller_reset_for_CANB_CAN8" );
  snprintf( chTestDescription, elCount(chTestDescription), "Purpose:To check GetCNDD_e_CanTrcvSpcfcFlts ");
  TestCaseAddInfo( chTestTitle, "TC_L30SW_Q-36403684", chTestDescription );

  /***************************************************************************************************************/
                                              // Start of Test Case
  /***************************************************************************************************************/

  /***************************************************************************************************************/
                                              // Test Step 0 PRECONDITIONS
  /***************************************************************************************************************/
   snprintf( chActionText, elCount(chActionText), "Flash the Software and ECU is running ");
  snprintf( chExpectedText, elCount(chExpectedText), "Ecu is should be in running state");
  TestStepAddActionExpected( chActionText, chExpectedText );

  A_DBGR_BreakpointDeleteAll();
  A_DBGR_BreakpointSet("TestCantrcv_GetCanTrcvSpcfcFlts\\2");
  A_DBGR_R();
  A_DBGR_Go();

  /***************************************************************************************************************/
                                              // Test Step 1 Call TestCantrcv_GetCanTrcvSpcfcFlts with channel ID as 1
  /***************************************************************************************************************/
  snprintf( chActionText, elCount(chActionText), "Set Breakpoint in TestCantrcv_GetCanTrcvSpcfcFlts\\2 ");
  snprintf( chExpectedText, elCount(chExpectedText), "verify is Breakpoint Set TestCantrcv_GetCanTrcvSpcfcFlts\\2");

  A_DBGR_Go();

  snprintf( chActionText, elCount(chActionText), "verify Breakpoint should hit in TestCantrcv_GetCanTrcvSpcfcFlts\\2 ");
  snprintf( chExpectedText, elCount(chExpectedText), "Breakpoint hit in TestCantrcv_GetCanTrcvSpcfcFlts\\2 function");

  E_DBGR_BreakpointCheckForHalt("TestCantrcv_GetCanTrcvSpcfcFlts\\2");

   snprintf( chActionText, elCount(chActionText), "Flash the Software and ECU is running ");
  snprintf( chExpectedText, elCount(chExpectedText), "Ecu is should be in running state");
  TestStepAddActionExpected( chActionText, chExpectedText );

  A_DBGR_BreakpointDeleteAll();

  snprintf( chActionText, elCount(chActionText), "Configure Channel_ID values ");
  snprintf( chExpectedText, elCount(chExpectedText), "verify Configure Channel_ID values");
  //TestStepAddActionExpected( chActionText, chExpectedText );
  A_DBGR_VariableSet("Channel_ID","1");

  snprintf( chActionText, elCount(chActionText), "Configure Channel_ID values ");
  snprintf( chExpectedText, elCount(chExpectedText), "verify Configure Channel_ID values");
  //TestStepAddActionExpected( chActionText, chExpectedText );
  E_DBGR_VariableCheck("Channel_ID",1,Equal);


  /***************************************************************************************************************/
                                              // Test Step 2 Set CheckCanTrcvSpcFaults value as 1
  /***************************************************************************************************************/

  snprintf( chActionText, elCount(chActionText), "Configure CheckCanTrcvSpcFaults values ");
  snprintf( chExpectedText, elCount(chExpectedText), "verify Configure CheckCanTrcvSpcFaults values");
  TestStepAddActionExpected( chActionText, chExpectedText );
  A_DBGR_VariableSet("CheckCanTrcvSpcFaults","1");

  snprintf( chActionText, elCount(chActionText), "Configure CheckCanTrcvSpcFaults values ");
  snprintf( chExpectedText, elCount(chExpectedText), "verify Configure CheckCanTrcvSpcFaults values");
  //TestStepAddActionExpected( chActionText, chExpectedText );
  E_DBGR_VariableCheck("CheckCanTrcvSpcFaults",1,Equal);

   /***************************************************************************************************************/
                                              // Test Step 3 Call GetCNDD_e_CanTrcvSpcfcFlts and verify channel ID as 1
  /***************************************************************************************************************/

  snprintf( chActionText, elCount(chActionText), "Set Breakpoint in GetCNDD_e_CanTrcvSpcfcFlts ");
  snprintf( chExpectedText, elCount(chExpectedText), "verify is Breakpoint Set GetCNDD_e_CanTrcvSpcfcFlts");
  TestStepAddActionExpected( chActionText, chExpectedText );
  A_DBGR_BreakpointSet("GetCNDD_e_CanTrcvSpcfcFlts");

  snprintf( chActionText, elCount(chActionText), "Flash the Software and ECU is running ");
  snprintf( chExpectedText, elCount(chExpectedText), "Ecu is should be in running state");
  //TestStepAddActionExpected( chActionText, chExpectedText );
  A_DBGR_Go();

  snprintf( chActionText, elCount(chActionText), "verify Breakpoint should hit in GetCNDD_e_CanTrcvSpcfcFlts ");
  snprintf( chExpectedText, elCount(chExpectedText), "Breakpoint hit in GetCNDD_e_CanTrcvSpcfcFlts function");

  E_DBGR_BreakpointCheckForHalt("GetCNDD_e_CanTrcvSpcfcFlts");

   snprintf( chActionText, elCount(chActionText), "Flash the Software and ECU is running ");
  snprintf( chExpectedText, elCount(chExpectedText), "Ecu is should be in running state");
  TestStepAddActionExpected( chActionText, chExpectedText );

  A_DBGR_BreakpointDeleteAll();

  snprintf( chActionText, elCount(chActionText), "Configure Channel_ID values ");
  snprintf( chExpectedText, elCount(chExpectedText), "verify Configure Channel_ID values");
 // TestStepAddActionExpected( chActionText, chExpectedText );
  A_DBGR_VariableSet("Channel_ID","1");
  E_DBGR_VariableCheck("Channel_ID",1,Equal);

  /***************************************************************************************************************/
                                              // Test Step 4 Simulate CRC_Eeprom_status
  /***************************************************************************************************************/

  snprintf( chActionText, elCount(chActionText), "Configure CanTrcvFaultStatus[1].trcvSpcfcFlt.CrcEepromFltSts values ");
  snprintf( chExpectedText, elCount(chExpectedText), "verify Configure CanTrcvFaultStatus[1].trcvSpcfcFlt.CrcEepromFltSts values");
  TestStepAddActionExpected( chActionText, chExpectedText );
  A_DBGR_VariableSet("CanTrcvFaultStatus[1].trcvSpcfcFlt.spiifFltSts","1");
  E_DBGR_VariableCheck("CanTrcvFaultStatus[1].trcvSpcfcFlt.spiifFltSts",1,Equal);

  snprintf( chActionText, elCount(chActionText), "Flash the Software and ECU is running ");
  snprintf( chExpectedText, elCount(chExpectedText), "Ecu is should be in running state");
  TestStepAddActionExpected( chActionText, chExpectedText );
  A_DBGR_Go();

  /***************************************************************************************************************/
                                              // Test Step 5 verify that value which represents CanTrcv_FaultStatus
  /***************************************************************************************************************/
  snprintf( chActionText, elCount(chActionText), "Configure CanTrcv_FaultStatus values ");
  snprintf( chExpectedText, elCount(chExpectedText), "verify Configure CanTrcv_FaultStatus values");
  //TestStepAddActionExpected( chActionText, chExpectedText );
  E_DBGR_VariableCheck("CanTrcv_FaultStatus",32768,Equal);

  /***************************************************************************************************************/
                                              // Test Step 6 Reset the CanTrcv_FaultStatus
  /***************************************************************************************************************/
  snprintf( chActionText, elCount(chActionText), "Configure CanTrcv_FaultStatus values ");
  snprintf( chExpectedText, elCount(chExpectedText), "verify Configure CanTrcv_FaultStatus values");
  TestStepAddActionExpected( chActionText, chExpectedText );
  E_DBGR_VariableCheck("CanTrcvFaultStatus[1].trcvFltSts",0,Equal);


}

testcase Verify_that_the_GetCNDD_Cnt_CanLoVoltEvnt_function_correctly_reports_the_low_voltage_event_counter_for_a_specified_CANA_CAN2()
{
  /***************************************************************************************************************/
                                                // Variable Definition
  /***************************************************************************************************************/



  /***************************************************************************************************************/
                                               // Local Values
  /***************************************************************************************************************/



  /***************************************************************************************************************/
                                              // Test Case Info
  /***************************************************************************************************************/
  setWriteDbgLevel(DebugOff);
  snprintf( chTestTitle, elCount(chTestTitle), "Verify_that_the_GetCNDD_Cnt_CanLoVoltEvnt_function_correctly_reports_the_low_voltage_event_counter_for_a_specified_CANA_CAN2" );
  snprintf( chTestDescription, elCount(chTestDescription), "Purpose:To check the GetCNDD_Cnt_CanLoVoltEvnt interface  ");
  TestCaseAddInfo( chTestTitle, "TC_L30SW_Q-36403672", chTestDescription );

  /***************************************************************************************************************/
                                              // Start of Test Case
  /***************************************************************************************************************/

  /***************************************************************************************************************/
                                              // Test Step 0 PRECONDITIONS
  /***************************************************************************************************************/
   snprintf( chActionText, elCount(chActionText), "Flash the Software and ECU is running ");
  snprintf( chExpectedText, elCount(chExpectedText), "Ecu is should be in running state");
  TestStepAddActionExpected( chActionText, chExpectedText );

  A_DBGR_BreakpointDeleteAll();
  A_DBGR_BreakpointSet("TestCantrcv_GetCanLoVoltEvnt\\2");
  A_DBGR_R();
  A_DBGR_Go();

  /***************************************************************************************************************/
                                              // Test Step 1 Configure the values for the structure TsCNDD_CanCnfgType with the minimum message length for CANA.
  /***************************************************************************************************************/
  snprintf( chActionText, elCount(chActionText), "Set Breakpoint in TestCantrcv_GetCanLoVoltEvnt\\2 ");
  snprintf( chExpectedText, elCount(chExpectedText), "verify is Breakpoint Set TestCantrcv_GetCanLoVoltEvnt\\2");

  A_DBGR_Go();

  snprintf( chActionText, elCount(chActionText), "verify Breakpoint should hit in TestCantrcv_GetCanLoVoltEvnt\\2 ");
  snprintf( chExpectedText, elCount(chExpectedText), "Breakpoint hit in TestCantrcv_GetCanLoVoltEvnt\\2 function");

  E_DBGR_BreakpointCheckForHalt("TestCantrcv_GetCanLoVoltEvnt\\2");

  snprintf( chActionText, elCount(chActionText), "Configure CheckCanLoEvent values ");
  snprintf( chExpectedText, elCount(chExpectedText), "verify Configure CheckCanLoEvent values");
  TestStepAddActionExpected( chActionText, chExpectedText );
  A_DBGR_VariableSet("CheckCanLoEvent","1");
  E_DBGR_VariableCheck("CheckCanLoEvent",1,Equal);

  snprintf( chActionText, elCount(chActionText), "Flash the Software and ECU is running ");
  snprintf( chExpectedText, elCount(chExpectedText), "Ecu is should be in running state");
  TestStepAddActionExpected( chActionText, chExpectedText );
  A_DBGR_BreakpointDeleteAll();
  A_DBGR_BreakpointSet("BatDisconnectStatus_MainFunc\\57");

  snprintf( chActionText, elCount(chActionText), "Flash the Software and ECU is running ");
  snprintf( chExpectedText, elCount(chExpectedText), "Ecu is should be in running state");
  //TestStepAddActionExpected( chActionText, chExpectedText );
  A_DBGR_Go();

  snprintf( chActionText, elCount(chActionText), "Set Breakpoint in BatDisconnectStatus_MainFunc\\57 ");
  snprintf( chExpectedText, elCount(chExpectedText), "verify is Breakpoint Set BatDisconnectStatus_MainFunc\\57");

  A_GENERIC_SetTimeout(100,"waiting for power supply change");
//  snprintf( chActionText, elCount(chActionText), "Set voltage to 4 volts ");
//  snprintf( chExpectedText, elCount(chExpectedText), "Voltage is 4");
//  Set_voltage(powersupply_port,3.6);
 // @sysvar::PowGeneral_Variables::VoltageVal = 4000;
  //@sysvar::PowGeneral_Variables::ReadVoltage = 1;
  Set_voltage(powersupply_port,4.5);

  Set_voltage(powersupply_port,12);

   snprintf( chActionText, elCount(chActionText), "verify Breakpoint should hit in TestCantrcv_GetCanLoVoltEvnt\\2 ");
  snprintf( chExpectedText, elCount(chExpectedText), "Breakpoint hit in TestCantrcv_GetCanLoVoltEvnt\\2 function");

  E_DBGR_BreakpointCheckForHalt("BatDisconnectStatus_MainFunc\\57");
//  snprintf( chActionText, elCount(chActionText), "Set voltage to 12 volts ");
//  snprintf( chExpectedText, elCount(chExpectedText), "Voltage is 12");
//  Set_voltage(powersupply_port,12);

  @sysvar::PowGeneral_Variables::VoltageVal = 12000;
  @sysvar::PowGeneral_Variables::ReadVoltage = 1;


  A_GENERIC_SetTimeout(10000,"waiting for power supply change");

  snprintf( chActionText, elCount(chActionText), "Configure CheckCanLoEvent values ");
  snprintf( chExpectedText, elCount(chExpectedText), "verify Configure CheckCanLoEvent values");
  //TestStepAddActionExpected( chActionText, chExpectedText );
  E_DBGR_VariableCheck("CanTrcv_UvSupCount_0",1,Equal);

}



testcase Verify_that_the_GetCNDD_Cnt_CanLoVoltEvnt_function_correctly_reports_the_low_voltage_event_counter_for_a_specified_CANB_CAN8()
{
  /***************************************************************************************************************/
                                                // Variable Definition
  /***************************************************************************************************************/



  /***************************************************************************************************************/
                                               // Local Values
  /***************************************************************************************************************/



  /***************************************************************************************************************/
                                              // Test Case Info
  /***************************************************************************************************************/
  setWriteDbgLevel(DebugOff);
  snprintf( chTestTitle, elCount(chTestTitle), "Verify_that_the_GetCNDD_Cnt_CanLoVoltEvnt_function_correctly_reports_the_low_voltage_event_counter_for_a_specified_CANB_CAN8" );
  snprintf( chTestDescription, elCount(chTestDescription), "Purpose:To check the GetCNDD_Cnt_CanLoVoltEvnt interface  ");
  TestCaseAddInfo( chTestTitle, "TC_L30SW_Q-36403673", chTestDescription );

  /***************************************************************************************************************/
                                              // Start of Test Case
  /***************************************************************************************************************/

  /***************************************************************************************************************/
                                              // Test Step 0 PRECONDITIONS
  /***************************************************************************************************************/
   snprintf( chActionText, elCount(chActionText), "Flash the Software and ECU is running ");
  snprintf( chExpectedText, elCount(chExpectedText), "Ecu is should be in running state");
  TestStepAddActionExpected( chActionText, chExpectedText );

  A_DBGR_BreakpointDeleteAll();
  A_DBGR_BreakpointSet("TestCantrcv_GetCanLoVoltEvnt\\2");
  A_DBGR_R();
  A_DBGR_Go();

  /***************************************************************************************************************/
                                              // Test Step 1 Configure the values for the structure TsCNDD_CanCnfgType with the minimum message length for CANA.
  /***************************************************************************************************************/
  snprintf( chActionText, elCount(chActionText), "Set Breakpoint in TestCantrcv_GetCanLoVoltEvnt\\2 ");
  snprintf( chExpectedText, elCount(chExpectedText), "verify is Breakpoint Set TestCantrcv_GetCanLoVoltEvnt\\2");

  A_DBGR_Go();

  snprintf( chActionText, elCount(chActionText), "verify Breakpoint should hit in TestCantrcv_GetCanLoVoltEvnt\\2 ");
  snprintf( chExpectedText, elCount(chExpectedText), "Breakpoint hit in TestCantrcv_GetCanLoVoltEvnt\\2 function");

  E_DBGR_BreakpointCheckForHalt("TestCantrcv_GetCanLoVoltEvnt\\2");

  snprintf( chActionText, elCount(chActionText), "Configure CheckCanLoEvent values ");
  snprintf( chExpectedText, elCount(chExpectedText), "verify Configure CheckCanLoEvent values");
  TestStepAddActionExpected( chActionText, chExpectedText );
  A_DBGR_VariableSet("CheckCanLoEvent","1");
  E_DBGR_VariableCheck("CheckCanLoEvent",1,Equal);


  snprintf( chActionText, elCount(chActionText), "Flash the Software and ECU is running ");
  snprintf( chExpectedText, elCount(chExpectedText), "Ecu is should be in running state");
  TestStepAddActionExpected( chActionText, chExpectedText );
  A_DBGR_BreakpointDeleteAll();


  snprintf( chActionText, elCount(chActionText), "Set Breakpoint in TestCantrcv_GetCanLoVoltEvnt\\4 ");
  snprintf( chExpectedText, elCount(chExpectedText), "verify is Breakpoint Set TestCantrcv_GetCanLoVoltEvnt\\4");
  //TestStepAddActionExpected( chActionText, chExpectedText );
  A_DBGR_Go();

//  snprintf( chActionText, elCount(chActionText), "Set voltage to 4 volts ");
//  snprintf( chExpectedText, elCount(chExpectedText), "Voltage is 4");
//  Set_voltage(powersupply_port,3.6);
  @sysvar::PowGeneral_Variables::VoltageVal = 4000;
  @sysvar::PowGeneral_Variables::ReadVoltage = 1;

  A_GENERIC_SetTimeout(3000,"waiting for power supply change");

//  snprintf( chActionText, elCount(chActionText), "Set voltage to 12 volts ");
//  snprintf( chExpectedText, elCount(chExpectedText), "Voltage is 12");
//  Set_voltage(powersupply_port,12);
  @sysvar::PowGeneral_Variables::VoltageVal = 12000;
  @sysvar::PowGeneral_Variables::ReadVoltage = 1;

  A_GENERIC_SetTimeout(3000,"waiting for power supply change");

  snprintf( chActionText, elCount(chActionText), "Configure CheckCanLoEvent values ");
  snprintf( chExpectedText, elCount(chExpectedText), "verify Configure CheckCanLoEvent values");
  //TestStepAddActionExpected( chActionText, chExpectedText );
  E_DBGR_VariableCheck("CanTrcv_UvSupCount_1",1,Equal);

}



testcase Verify_that_the_GetCNDD_Cnt_CanLoVoltEvnt_function_correctly_increments_for_multiple_low_voltage_events_for_CANA_CAN2()
{
  /***************************************************************************************************************/
                                                // Variable Definition
  /***************************************************************************************************************/



  /***************************************************************************************************************/
                                               // Local Values
  /***************************************************************************************************************/



  /***************************************************************************************************************/
                                              // Test Case Info
  /***************************************************************************************************************/
  setWriteDbgLevel(DebugOff);
  snprintf( chTestTitle, elCount(chTestTitle), "Verify_that_the_GetCNDD_Cnt_CanLoVoltEvnt_function_correctly_reports_the_low_voltage_event_counter_for_a_specified_CANA_CAN2" );
  snprintf( chTestDescription, elCount(chTestDescription), "Purpose:To check the GetCNDD_Cnt_CanLoVoltEvnt interface  ");
  TestCaseAddInfo( chTestTitle, "TC_L30SW_Q-36403672", chTestDescription );

  /***************************************************************************************************************/
                                              // Start of Test Case
  /***************************************************************************************************************/

  /***************************************************************************************************************/
                                              // Test Step 0 PRECONDITIONS
  /***************************************************************************************************************/
   snprintf( chActionText, elCount(chActionText), "Flash the Software and ECU is running ");
  snprintf( chExpectedText, elCount(chExpectedText), "Ecu is should be in running state");
  TestStepAddActionExpected( chActionText, chExpectedText );

  A_DBGR_BreakpointDeleteAll();
  A_DBGR_BreakpointSet("TestCantrcv_GetCanLoVoltEvnt\\2");
  A_DBGR_R();
  A_DBGR_Go();

  /***************************************************************************************************************/
                                              // Test Step 1 Configure the values for the structure TsCNDD_CanCnfgType with the minimum message length for CANA.
  /***************************************************************************************************************/
  snprintf( chActionText, elCount(chActionText), "Set Breakpoint in TestCantrcv_GetCanLoVoltEvnt\\2 ");
  snprintf( chExpectedText, elCount(chExpectedText), "verify is Breakpoint Set TestCantrcv_GetCanLoVoltEvnt\\2");

  A_DBGR_Go();

  snprintf( chActionText, elCount(chActionText), "verify Breakpoint should hit in TestCantrcv_GetCanLoVoltEvnt\\2 ");
  snprintf( chExpectedText, elCount(chExpectedText), "Breakpoint hit in TestCantrcv_GetCanLoVoltEvnt\\2 function");

  E_DBGR_BreakpointCheckForHalt("TestCantrcv_GetCanLoVoltEvnt\\2");

  snprintf( chActionText, elCount(chActionText), "Configure CheckCanLoEvent values ");
  snprintf( chExpectedText, elCount(chExpectedText), "verify Configure CheckCanLoEvent values");
  TestStepAddActionExpected( chActionText, chExpectedText );
  A_DBGR_VariableSet("CheckCanLoEvent","1");
  E_DBGR_VariableCheck("CheckCanLoEvent",1,Equal);

  snprintf( chActionText, elCount(chActionText), "Flash the Software and ECU is running ");
  snprintf( chExpectedText, elCount(chExpectedText), "Ecu is should be in running state");
  TestStepAddActionExpected( chActionText, chExpectedText );
  A_DBGR_BreakpointDeleteAll();

  snprintf( chActionText, elCount(chActionText), "Flash the Software and ECU is running ");
  snprintf( chExpectedText, elCount(chExpectedText), "Ecu is should be in running state");
  //TestStepAddActionExpected( chActionText, chExpectedText );
  A_DBGR_Go();

//  snprintf( chActionText, elCount(chActionText), "Set voltage to 4 volts ");
//  snprintf( chExpectedText, elCount(chExpectedText), "Voltage is 4");
//  Set_voltage(powersupply_port,3.6);

  @sysvar::PowGeneral_Variables::VoltageVal = 4000;
  @sysvar::PowGeneral_Variables::ReadVoltage = 1;


  A_GENERIC_SetTimeout(3000,"waiting for power supply change");

//  snprintf( chActionText, elCount(chActionText), "Set voltage to 12 volts ");
//  snprintf( chExpectedText, elCount(chExpectedText), "Voltage is 12");
//  Set_voltage(powersupply_port,12);

  @sysvar::PowGeneral_Variables::VoltageVal = 12000;
  @sysvar::PowGeneral_Variables::ReadVoltage = 1;


  A_GENERIC_SetTimeout(3000,"waiting for power supply change");


  @sysvar::PowGeneral_Variables::VoltageVal = 4000;
  @sysvar::PowGeneral_Variables::ReadVoltage = 1;


  A_GENERIC_SetTimeout(3000,"waiting for power supply change");

//  snprintf( chActionText, elCount(chActionText), "Set voltage to 12 volts ");
//  snprintf( chExpectedText, elCount(chExpectedText), "Voltage is 12");
//  Set_voltage(powersupply_port,12);

  @sysvar::PowGeneral_Variables::VoltageVal = 12000;
  @sysvar::PowGeneral_Variables::ReadVoltage = 1;


  A_GENERIC_SetTimeout(3000,"waiting for power supply change");

  snprintf( chActionText, elCount(chActionText), "Configure CheckCanLoEvent values ");
  snprintf( chExpectedText, elCount(chExpectedText), "verify Configure CheckCanLoEvent values");
  //TestStepAddActionExpected( chActionText, chExpectedText );
  E_DBGR_VariableCheck("CanTrcv_UvSupCount_0",2,Equal);

}



testcase Verify_that_the_GetCNDD_Cnt_CanLoVoltEvnt_function_correctly_increments_for_multiple_simulated_low_voltage_events_for_CANB_CAN8()
{
   /***************************************************************************************************************/
                                                // Variable Definition
  /***************************************************************************************************************/



  /***************************************************************************************************************/
                                               // Local Values
  /***************************************************************************************************************/



  /***************************************************************************************************************/
                                              // Test Case Info
  /***************************************************************************************************************/
  setWriteDbgLevel(DebugOff);
  snprintf( chTestTitle, elCount(chTestTitle), "Verify_that_the_GetCNDD_Cnt_CanLoVoltEvnt_function_correctly_increments_for_multiple_simulated_low_voltage_events_for_CANB_CAN8" );
  snprintf( chTestDescription, elCount(chTestDescription), "Purpose:To check the GetCNDD_Cnt_CanLoVoltEvnt interface  ");
  TestCaseAddInfo( chTestTitle, "TC_L30SW_Q-36403675", chTestDescription );

  /***************************************************************************************************************/
                                              // Start of Test Case
  /***************************************************************************************************************/

  /***************************************************************************************************************/
                                              // Test Step 0 PRECONDITIONS
  /***************************************************************************************************************/
   snprintf( chActionText, elCount(chActionText), "Flash the Software and ECU is running ");
  snprintf( chExpectedText, elCount(chExpectedText), "Ecu is should be in running state");
  TestStepAddActionExpected( chActionText, chExpectedText );

  A_DBGR_BreakpointDeleteAll();
  A_DBGR_BreakpointSet("TestCantrcv_GetCanLoVoltEvnt\\2");
  A_DBGR_R();
  A_DBGR_Go();

  /***************************************************************************************************************/
                                              // Test Step 1 Configure the values for the structure TsCNDD_CanCnfgType with the minimum message length for CANA.
  /***************************************************************************************************************/
  snprintf( chActionText, elCount(chActionText), "Set Breakpoint in TestCantrcv_GetCanLoVoltEvnt\\2 ");
  snprintf( chExpectedText, elCount(chExpectedText), "verify is Breakpoint Set TestCantrcv_GetCanLoVoltEvnt\\2");

  A_DBGR_Go();

  snprintf( chActionText, elCount(chActionText), "verify Breakpoint should hit in TestCantrcv_GetCanLoVoltEvnt\\2 ");
  snprintf( chExpectedText, elCount(chExpectedText), "Breakpoint hit in TestCantrcv_GetCanLoVoltEvnt\\2 function");

  E_DBGR_BreakpointCheckForHalt("TestCantrcv_GetCanLoVoltEvnt\\2");

  snprintf( chActionText, elCount(chActionText), "Configure CheckCanLoEvent values ");
  snprintf( chExpectedText, elCount(chExpectedText), "verify Configure CheckCanLoEvent values");
  TestStepAddActionExpected( chActionText, chExpectedText );
  A_DBGR_VariableSet("CheckCanLoEvent","1");
  E_DBGR_VariableCheck("CheckCanLoEvent",1,Equal);

  snprintf( chActionText, elCount(chActionText), "Flash the Software and ECU is running ");
  snprintf( chExpectedText, elCount(chExpectedText), "Ecu is should be in running state");
  TestStepAddActionExpected( chActionText, chExpectedText );
  A_DBGR_BreakpointDeleteAll();

  snprintf( chActionText, elCount(chActionText), "Flash the Software and ECU is running ");
  snprintf( chExpectedText, elCount(chExpectedText), "Ecu is should be in running state");
  //TestStepAddActionExpected( chActionText, chExpectedText );
  A_DBGR_Go();

//  snprintf( chActionText, elCount(chActionText), "Set voltage to 4 volts ");
//  snprintf( chExpectedText, elCount(chExpectedText), "Voltage is 4");
//  Set_voltage(powersupply_port,3.6);
  @sysvar::PowGeneral_Variables::VoltageVal = 4000;
  @sysvar::PowGeneral_Variables::ReadVoltage = 1;


  A_GENERIC_SetTimeout(3000,"waiting for power supply change");

//  snprintf( chActionText, elCount(chActionText), "Set voltage to 12 volts ");
//  snprintf( chExpectedText, elCount(chExpectedText), "Voltage is 12");
//  Set_voltage(powersupply_port,12);

  @sysvar::PowGeneral_Variables::VoltageVal = 12000;
  @sysvar::PowGeneral_Variables::ReadVoltage = 1;


  A_GENERIC_SetTimeout(3000,"waiting for power supply change");


//  snprintf( chActionText, elCount(chActionText), "Set voltage to 12 volts ");
//  snprintf( chExpectedText, elCount(chExpectedText), "Voltage is 12");
//  Set_voltage(powersupply_port,12);

  @sysvar::PowGeneral_Variables::VoltageVal = 4000;
  @sysvar::PowGeneral_Variables::ReadVoltage = 1;


  A_GENERIC_SetTimeout(3000,"waiting for power supply change");

//  snprintf( chActionText, elCount(chActionText), "Set voltage to 12 volts ");
//  snprintf( chExpectedText, elCount(chExpectedText), "Voltage is 12");
//  Set_voltage(powersupply_port,12);

  @sysvar::PowGeneral_Variables::VoltageVal = 12000;
  @sysvar::PowGeneral_Variables::ReadVoltage = 1;


  A_GENERIC_SetTimeout(3000,"waiting for power supply change");
  snprintf( chActionText, elCount(chActionText), "Configure CheckCanLoEvent values ");
  snprintf( chExpectedText, elCount(chExpectedText), "verify Configure CheckCanLoEvent values");
  //TestStepAddActionExpected( chActionText, chExpectedText );
  E_DBGR_VariableCheck("CanTrcv_UvSupCount_1",2,Equal);

}



testcase Verify_that_the_low_voltage_event_counter_is_reset_after_a_controller_reset_for_CANA_CAN2()
{
  /***************************************************************************************************************/
                                                // Variable Definition
  /***************************************************************************************************************/



  /***************************************************************************************************************/
                                               // Local Values
  /***************************************************************************************************************/



  /***************************************************************************************************************/
                                              // Test Case Info
  /***************************************************************************************************************/
  setWriteDbgLevel(DebugOff);
  snprintf( chTestTitle, elCount(chTestTitle), "Verify_that_the_low_voltage_event_counter_is_reset_after_a_controller_reset_for_CANA_CAN2" );
  snprintf( chTestDescription, elCount(chTestDescription), "Purpose:To check the GetCNDD_Cnt_CanLoVoltEvnt interface  ");
  TestCaseAddInfo( chTestTitle, "TC_L30SW_Q-36403683", chTestDescription );

  /***************************************************************************************************************/
                                              // Start of Test Case
  /***************************************************************************************************************/

  /***************************************************************************************************************/
                                              // Test Step 0 PRECONDITIONS
  /***************************************************************************************************************/
   snprintf( chActionText, elCount(chActionText), "Flash the Software and ECU is running ");
  snprintf( chExpectedText, elCount(chExpectedText), "Ecu is should be in running state");
  TestStepAddActionExpected( chActionText, chExpectedText );

  A_DBGR_BreakpointDeleteAll();
  A_DBGR_BreakpointSet("TestCantrcv_GetCanLoVoltEvnt\\2");
  A_DBGR_R();
  A_DBGR_Go();

  /***************************************************************************************************************/
                                              // Test Step 1 Configure the values for the structure TsCNDD_CanCnfgType with the minimum message length for CANA.
  /***************************************************************************************************************/
  snprintf( chActionText, elCount(chActionText), "Set Breakpoint in TestCantrcv_GetCanLoVoltEvnt\\2 ");
  snprintf( chExpectedText, elCount(chExpectedText), "verify is Breakpoint Set TestCantrcv_GetCanLoVoltEvnt\\2");

  A_DBGR_Go();

  snprintf( chActionText, elCount(chActionText), "verify Breakpoint should hit in TestCantrcv_GetCanLoVoltEvnt\\2 ");
  snprintf( chExpectedText, elCount(chExpectedText), "Breakpoint hit in TestCantrcv_GetCanLoVoltEvnt\\2 function");

  E_DBGR_BreakpointCheckForHalt("TestCantrcv_GetCanLoVoltEvnt\\2");

  snprintf( chActionText, elCount(chActionText), "Configure CheckCanLoEvent values ");
  snprintf( chExpectedText, elCount(chExpectedText), "verify Configure CheckCanLoEvent values");
  TestStepAddActionExpected( chActionText, chExpectedText );
  A_DBGR_VariableSet("CheckCanLoEvent","1");
  E_DBGR_VariableCheck("CheckCanLoEvent",1,Equal);

  snprintf( chActionText, elCount(chActionText), "Flash the Software and ECU is running ");
  snprintf( chExpectedText, elCount(chExpectedText), "Ecu is should be in running state");
  TestStepAddActionExpected( chActionText, chExpectedText );
  A_DBGR_BreakpointDeleteAll();

  snprintf( chActionText, elCount(chActionText), "Flash the Software and ECU is running ");
  snprintf( chExpectedText, elCount(chExpectedText), "Ecu is should be in running state");
  //TestStepAddActionExpected( chActionText, chExpectedText );
  A_DBGR_Go();

//  snprintf( chActionText, elCount(chActionText), "Set voltage to 4 volts ");
//  snprintf( chExpectedText, elCount(chExpectedText), "Voltage is 4");
//  Set_voltage(powersupply_port,3.6);
  @sysvar::PowGeneral_Variables::VoltageVal = 4000;
  @sysvar::PowGeneral_Variables::ReadVoltage = 1;

  A_GENERIC_SetTimeout(3000,"waiting for power supply change");

//  snprintf( chActionText, elCount(chActionText), "Set voltage to 12 volts ");
//  snprintf( chExpectedText, elCount(chExpectedText), "Voltage is 12");
//  Set_voltage(powersupply_port,12);
  @sysvar::PowGeneral_Variables::VoltageVal = 12000;
  @sysvar::PowGeneral_Variables::ReadVoltage = 1;


  A_GENERIC_SetTimeout(3000,"waiting for power supply change");

  snprintf( chActionText, elCount(chActionText), "Configure CheckCanLoEvent values ");
  snprintf( chExpectedText, elCount(chExpectedText), "verify Configure CheckCanLoEvent values");
  //TestStepAddActionExpected( chActionText, chExpectedText );
  E_DBGR_VariableCheck("CanTrcv_UvSupCount_0",1,Equal);

  snprintf( chActionText, elCount(chActionText), "Flash the Soft0are and ECU is running ");
  snprintf( chExpectedText, elCount(chExpectedText), "Ecu is should be in running state");
  TestStepAddActionExpected( chActionText, chExpectedText );
  A_DBGR_R();

  snprintf( chActionText, elCount(chActionText), "Flash the Soft0are and ECU is running ");
  snprintf( chExpectedText, elCount(chExpectedText), "Ecu is should be in running state");
 // TestStepAddActionExpected( chActionText, chExpectedText );
  A_DBGR_Go();

  snprintf( chActionText, elCount(chActionText), "Configure CheckCanLoEvent values ");
  snprintf( chExpectedText, elCount(chExpectedText), "verify Configure CheckCanLoEvent values");
  //TestStepAddActionExpected( chActionText, chExpectedText );
  E_DBGR_VariableCheck("CanTrcv_UvSupCount_0",0,Equal);

}



testcase Verify_that_the_low_voltage_event_counter_is_reset_after_a_controller_reset_for_CANB_CAN8()
{
   /***************************************************************************************************************/
                                                // Variable Definition
  /***************************************************************************************************************/



  /***************************************************************************************************************/
                                               // Local Values
  /***************************************************************************************************************/



  /***************************************************************************************************************/
                                              // Test Case Info
  /***************************************************************************************************************/
  setWriteDbgLevel(DebugOff);
  snprintf( chTestTitle, elCount(chTestTitle), "Verify_that_the_low_voltage_event_counter_is_reset_after_a_controller_reset_for_CANB_CAN8" );
  snprintf( chTestDescription, elCount(chTestDescription), "Purpose:To check the GetCNDD_Cnt_CanLoVoltEvnt interface  ");
  TestCaseAddInfo( chTestTitle, "TC_L30SW_Q-36403684", chTestDescription );

 /***************************************************************************************************************/
                                              // Start of Test Case
  /***************************************************************************************************************/

  /***************************************************************************************************************/
                                              // Test Step 0 PRECONDITIONS
  /***************************************************************************************************************/
   snprintf( chActionText, elCount(chActionText), "Flash the Software and ECU is running ");
  snprintf( chExpectedText, elCount(chExpectedText), "Ecu is should be in running state");
  TestStepAddActionExpected( chActionText, chExpectedText );

  A_DBGR_BreakpointDeleteAll();
  A_DBGR_BreakpointSet("TestCantrcv_GetCanLoVoltEvnt\\2");
  A_DBGR_R();
  A_DBGR_Go();

  /***************************************************************************************************************/
                                              // Test Step 1 Configure the values for the structure TsCNDD_CanCnfgType with the minimum message length for CANA.
  /***************************************************************************************************************/
  snprintf( chActionText, elCount(chActionText), "Set Breakpoint in TestCantrcv_GetCanLoVoltEvnt\\2 ");
  snprintf( chExpectedText, elCount(chExpectedText), "verify is Breakpoint Set TestCantrcv_GetCanLoVoltEvnt\\2");

  A_DBGR_Go();

  snprintf( chActionText, elCount(chActionText), "verify Breakpoint should hit in TestCantrcv_GetCanLoVoltEvnt\\2 ");
  snprintf( chExpectedText, elCount(chExpectedText), "Breakpoint hit in TestCantrcv_GetCanLoVoltEvnt\\2 function");

  E_DBGR_BreakpointCheckForHalt("TestCantrcv_GetCanLoVoltEvnt\\2");

  snprintf( chActionText, elCount(chActionText), "Configure CheckCanLoEvent values ");
  snprintf( chExpectedText, elCount(chExpectedText), "verify Configure CheckCanLoEvent values");
  TestStepAddActionExpected( chActionText, chExpectedText );
  A_DBGR_VariableSet("CheckCanLoEvent","1");
  E_DBGR_VariableCheck("CheckCanLoEvent",1,Equal);

  snprintf( chActionText, elCount(chActionText), "Flash the Software and ECU is running ");
  snprintf( chExpectedText, elCount(chExpectedText), "Ecu is should be in running state");
  TestStepAddActionExpected( chActionText, chExpectedText );
  A_DBGR_BreakpointDeleteAll();

  snprintf( chActionText, elCount(chActionText), "Flash the Software and ECU is running ");
  snprintf( chExpectedText, elCount(chExpectedText), "Ecu is should be in running state");
  //TestStepAddActionExpected( chActionText, chExpectedText );
  A_DBGR_Go();

//  snprintf( chActionText, elCount(chActionText), "Set voltage to 4 volts ");
//  snprintf( chExpectedText, elCount(chExpectedText), "Voltage is 4");
//  Set_voltage(powersupply_port,3.6);
  @sysvar::PowGeneral_Variables::VoltageVal = 4000;
  @sysvar::PowGeneral_Variables::ReadVoltage = 1;

  A_GENERIC_SetTimeout(3000,"waiting for power supply change");

//  snprintf( chActionText, elCount(chActionText), "Set voltage to 12 volts ");
//  snprintf( chExpectedText, elCount(chExpectedText), "Voltage is 12");
//  Set_voltage(powersupply_port,12);
  @sysvar::PowGeneral_Variables::VoltageVal = 12000;
  @sysvar::PowGeneral_Variables::ReadVoltage = 1;


  A_GENERIC_SetTimeout(3000,"waiting for power supply change");

  snprintf( chActionText, elCount(chActionText), "Configure CheckCanLoEvent values ");
  snprintf( chExpectedText, elCount(chExpectedText), "verify Configure CheckCanLoEvent values");
  //TestStepAddActionExpected( chActionText, chExpectedText );
  E_DBGR_VariableCheck("CanTrcv_UvSupCount_1",1,Equal);

  snprintf( chActionText, elCount(chActionText), "Flash the Soft0are and ECU is running ");
  snprintf( chExpectedText, elCount(chExpectedText), "Ecu is should be in running state");
  TestStepAddActionExpected( chActionText, chExpectedText );
  A_DBGR_R();

  snprintf( chActionText, elCount(chActionText), "Flash the Soft0are and ECU is running ");
  snprintf( chExpectedText, elCount(chExpectedText), "Ecu is should be in running state");
 // TestStepAddActionExpected( chActionText, chExpectedText );
  A_DBGR_Go();

  snprintf( chActionText, elCount(chActionText), "Configure CheckCanLoEvent values ");
  snprintf( chExpectedText, elCount(chExpectedText), "verify Configure CheckCanLoEvent values");
  //TestStepAddActionExpected( chActionText, chExpectedText );
  E_DBGR_VariableCheck("CanTrcv_UvSupCount_1",0,Equal);

}


testcase Stress_for_WakeUp_Sleep()
{
  /***************************************************************************************************************/
                                                // Variable Definition
  /***************************************************************************************************************/



  /***************************************************************************************************************/
                                               // Local Values
  /***************************************************************************************************************/



  /***************************************************************************************************************/
                                              // Test Case Info
  /***************************************************************************************************************/
  setWriteDbgLevel(DebugOff);
  snprintf( chTestTitle, elCount(chTestTitle), "Verify_MngCNDD_CanTrcvInitialize_interface_for_CAN_Transceiver_Initialization_for_CANA_CAN2" );
  snprintf( chTestDescription, elCount(chTestDescription), "Purpose:To check the MngCNDD_CanTrcvInitialize interface for CAN2 channel");
  TestCaseAddInfo( chTestTitle, "TC_L30SW_Q-36403647", chTestDescription );

  /***************************************************************************************************************/
                                              // Start of Test Case
  /***************************************************************************************************************/

  /***************************************************************************************************************/
                                              // Test Step 0 PRECONDITIONS
  /***************************************************************************************************************/

  snprintf( chActionText, elCount(chActionText), "Flash the Software and ECU is running ");
  snprintf( chExpectedText, elCount(chExpectedText), "ECU should be in running state");
  TestStepAddActionExpected( chActionText, chExpectedText );
  while(1)
  {
  A_DBGR_BreakpointDeleteAll();
  A_DBGR_VariableSet("StartPowerDown","1");
  A_DBGR_R();
  A_DBGR_Go();
  /***************************************************************************************************************/
                                              // Test Step 1 debugger Running
  /***************************************************************************************************************/
  snprintf( chActionText, elCount(chActionText), "Flash the Software and ECU is running ");
  snprintf( chExpectedText, elCount(chExpectedText), "ECU should be in running state");
  //TestStepAddActionExpected( chActionText, chExpectedText );
  A_DBGR_Go();
  //A_DBGR_Go();
  /***************************************************************************************************************/
                                              // Test Step 3  Call the function Test_SetHWIO_PowerDown by setting StartPowerDown to 1 then check transceiver is in the SLEEP mode and PMIC to STANDBY mode
  /***************************************************************************************************************/
  snprintf( chActionText, elCount(chActionText), "Configure StartPowerDown variable to invoke Test_SetHWIO_PowerDown interface");
  snprintf( chExpectedText, elCount(chExpectedText), "Verify StartPowerDown is configured as 1");

  /***************************************************************************************************************/
                                              // Test Step Verify Transceiver is in sleep or not.
  /***************************************************************************************************************/
  snprintf( chActionText, elCount(chActionText), "Transmit CAN message. ID:0x40000101, PDU info:0x01");
  snprintf( chExpectedText, elCount(chExpectedText), "CAN message transmitted. ID:0x40000101, PDU info:0x01");
  E_CAN_WaitForMessageByID(0x00000101,15000,cc_eCAN_ABSENT,"CAN1");

  /***************************************************************************************************************/
                                              // Test Step 4  This step involves sending a CAN wakeup frame with ID 0x123 and 8 bytes of data from Canoe.
  /***************************************************************************************************************/
  if(Stress % 2 == 1)
  {
  snprintf( chActionText, elCount(chActionText), "Transmit CAN message. ID:0x123");
  snprintf( chExpectedText, elCount(chExpectedText), "CAN message transmitted. ID:0x123");
  TestStepAddActionExpected( chActionText, chExpectedText );
  A_CAN_SendMessage(0x123, CANA_Wakeup, 8, 1);
  A_CAN_SendMessage(0x123, CANA_Wakeup, 8, 1);
  }
  else
  {
  snprintf( chActionText, elCount(chActionText), "Transmit CAN message. ID:0x456");
  snprintf( chExpectedText, elCount(chExpectedText), "CAN message transmitted. ID:0x456");
  TestStepAddActionExpected( chActionText, chExpectedText );
  A_CAN_SendMessage(0x456, CANB_Wakeup, 4, 2);
  A_CAN_SendMessage(0x456, CANB_Wakeup, 4, 2);
  }

  /***************************************************************************************************************/
                                              // Test Step 5  Verify Transceiver wakeUp or not.
  /***************************************************************************************************************/
  snprintf( chActionText, elCount(chActionText), "Transmit CAN message. ID:0x40000101, PDU info:0x01");
  snprintf( chExpectedText, elCount(chExpectedText), "CAN message transmitted. ID:0x40000101, PDU info:0x01");
  //TestStepAddActionExpected( chActionText, chExpectedText );

  E_CAN_WaitForMessageByID(0x00000102,15000,cc_eCAN_PRESENT,"CAN1");
  Stress = Stress+1;

  snprintf(chActionText, elCount(chActionText), "Stress Test count %d",Stress);
    snprintf(chExpectedText, elCount(chExpectedText), "Stress Test count %d",Stress);
  TestStepAddActionExpected( chActionText, chExpectedText );
    A_CAN_SendMessage(CANID[i], dat_64byte, 8, 2);

  if(Stress == 100)
  {
    break;
  }
  }
}




/*void MainTest ()
{
  ToVerify_MngCNDD_CanRxInitInterface_Initialization_with_Minimum_Message_Length_for_CANA_CAN2();
  To_verify_MngCNDD_CanRxInit_Interface_that_the_CAN_controller_for_CANB_CAN8_is_initialized_correctly_and_messages_are_transmitted_as_expected();
  To_verify_MngCNDD_CanRxInit_Interface_that_the_CAN_controller_for_CANA_CAN2_and_CANB_CAN8_is_initialized_correctly_and_messages_are_transmitted_as_expected();
  To_Verify_MngCNDD_CanRxInit_Interface_Initialization_with_Minimum_Message_Length_for_CANB_CAN8();
  To_Verify_MngCNDD_CanRxInit_Interface_Initialization_with_Maximum_Message_Length_for_CANB_CAN8();
  To_Verify_MngCNDD_CanRxInit_Interface_Initialization_with_Maximum_Message_Length_for_CANA_CAN2();
  To_Verify_MngCNDD_CanRxInit_Interface_Initialization_with_Extended_Message_ID_for_CANA_CAN2();
  To_Verify_MngCNDD_CanRxInit_Interface_Initialization_with_Extended_Message_ID_for_CANB_CAN8();
  To_Verify_MngCNDD_CanRxInit_Interface_Initialization_with_Standard_Message_ID_for_CANA_CAN2();
  To_Verify_MngCNDD_CanRxInit_Interface_Initialization_with_Standard_Message_ID_for_CANB_CAN8();
  To_verify_the_Interface_CntrlCNDD_h_CanWrt_Transmission_with_Maximum_Message_Length_on_CANB_CAN8();
  To_verify_the_Interface_CntrlCNDD_h_CanWrt_Transmission_with_Maximum_Message_Length_on_CANA_CAN2();
  To_Verify_CntrlCNDD_h_CanWrt_Interface_transmitted_Message_successfully_for_CANA_CAN2();
  To_verify_the_Interface_CntrlCNDD_h_CanWrt_Transmission_with_Minimum_Message_Length_on_CANA_CAN2();
  To_Verify_SetCANR_e_CanIfTxConfirmation_Interface_transmitted_Message_successfully_for_Standard_CANB_CAN8();
  To_Verify_SetCANR_e_CanIfTxConfirmation_Interface_transmitted_Message_successfully_for_Standard_CANA_CAN2();
  To_Verify_CntrlCNDD_h_CanWrt_Interface_transmitted_Message_successfully_for_CANB_CAN8();
  To_Verify_CntrlCNDD_h_CanWrt_Interface_transmitted_Message_successfully_for_CANA_CAN2_and_CANB_CAN8();
  To_verify_the_Interface_CntrlCNDD_h_CanWrt_Transmission_with_Minimum_Message_Length_on_CANB_CAN8();
  Verify_SetCNDD_e_CanControllerMode_Interface_Transition_to_Stop_Mode_for_CANA_CAN2();
  Verify_SetCNDD_e_CanControllerMode_Interface_Transition_to_Stop_Mode_for_CANB_CAN8();
  Verify_SetCNDD_e_CanControllerMode_Interface_Transition_to_Invalid_Mode_for_CANA_CAN2();
  Verify_SetCNDD_e_CanControllerMode_Interface_Transition_to_Invalid_Mode_for_CANB_CAN8();
  To_Verify_SetCNDD_e_CanControllerMode_Interface_Transition_to_Start_Mode_for_CANA_CAN2();
  To_Verify_SetCNDD_e_CanControllerMode_Interface_Transition_to_Start_Mode_for_CANB_CAN8();
  Verify_SetCNDD_e_CanControllerMode_Interface_Transition_to_Sleep_Mode_for_CANA_CAN2();
  Verify_SetCNDD_e_CanControllerMode_Interface_Transition_to_Sleep_Mode_for_CANB_CAN8();
  Verify_SetCNDD_e_CanControllerMode_Interface_Transition_to_WakeUp_Mode_for_CANA_CAN2();
  Verify_SetCNDD_e_CanControllerMode_Interface_Transition_to_WakeUp_Mode_for_CANB_CAN8();
  Verify_MngCNDD_CanMainMode_interface_Mode_Transition_to_Stop_Mode_for_CANA_CAN2();
  Verify_MngCNDD_CanMainMode_interface_Mode_Transition_to_Start_Mode_for_CANA_CAN2();
  Verify_the_interface_MngCNDD_CanMainRead_upon_CAN_Message_Reception_callback_function_SetCANR_h_CanIfRxIndication_should_invoke_for_CANA_CAN2();
  Verify_the_interface_MngCNDD_CanMainRead_upon_CAN_Message_Reception_callback_function_SetCANR_h_CanIfRxIndication_for_CANB_CAN8_should_invoke();
  Verify_MngCNDD_CanMainBusOff_Interface_CAN_Bus_Off_Detection_for_CANA_CAN2();
  Verify_SetCNDD_e_CanTrcvOpMode_Interface_by_Setting_CAN_Transceiver_to_Normal_Mode_for_CANA_CAN2();
  Verify_SetCNDD_e_CanTrcvOpMode_Interface_by_Setting_CAN_Transceiver_to_Sleep_Mode_for_CANA_CAN2();
  Verify_SetCNDD_e_CanTrcvOpMode_Interface_by_Setting_CAN_Transceiver_to_Standby_Mode_for_CANA_CAN2();
  Verify_SetCNDD_e_CanTrcvOpMode_Interface_by_Setting_CAN_Transceiver_to_LISTEN_ONLY_Mode_for_CANA_CAN2();
  Verify_SetCNDD_e_CanTrcvOpMode_Interface_by_Setting_CAN_Transceiver_to_Normal_Mode_for_CANB_CAN8();
  Verify_SetCNDD_e_CanTrcvOpMode_Interface_by_Setting_CAN_Transceiver_to_Sleep_Mode_for_CANB_CAN8();
  Verify_SetCNDD_e_CanTrcvOpMode_Interface_by_Setting_CAN_Transceiver_to_Standby_Mode_for_CANB_CAN8();
  Verify_SetCNDD_e_CanTrcvOpMode_Interface_by_Setting_CAN_Transceiver_to_LISTEN_ONLY_Mode_for_CANB_CAN8();
}*/

