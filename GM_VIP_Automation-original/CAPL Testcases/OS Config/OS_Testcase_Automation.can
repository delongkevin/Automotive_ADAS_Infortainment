/*@!Encoding:1252*/

includes
{
  #include "..\..\AutomationDependent\ProjectSpecific\GenLib_Includes.cin"
}

variables
{
  char chTestDescription[500];
  char chActionText[500];
  char chExpectedText[500];
  char chTestTitle[100];
  
  byte dat_102[3] = {0xAA,0x55,0xAA};
  mstimer delay;
  
}

  on timer delay 
  {
    write("wait for 3 Sec");
  }

  
  
  
  
   
/***************************************************************************************************
----------------------------------------------------------------------------------------------------
Test case name:  TC_L30SW_Q-36649610: Test_case_to_verify_the_functionality_of_interface_DisableHWIO_AllTasks_to_Disable_all_the_task_from_any_one_CPU()
----------------------------------------------------------------------------------------------------
Description:   test case to verify the functionality of interface DisableHWIO_AllTasks() to Disable all the task from any one CPU.

***************************************************************************************************/
testcase Test_case_to_verify_the_functionality_of_interface_DisableHWIO_AllTasks_to_Disable_all_the_task_from_any_one_CPU()
{
  /***************************************************************************************************************/    
                                                // Variable Definition
  /***************************************************************************************************************/ 
  
  long taskvalue;
  
  /***************************************************************************************************************/    
                                               // Local Values
  /***************************************************************************************************************/ 
  

  
  /***************************************************************************************************************/    
                                              // Test Case Info
  /***************************************************************************************************************/
  setWriteDbgLevel(DebugOff);
  snprintf( chTestTitle, elCount(chTestTitle), "Test_case_to_verify_the_functionality_of_interface_DisableHWIO_AllTasks_to_Disable_all_the_task_from_any_one_CPU" );
  snprintf( chTestDescription, elCount(chTestDescription), "Purpose:Test case to verify the functionality of interface DisableHWIO_AllTasks() to Disable all the task from any one CPU");
  TestCaseAddInfo( chTestTitle, "TC_L30SW_QT_36649610", chTestDescription );

  /***************************************************************************************************************/    
                                              // Start of Test Case
  /***************************************************************************************************************/
  
  /***************************************************************************************************************/    
                                              // Test Step 1 PRECONDITIONS
  /***************************************************************************************************************/
  
  snprintf( chActionText, elCount(chActionText), "Flash the Software and ECU is running"); 
  snprintf( chExpectedText, elCount(chExpectedText), "ECU should be in running state"); 
  TestStepAddActionExpected( chActionText, chExpectedText );

  A_DBGR_BreakpointDeleteAll();
  A_DBGR_RnGo();
  E_DBGR_CheckState(T32_State_Running);
  

   /***************************************************************************************************************/    
                                              // Test Step 1 Check all cores are in running state
  /***************************************************************************************************************/
  
  //Check Core0 is running
  snprintf( chActionText, elCount(chActionText), "Check 1000ms Task Counter from Core0 "); 
  snprintf( chExpectedText, elCount(chExpectedText), "1000ms Counter from Core0 is incrementing"); 
  TestStepAddActionExpected( chActionText, chExpectedText );
  A_DBGR_VariableRead( "Task_Core0_1000ms_Count", taskvalue);
  E_DBGR_VariableCheck("Task_Core0_1000ms_Count", taskvalue, Greater);
  
  //Check Core1 is running
  snprintf( chActionText, elCount(chActionText), "Check 1000ms Task Counter from Core1 "); 
  snprintf( chExpectedText, elCount(chExpectedText), "1000ms Counter from Core1 is incrementing"); 
  TestStepAddActionExpected( chActionText, chExpectedText );
  A_DBGR_VariableRead( "Task_Core1_1000ms_Count", taskvalue);  
  E_DBGR_VariableCheck("Task_Core1_1000ms_Count", taskvalue, Greater);
  
  //Check Core2 is running
  snprintf( chActionText, elCount(chActionText), "Check 1000ms Task Counter from Core2 "); 
  snprintf( chExpectedText, elCount(chExpectedText), "1000ms Counter from Core2 is incrementing"); 
  TestStepAddActionExpected( chActionText, chExpectedText );
  A_DBGR_VariableRead( "Task_Core2_1000ms_Count", taskvalue);
  E_DBGR_VariableCheck("Task_Core2_1000ms_Count", taskvalue, Greater);
    
  //Check Core3 is running
  snprintf( chActionText, elCount(chActionText), "Check 1000ms Task Counter from Core3 "); 
  snprintf( chExpectedText, elCount(chExpectedText), "1000ms Counter from Core3 is incrementing"); 
  TestStepAddActionExpected( chActionText, chExpectedText );
  A_DBGR_VariableRead( "Task_Core3_1000ms_Count", taskvalue);
  E_DBGR_VariableCheck("Task_Core3_1000ms_Count", taskvalue, Greater);
    
  //Check Core4 is running
  snprintf( chActionText, elCount(chActionText), "Check 1000ms Task Counter from Core4 "); 
  snprintf( chExpectedText, elCount(chExpectedText), "1000ms Counter from Core4 is incrementing"); 
  TestStepAddActionExpected( chActionText, chExpectedText );
  A_DBGR_VariableRead( "Task_Core4_1000ms_Count", taskvalue);
  E_DBGR_VariableCheck("Task_Core4_1000ms_Count", taskvalue, Greater);
    
  //Check Core5 is running
  snprintf( chActionText, elCount(chActionText), "Check 1000ms Task Counter from Core5 "); 
  snprintf( chExpectedText, elCount(chExpectedText), "1000ms Counter from Core5 is incrementing"); 
  TestStepAddActionExpected( chActionText, chExpectedText );
  A_DBGR_VariableRead( "Task_Core5_1000ms_Count", taskvalue);
  E_DBGR_VariableCheck("Task_Core5_1000ms_Count", taskvalue, Greater);
 
  
  /***************************************************************************************************************/    
  // Test Step 3 At runtime set core0 disable flag as TRUE in file app\hwio\os_hwio\Implementation\appl_dummy_impl.c static boolean disableAllTasks[ OS_NUM_OS_CORES ] = { FALSE , FALSE, FALSE, FALSE, FALSE, FALSE}; disableAllTasks[0]=TRUE
  /***************************************************************************************************************/
  
  snprintf( chActionText, elCount(chActionText), "Disable core 0 tasks"); 
  snprintf( chExpectedText, elCount(chExpectedText), "core 0 disabled"); 
  TestStepAddActionExpected( chActionText, chExpectedText );
  A_DBGR_VariableSet("disableAllTasks[0]", "1");
  E_DBGR_VariableCheck("disableAllTasks[0]", 0, Equal);   //variable is not updating in watch window when we disable task as TRUE, therfore checking 0 value here
  
  /***************************************************************************************************************/    
        // Test Step 4 check the task counters for all the cores stopped.
  /***************************************************************************************************************/
  
  //Check All tasks of Core0 are stopped
  snprintf( chActionText, elCount(chActionText), "Check 2pt5ms Task Counter from Core0 "); 
  snprintf( chExpectedText, elCount(chExpectedText), "2pt5ms Counter from Core0 is stop incrementing"); 
  TestStepAddActionExpected( chActionText, chExpectedText );
  A_DBGR_VariableRead( "Task_Core0_2pt5ms_Count", taskvalue);
  E_DBGR_VariableCheck("Task_Core0_2pt5ms_Count", taskvalue, Equal);
  
  snprintf( chActionText, elCount(chActionText), "Check 5ms Task Counter from Core0 "); 
  snprintf( chExpectedText, elCount(chExpectedText), "5ms Counter from Core0 is stop incrementing"); 
  TestStepAddActionExpected( chActionText, chExpectedText );
  A_DBGR_VariableRead( "Task_Core0_5ms_Count", taskvalue);
  E_DBGR_VariableCheck("Task_Core0_5ms_Count", taskvalue, Equal);
  
  snprintf( chActionText, elCount(chActionText), "Check 10ms Task Counter from Core0 "); 
  snprintf( chExpectedText, elCount(chExpectedText), "10ms Counter from Core0 is stop incrementing"); 
  TestStepAddActionExpected( chActionText, chExpectedText );
  A_DBGR_VariableRead( "Task_Core0_10ms_Count", taskvalue);
  E_DBGR_VariableCheck("Task_Core0_10ms_Count", taskvalue, Equal);  
  
  snprintf( chActionText, elCount(chActionText), "Check 25ms Task Counter from Core0 "); 
  snprintf( chExpectedText, elCount(chExpectedText), "25ms Counter from Core0 is stop incrementing"); 
  TestStepAddActionExpected( chActionText, chExpectedText );
  A_DBGR_VariableRead( "Task_Core0_25ms_Count", taskvalue);
  E_DBGR_VariableCheck("Task_Core0_25ms_Count", taskvalue, Equal);  

  snprintf( chActionText, elCount(chActionText), "Check 50ms Task Counter from Core0 "); 
  snprintf( chExpectedText, elCount(chExpectedText), "50ms Counter from Core0 is stop incrementing"); 
  TestStepAddActionExpected( chActionText, chExpectedText );
  A_DBGR_VariableRead( "Task_Core0_50ms_Count", taskvalue);
  E_DBGR_VariableCheck("Task_Core0_50ms_Count", taskvalue, Equal);
  
  snprintf( chActionText, elCount(chActionText), "Check 250ms Task Counter from Core0 "); 
  snprintf( chExpectedText, elCount(chExpectedText), "250ms Counter from Core0 is stop incrementing"); 
  TestStepAddActionExpected( chActionText, chExpectedText );
  A_DBGR_VariableRead( "Task_Core0_250ms_Count", taskvalue);
  E_DBGR_VariableCheck("Task_Core0_250ms_Count", taskvalue, Equal);
  
  snprintf( chActionText, elCount(chActionText), "Check 100ms Task Counter from Core0 "); 
  snprintf( chExpectedText, elCount(chExpectedText), "100ms Counter from Core0 is stop incrementing"); 
  TestStepAddActionExpected( chActionText, chExpectedText );
  A_DBGR_VariableRead( "Task_Core0_100ms_Count", taskvalue);
  E_DBGR_VariableCheck("Task_Core0_100ms_Count", taskvalue, Equal); 

  snprintf( chActionText, elCount(chActionText), "Check 500ms Task Counter from Core0 "); 
  snprintf( chExpectedText, elCount(chExpectedText), "500ms Counter from Core0 is stop incrementing"); 
  TestStepAddActionExpected( chActionText, chExpectedText );
  A_DBGR_VariableRead( "Task_Core0_500ms_Count", taskvalue);
  E_DBGR_VariableCheck("Task_Core0_500ms_Count", taskvalue, Equal);
  
  snprintf( chActionText, elCount(chActionText), "Check 1000ms Task Counter from Core0 "); 
  snprintf( chExpectedText, elCount(chExpectedText), "1000ms Counter from Core0 is stop incrementing"); 
  TestStepAddActionExpected( chActionText, chExpectedText );
  A_DBGR_VariableRead( "Task_Core0_1000ms_Count", taskvalue);
  E_DBGR_VariableCheck("Task_Core0_1000ms_Count", taskvalue, Equal);
  
  
  //Check All tasks of Core1 are stopped
  snprintf( chActionText, elCount(chActionText), "Check 2pt5ms Task Counter from Core1 "); 
  snprintf( chExpectedText, elCount(chExpectedText), "2pt5ms Counter from Core1 is stop incrementing"); 
  TestStepAddActionExpected( chActionText, chExpectedText );
  A_DBGR_VariableRead( "Task_Core1_2pt5ms_Count", taskvalue);
  E_DBGR_VariableCheck("Task_Core1_2pt5ms_Count", taskvalue, Equal);
  
  snprintf( chActionText, elCount(chActionText), "Check 5ms Task Counter from Core1 "); 
  snprintf( chExpectedText, elCount(chExpectedText), "5ms Counter from Core1 is stop incrementing"); 
  TestStepAddActionExpected( chActionText, chExpectedText );
  A_DBGR_VariableRead( "Task_Core1_5ms_Count", taskvalue);
  E_DBGR_VariableCheck("Task_Core1_5ms_Count", taskvalue, Equal);
  
  snprintf( chActionText, elCount(chActionText), "Check 10ms Task Counter from Core1 "); 
  snprintf( chExpectedText, elCount(chExpectedText), "10ms Counter from Core1 is stop incrementing"); 
  TestStepAddActionExpected( chActionText, chExpectedText );
  A_DBGR_VariableRead( "Task_Core1_10ms_Count", taskvalue);
  E_DBGR_VariableCheck("Task_Core1_10ms_Count", taskvalue, Equal);  
  
  snprintf( chActionText, elCount(chActionText), "Check 25ms Task Counter from Core1 "); 
  snprintf( chExpectedText, elCount(chExpectedText), "25ms Counter from Core1 is stop incrementing"); 
  TestStepAddActionExpected( chActionText, chExpectedText );
  A_DBGR_VariableRead( "Task_Core1_25ms_Count", taskvalue);
  E_DBGR_VariableCheck("Task_Core1_25ms_Count", taskvalue, Equal); 
  
  snprintf( chActionText, elCount(chActionText), "Check 50ms Task Counter from Core1 "); 
  snprintf( chExpectedText, elCount(chExpectedText), "50ms Counter from Core1 is stop incrementing"); 
  TestStepAddActionExpected( chActionText, chExpectedText );
  A_DBGR_VariableRead( "Task_Core1_50ms_Count", taskvalue);
  E_DBGR_VariableCheck("Task_Core1_50ms_Count", taskvalue, Equal);
    
  snprintf( chActionText, elCount(chActionText), "Check 100ms Task Counter from Core1 "); 
  snprintf( chExpectedText, elCount(chExpectedText), "100ms Counter from Core1 is stop incrementing"); 
  TestStepAddActionExpected( chActionText, chExpectedText );
  A_DBGR_VariableRead( "Task_Core1_100ms_Count", taskvalue);
  E_DBGR_VariableCheck("Task_Core1_100ms_Count", taskvalue, Equal);

  snprintf( chActionText, elCount(chActionText), "Check 250ms Task Counter from Core1 "); 
  snprintf( chExpectedText, elCount(chExpectedText), "250ms Counter from Core1 is stop incrementing"); 
  TestStepAddActionExpected( chActionText, chExpectedText );
  A_DBGR_VariableRead( "Task_Core1_250ms_Count", taskvalue);
  E_DBGR_VariableCheck("Task_Core1_250ms_Count", taskvalue, Equal);
  
  snprintf( chActionText, elCount(chActionText), "Check 500ms Task Counter from Core1 "); 
  snprintf( chExpectedText, elCount(chExpectedText), "500ms Counter from Core1 is stop incrementing"); 
  TestStepAddActionExpected( chActionText, chExpectedText );
  A_DBGR_VariableRead( "Task_Core1_500ms_Count", taskvalue);
  E_DBGR_VariableCheck("Task_Core1_500ms_Count", taskvalue, Equal);

  snprintf( chActionText, elCount(chActionText), "Check 1000ms Task Counter from Core1 "); 
  snprintf( chExpectedText, elCount(chExpectedText), "1000ms Counter from Core1 is incrementing"); 
  TestStepAddActionExpected( chActionText, chExpectedText );
  A_DBGR_VariableRead( "Task_Core1_1000ms_Count", taskvalue);
  E_DBGR_VariableCheck("Task_Core1_1000ms_Count", taskvalue, Equal);
  
  
  //Check All tasks of Core2 are stopped
  snprintf( chActionText, elCount(chActionText), "Check 2pt5ms Task Counter from Core2 "); 
  snprintf( chExpectedText, elCount(chExpectedText), "2pt5ms Counter from Core2 is stop incrementing"); 
  TestStepAddActionExpected( chActionText, chExpectedText );
  A_DBGR_VariableRead( "Task_Core2_2pt5ms_Count", taskvalue);
  E_DBGR_VariableCheck("Task_Core2_2pt5ms_Count", taskvalue, Equal);
  
  snprintf( chActionText, elCount(chActionText), "Check 5ms Task Counter from Core2 "); 
  snprintf( chExpectedText, elCount(chExpectedText), "5ms Counter from Core2 is stop incrementing"); 
  TestStepAddActionExpected( chActionText, chExpectedText );
  A_DBGR_VariableRead( "Task_Core2_5ms_Count", taskvalue);
  E_DBGR_VariableCheck("Task_Core2_5ms_Count", taskvalue, Equal);
  
  snprintf( chActionText, elCount(chActionText), "Check 10ms Task Counter from Core2 "); 
  snprintf( chExpectedText, elCount(chExpectedText), "10ms Counter from Core2 is stop incrementing"); 
  TestStepAddActionExpected( chActionText, chExpectedText );
  A_DBGR_VariableRead( "Task_Core2_10ms_Count", taskvalue);
  E_DBGR_VariableCheck("Task_Core2_10ms_Count", taskvalue, Equal);  
  
  snprintf( chActionText, elCount(chActionText), "Check 25ms Task Counter from Core2 "); 
  snprintf( chExpectedText, elCount(chExpectedText), "25ms Counter from Core2 is stop incrementing"); 
  TestStepAddActionExpected( chActionText, chExpectedText );
  A_DBGR_VariableRead( "Task_Core2_25ms_Count", taskvalue);
  E_DBGR_VariableCheck("Task_Core2_25ms_Count", taskvalue, Equal); 

  snprintf( chActionText, elCount(chActionText), "Check 50ms Task Counter from Core2 "); 
  snprintf( chExpectedText, elCount(chExpectedText), "50ms Counter from Core2 is stop incrementing"); 
  TestStepAddActionExpected( chActionText, chExpectedText );
  A_DBGR_VariableRead( "Task_Core2_50ms_Count", taskvalue);
  E_DBGR_VariableCheck("Task_Core2_50ms_Count", taskvalue, Equal);
  
  snprintf( chActionText, elCount(chActionText), "Check 100ms Task Counter from Core2 "); 
  snprintf( chExpectedText, elCount(chExpectedText), "100ms Counter from Core2 is stop incrementing"); 
  TestStepAddActionExpected( chActionText, chExpectedText );
  A_DBGR_VariableRead( "Task_Core2_100ms_Count", taskvalue);
  E_DBGR_VariableCheck("Task_Core2_100ms_Count", taskvalue, Equal); 
  
  snprintf( chActionText, elCount(chActionText), "Check 250ms Task Counter from Core2 "); 
  snprintf( chExpectedText, elCount(chExpectedText), "250ms Counter from Core2 is stop incrementing"); 
  TestStepAddActionExpected( chActionText, chExpectedText );
  A_DBGR_VariableRead( "Task_Core2_250ms_Count", taskvalue);
  E_DBGR_VariableCheck("Task_Core2_250ms_Count", taskvalue, Equal);

  snprintf( chActionText, elCount(chActionText), "Check 500ms Task Counter from Core2 "); 
  snprintf( chExpectedText, elCount(chExpectedText), "500ms Counter from Core2 is stop incrementing"); 
  TestStepAddActionExpected( chActionText, chExpectedText );
  A_DBGR_VariableRead( "Task_Core2_500ms_Count", taskvalue);
  E_DBGR_VariableCheck("Task_Core2_500ms_Count", taskvalue, Equal);

  snprintf( chActionText, elCount(chActionText), "Check 1000ms Task Counter from Core2 "); 
  snprintf( chExpectedText, elCount(chExpectedText), "1000ms Counter from Core2 is stop incrementing"); 
  TestStepAddActionExpected( chActionText, chExpectedText );
  A_DBGR_VariableRead( "Task_Core2_1000ms_Count", taskvalue);
  E_DBGR_VariableCheck("Task_Core2_1000ms_Count", taskvalue, Equal);
  
  
    //Check All tasks of Core3 are stopped
  snprintf( chActionText, elCount(chActionText), "Check 2pt5ms Task Counter from Core3 "); 
  snprintf( chExpectedText, elCount(chExpectedText), "2pt5ms Counter from Core3 is stop incrementing"); 
  TestStepAddActionExpected( chActionText, chExpectedText );
  A_DBGR_VariableRead( "Task_Core3_2pt5ms_Count", taskvalue);
  E_DBGR_VariableCheck("Task_Core3_2pt5ms_Count", taskvalue, Equal);
  
   snprintf( chActionText, elCount(chActionText), "Check 5ms Task Counter from Core3 "); 
  snprintf( chExpectedText, elCount(chExpectedText), "5ms Counter from Core3 is stop incrementing"); 
  TestStepAddActionExpected( chActionText, chExpectedText );
  A_DBGR_VariableRead( "Task_Core3_5ms_Count", taskvalue);
  E_DBGR_VariableCheck("Task_Core3_5ms_Count", taskvalue, Equal);
  
  snprintf( chActionText, elCount(chActionText), "Check 10ms Task Counter from Core3 "); 
  snprintf( chExpectedText, elCount(chExpectedText), "10ms Counter from Core3 is stop incrementing"); 
  TestStepAddActionExpected( chActionText, chExpectedText );
  A_DBGR_VariableRead( "Task_Core3_10ms_Count", taskvalue);
  E_DBGR_VariableCheck("Task_Core3_10ms_Count", taskvalue, Equal);  
  
  snprintf( chActionText, elCount(chActionText), "Check 25ms Task Counter from Core3 "); 
  snprintf( chExpectedText, elCount(chExpectedText), "25ms Counter from Core3 is stop incrementing"); 
  TestStepAddActionExpected( chActionText, chExpectedText );
  A_DBGR_VariableRead( "Task_Core3_25ms_Count", taskvalue);
  E_DBGR_VariableCheck("Task_Core3_25ms_Count", taskvalue, Equal);  
  
  snprintf( chActionText, elCount(chActionText), "Check 50ms Task Counter from Core3 "); 
  snprintf( chExpectedText, elCount(chExpectedText), "50ms Counter from Core3 is stop incrementing"); 
  TestStepAddActionExpected( chActionText, chExpectedText );
  A_DBGR_VariableRead( "Task_Core3_50ms_Count", taskvalue);
  E_DBGR_VariableCheck("Task_Core3_50ms_Count", taskvalue, Equal);

  snprintf( chActionText, elCount(chActionText), "Check 100ms Task Counter from Core3 "); 
  snprintf( chExpectedText, elCount(chExpectedText), "100ms Counter from Core3 is stop incrementing"); 
  TestStepAddActionExpected( chActionText, chExpectedText );
  A_DBGR_VariableRead( "Task_Core3_100ms_Count", taskvalue);
  E_DBGR_VariableCheck("Task_Core3_100ms_Count", taskvalue, Equal); 
  
  snprintf( chActionText, elCount(chActionText), "Check 250ms Task Counter from Core3 "); 
  snprintf( chExpectedText, elCount(chExpectedText), "250ms Counter from Core3 is stop incrementing"); 
  TestStepAddActionExpected( chActionText, chExpectedText );
  A_DBGR_VariableRead( "Task_Core3_250ms_Count", taskvalue);
  E_DBGR_VariableCheck("Task_Core3_250ms_Count", taskvalue, Equal);
  
  snprintf( chActionText, elCount(chActionText), "Check 1000ms Task Counter from Core3 "); 
  snprintf( chExpectedText, elCount(chExpectedText), "1000ms Counter from Core3 is stop incrementing"); 
  TestStepAddActionExpected( chActionText, chExpectedText );
  A_DBGR_VariableRead( "Task_Core3_1000ms_Count", taskvalue);
  E_DBGR_VariableCheck("Task_Core3_1000ms_Count", taskvalue, Equal);
  
    //Check task from Core4 is stopped
  snprintf( chActionText, elCount(chActionText), "Check 1000ms Task Counter from Core4 "); 
  snprintf( chExpectedText, elCount(chExpectedText), "1000ms Counter from Core4 is stop incrementing"); 
  TestStepAddActionExpected( chActionText, chExpectedText );
  A_DBGR_VariableRead( "Task_Core4_1000ms_Count", taskvalue);
  E_DBGR_VariableCheck("Task_Core4_1000ms_Count", taskvalue, Equal);
    
  //Check task from Core5 is stopped
  snprintf( chActionText, elCount(chActionText), "Check 1000ms Task Counter from Core5 "); 
  snprintf( chExpectedText, elCount(chExpectedText), "1000ms Counter from Core5 is stop incrementing"); 
  TestStepAddActionExpected( chActionText, chExpectedText );
  A_DBGR_VariableRead( "Task_Core5_1000ms_Count", taskvalue);
  E_DBGR_VariableCheck("Task_Core5_1000ms_Count", taskvalue, Equal);
  
}
  


/***************************************************************************************************
----------------------------------------------------------------------------------------------------
Test case name:  TC_L30SW_Q-36649611: Test_case_to_verify_the_functionality_of_interface_EnableHWIO_AllTasks_to_Enable_all_the_task_from_any_one_CPU()
----------------------------------------------------------------------------------------------------
Description:   test case to verify the functionality of interface EnableHWIO_AllTasks() to Enable all the task from any one CPU.

***************************************************************************************************/
testcase Test_case_to_verify_the_functionality_of_interface_EnableHWIO_AllTasks_to_Enable_all_the_task_from_any_one_CPU()
{
  /***************************************************************************************************************/    
                                                // Variable Definition
  /***************************************************************************************************************/ 
  
  long taskvalue;
  
  /***************************************************************************************************************/    
                                               // Local Values
  /***************************************************************************************************************/ 
  

  
  /***************************************************************************************************************/    
                                              // Test Case Info
  /***************************************************************************************************************/
  setWriteDbgLevel(DebugOff);
  snprintf( chTestTitle, elCount(chTestTitle), "Test_case_to_verify_the_functionality_of_interface_EnableHWIO_AllTasks_to_Enable_all_the_task_from_any_one_CPU" );
  snprintf( chTestDescription, elCount(chTestDescription), "Purpose:Test case to verify the functionality of interface EnableHWIO_AllTasks() to Enable all the task from any one CPU");
  TestCaseAddInfo( chTestTitle, "TC_L30SW_Q-36649611", chTestDescription );

  /***************************************************************************************************************/    
                                              // Start of Test Case
  /***************************************************************************************************************/
  
  /***************************************************************************************************************/    
                                              // Test Step 1 PRECONDITIONS
  /***************************************************************************************************************/
  
  snprintf( chActionText, elCount(chActionText), "Flash the Software and ECU is running"); 
  snprintf( chExpectedText, elCount(chExpectedText), "ECU should be in running state"); 
  TestStepAddActionExpected( chActionText, chExpectedText );

  A_DBGR_BreakpointDeleteAll();
  A_DBGR_RnGo();
  E_DBGR_CheckState(T32_State_Running);
  

   /***************************************************************************************************************/    
                      // Test Step 3 Check all cores are in running state
  /***************************************************************************************************************/
  
  //Check Core0 is running
  snprintf( chActionText, elCount(chActionText), "Check 1000ms Task Counter from Core0 "); 
  snprintf( chExpectedText, elCount(chExpectedText), "1000ms Counter from Core0 is incrementing"); 
  TestStepAddActionExpected( chActionText, chExpectedText );
  A_DBGR_VariableRead( "Task_Core0_1000ms_Count", taskvalue);
  E_DBGR_VariableCheck("Task_Core0_1000ms_Count", taskvalue, Greater);
  
  //Check Core1 is running
  snprintf( chActionText, elCount(chActionText), "Check 1000ms Task Counter from Core1 "); 
  snprintf( chExpectedText, elCount(chExpectedText), "1000ms Counter from Core1 is incrementing"); 
  TestStepAddActionExpected( chActionText, chExpectedText );
  A_DBGR_VariableRead( "Task_Core1_1000ms_Count", taskvalue);
  E_DBGR_VariableCheck("Task_Core1_1000ms_Count", taskvalue, Greater);
  
  //Check Core2 is running
  snprintf( chActionText, elCount(chActionText), "Check 1000ms Task Counter from Core2 "); 
  snprintf( chExpectedText, elCount(chExpectedText), "1000ms Counter from Core2 is incrementing"); 
  TestStepAddActionExpected( chActionText, chExpectedText );
  A_DBGR_VariableRead( "Task_Core2_1000ms_Count", taskvalue);
  E_DBGR_VariableCheck("Task_Core2_1000ms_Count", taskvalue, Greater);
    
  //Check Core3 is running
  snprintf( chActionText, elCount(chActionText), "Check 1000ms Task Counter from Core3 "); 
  snprintf( chExpectedText, elCount(chExpectedText), "1000ms Counter from Core3 is incrementing"); 
  TestStepAddActionExpected( chActionText, chExpectedText );
  A_DBGR_VariableRead( "Task_Core3_1000ms_Count", taskvalue);
  E_DBGR_VariableCheck("Task_Core3_1000ms_Count", taskvalue, Greater);
    
  //Check Core4 is running
  snprintf( chActionText, elCount(chActionText), "Check 1000ms Task Counter from Core4 "); 
  snprintf( chExpectedText, elCount(chExpectedText), "1000ms Counter from Core4 is incrementing"); 
  TestStepAddActionExpected( chActionText, chExpectedText );
  A_DBGR_VariableRead( "Task_Core4_1000ms_Count", taskvalue);
  E_DBGR_VariableCheck("Task_Core4_1000ms_Count", taskvalue, Greater);
    
  //Check Core5 is running
  snprintf( chActionText, elCount(chActionText), "Check 1000ms Task Counter from Core5 "); 
  snprintf( chExpectedText, elCount(chExpectedText), "1000ms Counter from Core5 is incrementing"); 
  TestStepAddActionExpected( chActionText, chExpectedText );
  A_DBGR_VariableRead( "Task_Core5_1000ms_Count", taskvalue);
  E_DBGR_VariableCheck("Task_Core5_1000ms_Count", taskvalue, Greater);
  
  /***************************************************************************************************************/    
    // Test Step 3 Disable All Task using interface DisableHWIO_AllTasks() & Check Tasks from each Core is stopped
  /***************************************************************************************************************/
  
  snprintf( chActionText, elCount(chActionText), "Disable core 0 tasks"); 
  snprintf( chExpectedText, elCount(chExpectedText), "core 0 disabled"); 
  TestStepAddActionExpected( chActionText, chExpectedText );
  A_DBGR_VariableSet("disableAllTasks[0]", "1");
  E_DBGR_VariableCheck("disableAllTasks[0]", 0, Equal);  //variable is not updating in watch window when we disable task as TRUE, therfore checking 0 value here
 
    //Check Core0 is stopped
  snprintf( chActionText, elCount(chActionText), "Check 1000ms Task Counter from Core0 "); 
  snprintf( chExpectedText, elCount(chExpectedText), "1000ms Counter from Core0 is Stopped"); 
  TestStepAddActionExpected( chActionText, chExpectedText );
  A_DBGR_VariableRead( "Task_Core0_1000ms_Count", taskvalue);
  E_DBGR_VariableCheck("Task_Core0_1000ms_Count", taskvalue, Equal);
  
  //Check Core1 is stopped
  snprintf( chActionText, elCount(chActionText), "Check 1000ms Task Counter from Core1 "); 
  snprintf( chExpectedText, elCount(chExpectedText), "1000ms Counter from Core1 is Stopped"); 
  TestStepAddActionExpected( chActionText, chExpectedText );
  A_DBGR_VariableRead( "Task_Core1_1000ms_Count", taskvalue);
  E_DBGR_VariableCheck("Task_Core1_1000ms_Count", taskvalue, Equal);
  
  //Check Core2 is stopped
  snprintf( chActionText, elCount(chActionText), "Check 1000ms Task Counter from Core2 "); 
  snprintf( chExpectedText, elCount(chExpectedText), "1000ms Counter from Core2 is Stopped"); 
  TestStepAddActionExpected( chActionText, chExpectedText );
  A_DBGR_VariableRead( "Task_Core2_1000ms_Count", taskvalue);
  E_DBGR_VariableCheck("Task_Core2_1000ms_Count", taskvalue, Equal);
    
  //Check Core3 is stopped
  snprintf( chActionText, elCount(chActionText), "Check 1000ms Task Counter from Core3 "); 
  snprintf( chExpectedText, elCount(chExpectedText), "1000ms Counter from Core3 is Stopped"); 
  TestStepAddActionExpected( chActionText, chExpectedText );
  A_DBGR_VariableRead( "Task_Core3_1000ms_Count", taskvalue);
  E_DBGR_VariableCheck("Task_Core3_1000ms_Count", taskvalue, Equal);
    
  //Check Core4 is stopped
  snprintf( chActionText, elCount(chActionText), "Check 1000ms Task Counter from Core4 "); 
  snprintf( chExpectedText, elCount(chExpectedText), "1000ms Counter from Core4 is Stopped"); 
  TestStepAddActionExpected( chActionText, chExpectedText );
  A_DBGR_VariableRead( "Task_Core4_1000ms_Count", taskvalue);
  E_DBGR_VariableCheck("Task_Core4_1000ms_Count", taskvalue, Equal);
    
  //Check Core5 is stopped
  snprintf( chActionText, elCount(chActionText), "Check 1000ms Task Counter from Core5 "); 
  snprintf( chExpectedText, elCount(chExpectedText), "1000ms Counter from Core5 is Stopped"); 
  TestStepAddActionExpected( chActionText, chExpectedText );
  A_DBGR_VariableRead( "Task_Core5_1000ms_Count", taskvalue);
  E_DBGR_VariableCheck("Task_Core5_1000ms_Count", taskvalue, Equal);
  
  
  /***************************************************************************************************************/    
    // Test Step 4 At runtime set core0 Enable flag as TRUE in file app\hwio\os_hwio\Implementation\appl_dummy_impl.c static boolean EnableAllTasks[ OS_NUM_OS_CORES ] = { FALSE , FALSE, FALSE, FALSE, FALSE, FALSE}; EnableAllTasks[0]=TRUE
  /***************************************************************************************************************/
  
  snprintf( chActionText, elCount(chActionText), "Enable core 0 tasks"); 
  snprintf( chExpectedText, elCount(chExpectedText), "core 0 Enabled"); 
  TestStepAddActionExpected( chActionText, chExpectedText );
  A_DBGR_VariableSet("enableAllTasks[0]", "1");
  E_DBGR_VariableCheck("enableAllTasks[0]", 0, Equal);   //variable is not updating in watch window when we disable task as TRUE, therfore checking 0 value here
  
  /***************************************************************************************************************/    
                // Test Step 5 check the task counters for all the cores Running.
  /***************************************************************************************************************/
  
  //Check All tasks of Core0 are Running
  snprintf( chActionText, elCount(chActionText), "Check 2pt5ms Task Counter from Core0 "); 
  snprintf( chExpectedText, elCount(chExpectedText), "2pt5ms Counter from Core0 is incrementing"); 
  TestStepAddActionExpected( chActionText, chExpectedText );
  A_DBGR_VariableRead( "Task_Core0_2pt5ms_Count", taskvalue);
  E_DBGR_VariableCheck("Task_Core0_2pt5ms_Count", taskvalue, Greater);
  
  snprintf( chActionText, elCount(chActionText), "Check 5ms Task Counter from Core0 "); 
  snprintf( chExpectedText, elCount(chExpectedText), "5ms Counter from Core0 is incrementing"); 
  TestStepAddActionExpected( chActionText, chExpectedText );
  A_DBGR_VariableRead( "Task_Core0_5ms_Count", taskvalue);
  E_DBGR_VariableCheck("Task_Core0_5ms_Count", taskvalue, Greater);  
  
  snprintf( chActionText, elCount(chActionText), "Check 10ms Task Counter from Core0 "); 
  snprintf( chExpectedText, elCount(chExpectedText), "10ms Counter from Core0 is incrementing"); 
  TestStepAddActionExpected( chActionText, chExpectedText );
  A_DBGR_VariableRead( "Task_Core0_10ms_Count", taskvalue);
  E_DBGR_VariableCheck("Task_Core0_10ms_Count", taskvalue, Greater);  
  
  snprintf( chActionText, elCount(chActionText), "Check 25ms Task Counter from Core0 "); 
  snprintf( chExpectedText, elCount(chExpectedText), "25ms Counter from Core0 is incrementing"); 
  TestStepAddActionExpected( chActionText, chExpectedText );
  A_DBGR_VariableRead( "Task_Core0_25ms_Count", taskvalue);
  E_DBGR_VariableCheck("Task_Core0_25ms_Count", taskvalue, Greater);  

  snprintf( chActionText, elCount(chActionText), "Check 250ms Task Counter from Core0 "); 
  snprintf( chExpectedText, elCount(chExpectedText), "250ms Counter from Core0 is incrementing"); 
  TestStepAddActionExpected( chActionText, chExpectedText );
  A_DBGR_VariableRead( "Task_Core0_250ms_Count", taskvalue);
  E_DBGR_VariableCheck("Task_Core0_250ms_Count", taskvalue, Greater);
  
  snprintf( chActionText, elCount(chActionText), "Check 100ms Task Counter from Core0 "); 
  snprintf( chExpectedText, elCount(chExpectedText), "100ms Counter from Core0 is incrementing"); 
  TestStepAddActionExpected( chActionText, chExpectedText );
  A_DBGR_VariableRead( "Task_Core0_100ms_Count", taskvalue);
  E_DBGR_VariableCheck("Task_Core0_100ms_Count", taskvalue, Greater); 

  snprintf( chActionText, elCount(chActionText), "Check 1000ms Task Counter from Core0 "); 
  snprintf( chExpectedText, elCount(chExpectedText), "1000ms Counter from Core0 is incrementing"); 
  TestStepAddActionExpected( chActionText, chExpectedText );
  A_DBGR_VariableRead( "Task_Core0_1000ms_Count", taskvalue);
  E_DBGR_VariableCheck("Task_Core0_1000ms_Count", taskvalue, Greater);
  
  
  //Check All tasks of Core1 are Running
  snprintf( chActionText, elCount(chActionText), "Check 2pt5ms Task Counter from Core1 "); 
  snprintf( chExpectedText, elCount(chExpectedText), "2pt5ms Counter from Core1 is incrementing"); 
  TestStepAddActionExpected( chActionText, chExpectedText );
  A_DBGR_VariableRead( "Task_Core1_2pt5ms_Count", taskvalue);
  E_DBGR_VariableCheck("Task_Core1_2pt5ms_Count", taskvalue, Greater);
  
    
  snprintf( chActionText, elCount(chActionText), "Check 10ms Task Counter from Core1 "); 
  snprintf( chExpectedText, elCount(chExpectedText), "10ms Counter from Core1 is incrementing"); 
  TestStepAddActionExpected( chActionText, chExpectedText );
  A_DBGR_VariableRead( "Task_Core1_10ms_Count", taskvalue);
  E_DBGR_VariableCheck("Task_Core1_10ms_Count", taskvalue, Greater);  
  
  snprintf( chActionText, elCount(chActionText), "Check 25ms Task Counter from Core1 "); 
  snprintf( chExpectedText, elCount(chExpectedText), "25ms Counter from Core1 is incrementing"); 
  TestStepAddActionExpected( chActionText, chExpectedText );
  A_DBGR_VariableRead( "Task_Core1_25ms_Count", taskvalue);
  E_DBGR_VariableCheck("Task_Core1_25ms_Count", taskvalue, Greater);  

  snprintf( chActionText, elCount(chActionText), "Check 250ms Task Counter from Core1 "); 
  snprintf( chExpectedText, elCount(chExpectedText), "250ms Counter from Core1 is incrementing"); 
  TestStepAddActionExpected( chActionText, chExpectedText );
  A_DBGR_VariableRead( "Task_Core1_250ms_Count", taskvalue);
  E_DBGR_VariableCheck("Task_Core1_250ms_Count", taskvalue, Greater);
  
  snprintf( chActionText, elCount(chActionText), "Check 100ms Task Counter from Core1 "); 
  snprintf( chExpectedText, elCount(chExpectedText), "100ms Counter from Core1 is incrementing"); 
  TestStepAddActionExpected( chActionText, chExpectedText );
  A_DBGR_VariableRead( "Task_Core1_100ms_Count", taskvalue);
  E_DBGR_VariableCheck("Task_Core1_100ms_Count", taskvalue, Greater); 

  snprintf( chActionText, elCount(chActionText), "Check 1000ms Task Counter from Core1 "); 
  snprintf( chExpectedText, elCount(chExpectedText), "1000ms Counter from Core1 is incrementing"); 
  TestStepAddActionExpected( chActionText, chExpectedText );
  A_DBGR_VariableRead( "Task_Core1_1000ms_Count", taskvalue);
  E_DBGR_VariableCheck("Task_Core1_1000ms_Count", taskvalue, Greater);
  
  
  //Check All tasks of Core2 are Running
  snprintf( chActionText, elCount(chActionText), "Check 2pt5ms Task Counter from Core2 "); 
  snprintf( chExpectedText, elCount(chExpectedText), "2pt5ms Counter from Core2 is incrementing"); 
  TestStepAddActionExpected( chActionText, chExpectedText );
  A_DBGR_VariableRead( "Task_Core2_2pt5ms_Count", taskvalue);
  E_DBGR_VariableCheck("Task_Core2_2pt5ms_Count", taskvalue, Greater);
  
    
  snprintf( chActionText, elCount(chActionText), "Check 10ms Task Counter from Core2 "); 
  snprintf( chExpectedText, elCount(chExpectedText), "10ms Counter from Core2 is incrementing"); 
  TestStepAddActionExpected( chActionText, chExpectedText );
  A_DBGR_VariableRead( "Task_Core2_10ms_Count", taskvalue);
  E_DBGR_VariableCheck("Task_Core2_10ms_Count", taskvalue, Greater);  
  
  snprintf( chActionText, elCount(chActionText), "Check 25ms Task Counter from Core2 "); 
  snprintf( chExpectedText, elCount(chExpectedText), "25ms Counter from Core2 is incrementing"); 
  TestStepAddActionExpected( chActionText, chExpectedText );
  A_DBGR_VariableRead( "Task_Core2_25ms_Count", taskvalue);
  E_DBGR_VariableCheck("Task_Core2_25ms_Count", taskvalue, Greater);  

  snprintf( chActionText, elCount(chActionText), "Check 250ms Task Counter from Core2 "); 
  snprintf( chExpectedText, elCount(chExpectedText), "250ms Counter from Core2 is incrementing"); 
  TestStepAddActionExpected( chActionText, chExpectedText );
  A_DBGR_VariableRead( "Task_Core2_250ms_Count", taskvalue);
  E_DBGR_VariableCheck("Task_Core2_250ms_Count", taskvalue, Greater);
  
  snprintf( chActionText, elCount(chActionText), "Check 100ms Task Counter from Core2 "); 
  snprintf( chExpectedText, elCount(chExpectedText), "100ms Counter from Core2 is incrementing"); 
  TestStepAddActionExpected( chActionText, chExpectedText );
  A_DBGR_VariableRead( "Task_Core2_100ms_Count", taskvalue);
  E_DBGR_VariableCheck("Task_Core2_100ms_Count", taskvalue, Greater); 

  snprintf( chActionText, elCount(chActionText), "Check 1000ms Task Counter from Core2 "); 
  snprintf( chExpectedText, elCount(chExpectedText), "1000ms Counter from Core2 is incrementing"); 
  TestStepAddActionExpected( chActionText, chExpectedText );
  A_DBGR_VariableRead( "Task_Core2_1000ms_Count", taskvalue);
  E_DBGR_VariableCheck("Task_Core2_1000ms_Count", taskvalue, Greater);
  
  
    //Check All tasks of Core3 are Running
  snprintf( chActionText, elCount(chActionText), "Check 2pt5ms Task Counter from Core3 "); 
  snprintf( chExpectedText, elCount(chExpectedText), "2pt5ms Counter from Core3 is incrementing"); 
  TestStepAddActionExpected( chActionText, chExpectedText );
  A_DBGR_VariableRead( "Task_Core3_2pt5ms_Count", taskvalue);
  E_DBGR_VariableCheck("Task_Core3_2pt5ms_Count", taskvalue, Greater);
  
    
  snprintf( chActionText, elCount(chActionText), "Check 10ms Task Counter from Core3 "); 
  snprintf( chExpectedText, elCount(chExpectedText), "10ms Counter from Core3 is incrementing"); 
  TestStepAddActionExpected( chActionText, chExpectedText );
  A_DBGR_VariableRead( "Task_Core3_10ms_Count", taskvalue);
  E_DBGR_VariableCheck("Task_Core3_10ms_Count", taskvalue, Greater);  
  
  snprintf( chActionText, elCount(chActionText), "Check 25ms Task Counter from Core3 "); 
  snprintf( chExpectedText, elCount(chExpectedText), "25ms Counter from Core3 is incrementing"); 
  TestStepAddActionExpected( chActionText, chExpectedText );
  A_DBGR_VariableRead( "Task_Core3_25ms_Count", taskvalue);
  E_DBGR_VariableCheck("Task_Core3_25ms_Count", taskvalue, Greater);  

  snprintf( chActionText, elCount(chActionText), "Check 250ms Task Counter from Core3 "); 
  snprintf( chExpectedText, elCount(chExpectedText), "250ms Counter from Core3 is incrementing"); 
  TestStepAddActionExpected( chActionText, chExpectedText );
  A_DBGR_VariableRead( "Task_Core3_250ms_Count", taskvalue);
  E_DBGR_VariableCheck("Task_Core3_250ms_Count", taskvalue, Greater);
  
  snprintf( chActionText, elCount(chActionText), "Check 100ms Task Counter from Core3 "); 
  snprintf( chExpectedText, elCount(chExpectedText), "100ms Counter from Core3 is incrementing"); 
  TestStepAddActionExpected( chActionText, chExpectedText );
  A_DBGR_VariableRead( "Task_Core3_100ms_Count", taskvalue);
  E_DBGR_VariableCheck("Task_Core3_100ms_Count", taskvalue, Greater); 

  snprintf( chActionText, elCount(chActionText), "Check 1000ms Task Counter from Core3 "); 
  snprintf( chExpectedText, elCount(chExpectedText), "1000ms Counter from Core3 is incrementing"); 
  TestStepAddActionExpected( chActionText, chExpectedText );
  A_DBGR_VariableRead( "Task_Core3_1000ms_Count", taskvalue);
  E_DBGR_VariableCheck("Task_Core3_1000ms_Count", taskvalue, Greater);
  
    //Check task from Core4 is incrementing
  snprintf( chActionText, elCount(chActionText), "Check 1000ms Task Counter from Core4 "); 
  snprintf( chExpectedText, elCount(chExpectedText), "1000ms Counter from Core4 is incrementing"); 
  TestStepAddActionExpected( chActionText, chExpectedText );
  A_DBGR_VariableRead( "Task_Core4_1000ms_Count", taskvalue);
  E_DBGR_VariableCheck("Task_Core4_1000ms_Count", taskvalue, Greater);
    
  //Check task from Core5 is incrementing
  snprintf( chActionText, elCount(chActionText), "Check 1000ms Task Counter from Core5 "); 
  snprintf( chExpectedText, elCount(chExpectedText), "1000ms Counter from Core5 is incrementing"); 
  TestStepAddActionExpected( chActionText, chExpectedText );
  A_DBGR_VariableRead( "Task_Core5_1000ms_Count", taskvalue);
  E_DBGR_VariableCheck("Task_Core5_1000ms_Count", taskvalue, Greater);
  
}
  


/***************************************************************************************************
----------------------------------------------------------------------------------------------------
Test case name:  TC_L30SW_Q-36649774: Test case to verify the functinality of interface DsblHWIO_CPU for disabling the CPU0
----------------------------------------------------------------------------------------------------
Description:   Test case to verify the functionality of interface DsblHWIO_CPU for disabling the CPU0.

***************************************************************************************************/
testcase Testcase_to_verify_the_functionality_of_interface_DsblHWIO_CPU_for_disabling_the_CPU0()
{
  /***************************************************************************************************************/    
                                                // Variable Definition
  /***************************************************************************************************************/ 
  
  long taskvalue;
  
  /***************************************************************************************************************/    
                                               // Local Values
  /***************************************************************************************************************/ 
  

  
  /***************************************************************************************************************/    
                                              // Test Case Info
  /***************************************************************************************************************/
  setWriteDbgLevel(DebugOff);
  snprintf( chTestTitle, elCount(chTestTitle), "Testcase_to_verify_the_functionality_of_interface_DsblHWIO_CPU_for_disabling_the_CPU0." );
  snprintf( chTestDescription, elCount(chTestDescription), "Purpose: Test case to verify the functionality of interface DsblHWIO_CPU for disabling the CPU0");
  TestCaseAddInfo( chTestTitle, "TC_L30SW_QT_36649774", chTestDescription );

  /***************************************************************************************************************/    
                                              // Start of Test Case
  /***************************************************************************************************************/
  
  /***************************************************************************************************************/    
                                              // Test Step 1 PRECONDITIONS
  /***************************************************************************************************************/
  
  snprintf( chActionText, elCount(chActionText), "Flash the Software and ECU is running"); 
  snprintf( chExpectedText, elCount(chExpectedText), "ECU should be in running state"); 
  TestStepAddActionExpected( chActionText, chExpectedText );

  A_DBGR_BreakpointDeleteAll();
  A_DBGR_RnGo();
  E_DBGR_CheckState(T32_State_Running);
  

   /***************************************************************************************************************/    
                      // Test Step 2 
                     // Check all cores are in running state
                    // stub Code to Check ISR Counter incrementing 
                   // Check all CPU States shall be running state = FALSE
                      
  /***************************************************************************************************************/
  
  //Check Core0 is running
  snprintf( chActionText, elCount(chActionText), "Check 1000ms Task Counter from Core0 "); 
  snprintf( chExpectedText, elCount(chExpectedText), "1000ms Counter from Core0 is incrementing"); 
  TestStepAddActionExpected( chActionText, chExpectedText );
  A_DBGR_VariableRead( "Task_Core0_1000ms_Count", taskvalue);
  E_DBGR_VariableCheck("Task_Core0_1000ms_Count", taskvalue, Greater);
  
  //Check Core1 is running
  snprintf( chActionText, elCount(chActionText), "Check 1000ms Task Counter from Core1 "); 
  snprintf( chExpectedText, elCount(chExpectedText), "1000ms Counter from Core1 is incrementing"); 
  TestStepAddActionExpected( chActionText, chExpectedText );
  A_DBGR_VariableRead( "Task_Core1_1000ms_Count", taskvalue);
  E_DBGR_VariableCheck("Task_Core1_1000ms_Count", taskvalue, Greater);
  
  //Check Core2 is running
  snprintf( chActionText, elCount(chActionText), "Check 1000ms Task Counter from Core2 "); 
  snprintf( chExpectedText, elCount(chExpectedText), "1000ms Counter from Core2 is incrementing"); 
  TestStepAddActionExpected( chActionText, chExpectedText );
  A_DBGR_VariableRead( "Task_Core2_1000ms_Count", taskvalue);
  E_DBGR_VariableCheck("Task_Core2_1000ms_Count", taskvalue, Greater);
    
  //Check Core3 is running
  snprintf( chActionText, elCount(chActionText), "Check 1000ms Task Counter from Core3 "); 
  snprintf( chExpectedText, elCount(chExpectedText), "1000ms Counter from Core3 is incrementing"); 
  TestStepAddActionExpected( chActionText, chExpectedText );
  A_DBGR_VariableRead( "Task_Core3_1000ms_Count", taskvalue);
  E_DBGR_VariableCheck("Task_Core3_1000ms_Count", taskvalue, Greater);
    
  //Check Core4 is running
  snprintf( chActionText, elCount(chActionText), "Check 1000ms Task Counter from Core4 "); 
  snprintf( chExpectedText, elCount(chExpectedText), "1000ms Counter from Core4 is incrementing"); 
  TestStepAddActionExpected( chActionText, chExpectedText );
  A_DBGR_VariableRead( "Task_Core4_1000ms_Count", taskvalue);
  E_DBGR_VariableCheck("Task_Core4_1000ms_Count", taskvalue, Greater);
    
  //Check Core5 is running
  snprintf( chActionText, elCount(chActionText), "Check 1000ms Task Counter from Core5 "); 
  snprintf( chExpectedText, elCount(chExpectedText), "1000ms Counter from Core5 is incrementing"); 
  TestStepAddActionExpected( chActionText, chExpectedText );
  A_DBGR_VariableRead( "Task_Core5_1000ms_Count", taskvalue);
  E_DBGR_VariableCheck("Task_Core5_1000ms_Count", taskvalue, Greater);
  
  //Check 2pt5 ms ISR Counter is Incrementing for each core
  snprintf( chActionText, elCount(chActionText), "Check 2pt5ms ISR Counter from Core0 "); 
  snprintf( chExpectedText, elCount(chExpectedText), "2pt5ms ISR Counter from Core0 is incrementing"); 
  TestStepAddActionExpected( chActionText, chExpectedText );
  A_DBGR_VariableRead( "Millisecond2pt5_ISR_count_core0", taskvalue);
  E_DBGR_VariableCheck("Millisecond2pt5_ISR_count_core0", taskvalue, NotEqual);
  
  snprintf( chActionText, elCount(chActionText), "Check 2pt5ms ISR Counter from Core1 "); 
  snprintf( chExpectedText, elCount(chExpectedText), "2pt5ms ISR Counter from Core1 is incrementing"); 
  TestStepAddActionExpected( chActionText, chExpectedText );
  A_DBGR_VariableRead( "Millisecond2pt5_ISR_count_core1", taskvalue);
  E_DBGR_VariableCheck("Millisecond2pt5_ISR_count_core1", taskvalue, NotEqual);
  
  snprintf( chActionText, elCount(chActionText), "Check 2pt5ms ISR Counter from Core2 "); 
  snprintf( chExpectedText, elCount(chExpectedText), "2pt5ms ISR Counter from Core2 is incrementing"); 
  TestStepAddActionExpected( chActionText, chExpectedText );
  A_DBGR_VariableRead( "Millisecond2pt5_ISR_count_core2", taskvalue);
  E_DBGR_VariableCheck("Millisecond2pt5_ISR_count_core2", taskvalue, NotEqual);
    
  snprintf( chActionText, elCount(chActionText), "Check 2pt5ms ISR Counter from Core3 "); 
  snprintf( chExpectedText, elCount(chExpectedText), "2pt5ms ISR Counter from Core3 is incrementing"); 
  TestStepAddActionExpected( chActionText, chExpectedText );
  A_DBGR_VariableRead( "Millisecond2pt5_ISR_count_core3", taskvalue);
  E_DBGR_VariableCheck("Millisecond2pt5_ISR_count_core3", taskvalue, NotEqual);
  
  snprintf( chActionText, elCount(chActionText), "Check 2pt5ms ISR Counter from Core4 "); 
  snprintf( chExpectedText, elCount(chExpectedText), "2pt5ms ISR Counter from Core4 is incrementing"); 
  TestStepAddActionExpected( chActionText, chExpectedText );
  A_DBGR_VariableRead( "Millisecond2pt5_ISR_count_core4", taskvalue);
  E_DBGR_VariableCheck("Millisecond2pt5_ISR_count_core4", taskvalue, NotEqual);
    
  snprintf( chActionText, elCount(chActionText), "Check 2pt5ms ISR Counter from Core5 "); 
  snprintf( chExpectedText, elCount(chExpectedText), "2pt5ms ISR Counter from Core5 is incrementing"); 
  TestStepAddActionExpected( chActionText, chExpectedText );
  A_DBGR_VariableRead( "Millisecond2pt5_ISR_count_core5", taskvalue);
  E_DBGR_VariableCheck("Millisecond2pt5_ISR_count_core5", taskvalue, NotEqual);
  
  // CPU State for All Cores
  snprintf( chActionText, elCount(chActionText), "Check CPU State for Core0 "); 
  snprintf( chExpectedText, elCount(chExpectedText), "CPU State for Core0 is 0"); 
  TestStepAddActionExpected( chActionText, chExpectedText );
  //A_DBGR_VariableRead( "disableCpu[0]", taskvalue);
  E_DBGR_VariableCheck("disableCpu[0]", 0, Equal);
  
  snprintf( chActionText, elCount(chActionText), "Check CPU State for Core1 "); 
  snprintf( chExpectedText, elCount(chExpectedText), "CPU State for Core1 is 0"); 
  TestStepAddActionExpected( chActionText, chExpectedText );
 // A_DBGR_VariableRead( "disableCpu[1]", taskvalue);
  E_DBGR_VariableCheck("disableCpu[1]", 0, Equal);
  
  snprintf( chActionText, elCount(chActionText), "Check CPU State for Core2 "); 
  snprintf( chExpectedText, elCount(chExpectedText), "CPU State for Core2 is 0"); 
  TestStepAddActionExpected( chActionText, chExpectedText );
 // A_DBGR_VariableRead( "disableCpu[2]", taskvalue);
  E_DBGR_VariableCheck("disableCpu[2]", 0, Equal);
  
  snprintf( chActionText, elCount(chActionText), "Check CPU State for Core3 "); 
  snprintf( chExpectedText, elCount(chExpectedText), "CPU State for Core3 is 0"); 
  TestStepAddActionExpected( chActionText, chExpectedText );
 // A_DBGR_VariableRead( "disableCpu[3]", taskvalue);
  E_DBGR_VariableCheck("disableCpu[3]", 0, Equal);
  
  snprintf( chActionText, elCount(chActionText), "Check CPU State for Core4 "); 
  snprintf( chExpectedText, elCount(chExpectedText), "CPU State for Core4 is 0"); 
  TestStepAddActionExpected( chActionText, chExpectedText );
 // A_DBGR_VariableRead( "disableCpu[4]", taskvalue);
  E_DBGR_VariableCheck("disableCpu[4]", 0, Equal);
  
  snprintf( chActionText, elCount(chActionText), "Check CPU State for Core5 "); 
  snprintf( chExpectedText, elCount(chExpectedText), "CPU State for Core5 is 0"); 
  TestStepAddActionExpected( chActionText, chExpectedText );
 // A_DBGR_VariableRead( "disableCpu[5]", taskvalue);
  E_DBGR_VariableCheck("disableCpu[5]", 0, Equal);
  
  /***************************************************************************************************************/    
    // Test Step 3: Disable CPU Core 0 with interface disableCPU[0] = TRUE
  /***************************************************************************************************************/

  snprintf( chActionText, elCount(chActionText), "Disable core 0 tasks"); 
  snprintf( chExpectedText, elCount(chExpectedText), "core 0 disabled"); 
  TestStepAddActionExpected( chActionText, chExpectedText );
  A_DBGR_VariableSet("disableCpu[1]", "1");
  A_DBGR_VariableSet("disableCpu[2]", "1");
  A_DBGR_VariableSet("disableCpu[3]", "1");
  A_DBGR_VariableSet("disableCpu[4]", "1");
  A_DBGR_VariableSet("disableCpu[5]", "1");
  A_DBGR_VariableSet("disableCpu[0]", "1");
  E_DBGR_VariableCheck("disableCpu[0]", 1, Equal);  
  
 /***************************************************************************************************************/    
                      // Test Step 4
                     // Check all cores are in running state except Core0
                    // stub Code to Check ISR Counter incrementing except Core0
                   // Check all CPU States shall be running state = FALSE, except Core[0] = TRUE
                      
  /***************************************************************************************************************/
  //Check All tasks of Core0 are stopped
  snprintf( chActionText, elCount(chActionText), "Check 2pt5ms Task Counter from Core0 "); 
  snprintf( chExpectedText, elCount(chExpectedText), "2pt5ms Counter from Core0 is stop  incrementing"); 
  TestStepAddActionExpected( chActionText, chExpectedText );
  A_DBGR_VariableRead( "Task_Core0_2pt5ms_Count", taskvalue);
  E_DBGR_VariableCheck("Task_Core0_2pt5ms_Count", taskvalue, Equal);
  
  snprintf( chActionText, elCount(chActionText), "Check 5ms Task Counter from Core0 "); 
  snprintf( chExpectedText, elCount(chExpectedText), "5ms Counter from Core0 is stop  incrementing"); 
  TestStepAddActionExpected( chActionText, chExpectedText );
  A_DBGR_VariableRead( "Task_Core0_5ms_Count", taskvalue);
  E_DBGR_VariableCheck("Task_Core0_5ms_Count", taskvalue, Equal);
  
  snprintf( chActionText, elCount(chActionText), "Check 10ms Task Counter from Core0 "); 
  snprintf( chExpectedText, elCount(chExpectedText), "10ms Counter from Core0 is stop  incrementing"); 
  TestStepAddActionExpected( chActionText, chExpectedText );
  A_DBGR_VariableRead( "Task_Core0_10ms_Count", taskvalue);
  E_DBGR_VariableCheck("Task_Core0_10ms_Count", taskvalue, Equal);  
  
  snprintf( chActionText, elCount(chActionText), "Check 25ms Task Counter from Core0 "); 
  snprintf( chExpectedText, elCount(chExpectedText), "25ms Counter from Core0 is stop  incrementing"); 
  TestStepAddActionExpected( chActionText, chExpectedText );
  A_DBGR_VariableRead( "Task_Core0_25ms_Count", taskvalue);
  E_DBGR_VariableCheck("Task_Core0_25ms_Count", taskvalue, Equal);  

  snprintf( chActionText, elCount(chActionText), "Check 50ms Task Counter from Core0 "); 
  snprintf( chExpectedText, elCount(chExpectedText), "50ms Counter from Core0 is stop  incrementing"); 
  TestStepAddActionExpected( chActionText, chExpectedText );
  A_DBGR_VariableRead( "Task_Core0_50ms_Count", taskvalue);
  E_DBGR_VariableCheck("Task_Core0_50ms_Count", taskvalue, Equal);
  
  snprintf( chActionText, elCount(chActionText), "Check 250ms Task Counter from Core0 "); 
  snprintf( chExpectedText, elCount(chExpectedText), "250ms Counter from Core0 is stop  incrementing"); 
  TestStepAddActionExpected( chActionText, chExpectedText );
  A_DBGR_VariableRead( "Task_Core0_250ms_Count", taskvalue);
  E_DBGR_VariableCheck("Task_Core0_250ms_Count", taskvalue, Equal);
  
  snprintf( chActionText, elCount(chActionText), "Check 100ms Task Counter from Core0 "); 
  snprintf( chExpectedText, elCount(chExpectedText), "100ms Counter from Core0 is stop  incrementing"); 
  TestStepAddActionExpected( chActionText, chExpectedText );
  A_DBGR_VariableRead( "Task_Core0_100ms_Count", taskvalue);
  E_DBGR_VariableCheck("Task_Core0_100ms_Count", taskvalue, Equal); 

  snprintf( chActionText, elCount(chActionText), "Check 500ms Task Counter from Core0 "); 
  snprintf( chExpectedText, elCount(chExpectedText), "500ms Counter from Core0 is stop  incrementing"); 
  TestStepAddActionExpected( chActionText, chExpectedText );
  A_DBGR_VariableRead( "Task_Core0_500ms_Count", taskvalue);
  E_DBGR_VariableCheck("Task_Core0_500ms_Count", taskvalue, Equal);
  
  snprintf( chActionText, elCount(chActionText), "Check 1000ms Task Counter from Core0 "); 
  snprintf( chExpectedText, elCount(chExpectedText), "1000ms Counter from Core0 is stop  incrementing"); 
  TestStepAddActionExpected( chActionText, chExpectedText );
  A_DBGR_VariableRead( "Task_Core0_1000ms_Count", taskvalue);
  E_DBGR_VariableCheck("Task_Core0_1000ms_Count", taskvalue, Equal);
  
  
  //Check All tasks of Core1 are running
  snprintf( chActionText, elCount(chActionText), "Check 2pt5ms Task Counter from Core1 "); 
  snprintf( chExpectedText, elCount(chExpectedText), "2pt5ms Counter from Core1 is  incrementing"); 
  TestStepAddActionExpected( chActionText, chExpectedText );
  A_DBGR_VariableRead( "Task_Core1_2pt5ms_Count", taskvalue);
  E_DBGR_VariableCheck("Task_Core1_2pt5ms_Count", taskvalue, Equal);
  
  snprintf( chActionText, elCount(chActionText), "Check 5ms Task Counter from Core1 "); 
  snprintf( chExpectedText, elCount(chExpectedText), "5ms Counter from Core1 is  incrementing"); 
  TestStepAddActionExpected( chActionText, chExpectedText );
  A_DBGR_VariableRead( "Task_Core1_5ms_Count", taskvalue);
  E_DBGR_VariableCheck("Task_Core1_5ms_Count", taskvalue, Equal);
  
  snprintf( chActionText, elCount(chActionText), "Check 10ms Task Counter from Core1 "); 
  snprintf( chExpectedText, elCount(chExpectedText), "10ms Counter from Core1 is  incrementing"); 
  TestStepAddActionExpected( chActionText, chExpectedText );
  A_DBGR_VariableRead( "Task_Core1_10ms_Count", taskvalue);
  E_DBGR_VariableCheck("Task_Core1_10ms_Count", taskvalue, Equal);  
  
  snprintf( chActionText, elCount(chActionText), "Check 25ms Task Counter from Core1 "); 
  snprintf( chExpectedText, elCount(chExpectedText), "25ms Counter from Core1 is  incrementing"); 
  TestStepAddActionExpected( chActionText, chExpectedText );
  A_DBGR_VariableRead( "Task_Core1_25ms_Count", taskvalue);
  E_DBGR_VariableCheck("Task_Core1_25ms_Count", taskvalue, Equal); 
  
  snprintf( chActionText, elCount(chActionText), "Check 50ms Task Counter from Core1 "); 
  snprintf( chExpectedText, elCount(chExpectedText), "50ms Counter from Core1 is  incrementing"); 
  TestStepAddActionExpected( chActionText, chExpectedText );
  A_DBGR_VariableRead( "Task_Core1_50ms_Count", taskvalue);
  E_DBGR_VariableCheck("Task_Core1_50ms_Count", taskvalue, Equal);
    
  snprintf( chActionText, elCount(chActionText), "Check 100ms Task Counter from Core1 "); 
  snprintf( chExpectedText, elCount(chExpectedText), "100ms Counter from Core1 is  incrementing"); 
  TestStepAddActionExpected( chActionText, chExpectedText );
  A_DBGR_VariableRead( "Task_Core1_100ms_Count", taskvalue);
  E_DBGR_VariableCheck("Task_Core1_100ms_Count", taskvalue, Equal);

  snprintf( chActionText, elCount(chActionText), "Check 250ms Task Counter from Core1 "); 
  snprintf( chExpectedText, elCount(chExpectedText), "250ms Counter from Core1 is  incrementing"); 
  TestStepAddActionExpected( chActionText, chExpectedText );
  A_DBGR_VariableRead( "Task_Core1_250ms_Count", taskvalue);
  E_DBGR_VariableCheck("Task_Core1_250ms_Count", taskvalue, Equal);
  
  snprintf( chActionText, elCount(chActionText), "Check 500ms Task Counter from Core1 "); 
  snprintf( chExpectedText, elCount(chExpectedText), "500ms Counter from Core1 is  incrementing"); 
  TestStepAddActionExpected( chActionText, chExpectedText );
  A_DBGR_VariableRead( "Task_Core1_500ms_Count", taskvalue);
  E_DBGR_VariableCheck("Task_Core1_500ms_Count", taskvalue, Equal);

  snprintf( chActionText, elCount(chActionText), "Check 1000ms Task Counter from Core1 "); 
  snprintf( chExpectedText, elCount(chExpectedText), "1000ms Counter from Core1 is incrementing"); 
  TestStepAddActionExpected( chActionText, chExpectedText );
  A_DBGR_VariableRead( "Task_Core1_1000ms_Count", taskvalue);
  E_DBGR_VariableCheck("Task_Core1_1000ms_Count", taskvalue, Equal);
  
  
  //Check All tasks of Core2 are running
  snprintf( chActionText, elCount(chActionText), "Check 2pt5ms Task Counter from Core2 "); 
  snprintf( chExpectedText, elCount(chExpectedText), "2pt5ms Counter from Core2 is  incrementing"); 
  TestStepAddActionExpected( chActionText, chExpectedText );
  A_DBGR_VariableRead( "Task_Core2_2pt5ms_Count", taskvalue);
  E_DBGR_VariableCheck("Task_Core2_2pt5ms_Count", taskvalue, Equal);
  
  snprintf( chActionText, elCount(chActionText), "Check 5ms Task Counter from Core2 "); 
  snprintf( chExpectedText, elCount(chExpectedText), "5ms Counter from Core2 is  incrementing"); 
  TestStepAddActionExpected( chActionText, chExpectedText );
  A_DBGR_VariableRead( "Task_Core2_5ms_Count", taskvalue);
  E_DBGR_VariableCheck("Task_Core2_5ms_Count", taskvalue, Equal);
  
  snprintf( chActionText, elCount(chActionText), "Check 10ms Task Counter from Core2 "); 
  snprintf( chExpectedText, elCount(chExpectedText), "10ms Counter from Core2 is  incrementing"); 
  TestStepAddActionExpected( chActionText, chExpectedText );
  A_DBGR_VariableRead( "Task_Core2_10ms_Count", taskvalue);
  E_DBGR_VariableCheck("Task_Core2_10ms_Count", taskvalue, Equal);  
  
  snprintf( chActionText, elCount(chActionText), "Check 25ms Task Counter from Core2 "); 
  snprintf( chExpectedText, elCount(chExpectedText), "25ms Counter from Core2 is  incrementing"); 
  TestStepAddActionExpected( chActionText, chExpectedText );
  A_DBGR_VariableRead( "Task_Core2_25ms_Count", taskvalue);
  E_DBGR_VariableCheck("Task_Core2_25ms_Count", taskvalue, Equal); 

  snprintf( chActionText, elCount(chActionText), "Check 50ms Task Counter from Core2 "); 
  snprintf( chExpectedText, elCount(chExpectedText), "50ms Counter from Core2 is  incrementing"); 
  TestStepAddActionExpected( chActionText, chExpectedText );
  A_DBGR_VariableRead( "Task_Core2_50ms_Count", taskvalue);
  E_DBGR_VariableCheck("Task_Core2_50ms_Count", taskvalue, Equal);
  
  snprintf( chActionText, elCount(chActionText), "Check 100ms Task Counter from Core2 "); 
  snprintf( chExpectedText, elCount(chExpectedText), "100ms Counter from Core2 is  incrementing"); 
  TestStepAddActionExpected( chActionText, chExpectedText );
  A_DBGR_VariableRead( "Task_Core2_100ms_Count", taskvalue);
  E_DBGR_VariableCheck("Task_Core2_100ms_Count", taskvalue, Equal); 
  
  snprintf( chActionText, elCount(chActionText), "Check 250ms Task Counter from Core2 "); 
  snprintf( chExpectedText, elCount(chExpectedText), "250ms Counter from Core2 is  incrementing"); 
  TestStepAddActionExpected( chActionText, chExpectedText );
  A_DBGR_VariableRead( "Task_Core2_250ms_Count", taskvalue);
  E_DBGR_VariableCheck("Task_Core2_250ms_Count", taskvalue, Equal);

  snprintf( chActionText, elCount(chActionText), "Check 500ms Task Counter from Core2 "); 
  snprintf( chExpectedText, elCount(chExpectedText), "500ms Counter from Core2 is  incrementing"); 
  TestStepAddActionExpected( chActionText, chExpectedText );
  A_DBGR_VariableRead( "Task_Core2_500ms_Count", taskvalue);
  E_DBGR_VariableCheck("Task_Core2_500ms_Count", taskvalue, Equal);

  snprintf( chActionText, elCount(chActionText), "Check 1000ms Task Counter from Core2 "); 
  snprintf( chExpectedText, elCount(chExpectedText), "1000ms Counter from Core2 is  incrementing"); 
  TestStepAddActionExpected( chActionText, chExpectedText );
  A_DBGR_VariableRead( "Task_Core2_1000ms_Count", taskvalue);
  E_DBGR_VariableCheck("Task_Core2_1000ms_Count", taskvalue, Equal);
  
  
    //Check All tasks of Core3 are running
  snprintf( chActionText, elCount(chActionText), "Check 2pt5ms Task Counter from Core3 "); 
  snprintf( chExpectedText, elCount(chExpectedText), "2pt5ms Counter from Core3 is  incrementing"); 
  TestStepAddActionExpected( chActionText, chExpectedText );
  A_DBGR_VariableRead( "Task_Core3_2pt5ms_Count", taskvalue);
  E_DBGR_VariableCheck("Task_Core3_2pt5ms_Count", taskvalue, Equal);
  
   snprintf( chActionText, elCount(chActionText), "Check 5ms Task Counter from Core3 "); 
  snprintf( chExpectedText, elCount(chExpectedText), "5ms Counter from Core3 is  incrementing"); 
  TestStepAddActionExpected( chActionText, chExpectedText );
  A_DBGR_VariableRead( "Task_Core3_5ms_Count", taskvalue);
  E_DBGR_VariableCheck("Task_Core3_5ms_Count", taskvalue, Equal);
  
  snprintf( chActionText, elCount(chActionText), "Check 10ms Task Counter from Core3 "); 
  snprintf( chExpectedText, elCount(chExpectedText), "10ms Counter from Core3 is  incrementing"); 
  TestStepAddActionExpected( chActionText, chExpectedText );
  A_DBGR_VariableRead( "Task_Core3_10ms_Count", taskvalue);
  E_DBGR_VariableCheck("Task_Core3_10ms_Count", taskvalue, Equal);  
  
  snprintf( chActionText, elCount(chActionText), "Check 25ms Task Counter from Core3 "); 
  snprintf( chExpectedText, elCount(chExpectedText), "25ms Counter from Core3 is  incrementing"); 
  TestStepAddActionExpected( chActionText, chExpectedText );
  A_DBGR_VariableRead( "Task_Core3_25ms_Count", taskvalue);
  E_DBGR_VariableCheck("Task_Core3_25ms_Count", taskvalue, Equal);  
  
  snprintf( chActionText, elCount(chActionText), "Check 50ms Task Counter from Core3 "); 
  snprintf( chExpectedText, elCount(chExpectedText), "50ms Counter from Core3 is  incrementing"); 
  TestStepAddActionExpected( chActionText, chExpectedText );
  A_DBGR_VariableRead( "Task_Core3_50ms_Count", taskvalue);
  E_DBGR_VariableCheck("Task_Core3_50ms_Count", taskvalue, Equal);

  snprintf( chActionText, elCount(chActionText), "Check 100ms Task Counter from Core3 "); 
  snprintf( chExpectedText, elCount(chExpectedText), "100ms Counter from Core3 is  incrementing"); 
  TestStepAddActionExpected( chActionText, chExpectedText );
  A_DBGR_VariableRead( "Task_Core3_100ms_Count", taskvalue);
  E_DBGR_VariableCheck("Task_Core3_100ms_Count", taskvalue, Equal); 
  
  snprintf( chActionText, elCount(chActionText), "Check 250ms Task Counter from Core3 "); 
  snprintf( chExpectedText, elCount(chExpectedText), "250ms Counter from Core3 is  incrementing"); 
  TestStepAddActionExpected( chActionText, chExpectedText );
  A_DBGR_VariableRead( "Task_Core3_250ms_Count", taskvalue);
  E_DBGR_VariableCheck("Task_Core3_250ms_Count", taskvalue, Equal);
  
  snprintf( chActionText, elCount(chActionText), "Check 1000ms Task Counter from Core3 "); 
  snprintf( chExpectedText, elCount(chExpectedText), "1000ms Counter from Core3 is  incrementing"); 
  TestStepAddActionExpected( chActionText, chExpectedText );
  A_DBGR_VariableRead( "Task_Core3_1000ms_Count", taskvalue);
  E_DBGR_VariableCheck("Task_Core3_1000ms_Count", taskvalue, Equal);
  
    //Check task from Core4 is running
  snprintf( chActionText, elCount(chActionText), "Check 1000ms Task Counter from Core4 "); 
  snprintf( chExpectedText, elCount(chExpectedText), "1000ms Counter from Core4 is  incrementing"); 
  TestStepAddActionExpected( chActionText, chExpectedText );
  A_DBGR_VariableRead( "Task_Core4_1000ms_Count", taskvalue);
  E_DBGR_VariableCheck("Task_Core4_1000ms_Count", taskvalue, Equal);
    
  //Check task from Core5 is running
  snprintf( chActionText, elCount(chActionText), "Check 1000ms Task Counter from Core5 "); 
  snprintf( chExpectedText, elCount(chExpectedText), "1000ms Counter from Core5 is  incrementing"); 
  TestStepAddActionExpected( chActionText, chExpectedText );
  A_DBGR_VariableRead( "Task_Core5_1000ms_Count", taskvalue);
  E_DBGR_VariableCheck("Task_Core5_1000ms_Count", taskvalue, Equal);
  
  
  //Check 2pt5 ms ISR Counter is Incrementing for each core except Core0
  snprintf( chActionText, elCount(chActionText), "Check 2pt5ms ISR Counter from Core0 "); 
  snprintf( chExpectedText, elCount(chExpectedText), "2pt5ms ISR Counter from Core0 is incrementing"); 
  TestStepAddActionExpected( chActionText, chExpectedText );
  A_DBGR_VariableRead( "Millisecond2pt5_ISR_count_core0", taskvalue);
  E_DBGR_VariableCheck("Millisecond2pt5_ISR_count_core0", taskvalue, Equal);
  
  snprintf( chActionText, elCount(chActionText), "Check 2pt5ms ISR Counter from Core1 "); 
  snprintf( chExpectedText, elCount(chExpectedText), "2pt5ms ISR Counter from Core1 is incrementing"); 
  TestStepAddActionExpected( chActionText, chExpectedText );
  A_DBGR_VariableRead( "Millisecond2pt5_ISR_count_core1", taskvalue);
  E_DBGR_VariableCheck("Millisecond2pt5_ISR_count_core1", taskvalue, Equal);
  
  snprintf( chActionText, elCount(chActionText), "Check 2pt5ms ISR Counter from Core2 "); 
  snprintf( chExpectedText, elCount(chExpectedText), "2pt5ms ISR Counter from Core2 is incrementing"); 
  TestStepAddActionExpected( chActionText, chExpectedText );
  A_DBGR_VariableRead( "Millisecond2pt5_ISR_count_core2", taskvalue);
  E_DBGR_VariableCheck("Millisecond2pt5_ISR_count_core2", taskvalue, Equal);
    
  snprintf( chActionText, elCount(chActionText), "Check 2pt5ms ISR Counter from Core3 "); 
  snprintf( chExpectedText, elCount(chExpectedText), "2pt5ms ISR Counter from Core3 is incrementing"); 
  TestStepAddActionExpected( chActionText, chExpectedText );
  A_DBGR_VariableRead( "Millisecond2pt5_ISR_count_core3", taskvalue);
  E_DBGR_VariableCheck("Millisecond2pt5_ISR_count_core3", taskvalue, Equal);
  
  snprintf( chActionText, elCount(chActionText), "Check 2pt5ms ISR Counter from Core4 "); 
  snprintf( chExpectedText, elCount(chExpectedText), "2pt5ms ISR Counter from Core4 is incrementing"); 
  TestStepAddActionExpected( chActionText, chExpectedText );
  A_DBGR_VariableRead( "Millisecond2pt5_ISR_count_core4", taskvalue);
  E_DBGR_VariableCheck("Millisecond2pt5_ISR_count_core4", taskvalue, Equal);
    
  snprintf( chActionText, elCount(chActionText), "Check 2pt5ms ISR Counter from Core5 "); 
  snprintf( chExpectedText, elCount(chExpectedText), "2pt5ms ISR Counter from Core5 is incrementing"); 
  TestStepAddActionExpected( chActionText, chExpectedText );
  A_DBGR_VariableRead( "Millisecond2pt5_ISR_count_core5", taskvalue);
  E_DBGR_VariableCheck("Millisecond2pt5_ISR_count_core5", taskvalue, Equal);
  
  // CPU State for All Cores shall be FALSE, Excepr Core0 = TRUE
  snprintf( chActionText, elCount(chActionText), "Check CPU State for Core0 "); 
  snprintf( chExpectedText, elCount(chExpectedText), "CPU State for Core0 is TRUE"); 
  TestStepAddActionExpected( chActionText, chExpectedText );
  //A_DBGR_VariableRead( "disableCpu[0]", taskvalue);
  E_DBGR_VariableCheck("disableCpu[0]", 1, Equal);
  
  snprintf( chActionText, elCount(chActionText), "Check CPU State for Core1 "); 
  snprintf( chExpectedText, elCount(chExpectedText), "CPU State for Core1 is 0"); 
  TestStepAddActionExpected( chActionText, chExpectedText );
  //A_DBGR_VariableRead( "disableCpu[1]", taskvalue);
  E_DBGR_VariableCheck("disableCpu[1]", 1, Equal);
  
  snprintf( chActionText, elCount(chActionText), "Check CPU State for Core2 "); 
  snprintf( chExpectedText, elCount(chExpectedText), "CPU State for Core2 is 0"); 
  TestStepAddActionExpected( chActionText, chExpectedText );
  //A_DBGR_VariableRead( "disableCpu[2]", taskvalue);
  E_DBGR_VariableCheck("disableCpu[2]", 1, Equal);
  
  snprintf( chActionText, elCount(chActionText), "Check CPU State for Core3 "); 
  snprintf( chExpectedText, elCount(chExpectedText), "CPU State for Core3 is 0"); 
  TestStepAddActionExpected( chActionText, chExpectedText );
 // A_DBGR_VariableRead( "disableCpu[3]", taskvalue);
  E_DBGR_VariableCheck("disableCpu[3]", 1, Equal);
  
  snprintf( chActionText, elCount(chActionText), "Check CPU State for Core4 "); 
  snprintf( chExpectedText, elCount(chExpectedText), "CPU State for Core4 is 0"); 
  TestStepAddActionExpected( chActionText, chExpectedText );
  //A_DBGR_VariableRead( "disableCpu[4]", taskvalue);
  E_DBGR_VariableCheck("disableCpu[4]", 1, Equal);
  
  snprintf( chActionText, elCount(chActionText), "Check CPU State for Core5 "); 
  snprintf( chExpectedText, elCount(chExpectedText), "CPU State for Core5 is 0"); 
  TestStepAddActionExpected( chActionText, chExpectedText );
  //A_DBGR_VariableRead( "disableCpu[5]", taskvalue);
  E_DBGR_VariableCheck("disableCpu[5]", 1, Equal);
}

/***************************************************************************************************
----------------------------------------------------------------------------------------------------
Test case name:  TC_L30SW_Q-36649773: Test case to verify the functinality of interface DsblHWIO_CPU for disabling the CPU1
----------------------------------------------------------------------------------------------------
Description:   Test case to verify the functionality of interface DsblHWIO_CPU for disabling the CPU1.

***************************************************************************************************/
testcase Testcase_to_verify_the_functionality_of_interface_DsblHWIO_CPU_for_disabling_the_CPU1()
{
  /***************************************************************************************************************/    
                                                // Variable Definition
  /***************************************************************************************************************/ 
  ;
  long taskvalue;
  
  /***************************************************************************************************************/    
                                               // Local Values
  /***************************************************************************************************************/ 
  

  
  /***************************************************************************************************************/    
                                              // Test Case Info
  /***************************************************************************************************************/
  setWriteDbgLevel(DebugOff);
  snprintf( chTestTitle, elCount(chTestTitle), "Testcase_to_verify_the_functionality_of_interface_DsblHWIO_CPU_for_disabling_the_CPU1." );
  snprintf( chTestDescription, elCount(chTestDescription), "Purpose: Test case to verify the functionality of interface DsblHWIO_CPU for disabling the CPU1");
  TestCaseAddInfo( chTestTitle, "TC_L30SW_Q-36649773", chTestDescription );

  /***************************************************************************************************************/    
                                              // Start of Test Case
  /***************************************************************************************************************/
  
  /***************************************************************************************************************/    
                                              // Test Step 1 PRECONDITIONS
  /***************************************************************************************************************/
  
  snprintf( chActionText, elCount(chActionText), "Flash the Software and ECU is running"); 
  snprintf( chExpectedText, elCount(chExpectedText), "ECU should be in running state"); 
  TestStepAddActionExpected( chActionText, chExpectedText );

  A_DBGR_BreakpointDeleteAll();
  A_DBGR_RnGo();
  E_DBGR_CheckState(T32_State_Running);
  

   /***************************************************************************************************************/    
                      // Test Step 2 
                     // Check all cores are in running state
                    // stub Code to Check ISR Counter incrementing 
                   // Check all CPU States shall be running state = FALSE
                      
  /***************************************************************************************************************/
  
  //Check Core0 is running
  snprintf( chActionText, elCount(chActionText), "Check 1000ms Task Counter from Core0 "); 
  snprintf( chExpectedText, elCount(chExpectedText), "1000ms Counter from Core0 is incrementing"); 
  TestStepAddActionExpected( chActionText, chExpectedText );
  A_DBGR_VariableRead( "Task_Core0_1000ms_Count", taskvalue);
  E_DBGR_VariableCheck("Task_Core0_1000ms_Count", taskvalue, Greater);
  
  //Check Core1 is running
  snprintf( chActionText, elCount(chActionText), "Check 1000ms Task Counter from Core1 "); 
  snprintf( chExpectedText, elCount(chExpectedText), "1000ms Counter from Core1 is incrementing"); 
  TestStepAddActionExpected( chActionText, chExpectedText );
  A_DBGR_VariableRead( "Task_Core1_1000ms_Count", taskvalue);
  E_DBGR_VariableCheck("Task_Core1_1000ms_Count", taskvalue, Greater);
  
  //Check Core2 is running
  snprintf( chActionText, elCount(chActionText), "Check 1000ms Task Counter from Core2 "); 
  snprintf( chExpectedText, elCount(chExpectedText), "1000ms Counter from Core2 is incrementing"); 
  TestStepAddActionExpected( chActionText, chExpectedText );
  A_DBGR_VariableRead( "Task_Core2_1000ms_Count", taskvalue);
  E_DBGR_VariableCheck("Task_Core2_1000ms_Count", taskvalue, Greater);
    
  //Check Core3 is running
  snprintf( chActionText, elCount(chActionText), "Check 1000ms Task Counter from Core3 "); 
  snprintf( chExpectedText, elCount(chExpectedText), "1000ms Counter from Core3 is incrementing"); 
  TestStepAddActionExpected( chActionText, chExpectedText );
  A_DBGR_VariableRead( "Task_Core3_1000ms_Count", taskvalue);
  E_DBGR_VariableCheck("Task_Core3_1000ms_Count", taskvalue, Greater);
    
  //Check Core4 is running
  snprintf( chActionText, elCount(chActionText), "Check 1000ms Task Counter from Core4 "); 
  snprintf( chExpectedText, elCount(chExpectedText), "1000ms Counter from Core4 is incrementing"); 
  TestStepAddActionExpected( chActionText, chExpectedText );
  A_DBGR_VariableRead( "Task_Core4_1000ms_Count", taskvalue);
  E_DBGR_VariableCheck("Task_Core4_1000ms_Count", taskvalue, Greater);
    
  //Check Core5 is running
  snprintf( chActionText, elCount(chActionText), "Check 1000ms Task Counter from Core5 "); 
  snprintf( chExpectedText, elCount(chExpectedText), "1000ms Counter from Core5 is incrementing"); 
  TestStepAddActionExpected( chActionText, chExpectedText );
  A_DBGR_VariableRead( "Task_Core5_1000ms_Count", taskvalue);
  E_DBGR_VariableCheck("Task_Core5_1000ms_Count", taskvalue, Greater);
  
  //Check 2pt5 ms ISR Counter is Incrementing for each core
  snprintf( chActionText, elCount(chActionText), "Check 2pt5ms ISR Counter from Core0 "); 
  snprintf( chExpectedText, elCount(chExpectedText), "2pt5ms ISR Counter from Core0 is incrementing"); 
  TestStepAddActionExpected( chActionText, chExpectedText );
  A_DBGR_VariableRead( "Millisecond2pt5_ISR_count_core0", taskvalue);
  E_DBGR_VariableCheck("Millisecond2pt5_ISR_count_core0", taskvalue, NotEqual);
  
  snprintf( chActionText, elCount(chActionText), "Check 2pt5ms ISR Counter from Core1 "); 
  snprintf( chExpectedText, elCount(chExpectedText), "2pt5ms ISR Counter from Core1 is incrementing"); 
  TestStepAddActionExpected( chActionText, chExpectedText );
  A_DBGR_VariableRead( "Millisecond2pt5_ISR_count_core1", taskvalue);
  E_DBGR_VariableCheck("Millisecond2pt5_ISR_count_core1", taskvalue, NotEqual);
  
  snprintf( chActionText, elCount(chActionText), "Check 2pt5ms ISR Counter from Core2 "); 
  snprintf( chExpectedText, elCount(chExpectedText), "2pt5ms ISR Counter from Core2 is incrementing"); 
  TestStepAddActionExpected( chActionText, chExpectedText );
  A_DBGR_VariableRead( "Millisecond2pt5_ISR_count_core2", taskvalue);
  E_DBGR_VariableCheck("Millisecond2pt5_ISR_count_core2", taskvalue, NotEqual);
    
  snprintf( chActionText, elCount(chActionText), "Check 2pt5ms ISR Counter from Core3 "); 
  snprintf( chExpectedText, elCount(chExpectedText), "2pt5ms ISR Counter from Core3 is incrementing"); 
  TestStepAddActionExpected( chActionText, chExpectedText );
  A_DBGR_VariableRead( "Millisecond2pt5_ISR_count_core3", taskvalue);
  E_DBGR_VariableCheck("Millisecond2pt5_ISR_count_core3", taskvalue, NotEqual);
  
  snprintf( chActionText, elCount(chActionText), "Check 2pt5ms ISR Counter from Core4 "); 
  snprintf( chExpectedText, elCount(chExpectedText), "2pt5ms ISR Counter from Core4 is incrementing"); 
  TestStepAddActionExpected( chActionText, chExpectedText );
  A_DBGR_VariableRead( "Millisecond2pt5_ISR_count_core4", taskvalue);
  E_DBGR_VariableCheck("Millisecond2pt5_ISR_count_core4", taskvalue, NotEqual);
    
  snprintf( chActionText, elCount(chActionText), "Check 2pt5ms ISR Counter from Core5 "); 
  snprintf( chExpectedText, elCount(chExpectedText), "2pt5ms ISR Counter from Core5 is incrementing"); 
  TestStepAddActionExpected( chActionText, chExpectedText );
  A_DBGR_VariableRead( "Millisecond2pt5_ISR_count_core5", taskvalue);
  E_DBGR_VariableCheck("Millisecond2pt5_ISR_count_core5", taskvalue, NotEqual);
  
  // CPU State for All Cores
  snprintf( chActionText, elCount(chActionText), "Check CPU State for Core0 "); 
  snprintf( chExpectedText, elCount(chExpectedText), "CPU State for Core0 is 0"); 
  TestStepAddActionExpected( chActionText, chExpectedText );
  //A_DBGR_VariableRead( "disableCpu[0]", taskvalue);
  E_DBGR_VariableCheck("disableCpu[0]", 0, Equal);
  
  snprintf( chActionText, elCount(chActionText), "Check CPU State for Core1 "); 
  snprintf( chExpectedText, elCount(chExpectedText), "CPU State for Core1 is 0"); 
  TestStepAddActionExpected( chActionText, chExpectedText );
 // A_DBGR_VariableRead( "disableCpu[1]", taskvalue);
  E_DBGR_VariableCheck("disableCpu[1]", 0, Equal);
  
  snprintf( chActionText, elCount(chActionText), "Check CPU State for Core2 "); 
  snprintf( chExpectedText, elCount(chExpectedText), "CPU State for Core2 is 0"); 
  TestStepAddActionExpected( chActionText, chExpectedText );
 // A_DBGR_VariableRead( "disableCpu[2]", taskvalue);
  E_DBGR_VariableCheck("disableCpu[2]", 0, Equal);
  
  snprintf( chActionText, elCount(chActionText), "Check CPU State for Core3 "); 
  snprintf( chExpectedText, elCount(chExpectedText), "CPU State for Core3 is 0"); 
  TestStepAddActionExpected( chActionText, chExpectedText );
 // A_DBGR_VariableRead( "disableCpu[3]", taskvalue);
  E_DBGR_VariableCheck("disableCpu[3]", 0, Equal);
  
  snprintf( chActionText, elCount(chActionText), "Check CPU State for Core4 "); 
  snprintf( chExpectedText, elCount(chExpectedText), "CPU State for Core4 is 0"); 
  TestStepAddActionExpected( chActionText, chExpectedText );
 // A_DBGR_VariableRead( "disableCpu[4]", taskvalue);
  E_DBGR_VariableCheck("disableCpu[4]", 0, Equal);
  
  snprintf( chActionText, elCount(chActionText), "Check CPU State for Core5 "); 
  snprintf( chExpectedText, elCount(chExpectedText), "CPU State for Core5 is 0"); 
  TestStepAddActionExpected( chActionText, chExpectedText );
 // A_DBGR_VariableRead( "disableCpu[5]", taskvalue);
  E_DBGR_VariableCheck("disableCpu[5]", 0, Equal);
  
  /***************************************************************************************************************/    
    // Test Step 3: Disable CPU Core 1 with interface disableCPU[1] = TRUE
  /***************************************************************************************************************/

  snprintf( chActionText, elCount(chActionText), "Disable CPU1"); 
  snprintf( chExpectedText, elCount(chExpectedText), "CPU 1 disabled"); 
  TestStepAddActionExpected( chActionText, chExpectedText );
  A_DBGR_VariableSet("disableCpu[1]", "1");
  E_DBGR_VariableCheck("disableCpu[1]", 1, Equal);  
  
 /***************************************************************************************************************/    
                      // Test Step 4
                     // Check all cores are in running state except Core1
                    // stub Code to Check ISR Counter incrementing except Core1
                   // Check all CPU States shall be running state = FALSE, except Core[1] = TRUE
                      
  /***************************************************************************************************************/
  //Check All tasks of Core0 are running
  snprintf( chActionText, elCount(chActionText), "Check 2pt5ms Task Counter from Core0 "); 
  snprintf( chExpectedText, elCount(chExpectedText), "2pt5ms Counter from Core0 is   incrementing"); 
  TestStepAddActionExpected( chActionText, chExpectedText );
  A_DBGR_VariableRead( "Task_Core0_2pt5ms_Count", taskvalue);
  E_DBGR_VariableCheck("Task_Core0_2pt5ms_Count", taskvalue, Greater);
  
  snprintf( chActionText, elCount(chActionText), "Check 5ms Task Counter from Core0 "); 
  snprintf( chExpectedText, elCount(chExpectedText), "5ms Counter from Core0 is  incrementing"); 
  TestStepAddActionExpected( chActionText, chExpectedText );
  A_DBGR_VariableRead( "Task_Core0_5ms_Count", taskvalue);
  E_DBGR_VariableCheck("Task_Core0_5ms_Count", taskvalue, Greater);
  
  snprintf( chActionText, elCount(chActionText), "Check 10ms Task Counter from Core0 "); 
  snprintf( chExpectedText, elCount(chExpectedText), "10ms Counter from Core0 is  incrementing"); 
  TestStepAddActionExpected( chActionText, chExpectedText );
  A_DBGR_VariableRead( "Task_Core0_10ms_Count", taskvalue);
  E_DBGR_VariableCheck("Task_Core0_10ms_Count", taskvalue, Greater);  
  
  snprintf( chActionText, elCount(chActionText), "Check 25ms Task Counter from Core0 "); 
  snprintf( chExpectedText, elCount(chExpectedText), "25ms Counter from Core0 is  incrementing"); 
  TestStepAddActionExpected( chActionText, chExpectedText );
  A_DBGR_VariableRead( "Task_Core0_25ms_Count", taskvalue);
  E_DBGR_VariableCheck("Task_Core0_25ms_Count", taskvalue, Greater);  

  snprintf( chActionText, elCount(chActionText), "Check 50ms Task Counter from Core0 "); 
  snprintf( chExpectedText, elCount(chExpectedText), "50ms Counter from Core0 is  incrementing"); 
  TestStepAddActionExpected( chActionText, chExpectedText );
  A_DBGR_VariableRead( "Task_Core0_50ms_Count", taskvalue);
  E_DBGR_VariableCheck("Task_Core0_50ms_Count", taskvalue, Greater);
  
  snprintf( chActionText, elCount(chActionText), "Check 100ms Task Counter from Core0 "); 
  snprintf( chExpectedText, elCount(chExpectedText), "100ms Counter from Core0 is  incrementing"); 
  TestStepAddActionExpected( chActionText, chExpectedText );
  A_DBGR_VariableRead( "Task_Core0_100ms_Count", taskvalue);
  E_DBGR_VariableCheck("Task_Core0_100ms_Count", taskvalue, Greater); 
  
  snprintf( chActionText, elCount(chActionText), "Check 250ms Task Counter from Core0 "); 
  snprintf( chExpectedText, elCount(chExpectedText), "250ms Counter from Core0 is  incrementing"); 
  TestStepAddActionExpected( chActionText, chExpectedText );
  A_DBGR_VariableRead( "Task_Core0_250ms_Count", taskvalue);
  E_DBGR_VariableCheck("Task_Core0_250ms_Count", taskvalue, Greater);
  
  snprintf( chActionText, elCount(chActionText), "Check 500ms Task Counter from Core0 "); 
  snprintf( chExpectedText, elCount(chExpectedText), "500ms Counter from Core0 is  incrementing"); 
  TestStepAddActionExpected( chActionText, chExpectedText );
  A_DBGR_VariableRead( "Task_Core0_500ms_Count", taskvalue);
  E_DBGR_VariableCheck("Task_Core0_500ms_Count", taskvalue, Greater);
  
  snprintf( chActionText, elCount(chActionText), "Check 1000ms Task Counter from Core0 "); 
  snprintf( chExpectedText, elCount(chExpectedText), "1000ms Counter from Core0 is  incrementing"); 
  TestStepAddActionExpected( chActionText, chExpectedText );
  A_DBGR_VariableRead( "Task_Core0_1000ms_Count", taskvalue);
  E_DBGR_VariableCheck("Task_Core0_1000ms_Count", taskvalue, Greater);
  
  
  //Check All tasks of Core1 are stopped  
  snprintf( chActionText, elCount(chActionText), "Check 2pt5ms Task Counter from Core1 "); 
  snprintf( chExpectedText, elCount(chExpectedText), "2pt5ms Counter from Core1 is stop incrementing"); 
  TestStepAddActionExpected( chActionText, chExpectedText );
  A_DBGR_VariableRead( "Task_Core1_2pt5ms_Count", taskvalue);
  E_DBGR_VariableCheck("Task_Core1_2pt5ms_Count", taskvalue, Equal);
  
  snprintf( chActionText, elCount(chActionText), "Check 5ms Task Counter from Core1 "); 
  snprintf( chExpectedText, elCount(chExpectedText), "5ms Counter from Core1 is stop incrementing"); 
  TestStepAddActionExpected( chActionText, chExpectedText );
  A_DBGR_VariableRead( "Task_Core1_5ms_Count", taskvalue);
  E_DBGR_VariableCheck("Task_Core1_5ms_Count", taskvalue, Equal);
  
  snprintf( chActionText, elCount(chActionText), "Check 10ms Task Counter from Core1 "); 
  snprintf( chExpectedText, elCount(chExpectedText), "10ms Counter from Core1 is  incrementing"); 
  TestStepAddActionExpected( chActionText, chExpectedText );
  A_DBGR_VariableRead( "Task_Core1_10ms_Count", taskvalue);
  E_DBGR_VariableCheck("Task_Core1_10ms_Count", taskvalue, Equal);  
  
  snprintf( chActionText, elCount(chActionText), "Check 25ms Task Counter from Core1 "); 
  snprintf( chExpectedText, elCount(chExpectedText), "25ms Counter from Core1 is stop incrementing"); 
  TestStepAddActionExpected( chActionText, chExpectedText );
  A_DBGR_VariableRead( "Task_Core1_25ms_Count", taskvalue);
  E_DBGR_VariableCheck("Task_Core1_25ms_Count", taskvalue, Equal); 
  
  snprintf( chActionText, elCount(chActionText), "Check 50ms Task Counter from Core1 "); 
  snprintf( chExpectedText, elCount(chExpectedText), "50ms Counter from Core1 is stop incrementing"); 
  TestStepAddActionExpected( chActionText, chExpectedText );
  A_DBGR_VariableRead( "Task_Core1_50ms_Count", taskvalue);
  E_DBGR_VariableCheck("Task_Core1_50ms_Count", taskvalue, Equal);
    
  snprintf( chActionText, elCount(chActionText), "Check 100ms Task Counter from Core1 "); 
  snprintf( chExpectedText, elCount(chExpectedText), "100ms Counter from Core1 is stop incrementing"); 
  TestStepAddActionExpected( chActionText, chExpectedText );
  A_DBGR_VariableRead( "Task_Core1_100ms_Count", taskvalue);
  E_DBGR_VariableCheck("Task_Core1_100ms_Count", taskvalue, Equal);

  snprintf( chActionText, elCount(chActionText), "Check 250ms Task Counter from Core1 "); 
  snprintf( chExpectedText, elCount(chExpectedText), "250ms Counter from Core1 is stop incrementing"); 
  TestStepAddActionExpected( chActionText, chExpectedText );
  A_DBGR_VariableRead( "Task_Core1_250ms_Count", taskvalue);
  E_DBGR_VariableCheck("Task_Core1_250ms_Count", taskvalue, Equal);
  
  snprintf( chActionText, elCount(chActionText), "Check 500ms Task Counter from Core1 "); 
  snprintf( chExpectedText, elCount(chExpectedText), "500ms Counter from Core1 is stop incrementing"); 
  TestStepAddActionExpected( chActionText, chExpectedText );
  A_DBGR_VariableRead( "Task_Core1_500ms_Count", taskvalue);
  E_DBGR_VariableCheck("Task_Core1_500ms_Count", taskvalue, Equal);

  snprintf( chActionText, elCount(chActionText), "Check 1000ms Task Counter from Core1 "); 
  snprintf( chExpectedText, elCount(chExpectedText), "1000ms Counter from Core1 is stop incrementing"); 
  TestStepAddActionExpected( chActionText, chExpectedText );
  A_DBGR_VariableRead( "Task_Core1_1000ms_Count", taskvalue);
  E_DBGR_VariableCheck("Task_Core1_1000ms_Count", taskvalue, Equal);
  
  
  //Check All tasks of Core2 are running
  snprintf( chActionText, elCount(chActionText), "Check 2pt5ms Task Counter from Core2 "); 
  snprintf( chExpectedText, elCount(chExpectedText), "2pt5ms Counter from Core2 is  incrementing"); 
  TestStepAddActionExpected( chActionText, chExpectedText );
  A_DBGR_VariableRead( "Task_Core2_2pt5ms_Count", taskvalue);
  E_DBGR_VariableCheck("Task_Core2_2pt5ms_Count", taskvalue, Greater);
  
  snprintf( chActionText, elCount(chActionText), "Check 5ms Task Counter from Core2 "); 
  snprintf( chExpectedText, elCount(chExpectedText), "5ms Counter from Core2 is  incrementing"); 
  TestStepAddActionExpected( chActionText, chExpectedText );
  A_DBGR_VariableRead( "Task_Core2_5ms_Count", taskvalue);
  E_DBGR_VariableCheck("Task_Core2_5ms_Count", taskvalue, Greater);
  
  snprintf( chActionText, elCount(chActionText), "Check 10ms Task Counter from Core2 "); 
  snprintf( chExpectedText, elCount(chExpectedText), "10ms Counter from Core2 is  incrementing"); 
  TestStepAddActionExpected( chActionText, chExpectedText );
  A_DBGR_VariableRead( "Task_Core2_10ms_Count", taskvalue);
  E_DBGR_VariableCheck("Task_Core2_10ms_Count", taskvalue, Greater);  
  
  snprintf( chActionText, elCount(chActionText), "Check 25ms Task Counter from Core2 "); 
  snprintf( chExpectedText, elCount(chExpectedText), "25ms Counter from Core2 is  incrementing"); 
  TestStepAddActionExpected( chActionText, chExpectedText );
  A_DBGR_VariableRead( "Task_Core2_25ms_Count", taskvalue);
  E_DBGR_VariableCheck("Task_Core2_25ms_Count", taskvalue, Greater); 

  snprintf( chActionText, elCount(chActionText), "Check 50ms Task Counter from Core2 "); 
  snprintf( chExpectedText, elCount(chExpectedText), "50ms Counter from Core2 is  incrementing"); 
  TestStepAddActionExpected( chActionText, chExpectedText );
  A_DBGR_VariableRead( "Task_Core2_50ms_Count", taskvalue);
  E_DBGR_VariableCheck("Task_Core2_50ms_Count", taskvalue, Greater);
  
  snprintf( chActionText, elCount(chActionText), "Check 100ms Task Counter from Core2 "); 
  snprintf( chExpectedText, elCount(chExpectedText), "100ms Counter from Core2 is  incrementing"); 
  TestStepAddActionExpected( chActionText, chExpectedText );
  A_DBGR_VariableRead( "Task_Core2_100ms_Count", taskvalue);
  E_DBGR_VariableCheck("Task_Core2_100ms_Count", taskvalue, Greater); 
  
  snprintf( chActionText, elCount(chActionText), "Check 250ms Task Counter from Core2 "); 
  snprintf( chExpectedText, elCount(chExpectedText), "250ms Counter from Core2 is  incrementing"); 
  TestStepAddActionExpected( chActionText, chExpectedText );
  A_DBGR_VariableRead( "Task_Core2_250ms_Count", taskvalue);
  E_DBGR_VariableCheck("Task_Core2_250ms_Count", taskvalue, Greater);

  snprintf( chActionText, elCount(chActionText), "Check 500ms Task Counter from Core2 "); 
  snprintf( chExpectedText, elCount(chExpectedText), "500ms Counter from Core2 is  incrementing"); 
  TestStepAddActionExpected( chActionText, chExpectedText );
  A_DBGR_VariableRead( "Task_Core2_500ms_Count", taskvalue);
  E_DBGR_VariableCheck("Task_Core2_500ms_Count", taskvalue, Greater);

  snprintf( chActionText, elCount(chActionText), "Check 1000ms Task Counter from Core2 "); 
  snprintf( chExpectedText, elCount(chExpectedText), "1000ms Counter from Core2 is  incrementing"); 
  TestStepAddActionExpected( chActionText, chExpectedText );
  A_DBGR_VariableRead( "Task_Core2_1000ms_Count", taskvalue);
  E_DBGR_VariableCheck("Task_Core2_1000ms_Count", taskvalue, Greater);
  
  
    //Check All tasks of Core3 are running
  snprintf( chActionText, elCount(chActionText), "Check 2pt5ms Task Counter from Core3 "); 
  snprintf( chExpectedText, elCount(chExpectedText), "2pt5ms Counter from Core3 is  incrementing"); 
  TestStepAddActionExpected( chActionText, chExpectedText );
  A_DBGR_VariableRead( "Task_Core3_2pt5ms_Count", taskvalue);
  E_DBGR_VariableCheck("Task_Core3_2pt5ms_Count", taskvalue, Greater);
  
   snprintf( chActionText, elCount(chActionText), "Check 5ms Task Counter from Core3 "); 
  snprintf( chExpectedText, elCount(chExpectedText), "5ms Counter from Core3 is  incrementing"); 
  TestStepAddActionExpected( chActionText, chExpectedText );
  A_DBGR_VariableRead( "Task_Core3_5ms_Count", taskvalue);
  E_DBGR_VariableCheck("Task_Core3_5ms_Count", taskvalue, Greater);
  
  snprintf( chActionText, elCount(chActionText), "Check 10ms Task Counter from Core3 "); 
  snprintf( chExpectedText, elCount(chExpectedText), "10ms Counter from Core3 is  incrementing"); 
  TestStepAddActionExpected( chActionText, chExpectedText );
  A_DBGR_VariableRead( "Task_Core3_10ms_Count", taskvalue);
  E_DBGR_VariableCheck("Task_Core3_10ms_Count", taskvalue, Greater);  
  
  snprintf( chActionText, elCount(chActionText), "Check 25ms Task Counter from Core3 "); 
  snprintf( chExpectedText, elCount(chExpectedText), "25ms Counter from Core3 is  incrementing"); 
  TestStepAddActionExpected( chActionText, chExpectedText );
  A_DBGR_VariableRead( "Task_Core3_25ms_Count", taskvalue);
  E_DBGR_VariableCheck("Task_Core3_25ms_Count", taskvalue, Greater);  
  
  snprintf( chActionText, elCount(chActionText), "Check 50ms Task Counter from Core3 "); 
  snprintf( chExpectedText, elCount(chExpectedText), "50ms Counter from Core3 is  incrementing"); 
  TestStepAddActionExpected( chActionText, chExpectedText );
  A_DBGR_VariableRead( "Task_Core3_50ms_Count", taskvalue);
  E_DBGR_VariableCheck("Task_Core3_50ms_Count", taskvalue, Greater);

  snprintf( chActionText, elCount(chActionText), "Check 100ms Task Counter from Core3 "); 
  snprintf( chExpectedText, elCount(chExpectedText), "100ms Counter from Core3 is  incrementing"); 
  TestStepAddActionExpected( chActionText, chExpectedText );
  A_DBGR_VariableRead( "Task_Core3_100ms_Count", taskvalue);
  E_DBGR_VariableCheck("Task_Core3_100ms_Count", taskvalue, Greater); 
  
  snprintf( chActionText, elCount(chActionText), "Check 250ms Task Counter from Core3 "); 
  snprintf( chExpectedText, elCount(chExpectedText), "250ms Counter from Core3 is  incrementing"); 
  TestStepAddActionExpected( chActionText, chExpectedText );
  A_DBGR_VariableRead( "Task_Core3_250ms_Count", taskvalue);
  E_DBGR_VariableCheck("Task_Core3_250ms_Count", taskvalue, Greater);
  
  snprintf( chActionText, elCount(chActionText), "Check 1000ms Task Counter from Core3 "); 
  snprintf( chExpectedText, elCount(chExpectedText), "1000ms Counter from Core3 is  incrementing"); 
  TestStepAddActionExpected( chActionText, chExpectedText );
  A_DBGR_VariableRead( "Task_Core3_1000ms_Count", taskvalue);
  E_DBGR_VariableCheck("Task_Core3_1000ms_Count", taskvalue, Greater);
  
    //Check task from Core4 is running
  snprintf( chActionText, elCount(chActionText), "Check 1000ms Task Counter from Core4 "); 
  snprintf( chExpectedText, elCount(chExpectedText), "1000ms Counter from Core4 is  incrementing"); 
  TestStepAddActionExpected( chActionText, chExpectedText );
  A_DBGR_VariableRead( "Task_Core4_1000ms_Count", taskvalue);
  E_DBGR_VariableCheck("Task_Core4_1000ms_Count", taskvalue, Greater);
    
  //Check task from Core5 is running
  snprintf( chActionText, elCount(chActionText), "Check 1000ms Task Counter from Core5 "); 
  snprintf( chExpectedText, elCount(chExpectedText), "1000ms Counter from Core5 is  incrementing"); 
  TestStepAddActionExpected( chActionText, chExpectedText );
  A_DBGR_VariableRead( "Task_Core5_1000ms_Count", taskvalue);
  E_DBGR_VariableCheck("Task_Core5_1000ms_Count", taskvalue, Greater);
  
  
  //Check 2pt5 ms ISR Counter is Incrementing for each core except Core1
  snprintf( chActionText, elCount(chActionText), "Check 2pt5ms ISR Counter from Core0 "); 
  snprintf( chExpectedText, elCount(chExpectedText), "2pt5ms ISR Counter from Core0 is incrementing"); 
  TestStepAddActionExpected( chActionText, chExpectedText );
  A_DBGR_VariableRead( "Millisecond2pt5_ISR_count_core0", taskvalue);
  E_DBGR_VariableCheck("Millisecond2pt5_ISR_count_core0", taskvalue, NotEqual);
  
  snprintf( chActionText, elCount(chActionText), "Check 2pt5ms ISR Counter from Core1 "); 
  snprintf( chExpectedText, elCount(chExpectedText), "2pt5ms ISR Counter from Core1 is  stop incrementing"); 
  TestStepAddActionExpected( chActionText, chExpectedText );
  A_DBGR_VariableRead( "Millisecond2pt5_ISR_count_core1", taskvalue);
  E_DBGR_VariableCheck("Millisecond2pt5_ISR_count_core1", taskvalue, Equal);
  
  snprintf( chActionText, elCount(chActionText), "Check 2pt5ms ISR Counter from Core2 "); 
  snprintf( chExpectedText, elCount(chExpectedText), "2pt5ms ISR Counter from Core2 is incrementing"); 
  TestStepAddActionExpected( chActionText, chExpectedText );
  A_DBGR_VariableRead( "Millisecond2pt5_ISR_count_core2", taskvalue);
  E_DBGR_VariableCheck("Millisecond2pt5_ISR_count_core2", taskvalue, NotEqual);
    
  snprintf( chActionText, elCount(chActionText), "Check 2pt5ms ISR Counter from Core3 "); 
  snprintf( chExpectedText, elCount(chExpectedText), "2pt5ms ISR Counter from Core3 is incrementing"); 
  TestStepAddActionExpected( chActionText, chExpectedText );
  A_DBGR_VariableRead( "Millisecond2pt5_ISR_count_core3", taskvalue);
  E_DBGR_VariableCheck("Millisecond2pt5_ISR_count_core3", taskvalue, NotEqual);
  
  snprintf( chActionText, elCount(chActionText), "Check 2pt5ms ISR Counter from Core4 "); 
  snprintf( chExpectedText, elCount(chExpectedText), "2pt5ms ISR Counter from Core4 is incrementing"); 
  TestStepAddActionExpected( chActionText, chExpectedText );
  A_DBGR_VariableRead( "Millisecond2pt5_ISR_count_core4", taskvalue);
  E_DBGR_VariableCheck("Millisecond2pt5_ISR_count_core4", taskvalue, NotEqual);
    
  snprintf( chActionText, elCount(chActionText), "Check 2pt5ms ISR Counter from Core5 "); 
  snprintf( chExpectedText, elCount(chExpectedText), "2pt5ms ISR Counter from Core5 is incrementing"); 
  TestStepAddActionExpected( chActionText, chExpectedText );
  A_DBGR_VariableRead( "Millisecond2pt5_ISR_count_core5", taskvalue);
  E_DBGR_VariableCheck("Millisecond2pt5_ISR_count_core5", taskvalue, NotEqual);
  
  // CPU State for All Cores shall be FALSE, Excepr Core1 = TRUE
  snprintf( chActionText, elCount(chActionText), "Check CPU State for Core0 "); 
  snprintf( chExpectedText, elCount(chExpectedText), "CPU State for Core0 is 0"); 
  TestStepAddActionExpected( chActionText, chExpectedText );
  //A_DBGR_VariableRead( "disableCpu[0]", taskvalue);
  E_DBGR_VariableCheck("disableCpu[0]", 0, Equal);
  
  snprintf( chActionText, elCount(chActionText), "Check CPU State for Core1 "); 
  snprintf( chExpectedText, elCount(chExpectedText), "CPU State for Core1 is TRUE"); 
  TestStepAddActionExpected( chActionText, chExpectedText );
  //A_DBGR_VariableRead( "disableCpu[1]", taskvalue);
  E_DBGR_VariableCheck("disableCpu[1]", 1, Equal);
  
  snprintf( chActionText, elCount(chActionText), "Check CPU State for Core2 "); 
  snprintf( chExpectedText, elCount(chExpectedText), "CPU State for Core2 is 0"); 
  TestStepAddActionExpected( chActionText, chExpectedText );
  //A_DBGR_VariableRead( "disableCpu[2]", taskvalue);
  E_DBGR_VariableCheck("disableCpu[2]", 0, Equal);
  
  snprintf( chActionText, elCount(chActionText), "Check CPU State for Core3 "); 
  snprintf( chExpectedText, elCount(chExpectedText), "CPU State for Core3 is 0"); 
  TestStepAddActionExpected( chActionText, chExpectedText );
 // A_DBGR_VariableRead( "disableCpu[3]", taskvalue);
  E_DBGR_VariableCheck("disableCpu[3]", 0, Equal);
  
  snprintf( chActionText, elCount(chActionText), "Check CPU State for Core4 "); 
  snprintf( chExpectedText, elCount(chExpectedText), "CPU State for Core4 is 0"); 
  TestStepAddActionExpected( chActionText, chExpectedText );
  //A_DBGR_VariableRead( "disableCpu[4]", taskvalue);
  E_DBGR_VariableCheck("disableCpu[4]", 0, Equal);
  
  snprintf( chActionText, elCount(chActionText), "Check CPU State for Core5 "); 
  snprintf( chExpectedText, elCount(chExpectedText), "CPU State for Core5 is 0"); 
  TestStepAddActionExpected( chActionText, chExpectedText );
  //A_DBGR_VariableRead( "disableCpu[5]", taskvalue);
  E_DBGR_VariableCheck("disableCpu[5]", 0, Equal);
}



/***************************************************************************************************
----------------------------------------------------------------------------------------------------
Test case name:  TC_L30SW_Q-36649772: Test case to verify the functinality of interface DsblHWIO_CPU for disabling the CPU3
----------------------------------------------------------------------------------------------------
Description:   Test case to verify the functionality of interface DsblHWIO_CPU for disabling the CPU3.

***************************************************************************************************/
testcase Testcase_to_verify_the_functionality_of_interface_DsblHWIO_CPU_for_disabling_the_CPU2()
{
  /***************************************************************************************************************/    
                                                // Variable Definition
  /***************************************************************************************************************/ 
  ;
  long taskvalue;
  
  /***************************************************************************************************************/    
                                               // Local Values
  /***************************************************************************************************************/ 
  

  
  /***************************************************************************************************************/    
                                              // Test Case Info
  /***************************************************************************************************************/
  setWriteDbgLevel(DebugOff);
  snprintf( chTestTitle, elCount(chTestTitle), "Testcase_to_verify_the_functionality_of_interface_DsblHWIO_CPU_for_disabling_the_CPU2." );
  snprintf( chTestDescription, elCount(chTestDescription), "Purpose: Test case to verify the functionality of interface DsblHWIO_CPU for disabling the CPU2");
  TestCaseAddInfo( chTestTitle, "TC_L30SW_Q-36649772", chTestDescription );

  /***************************************************************************************************************/    
                                              // Start of Test Case
  /***************************************************************************************************************/
  
  /***************************************************************************************************************/    
                                              // Test Step 1 PRECONDITIONS
  /***************************************************************************************************************/
  
  snprintf( chActionText, elCount(chActionText), "Flash the Software and ECU is running"); 
  snprintf( chExpectedText, elCount(chExpectedText), "ECU should be in running state"); 
  TestStepAddActionExpected( chActionText, chExpectedText );

  A_DBGR_BreakpointDeleteAll();
  A_DBGR_RnGo();
  E_DBGR_CheckState(T32_State_Running);
  

   /***************************************************************************************************************/    
                      // Test Step 2 
                     // Check all cores are in running state
                    // stub Code to Check ISR Counter incrementing 
                   // Check all CPU States shall be running state = FALSE
                      
  /***************************************************************************************************************/
  
  //Check Core0 is running
  snprintf( chActionText, elCount(chActionText), "Check 1000ms Task Counter from Core0 "); 
  snprintf( chExpectedText, elCount(chExpectedText), "1000ms Counter from Core0 is incrementing"); 
  TestStepAddActionExpected( chActionText, chExpectedText );
  A_DBGR_VariableRead( "Task_Core0_1000ms_Count", taskvalue);
  E_DBGR_VariableCheck("Task_Core0_1000ms_Count", taskvalue, Greater);
  
  //Check Core1 is running
  snprintf( chActionText, elCount(chActionText), "Check 1000ms Task Counter from Core1 "); 
  snprintf( chExpectedText, elCount(chExpectedText), "1000ms Counter from Core1 is incrementing"); 
  TestStepAddActionExpected( chActionText, chExpectedText );
  A_DBGR_VariableRead( "Task_Core1_1000ms_Count", taskvalue);
  E_DBGR_VariableCheck("Task_Core1_1000ms_Count", taskvalue, Greater);
  
  //Check Core2 is running
  snprintf( chActionText, elCount(chActionText), "Check 1000ms Task Counter from Core2 "); 
  snprintf( chExpectedText, elCount(chExpectedText), "1000ms Counter from Core2 is incrementing"); 
  TestStepAddActionExpected( chActionText, chExpectedText );
  A_DBGR_VariableRead( "Task_Core2_1000ms_Count", taskvalue);
  E_DBGR_VariableCheck("Task_Core2_1000ms_Count", taskvalue, Greater);
    
  //Check Core3 is running
  snprintf( chActionText, elCount(chActionText), "Check 1000ms Task Counter from Core3 "); 
  snprintf( chExpectedText, elCount(chExpectedText), "1000ms Counter from Core3 is incrementing"); 
  TestStepAddActionExpected( chActionText, chExpectedText );
  A_DBGR_VariableRead( "Task_Core3_1000ms_Count", taskvalue);
  E_DBGR_VariableCheck("Task_Core3_1000ms_Count", taskvalue, Greater);
    
  //Check Core4 is running
  snprintf( chActionText, elCount(chActionText), "Check 1000ms Task Counter from Core4 "); 
  snprintf( chExpectedText, elCount(chExpectedText), "1000ms Counter from Core4 is incrementing"); 
  TestStepAddActionExpected( chActionText, chExpectedText );
  A_DBGR_VariableRead( "Task_Core4_1000ms_Count", taskvalue);
  E_DBGR_VariableCheck("Task_Core4_1000ms_Count", taskvalue, Greater);
    
  //Check Core5 is running
  snprintf( chActionText, elCount(chActionText), "Check 1000ms Task Counter from Core5 "); 
  snprintf( chExpectedText, elCount(chExpectedText), "1000ms Counter from Core5 is incrementing"); 
  TestStepAddActionExpected( chActionText, chExpectedText );
  A_DBGR_VariableRead( "Task_Core5_1000ms_Count", taskvalue);
  E_DBGR_VariableCheck("Task_Core5_1000ms_Count", taskvalue, Greater);
  
  //Check 2pt5 ms ISR Counter is Incrementing for each core
  snprintf( chActionText, elCount(chActionText), "Check 2pt5ms ISR Counter from Core0 "); 
  snprintf( chExpectedText, elCount(chExpectedText), "2pt5ms ISR Counter from Core0 is incrementing"); 
  TestStepAddActionExpected( chActionText, chExpectedText );
  A_DBGR_VariableRead( "Millisecond2pt5_ISR_count_core0", taskvalue);
  E_DBGR_VariableCheck("Millisecond2pt5_ISR_count_core0", taskvalue, NotEqual);
  
  snprintf( chActionText, elCount(chActionText), "Check 2pt5ms ISR Counter from Core1 "); 
  snprintf( chExpectedText, elCount(chExpectedText), "2pt5ms ISR Counter from Core1 is incrementing"); 
  TestStepAddActionExpected( chActionText, chExpectedText );
  A_DBGR_VariableRead( "Millisecond2pt5_ISR_count_core1", taskvalue);
  E_DBGR_VariableCheck("Millisecond2pt5_ISR_count_core1", taskvalue, NotEqual);
  
  snprintf( chActionText, elCount(chActionText), "Check 2pt5ms ISR Counter from Core2 "); 
  snprintf( chExpectedText, elCount(chExpectedText), "2pt5ms ISR Counter from Core2 is incrementing"); 
  TestStepAddActionExpected( chActionText, chExpectedText );
  A_DBGR_VariableRead( "Millisecond2pt5_ISR_count_core2", taskvalue);
  E_DBGR_VariableCheck("Millisecond2pt5_ISR_count_core2", taskvalue, NotEqual);
    
  snprintf( chActionText, elCount(chActionText), "Check 2pt5ms ISR Counter from Core3 "); 
  snprintf( chExpectedText, elCount(chExpectedText), "2pt5ms ISR Counter from Core3 is incrementing"); 
  TestStepAddActionExpected( chActionText, chExpectedText );
  A_DBGR_VariableRead( "Millisecond2pt5_ISR_count_core3", taskvalue);
  E_DBGR_VariableCheck("Millisecond2pt5_ISR_count_core3", taskvalue, NotEqual);
  
  snprintf( chActionText, elCount(chActionText), "Check 2pt5ms ISR Counter from Core4 "); 
  snprintf( chExpectedText, elCount(chExpectedText), "2pt5ms ISR Counter from Core4 is incrementing"); 
  TestStepAddActionExpected( chActionText, chExpectedText );
  A_DBGR_VariableRead( "Millisecond2pt5_ISR_count_core4", taskvalue);
  E_DBGR_VariableCheck("Millisecond2pt5_ISR_count_core4", taskvalue, NotEqual);
    
  snprintf( chActionText, elCount(chActionText), "Check 2pt5ms ISR Counter from Core5 "); 
  snprintf( chExpectedText, elCount(chExpectedText), "2pt5ms ISR Counter from Core5 is incrementing"); 
  TestStepAddActionExpected( chActionText, chExpectedText );
  A_DBGR_VariableRead( "Millisecond2pt5_ISR_count_core5", taskvalue);
  E_DBGR_VariableCheck("Millisecond2pt5_ISR_count_core5", taskvalue, NotEqual);
  
  // CPU State for All Cores
  snprintf( chActionText, elCount(chActionText), "Check CPU State for Core0 "); 
  snprintf( chExpectedText, elCount(chExpectedText), "CPU State for Core0 is 0"); 
  TestStepAddActionExpected( chActionText, chExpectedText );
  //A_DBGR_VariableRead( "disableCpu[0]", taskvalue);
  E_DBGR_VariableCheck("disableCpu[0]", 0, Equal);
  
  snprintf( chActionText, elCount(chActionText), "Check CPU State for Core1 "); 
  snprintf( chExpectedText, elCount(chExpectedText), "CPU State for Core1 is 0"); 
  TestStepAddActionExpected( chActionText, chExpectedText );
 // A_DBGR_VariableRead( "disableCpu[1]", taskvalue);
  E_DBGR_VariableCheck("disableCpu[1]", 0, Equal);
  
  snprintf( chActionText, elCount(chActionText), "Check CPU State for Core2 "); 
  snprintf( chExpectedText, elCount(chExpectedText), "CPU State for Core2 is 0"); 
  TestStepAddActionExpected( chActionText, chExpectedText );
 // A_DBGR_VariableRead( "disableCpu[2]", taskvalue);
  E_DBGR_VariableCheck("disableCpu[2]", 0, Equal);
  
  snprintf( chActionText, elCount(chActionText), "Check CPU State for Core3 "); 
  snprintf( chExpectedText, elCount(chExpectedText), "CPU State for Core3 is 0"); 
  TestStepAddActionExpected( chActionText, chExpectedText );
 // A_DBGR_VariableRead( "disableCpu[3]", taskvalue);
  E_DBGR_VariableCheck("disableCpu[3]", 0, Equal);
  
  snprintf( chActionText, elCount(chActionText), "Check CPU State for Core4 "); 
  snprintf( chExpectedText, elCount(chExpectedText), "CPU State for Core4 is 0"); 
  TestStepAddActionExpected( chActionText, chExpectedText );
 // A_DBGR_VariableRead( "disableCpu[4]", taskvalue);
  E_DBGR_VariableCheck("disableCpu[4]", 0, Equal);
  
  snprintf( chActionText, elCount(chActionText), "Check CPU State for Core5 "); 
  snprintf( chExpectedText, elCount(chExpectedText), "CPU State for Core5 is 0"); 
  TestStepAddActionExpected( chActionText, chExpectedText );
 // A_DBGR_VariableRead( "disableCpu[5]", taskvalue);
  E_DBGR_VariableCheck("disableCpu[5]", 0, Equal);
  
  /***************************************************************************************************************/    
    // Test Step 3: Disable CPU Core 2 with interface disableCPU[1] = TRUE
  /***************************************************************************************************************/

  snprintf( chActionText, elCount(chActionText), "Disable CPU2"); 
  snprintf( chExpectedText, elCount(chExpectedText), "CPU 2 disabled"); 
  TestStepAddActionExpected( chActionText, chExpectedText );
  A_DBGR_VariableSet("disableCpu[2]", "1");
  E_DBGR_VariableCheck("disableCpu[2]", 1, Equal);  
  
 /***************************************************************************************************************/    
                      // Test Step 4
                     // Check all cores are in running state except Core2
                    // stub Code to Check ISR Counter incrementing except Core2
                   // Check all CPU States shall be running state = FALSE, except Core[2] = TRUE
                      
  /***************************************************************************************************************/
  //Check All tasks of Core0 are running
  snprintf( chActionText, elCount(chActionText), "Check 2pt5ms Task Counter from Core0 "); 
  snprintf( chExpectedText, elCount(chExpectedText), "2pt5ms Counter from Core0 is incrementing"); 
  TestStepAddActionExpected( chActionText, chExpectedText );
  A_DBGR_VariableRead( "Task_Core0_2pt5ms_Count", taskvalue);
  E_DBGR_VariableCheck("Task_Core0_2pt5ms_Count", taskvalue, Greater);
  
  snprintf( chActionText, elCount(chActionText), "Check 5ms Task Counter from Core0 "); 
  snprintf( chExpectedText, elCount(chExpectedText), "5ms Counter from Core0 is incrementing"); 
  TestStepAddActionExpected( chActionText, chExpectedText );
  A_DBGR_VariableRead( "Task_Core0_5ms_Count", taskvalue);
  E_DBGR_VariableCheck("Task_Core0_5ms_Count", taskvalue, Greater);
  
  snprintf( chActionText, elCount(chActionText), "Check 10ms Task Counter from Core0 "); 
  snprintf( chExpectedText, elCount(chExpectedText), "10ms Counter from Core0 is incrementing"); 
  TestStepAddActionExpected( chActionText, chExpectedText );
  A_DBGR_VariableRead( "Task_Core0_10ms_Count", taskvalue);
  E_DBGR_VariableCheck("Task_Core0_10ms_Count", taskvalue, Greater);  
  
  snprintf( chActionText, elCount(chActionText), "Check 25ms Task Counter from Core0 "); 
  snprintf( chExpectedText, elCount(chExpectedText), "25ms Counter from Core0 is incrementing"); 
  TestStepAddActionExpected( chActionText, chExpectedText );
  A_DBGR_VariableRead( "Task_Core0_25ms_Count", taskvalue);
  E_DBGR_VariableCheck("Task_Core0_25ms_Count", taskvalue, Greater);  

  snprintf( chActionText, elCount(chActionText), "Check 50ms Task Counter from Core0 "); 
  snprintf( chExpectedText, elCount(chExpectedText), "50ms Counter from Core0 is incrementing"); 
  TestStepAddActionExpected( chActionText, chExpectedText );
  A_DBGR_VariableRead( "Task_Core0_50ms_Count", taskvalue);
  E_DBGR_VariableCheck("Task_Core0_50ms_Count", taskvalue, Greater);
  
  snprintf( chActionText, elCount(chActionText), "Check 100ms Task Counter from Core0 "); 
  snprintf( chExpectedText, elCount(chExpectedText), "100ms Counter from Core0 is incrementing"); 
  TestStepAddActionExpected( chActionText, chExpectedText );
  A_DBGR_VariableRead( "Task_Core0_100ms_Count", taskvalue);
  E_DBGR_VariableCheck("Task_Core0_100ms_Count", taskvalue, Greater); 
  
  snprintf( chActionText, elCount(chActionText), "Check 250ms Task Counter from Core0 "); 
  snprintf( chExpectedText, elCount(chExpectedText), "250ms Counter from Core0 is incrementing"); 
  TestStepAddActionExpected( chActionText, chExpectedText );
  A_DBGR_VariableRead( "Task_Core0_250ms_Count", taskvalue);
  E_DBGR_VariableCheck("Task_Core0_250ms_Count", taskvalue, Greater);
  
  snprintf( chActionText, elCount(chActionText), "Check 500ms Task Counter from Core0 "); 
  snprintf( chExpectedText, elCount(chExpectedText), "500ms Counter from Core0 is incrementing"); 
  TestStepAddActionExpected( chActionText, chExpectedText );
  A_DBGR_VariableRead( "Task_Core0_500ms_Count", taskvalue);
  E_DBGR_VariableCheck("Task_Core0_500ms_Count", taskvalue, Greater);
  
  snprintf( chActionText, elCount(chActionText), "Check 1000ms Task Counter from Core0 "); 
  snprintf( chExpectedText, elCount(chExpectedText), "1000ms Counter from Core0 is incrementing"); 
  TestStepAddActionExpected( chActionText, chExpectedText );
  A_DBGR_VariableRead( "Task_Core0_1000ms_Count", taskvalue);
  E_DBGR_VariableCheck("Task_Core0_1000ms_Count", taskvalue, Greater);
  
  
  //Check All tasks of Core1 are Running  
  snprintf( chActionText, elCount(chActionText), "Check 2pt5ms Task Counter from Core1 "); 
  snprintf( chExpectedText, elCount(chExpectedText), "2pt5ms Counter from Core1 is  incrementing"); 
  TestStepAddActionExpected( chActionText, chExpectedText );
  A_DBGR_VariableRead( "Task_Core1_2pt5ms_Count", taskvalue);
  E_DBGR_VariableCheck("Task_Core1_2pt5ms_Count", taskvalue, Greater);
  
  snprintf( chActionText, elCount(chActionText), "Check 5ms Task Counter from Core1 "); 
  snprintf( chExpectedText, elCount(chExpectedText), "5ms Counter from Core1 is  incrementing"); 
  TestStepAddActionExpected( chActionText, chExpectedText );
  A_DBGR_VariableRead( "Task_Core1_5ms_Count", taskvalue);
  E_DBGR_VariableCheck("Task_Core1_5ms_Count", taskvalue, Greater);
  
  snprintf( chActionText, elCount(chActionText), "Check 10ms Task Counter from Core1 "); 
  snprintf( chExpectedText, elCount(chExpectedText), "10ms Counter from Core1 is  incrementing"); 
  TestStepAddActionExpected( chActionText, chExpectedText );
  A_DBGR_VariableRead( "Task_Core1_10ms_Count", taskvalue);
  E_DBGR_VariableCheck("Task_Core1_10ms_Count", taskvalue, Greater);  
  
  snprintf( chActionText, elCount(chActionText), "Check 25ms Task Counter from Core1 "); 
  snprintf( chExpectedText, elCount(chExpectedText), "25ms Counter from Core1 is  incrementing"); 
  TestStepAddActionExpected( chActionText, chExpectedText );
  A_DBGR_VariableRead( "Task_Core1_25ms_Count", taskvalue);
  E_DBGR_VariableCheck("Task_Core1_25ms_Count", taskvalue, Greater); 
  
  snprintf( chActionText, elCount(chActionText), "Check 50ms Task Counter from Core1 "); 
  snprintf( chExpectedText, elCount(chExpectedText), "50ms Counter from Core1 is  incrementing"); 
  TestStepAddActionExpected( chActionText, chExpectedText );
  A_DBGR_VariableRead( "Task_Core1_50ms_Count", taskvalue);
  E_DBGR_VariableCheck("Task_Core1_50ms_Count", taskvalue, Greater);
    
  snprintf( chActionText, elCount(chActionText), "Check 100ms Task Counter from Core1 "); 
  snprintf( chExpectedText, elCount(chExpectedText), "100ms Counter from Core1 is  incrementing"); 
  TestStepAddActionExpected( chActionText, chExpectedText );
  A_DBGR_VariableRead( "Task_Core1_100ms_Count", taskvalue);
  E_DBGR_VariableCheck("Task_Core1_100ms_Count", taskvalue, Greater);

  snprintf( chActionText, elCount(chActionText), "Check 250ms Task Counter from Core1 "); 
  snprintf( chExpectedText, elCount(chExpectedText), "250ms Counter from Core1 is  incrementing"); 
  TestStepAddActionExpected( chActionText, chExpectedText );
  A_DBGR_VariableRead( "Task_Core1_250ms_Count", taskvalue);
  E_DBGR_VariableCheck("Task_Core1_250ms_Count", taskvalue, Greater);
  
  snprintf( chActionText, elCount(chActionText), "Check 500ms Task Counter from Core1 "); 
  snprintf( chExpectedText, elCount(chExpectedText), "500ms Counter from Core1 is  incrementing"); 
  TestStepAddActionExpected( chActionText, chExpectedText );
  A_DBGR_VariableRead( "Task_Core1_500ms_Count", taskvalue);
  E_DBGR_VariableCheck("Task_Core1_500ms_Count", taskvalue, Greater);

  snprintf( chActionText, elCount(chActionText), "Check 1000ms Task Counter from Core1 "); 
  snprintf( chExpectedText, elCount(chExpectedText), "1000ms Counter from Core1 is incrementing"); 
  TestStepAddActionExpected( chActionText, chExpectedText );
  A_DBGR_VariableRead( "Task_Core1_1000ms_Count", taskvalue);
  E_DBGR_VariableCheck("Task_Core1_1000ms_Count", taskvalue, Greater);
  
  
  //Check All tasks of Core2 are Stopped
  snprintf( chActionText, elCount(chActionText), "Check 2pt5ms Task Counter from Core2 "); 
  snprintf( chExpectedText, elCount(chExpectedText), "2pt5ms Counter from Core2 is stop incrementing"); 
  TestStepAddActionExpected( chActionText, chExpectedText );
  A_DBGR_VariableRead( "Task_Core2_2pt5ms_Count", taskvalue);
  E_DBGR_VariableCheck("Task_Core2_2pt5ms_Count", taskvalue, Equal);
  
  snprintf( chActionText, elCount(chActionText), "Check 5ms Task Counter from Core2 "); 
  snprintf( chExpectedText, elCount(chExpectedText), "5ms Counter from Core2 is stop incrementing"); 
  TestStepAddActionExpected( chActionText, chExpectedText );
  A_DBGR_VariableRead( "Task_Core2_5ms_Count", taskvalue);
  E_DBGR_VariableCheck("Task_Core2_5ms_Count", taskvalue, Equal);
  
  snprintf( chActionText, elCount(chActionText), "Check 10ms Task Counter from Core2 "); 
  snprintf( chExpectedText, elCount(chExpectedText), "10ms Counter from Core2 is stop incrementing"); 
  TestStepAddActionExpected( chActionText, chExpectedText );
  A_DBGR_VariableRead( "Task_Core2_10ms_Count", taskvalue);
  E_DBGR_VariableCheck("Task_Core2_10ms_Count", taskvalue, Equal);  
  
  snprintf( chActionText, elCount(chActionText), "Check 25ms Task Counter from Core2 "); 
  snprintf( chExpectedText, elCount(chExpectedText), "25ms Counter from Core2 is stop incrementing"); 
  TestStepAddActionExpected( chActionText, chExpectedText );
  A_DBGR_VariableRead( "Task_Core2_25ms_Count", taskvalue);
  E_DBGR_VariableCheck("Task_Core2_25ms_Count", taskvalue, Equal); 

  snprintf( chActionText, elCount(chActionText), "Check 50ms Task Counter from Core2 "); 
  snprintf( chExpectedText, elCount(chExpectedText), "50ms Counter from Core2 is stop incrementing"); 
  TestStepAddActionExpected( chActionText, chExpectedText );
  A_DBGR_VariableRead( "Task_Core2_50ms_Count", taskvalue);
  E_DBGR_VariableCheck("Task_Core2_50ms_Count", taskvalue, Equal);
  
  snprintf( chActionText, elCount(chActionText), "Check 100ms Task Counter from Core2 "); 
  snprintf( chExpectedText, elCount(chExpectedText), "100ms Counter from Core2 is stop incrementing"); 
  TestStepAddActionExpected( chActionText, chExpectedText );
  A_DBGR_VariableRead( "Task_Core2_100ms_Count", taskvalue);
  E_DBGR_VariableCheck("Task_Core2_100ms_Count", taskvalue, Equal); 
  
  snprintf( chActionText, elCount(chActionText), "Check 250ms Task Counter from Core2 "); 
  snprintf( chExpectedText, elCount(chExpectedText), "250ms Counter from Core2 is stop incrementing"); 
  TestStepAddActionExpected( chActionText, chExpectedText );
  A_DBGR_VariableRead( "Task_Core2_250ms_Count", taskvalue);
  E_DBGR_VariableCheck("Task_Core2_250ms_Count", taskvalue, Equal);

  snprintf( chActionText, elCount(chActionText), "Check 500ms Task Counter from Core2 "); 
  snprintf( chExpectedText, elCount(chExpectedText), "500ms Counter from Core2 is stop incrementing"); 
  TestStepAddActionExpected( chActionText, chExpectedText );
  A_DBGR_VariableRead( "Task_Core2_500ms_Count", taskvalue);
  E_DBGR_VariableCheck("Task_Core2_500ms_Count", taskvalue, Equal);

  snprintf( chActionText, elCount(chActionText), "Check 1000ms Task Counter from Core2 "); 
  snprintf( chExpectedText, elCount(chExpectedText), "1000ms Counter from Core2 is stop incrementing"); 
  TestStepAddActionExpected( chActionText, chExpectedText );
  A_DBGR_VariableRead( "Task_Core2_1000ms_Count", taskvalue);
  E_DBGR_VariableCheck("Task_Core2_1000ms_Count", taskvalue, Equal);
  
  
    //Check All tasks of Core3 are running
  snprintf( chActionText, elCount(chActionText), "Check 2pt5ms Task Counter from Core3 "); 
  snprintf( chExpectedText, elCount(chExpectedText), "2pt5ms Counter from Core3 is  incrementing"); 
  TestStepAddActionExpected( chActionText, chExpectedText );
  A_DBGR_VariableRead( "Task_Core3_2pt5ms_Count", taskvalue);
  E_DBGR_VariableCheck("Task_Core3_2pt5ms_Count", taskvalue, Greater);
  
   snprintf( chActionText, elCount(chActionText), "Check 5ms Task Counter from Core3 "); 
  snprintf( chExpectedText, elCount(chExpectedText), "5ms Counter from Core3 is  incrementing"); 
  TestStepAddActionExpected( chActionText, chExpectedText );
  A_DBGR_VariableRead( "Task_Core3_5ms_Count", taskvalue);
  E_DBGR_VariableCheck("Task_Core3_5ms_Count", taskvalue, Greater);
  
  snprintf( chActionText, elCount(chActionText), "Check 10ms Task Counter from Core3 "); 
  snprintf( chExpectedText, elCount(chExpectedText), "10ms Counter from Core3 is  incrementing"); 
  TestStepAddActionExpected( chActionText, chExpectedText );
  A_DBGR_VariableRead( "Task_Core3_10ms_Count", taskvalue);
  E_DBGR_VariableCheck("Task_Core3_10ms_Count", taskvalue, Greater);  
  
  snprintf( chActionText, elCount(chActionText), "Check 25ms Task Counter from Core3 "); 
  snprintf( chExpectedText, elCount(chExpectedText), "25ms Counter from Core3 is  incrementing"); 
  TestStepAddActionExpected( chActionText, chExpectedText );
  A_DBGR_VariableRead( "Task_Core3_25ms_Count", taskvalue);
  E_DBGR_VariableCheck("Task_Core3_25ms_Count", taskvalue, Greater);  
  
  snprintf( chActionText, elCount(chActionText), "Check 50ms Task Counter from Core3 "); 
  snprintf( chExpectedText, elCount(chExpectedText), "50ms Counter from Core3 is  incrementing"); 
  TestStepAddActionExpected( chActionText, chExpectedText );
  A_DBGR_VariableRead( "Task_Core3_50ms_Count", taskvalue);
  E_DBGR_VariableCheck("Task_Core3_50ms_Count", taskvalue, Greater);

  snprintf( chActionText, elCount(chActionText), "Check 100ms Task Counter from Core3 "); 
  snprintf( chExpectedText, elCount(chExpectedText), "100ms Counter from Core3 is  incrementing"); 
  TestStepAddActionExpected( chActionText, chExpectedText );
  A_DBGR_VariableRead( "Task_Core3_100ms_Count", taskvalue);
  E_DBGR_VariableCheck("Task_Core3_100ms_Count", taskvalue, Greater); 
  
  snprintf( chActionText, elCount(chActionText), "Check 250ms Task Counter from Core3 "); 
  snprintf( chExpectedText, elCount(chExpectedText), "250ms Counter from Core3 is  incrementing"); 
  TestStepAddActionExpected( chActionText, chExpectedText );
  A_DBGR_VariableRead( "Task_Core3_250ms_Count", taskvalue);
  E_DBGR_VariableCheck("Task_Core3_250ms_Count", taskvalue, Greater);
  
  snprintf( chActionText, elCount(chActionText), "Check 1000ms Task Counter from Core3 "); 
  snprintf( chExpectedText, elCount(chExpectedText), "1000ms Counter from Core3 is  incrementing"); 
  TestStepAddActionExpected( chActionText, chExpectedText );
  A_DBGR_VariableRead( "Task_Core3_1000ms_Count", taskvalue);
  E_DBGR_VariableCheck("Task_Core3_1000ms_Count", taskvalue, Greater);
  
    //Check task from Core4 is running
  snprintf( chActionText, elCount(chActionText), "Check 1000ms Task Counter from Core4 "); 
  snprintf( chExpectedText, elCount(chExpectedText), "1000ms Counter from Core4 is  incrementing"); 
  TestStepAddActionExpected( chActionText, chExpectedText );
  A_DBGR_VariableRead( "Task_Core4_1000ms_Count", taskvalue);
  E_DBGR_VariableCheck("Task_Core4_1000ms_Count", taskvalue, Greater);
    
  //Check task from Core5 is running
  snprintf( chActionText, elCount(chActionText), "Check 1000ms Task Counter from Core5 "); 
  snprintf( chExpectedText, elCount(chExpectedText), "1000ms Counter from Core5 is  incrementing"); 
  TestStepAddActionExpected( chActionText, chExpectedText );
  A_DBGR_VariableRead( "Task_Core5_1000ms_Count", taskvalue);
  E_DBGR_VariableCheck("Task_Core5_1000ms_Count", taskvalue, Greater);
  
  
  //Check 2pt5 ms ISR Counter is Incrementing for each core except Core2
  snprintf( chActionText, elCount(chActionText), "Check 2pt5ms ISR Counter from Core0 "); 
  snprintf( chExpectedText, elCount(chExpectedText), "2pt5ms ISR Counter from Core0 is incrementing"); 
  TestStepAddActionExpected( chActionText, chExpectedText );
  A_DBGR_VariableRead( "Millisecond2pt5_ISR_count_core0", taskvalue);
  E_DBGR_VariableCheck("Millisecond2pt5_ISR_count_core0", taskvalue, NotEqual);
  
  snprintf( chActionText, elCount(chActionText), "Check 2pt5ms ISR Counter from Core1 "); 
  snprintf( chExpectedText, elCount(chExpectedText), "2pt5ms ISR Counter from Core1 is incrementing"); 
  TestStepAddActionExpected( chActionText, chExpectedText );
  A_DBGR_VariableRead( "Millisecond2pt5_ISR_count_core1", taskvalue);
  E_DBGR_VariableCheck("Millisecond2pt5_ISR_count_core1", taskvalue, NotEqual);
  
  snprintf( chActionText, elCount(chActionText), "Check 2pt5ms ISR Counter from Core2 "); 
  snprintf( chExpectedText, elCount(chExpectedText), "2pt5ms ISR Counter from Core2 is stop incrementing"); 
  TestStepAddActionExpected( chActionText, chExpectedText );
  A_DBGR_VariableRead( "Millisecond2pt5_ISR_count_core2", taskvalue);
  E_DBGR_VariableCheck("Millisecond2pt5_ISR_count_core2", taskvalue, Equal);
    
  snprintf( chActionText, elCount(chActionText), "Check 2pt5ms ISR Counter from Core3 "); 
  snprintf( chExpectedText, elCount(chExpectedText), "2pt5ms ISR Counter from Core3 is incrementing"); 
  TestStepAddActionExpected( chActionText, chExpectedText );
  A_DBGR_VariableRead( "Millisecond2pt5_ISR_count_core3", taskvalue);
  E_DBGR_VariableCheck("Millisecond2pt5_ISR_count_core3", taskvalue, NotEqual);
  
  snprintf( chActionText, elCount(chActionText), "Check 2pt5ms ISR Counter from Core4 "); 
  snprintf( chExpectedText, elCount(chExpectedText), "2pt5ms ISR Counter from Core4 is incrementing"); 
  TestStepAddActionExpected( chActionText, chExpectedText );
  A_DBGR_VariableRead( "Millisecond2pt5_ISR_count_core4", taskvalue);
  E_DBGR_VariableCheck("Millisecond2pt5_ISR_count_core4", taskvalue, NotEqual);
    
  snprintf( chActionText, elCount(chActionText), "Check 2pt5ms ISR Counter from Core5 "); 
  snprintf( chExpectedText, elCount(chExpectedText), "2pt5ms ISR Counter from Core5 is incrementing"); 
  TestStepAddActionExpected( chActionText, chExpectedText );
  A_DBGR_VariableRead( "Millisecond2pt5_ISR_count_core5", taskvalue);
  E_DBGR_VariableCheck("Millisecond2pt5_ISR_count_core5", taskvalue, NotEqual);
  
  // CPU State for All Cores shall be FALSE, Excepr Core2 = TRUE
  snprintf( chActionText, elCount(chActionText), "Check CPU State for Core0 "); 
  snprintf( chExpectedText, elCount(chExpectedText), "CPU State for Core0 is 0"); 
  TestStepAddActionExpected( chActionText, chExpectedText );
  //A_DBGR_VariableRead( "disableCpu[0]", taskvalue);
  E_DBGR_VariableCheck("disableCpu[0]", 0, Equal);
  
  snprintf( chActionText, elCount(chActionText), "Check CPU State for Core1 "); 
  snprintf( chExpectedText, elCount(chExpectedText), "CPU State for Core1 is 0"); 
  TestStepAddActionExpected( chActionText, chExpectedText );
  //A_DBGR_VariableRead( "disableCpu[1]", taskvalue);
  E_DBGR_VariableCheck("disableCpu[1]", 0, Equal);
  
  snprintf( chActionText, elCount(chActionText), "Check CPU State for Core2 "); 
  snprintf( chExpectedText, elCount(chExpectedText), "CPU State for Core2 is TRUE"); 
  TestStepAddActionExpected( chActionText, chExpectedText );
  //A_DBGR_VariableRead( "disableCpu[2]", taskvalue);
  E_DBGR_VariableCheck("disableCpu[2]", 1, Equal);
  
  snprintf( chActionText, elCount(chActionText), "Check CPU State for Core3 "); 
  snprintf( chExpectedText, elCount(chExpectedText), "CPU State for Core3 is 0"); 
  TestStepAddActionExpected( chActionText, chExpectedText );
 // A_DBGR_VariableRead( "disableCpu[3]", taskvalue);
  E_DBGR_VariableCheck("disableCpu[3]", 0, Equal);
  
  snprintf( chActionText, elCount(chActionText), "Check CPU State for Core4 "); 
  snprintf( chExpectedText, elCount(chExpectedText), "CPU State for Core4 is 0"); 
  TestStepAddActionExpected( chActionText, chExpectedText );
  //A_DBGR_VariableRead( "disableCpu[4]", taskvalue);
  E_DBGR_VariableCheck("disableCpu[4]", 0, Equal);
  
  snprintf( chActionText, elCount(chActionText), "Check CPU State for Core5 "); 
  snprintf( chExpectedText, elCount(chExpectedText), "CPU State for Core5 is 0"); 
  TestStepAddActionExpected( chActionText, chExpectedText );
  //A_DBGR_VariableRead( "disableCpu[5]", taskvalue);
  E_DBGR_VariableCheck("disableCpu[5]", 0, Equal);
}

/***************************************************************************************************
----------------------------------------------------------------------------------------------------
Test case name:  TC_L30SW_Q-36649771: Test case to verify the functinality of interface DsblHWIO_CPU for disabling the CPU3
----------------------------------------------------------------------------------------------------
Description:   Test case to verify the functionality of interface DsblHWIO_CPU for disabling the CPU3.

***************************************************************************************************/
testcase Testcase_to_verify_the_functionality_of_interface_DsblHWIO_CPU_for_disabling_the_CPU3()
{
  /***************************************************************************************************************/    
                                                // Variable Definition
  /***************************************************************************************************************/ 
  ;
  long taskvalue;
  
  /***************************************************************************************************************/    
                                               // Local Values
  /***************************************************************************************************************/ 
  

  
  /***************************************************************************************************************/    
                                              // Test Case Info
  /***************************************************************************************************************/
  setWriteDbgLevel(DebugOff);
  snprintf( chTestTitle, elCount(chTestTitle), "Testcase_to_verify_the_functionality_of_interface_DsblHWIO_CPU_for_disabling_the_CPU3." );
  snprintf( chTestDescription, elCount(chTestDescription), "Purpose: Test case to verify the functionality of interface DsblHWIO_CPU for disabling the CPU3");
  TestCaseAddInfo( chTestTitle, "TC_L30SW_Q-36649771", chTestDescription );

  /***************************************************************************************************************/    
                                              // Start of Test Case
  /***************************************************************************************************************/
  
  /***************************************************************************************************************/    
                                              // Test Step 1 PRECONDITIONS
  /***************************************************************************************************************/
  
  snprintf( chActionText, elCount(chActionText), "Flash the Software and ECU is running"); 
  snprintf( chExpectedText, elCount(chExpectedText), "ECU should be in running state"); 
  TestStepAddActionExpected( chActionText, chExpectedText );

  A_DBGR_BreakpointDeleteAll();
  A_DBGR_RnGo();
  E_DBGR_CheckState(T32_State_Running);
  

   /***************************************************************************************************************/    
                      // Test Step 2 
                     // Check all cores are in running state
                    // stub Code to Check ISR Counter incrementing 
                   // Check all CPU States shall be running state = FALSE
                      
  /***************************************************************************************************************/
  
  //Check Core0 is running
  snprintf( chActionText, elCount(chActionText), "Check 1000ms Task Counter from Core0 "); 
  snprintf( chExpectedText, elCount(chExpectedText), "1000ms Counter from Core0 is incrementing"); 
  TestStepAddActionExpected( chActionText, chExpectedText );
  A_DBGR_VariableRead( "Task_Core0_1000ms_Count", taskvalue);
  E_DBGR_VariableCheck("Task_Core0_1000ms_Count", taskvalue, Greater);
  
  //Check Core1 is running
  snprintf( chActionText, elCount(chActionText), "Check 1000ms Task Counter from Core1 "); 
  snprintf( chExpectedText, elCount(chExpectedText), "1000ms Counter from Core1 is incrementing"); 
  TestStepAddActionExpected( chActionText, chExpectedText );
  A_DBGR_VariableRead( "Task_Core1_1000ms_Count", taskvalue);
  E_DBGR_VariableCheck("Task_Core1_1000ms_Count", taskvalue, Greater);
  
  //Check Core2 is running
  snprintf( chActionText, elCount(chActionText), "Check 1000ms Task Counter from Core2 "); 
  snprintf( chExpectedText, elCount(chExpectedText), "1000ms Counter from Core2 is incrementing"); 
  TestStepAddActionExpected( chActionText, chExpectedText );
  A_DBGR_VariableRead( "Task_Core2_1000ms_Count", taskvalue);
  E_DBGR_VariableCheck("Task_Core2_1000ms_Count", taskvalue, Greater);
    
  //Check Core3 is running
  snprintf( chActionText, elCount(chActionText), "Check 1000ms Task Counter from Core3 "); 
  snprintf( chExpectedText, elCount(chExpectedText), "1000ms Counter from Core3 is incrementing"); 
  TestStepAddActionExpected( chActionText, chExpectedText );
  A_DBGR_VariableRead( "Task_Core3_1000ms_Count", taskvalue);
  E_DBGR_VariableCheck("Task_Core3_1000ms_Count", taskvalue, Greater);
    
  //Check Core4 is running
  snprintf( chActionText, elCount(chActionText), "Check 1000ms Task Counter from Core4 "); 
  snprintf( chExpectedText, elCount(chExpectedText), "1000ms Counter from Core4 is incrementing"); 
  TestStepAddActionExpected( chActionText, chExpectedText );
  A_DBGR_VariableRead( "Task_Core4_1000ms_Count", taskvalue);
  E_DBGR_VariableCheck("Task_Core4_1000ms_Count", taskvalue, Greater);
    
  //Check Core5 is running
  snprintf( chActionText, elCount(chActionText), "Check 1000ms Task Counter from Core5 "); 
  snprintf( chExpectedText, elCount(chExpectedText), "1000ms Counter from Core5 is incrementing"); 
  TestStepAddActionExpected( chActionText, chExpectedText );
  A_DBGR_VariableRead( "Task_Core5_1000ms_Count", taskvalue);
  E_DBGR_VariableCheck("Task_Core5_1000ms_Count", taskvalue, Greater);
  
  //Check 2pt5 ms ISR Counter is Incrementing for each core
  snprintf( chActionText, elCount(chActionText), "Check 2pt5ms ISR Counter from Core0 "); 
  snprintf( chExpectedText, elCount(chExpectedText), "2pt5ms ISR Counter from Core0 is incrementing"); 
  TestStepAddActionExpected( chActionText, chExpectedText );
  A_DBGR_VariableRead( "Millisecond2pt5_ISR_count_core0", taskvalue);
  E_DBGR_VariableCheck("Millisecond2pt5_ISR_count_core0", taskvalue, NotEqual);
  
  snprintf( chActionText, elCount(chActionText), "Check 2pt5ms ISR Counter from Core1 "); 
  snprintf( chExpectedText, elCount(chExpectedText), "2pt5ms ISR Counter from Core1 is incrementing"); 
  TestStepAddActionExpected( chActionText, chExpectedText );
  A_DBGR_VariableRead( "Millisecond2pt5_ISR_count_core1", taskvalue);
  E_DBGR_VariableCheck("Millisecond2pt5_ISR_count_core1", taskvalue, NotEqual);
  
  snprintf( chActionText, elCount(chActionText), "Check 2pt5ms ISR Counter from Core2 "); 
  snprintf( chExpectedText, elCount(chExpectedText), "2pt5ms ISR Counter from Core2 is incrementing"); 
  TestStepAddActionExpected( chActionText, chExpectedText );
  A_DBGR_VariableRead( "Millisecond2pt5_ISR_count_core2", taskvalue);
  E_DBGR_VariableCheck("Millisecond2pt5_ISR_count_core2", taskvalue, NotEqual);
    
  snprintf( chActionText, elCount(chActionText), "Check 2pt5ms ISR Counter from Core3 "); 
  snprintf( chExpectedText, elCount(chExpectedText), "2pt5ms ISR Counter from Core3 is incrementing"); 
  TestStepAddActionExpected( chActionText, chExpectedText );
  A_DBGR_VariableRead( "Millisecond2pt5_ISR_count_core3", taskvalue);
  E_DBGR_VariableCheck("Millisecond2pt5_ISR_count_core3", taskvalue, NotEqual);
  
  snprintf( chActionText, elCount(chActionText), "Check 2pt5ms ISR Counter from Core4 "); 
  snprintf( chExpectedText, elCount(chExpectedText), "2pt5ms ISR Counter from Core4 is incrementing"); 
  TestStepAddActionExpected( chActionText, chExpectedText );
  A_DBGR_VariableRead( "Millisecond2pt5_ISR_count_core4", taskvalue);
  E_DBGR_VariableCheck("Millisecond2pt5_ISR_count_core4", taskvalue, NotEqual);
    
  snprintf( chActionText, elCount(chActionText), "Check 2pt5ms ISR Counter from Core5 "); 
  snprintf( chExpectedText, elCount(chExpectedText), "2pt5ms ISR Counter from Core5 is incrementing"); 
  TestStepAddActionExpected( chActionText, chExpectedText );
  A_DBGR_VariableRead( "Millisecond2pt5_ISR_count_core5", taskvalue);
  E_DBGR_VariableCheck("Millisecond2pt5_ISR_count_core5", taskvalue, NotEqual);
  
  // CPU State for All Cores
  snprintf( chActionText, elCount(chActionText), "Check CPU State for Core0 "); 
  snprintf( chExpectedText, elCount(chExpectedText), "CPU State for Core0 is 0"); 
  TestStepAddActionExpected( chActionText, chExpectedText );
  //A_DBGR_VariableRead( "disableCpu[0]", taskvalue);
  E_DBGR_VariableCheck("disableCpu[0]", 0, Equal);
  
  snprintf( chActionText, elCount(chActionText), "Check CPU State for Core1 "); 
  snprintf( chExpectedText, elCount(chExpectedText), "CPU State for Core1 is 0"); 
  TestStepAddActionExpected( chActionText, chExpectedText );
 // A_DBGR_VariableRead( "disableCpu[1]", taskvalue);
  E_DBGR_VariableCheck("disableCpu[1]", 0, Equal);
  
  snprintf( chActionText, elCount(chActionText), "Check CPU State for Core2 "); 
  snprintf( chExpectedText, elCount(chExpectedText), "CPU State for Core2 is 0"); 
  TestStepAddActionExpected( chActionText, chExpectedText );
 // A_DBGR_VariableRead( "disableCpu[2]", taskvalue);
  E_DBGR_VariableCheck("disableCpu[2]", 0, Equal);
  
  snprintf( chActionText, elCount(chActionText), "Check CPU State for Core3 "); 
  snprintf( chExpectedText, elCount(chExpectedText), "CPU State for Core3 is 0"); 
  TestStepAddActionExpected( chActionText, chExpectedText );
 // A_DBGR_VariableRead( "disableCpu[3]", taskvalue);
  E_DBGR_VariableCheck("disableCpu[3]", 0, Equal);
  
  snprintf( chActionText, elCount(chActionText), "Check CPU State for Core4 "); 
  snprintf( chExpectedText, elCount(chExpectedText), "CPU State for Core4 is 0"); 
  TestStepAddActionExpected( chActionText, chExpectedText );
 // A_DBGR_VariableRead( "disableCpu[4]", taskvalue);
  E_DBGR_VariableCheck("disableCpu[4]", 0, Equal);
  
  snprintf( chActionText, elCount(chActionText), "Check CPU State for Core5 "); 
  snprintf( chExpectedText, elCount(chExpectedText), "CPU State for Core5 is 0"); 
  TestStepAddActionExpected( chActionText, chExpectedText );
 // A_DBGR_VariableRead( "disableCpu[5]", taskvalue);
  E_DBGR_VariableCheck("disableCpu[5]", 0, Equal);
  
  /***************************************************************************************************************/    
    // Test Step 3: Disable CPU Core 3 with interface disableCPU[3] = TRUE
  /***************************************************************************************************************/

  snprintf( chActionText, elCount(chActionText), "Disable CPU3"); 
  snprintf( chExpectedText, elCount(chExpectedText), "CPU 3 disabled"); 
  TestStepAddActionExpected( chActionText, chExpectedText );
  A_DBGR_VariableSet("disableCpu[3]", "1");
  E_DBGR_VariableCheck("disableCpu[3]", 1, Equal);  
  
 /***************************************************************************************************************/    
                      // Test Step 4
                     // Check all cores are in running state except Core3
                    // stub Code to Check ISR Counter incrementing except Core3
                   // Check all CPU States shall be running state = FALSE, except Core[3] = TRUE
                      
  /***************************************************************************************************************/
  //Check All tasks of Core0 are running
  snprintf( chActionText, elCount(chActionText), "Check 2pt5ms Task Counter from Core0 "); 
  snprintf( chExpectedText, elCount(chExpectedText), "2pt5ms Counter from Core0 is incrementing"); 
  TestStepAddActionExpected( chActionText, chExpectedText );
  A_DBGR_VariableRead( "Task_Core0_2pt5ms_Count", taskvalue);
  E_DBGR_VariableCheck("Task_Core0_2pt5ms_Count", taskvalue, Greater);
  
  snprintf( chActionText, elCount(chActionText), "Check 5ms Task Counter from Core0 "); 
  snprintf( chExpectedText, elCount(chExpectedText), "5ms Counter from Core0 is incrementing"); 
  TestStepAddActionExpected( chActionText, chExpectedText );
  A_DBGR_VariableRead( "Task_Core0_5ms_Count", taskvalue);
  E_DBGR_VariableCheck("Task_Core0_5ms_Count", taskvalue, Greater);
  
  snprintf( chActionText, elCount(chActionText), "Check 10ms Task Counter from Core0 "); 
  snprintf( chExpectedText, elCount(chExpectedText), "10ms Counter from Core0 is incrementing"); 
  TestStepAddActionExpected( chActionText, chExpectedText );
  A_DBGR_VariableRead( "Task_Core0_10ms_Count", taskvalue);
  E_DBGR_VariableCheck("Task_Core0_10ms_Count", taskvalue, Greater);  
  
  snprintf( chActionText, elCount(chActionText), "Check 25ms Task Counter from Core0 "); 
  snprintf( chExpectedText, elCount(chExpectedText), "25ms Counter from Core0 is incrementing"); 
  TestStepAddActionExpected( chActionText, chExpectedText );
  A_DBGR_VariableRead( "Task_Core0_25ms_Count", taskvalue);
  E_DBGR_VariableCheck("Task_Core0_25ms_Count", taskvalue, Greater);  

  snprintf( chActionText, elCount(chActionText), "Check 50ms Task Counter from Core0 "); 
  snprintf( chExpectedText, elCount(chExpectedText), "50ms Counter from Core0 is incrementing"); 
  TestStepAddActionExpected( chActionText, chExpectedText );
  A_DBGR_VariableRead( "Task_Core0_50ms_Count", taskvalue);
  E_DBGR_VariableCheck("Task_Core0_50ms_Count", taskvalue, Greater);
  
  snprintf( chActionText, elCount(chActionText), "Check 100ms Task Counter from Core0 "); 
  snprintf( chExpectedText, elCount(chExpectedText), "100ms Counter from Core0 is incrementing"); 
  TestStepAddActionExpected( chActionText, chExpectedText );
  A_DBGR_VariableRead( "Task_Core0_100ms_Count", taskvalue);
  E_DBGR_VariableCheck("Task_Core0_100ms_Count", taskvalue, Greater); 
  
  snprintf( chActionText, elCount(chActionText), "Check 250ms Task Counter from Core0 "); 
  snprintf( chExpectedText, elCount(chExpectedText), "250ms Counter from Core0 is incrementing"); 
  TestStepAddActionExpected( chActionText, chExpectedText );
  A_DBGR_VariableRead( "Task_Core0_250ms_Count", taskvalue);
  E_DBGR_VariableCheck("Task_Core0_250ms_Count", taskvalue, Greater);
  
  snprintf( chActionText, elCount(chActionText), "Check 500ms Task Counter from Core0 "); 
  snprintf( chExpectedText, elCount(chExpectedText), "500ms Counter from Core0 is incrementing"); 
  TestStepAddActionExpected( chActionText, chExpectedText );
  A_DBGR_VariableRead( "Task_Core0_500ms_Count", taskvalue);
  E_DBGR_VariableCheck("Task_Core0_500ms_Count", taskvalue, Greater);
  
  snprintf( chActionText, elCount(chActionText), "Check 1000ms Task Counter from Core0 "); 
  snprintf( chExpectedText, elCount(chExpectedText), "1000ms Counter from Core0 is incrementing"); 
  TestStepAddActionExpected( chActionText, chExpectedText );
  A_DBGR_VariableRead( "Task_Core0_1000ms_Count", taskvalue);
  E_DBGR_VariableCheck("Task_Core0_1000ms_Count", taskvalue, Greater);
  
  
  //Check All tasks of Core1 are Running  
  snprintf( chActionText, elCount(chActionText), "Check 2pt5ms Task Counter from Core1 "); 
  snprintf( chExpectedText, elCount(chExpectedText), "2pt5ms Counter from Core1 is  incrementing"); 
  TestStepAddActionExpected( chActionText, chExpectedText );
  A_DBGR_VariableRead( "Task_Core1_2pt5ms_Count", taskvalue);
  E_DBGR_VariableCheck("Task_Core1_2pt5ms_Count", taskvalue, Greater);
  
  snprintf( chActionText, elCount(chActionText), "Check 5ms Task Counter from Core1 "); 
  snprintf( chExpectedText, elCount(chExpectedText), "5ms Counter from Core1 is  incrementing"); 
  TestStepAddActionExpected( chActionText, chExpectedText );
  A_DBGR_VariableRead( "Task_Core1_5ms_Count", taskvalue);
  E_DBGR_VariableCheck("Task_Core1_5ms_Count", taskvalue, Greater);
  
  snprintf( chActionText, elCount(chActionText), "Check 10ms Task Counter from Core1 "); 
  snprintf( chExpectedText, elCount(chExpectedText), "10ms Counter from Core1 is  incrementing"); 
  TestStepAddActionExpected( chActionText, chExpectedText );
  A_DBGR_VariableRead( "Task_Core1_10ms_Count", taskvalue);
  E_DBGR_VariableCheck("Task_Core1_10ms_Count", taskvalue, Greater);  
  
  snprintf( chActionText, elCount(chActionText), "Check 25ms Task Counter from Core1 "); 
  snprintf( chExpectedText, elCount(chExpectedText), "25ms Counter from Core1 is  incrementing"); 
  TestStepAddActionExpected( chActionText, chExpectedText );
  A_DBGR_VariableRead( "Task_Core1_25ms_Count", taskvalue);
  E_DBGR_VariableCheck("Task_Core1_25ms_Count", taskvalue, Greater); 
  
  snprintf( chActionText, elCount(chActionText), "Check 50ms Task Counter from Core1 "); 
  snprintf( chExpectedText, elCount(chExpectedText), "50ms Counter from Core1 is  incrementing"); 
  TestStepAddActionExpected( chActionText, chExpectedText );
  A_DBGR_VariableRead( "Task_Core1_50ms_Count", taskvalue);
  E_DBGR_VariableCheck("Task_Core1_50ms_Count", taskvalue, Greater);
    
  snprintf( chActionText, elCount(chActionText), "Check 100ms Task Counter from Core1 "); 
  snprintf( chExpectedText, elCount(chExpectedText), "100ms Counter from Core1 is  incrementing"); 
  TestStepAddActionExpected( chActionText, chExpectedText );
  A_DBGR_VariableRead( "Task_Core1_100ms_Count", taskvalue);
  E_DBGR_VariableCheck("Task_Core1_100ms_Count", taskvalue, Greater);

  snprintf( chActionText, elCount(chActionText), "Check 250ms Task Counter from Core1 "); 
  snprintf( chExpectedText, elCount(chExpectedText), "250ms Counter from Core1 is  incrementing"); 
  TestStepAddActionExpected( chActionText, chExpectedText );
  A_DBGR_VariableRead( "Task_Core1_250ms_Count", taskvalue);
  E_DBGR_VariableCheck("Task_Core1_250ms_Count", taskvalue, Greater);
  
  snprintf( chActionText, elCount(chActionText), "Check 500ms Task Counter from Core1 "); 
  snprintf( chExpectedText, elCount(chExpectedText), "500ms Counter from Core1 is  incrementing"); 
  TestStepAddActionExpected( chActionText, chExpectedText );
  A_DBGR_VariableRead( "Task_Core1_500ms_Count", taskvalue);
  E_DBGR_VariableCheck("Task_Core1_500ms_Count", taskvalue, Greater);

  snprintf( chActionText, elCount(chActionText), "Check 1000ms Task Counter from Core1 "); 
  snprintf( chExpectedText, elCount(chExpectedText), "1000ms Counter from Core1 is incrementing"); 
  TestStepAddActionExpected( chActionText, chExpectedText );
  A_DBGR_VariableRead( "Task_Core1_1000ms_Count", taskvalue);
  E_DBGR_VariableCheck("Task_Core1_1000ms_Count", taskvalue, Greater);
  
  
  //Check All tasks of Core2 are Running
  snprintf( chActionText, elCount(chActionText), "Check 2pt5ms Task Counter from Core2 "); 
  snprintf( chExpectedText, elCount(chExpectedText), "2pt5ms Counter from Core2 is  incrementing"); 
  TestStepAddActionExpected( chActionText, chExpectedText );
  A_DBGR_VariableRead( "Task_Core2_2pt5ms_Count", taskvalue);
  E_DBGR_VariableCheck("Task_Core2_2pt5ms_Count", taskvalue, Greater);
  
  snprintf( chActionText, elCount(chActionText), "Check 5ms Task Counter from Core2 "); 
  snprintf( chExpectedText, elCount(chExpectedText), "5ms Counter from Core2 is  incrementing"); 
  TestStepAddActionExpected( chActionText, chExpectedText );
  A_DBGR_VariableRead( "Task_Core2_5ms_Count", taskvalue);
  E_DBGR_VariableCheck("Task_Core2_5ms_Count", taskvalue, Greater);
  
  snprintf( chActionText, elCount(chActionText), "Check 10ms Task Counter from Core2 "); 
  snprintf( chExpectedText, elCount(chExpectedText), "10ms Counter from Core2 is  incrementing"); 
  TestStepAddActionExpected( chActionText, chExpectedText );
  A_DBGR_VariableRead( "Task_Core2_10ms_Count", taskvalue);
  E_DBGR_VariableCheck("Task_Core2_10ms_Count", taskvalue, Greater);  
  
  snprintf( chActionText, elCount(chActionText), "Check 25ms Task Counter from Core2 "); 
  snprintf( chExpectedText, elCount(chExpectedText), "25ms Counter from Core2 is  incrementing"); 
  TestStepAddActionExpected( chActionText, chExpectedText );
  A_DBGR_VariableRead( "Task_Core2_25ms_Count", taskvalue);
  E_DBGR_VariableCheck("Task_Core2_25ms_Count", taskvalue, Greater); 

  snprintf( chActionText, elCount(chActionText), "Check 50ms Task Counter from Core2 "); 
  snprintf( chExpectedText, elCount(chExpectedText), "50ms Counter from Core2 is  incrementing"); 
  TestStepAddActionExpected( chActionText, chExpectedText );
  A_DBGR_VariableRead( "Task_Core2_50ms_Count", taskvalue);
  E_DBGR_VariableCheck("Task_Core2_50ms_Count", taskvalue, Greater);
  
  snprintf( chActionText, elCount(chActionText), "Check 100ms Task Counter from Core2 "); 
  snprintf( chExpectedText, elCount(chExpectedText), "100ms Counter from Core2 is  incrementing"); 
  TestStepAddActionExpected( chActionText, chExpectedText );
  A_DBGR_VariableRead( "Task_Core2_100ms_Count", taskvalue);
  E_DBGR_VariableCheck("Task_Core2_100ms_Count", taskvalue, Greater); 
  
  snprintf( chActionText, elCount(chActionText), "Check 250ms Task Counter from Core2 "); 
  snprintf( chExpectedText, elCount(chExpectedText), "250ms Counter from Core2 is  incrementing"); 
  TestStepAddActionExpected( chActionText, chExpectedText );
  A_DBGR_VariableRead( "Task_Core2_250ms_Count", taskvalue);
  E_DBGR_VariableCheck("Task_Core2_250ms_Count", taskvalue, Greater);

  snprintf( chActionText, elCount(chActionText), "Check 500ms Task Counter from Core2 "); 
  snprintf( chExpectedText, elCount(chExpectedText), "500ms Counter from Core2 is  incrementing"); 
  TestStepAddActionExpected( chActionText, chExpectedText );
  A_DBGR_VariableRead( "Task_Core2_500ms_Count", taskvalue);
  E_DBGR_VariableCheck("Task_Core2_500ms_Count", taskvalue, Greater);

  snprintf( chActionText, elCount(chActionText), "Check 1000ms Task Counter from Core2 "); 
  snprintf( chExpectedText, elCount(chExpectedText), "1000ms Counter from Core2 is  incrementing"); 
  TestStepAddActionExpected( chActionText, chExpectedText );
  A_DBGR_VariableRead( "Task_Core2_1000ms_Count", taskvalue);
  E_DBGR_VariableCheck("Task_Core2_1000ms_Count", taskvalue, Greater);
  
  
    //Check All tasks of Core3 are Stopped
  snprintf( chActionText, elCount(chActionText), "Check 2pt5ms Task Counter from Core3 "); 
  snprintf( chExpectedText, elCount(chExpectedText), "2pt5ms Counter from Core3 is stop incrementing"); 
  TestStepAddActionExpected( chActionText, chExpectedText );
  A_DBGR_VariableRead( "Task_Core3_2pt5ms_Count", taskvalue);
  E_DBGR_VariableCheck("Task_Core3_2pt5ms_Count", taskvalue, Equal);
  
   snprintf( chActionText, elCount(chActionText), "Check 5ms Task Counter from Core3 "); 
  snprintf( chExpectedText, elCount(chExpectedText), "5ms Counter from Core3 is stop incrementing"); 
  TestStepAddActionExpected( chActionText, chExpectedText );
  A_DBGR_VariableRead( "Task_Core3_5ms_Count", taskvalue);
  E_DBGR_VariableCheck("Task_Core3_5ms_Count", taskvalue, Equal);
  
  snprintf( chActionText, elCount(chActionText), "Check 10ms Task Counter from Core3 "); 
  snprintf( chExpectedText, elCount(chExpectedText), "10ms Counter from Core3 is stop incrementing"); 
  TestStepAddActionExpected( chActionText, chExpectedText );
  A_DBGR_VariableRead( "Task_Core3_10ms_Count", taskvalue);
  E_DBGR_VariableCheck("Task_Core3_10ms_Count", taskvalue, Equal);  
  
  snprintf( chActionText, elCount(chActionText), "Check 25ms Task Counter from Core3 "); 
  snprintf( chExpectedText, elCount(chExpectedText), "25ms Counter from Core3 is stop incrementing"); 
  TestStepAddActionExpected( chActionText, chExpectedText );
  A_DBGR_VariableRead( "Task_Core3_25ms_Count", taskvalue);
  E_DBGR_VariableCheck("Task_Core3_25ms_Count", taskvalue, Equal);  
  
  snprintf( chActionText, elCount(chActionText), "Check 50ms Task Counter from Core3 "); 
  snprintf( chExpectedText, elCount(chExpectedText), "50ms Counter from Core3 is stop incrementing"); 
  TestStepAddActionExpected( chActionText, chExpectedText );
  A_DBGR_VariableRead( "Task_Core3_50ms_Count", taskvalue);
  E_DBGR_VariableCheck("Task_Core3_50ms_Count", taskvalue, Equal);

  snprintf( chActionText, elCount(chActionText), "Check 100ms Task Counter from Core3 "); 
  snprintf( chExpectedText, elCount(chExpectedText), "100ms Counter from Core3 is stop incrementing"); 
  TestStepAddActionExpected( chActionText, chExpectedText );
  A_DBGR_VariableRead( "Task_Core3_100ms_Count", taskvalue);
  E_DBGR_VariableCheck("Task_Core3_100ms_Count", taskvalue, Equal); 
  
  snprintf( chActionText, elCount(chActionText), "Check 250ms Task Counter from Core3 "); 
  snprintf( chExpectedText, elCount(chExpectedText), "250ms Counter from Core3 is stop incrementing"); 
  TestStepAddActionExpected( chActionText, chExpectedText );
  A_DBGR_VariableRead( "Task_Core3_250ms_Count", taskvalue);
  E_DBGR_VariableCheck("Task_Core3_250ms_Count", taskvalue, Equal);
  
  snprintf( chActionText, elCount(chActionText), "Check 1000ms Task Counter from Core3 "); 
  snprintf( chExpectedText, elCount(chExpectedText), "1000ms Counter from Core3 is stop incrementing"); 
  TestStepAddActionExpected( chActionText, chExpectedText );
  A_DBGR_VariableRead( "Task_Core3_1000ms_Count", taskvalue);
  E_DBGR_VariableCheck("Task_Core3_1000ms_Count", taskvalue, Equal);
  
    //Check task from Core4 is running
  snprintf( chActionText, elCount(chActionText), "Check 1000ms Task Counter from Core4 "); 
  snprintf( chExpectedText, elCount(chExpectedText), "1000ms Counter from Core4 is  incrementing"); 
  TestStepAddActionExpected( chActionText, chExpectedText );
  A_DBGR_VariableRead( "Task_Core4_1000ms_Count", taskvalue);
  E_DBGR_VariableCheck("Task_Core4_1000ms_Count", taskvalue, Greater);
    
  //Check task from Core5 is running
  snprintf( chActionText, elCount(chActionText), "Check 1000ms Task Counter from Core5 "); 
  snprintf( chExpectedText, elCount(chExpectedText), "1000ms Counter from Core5 is  incrementing"); 
  TestStepAddActionExpected( chActionText, chExpectedText );
  A_DBGR_VariableRead( "Task_Core5_1000ms_Count", taskvalue);
  E_DBGR_VariableCheck("Task_Core5_1000ms_Count", taskvalue, Greater);
  
  
  //Check 2pt5 ms ISR Counter is Incrementing for each core except Core3
  snprintf( chActionText, elCount(chActionText), "Check 2pt5ms ISR Counter from Core0 "); 
  snprintf( chExpectedText, elCount(chExpectedText), "2pt5ms ISR Counter from Core0 is incrementing"); 
  TestStepAddActionExpected( chActionText, chExpectedText );
  A_DBGR_VariableRead( "Millisecond2pt5_ISR_count_core0", taskvalue);
  E_DBGR_VariableCheck("Millisecond2pt5_ISR_count_core0", taskvalue, NotEqual);
  
  snprintf( chActionText, elCount(chActionText), "Check 2pt5ms ISR Counter from Core1 "); 
  snprintf( chExpectedText, elCount(chExpectedText), "2pt5ms ISR Counter from Core1 is incrementing"); 
  TestStepAddActionExpected( chActionText, chExpectedText );
  A_DBGR_VariableRead( "Millisecond2pt5_ISR_count_core1", taskvalue);
  E_DBGR_VariableCheck("Millisecond2pt5_ISR_count_core1", taskvalue, NotEqual);
  
  snprintf( chActionText, elCount(chActionText), "Check 2pt5ms ISR Counter from Core2 "); 
  snprintf( chExpectedText, elCount(chExpectedText), "2pt5ms ISR Counter from Core2 is  incrementing"); 
  TestStepAddActionExpected( chActionText, chExpectedText );
  A_DBGR_VariableRead( "Millisecond2pt5_ISR_count_core2", taskvalue);
  E_DBGR_VariableCheck("Millisecond2pt5_ISR_count_core2", taskvalue, NotEqual);
    
  snprintf( chActionText, elCount(chActionText), "Check 2pt5ms ISR Counter from Core3 "); 
  snprintf( chExpectedText, elCount(chExpectedText), "2pt5ms ISR Counter from Core3 is stop incrementing"); 
  TestStepAddActionExpected( chActionText, chExpectedText );
  A_DBGR_VariableRead( "Millisecond2pt5_ISR_count_core3", taskvalue);
  E_DBGR_VariableCheck("Millisecond2pt5_ISR_count_core3", taskvalue, Equal);
  
  snprintf( chActionText, elCount(chActionText), "Check 2pt5ms ISR Counter from Core4 "); 
  snprintf( chExpectedText, elCount(chExpectedText), "2pt5ms ISR Counter from Core4 is incrementing"); 
  TestStepAddActionExpected( chActionText, chExpectedText );
  A_DBGR_VariableRead( "Millisecond2pt5_ISR_count_core4", taskvalue);
  E_DBGR_VariableCheck("Millisecond2pt5_ISR_count_core4", taskvalue, NotEqual);
    
  snprintf( chActionText, elCount(chActionText), "Check 2pt5ms ISR Counter from Core5 "); 
  snprintf( chExpectedText, elCount(chExpectedText), "2pt5ms ISR Counter from Core5 is incrementing"); 
  TestStepAddActionExpected( chActionText, chExpectedText );
  A_DBGR_VariableRead( "Millisecond2pt5_ISR_count_core5", taskvalue);
  E_DBGR_VariableCheck("Millisecond2pt5_ISR_count_core5", taskvalue, NotEqual);
  
  // CPU State for All Cores shall be FALSE, Excepr Core3 = TRUE
  snprintf( chActionText, elCount(chActionText), "Check CPU State for Core0 "); 
  snprintf( chExpectedText, elCount(chExpectedText), "CPU State for Core0 is 0"); 
  TestStepAddActionExpected( chActionText, chExpectedText );
  //A_DBGR_VariableRead( "disableCpu[0]", taskvalue);
  E_DBGR_VariableCheck("disableCpu[0]", 0, Equal);
  
  snprintf( chActionText, elCount(chActionText), "Check CPU State for Core1 "); 
  snprintf( chExpectedText, elCount(chExpectedText), "CPU State for Core1 is 0"); 
  TestStepAddActionExpected( chActionText, chExpectedText );
  //A_DBGR_VariableRead( "disableCpu[1]", taskvalue);
  E_DBGR_VariableCheck("disableCpu[1]", 0, Equal);
  
  snprintf( chActionText, elCount(chActionText), "Check CPU State for Core2 "); 
  snprintf( chExpectedText, elCount(chExpectedText), "CPU State for Core2 is 0"); 
  TestStepAddActionExpected( chActionText, chExpectedText );
  //A_DBGR_VariableRead( "disableCpu[2]", taskvalue);
  E_DBGR_VariableCheck("disableCpu[2]", 0, Equal);
  
  snprintf( chActionText, elCount(chActionText), "Check CPU State for Core3 "); 
  snprintf( chExpectedText, elCount(chExpectedText), "CPU State for Core3 is TRUE"); 
  TestStepAddActionExpected( chActionText, chExpectedText );
 // A_DBGR_VariableRead( "disableCpu[3]", taskvalue);
  E_DBGR_VariableCheck("disableCpu[3]", 1, Equal);
  
  snprintf( chActionText, elCount(chActionText), "Check CPU State for Core4 "); 
  snprintf( chExpectedText, elCount(chExpectedText), "CPU State for Core4 is 0"); 
  TestStepAddActionExpected( chActionText, chExpectedText );
  //A_DBGR_VariableRead( "disableCpu[4]", taskvalue);
  E_DBGR_VariableCheck("disableCpu[4]", 0, Equal);
  
  snprintf( chActionText, elCount(chActionText), "Check CPU State for Core5 "); 
  snprintf( chExpectedText, elCount(chExpectedText), "CPU State for Core5 is 0"); 
  TestStepAddActionExpected( chActionText, chExpectedText );
  //A_DBGR_VariableRead( "disableCpu[5]", taskvalue);
  E_DBGR_VariableCheck("disableCpu[5]", 0, Equal);
}


/***************************************************************************************************
----------------------------------------------------------------------------------------------------
Test case name:  TC_L30SW_Q-36649770: Test case to verify the functinality of interface DsblHWIO_CPU for disabling the CPU4
----------------------------------------------------------------------------------------------------
Description:   Test case to verify the functionality of interface DsblHWIO_CPU for disabling the CPU4.

***************************************************************************************************/
testcase Testcase_to_verify_the_functionality_of_interface_DsblHWIO_CPU_for_disabling_the_CPU4()
{
  /***************************************************************************************************************/    
                                                // Variable Definition
  /***************************************************************************************************************/ 
  ;
  long taskvalue;
  
  /***************************************************************************************************************/    
                                               // Local Values
  /***************************************************************************************************************/ 
  

  
  /***************************************************************************************************************/    
                                              // Test Case Info
  /***************************************************************************************************************/
  setWriteDbgLevel(DebugOff);
  snprintf( chTestTitle, elCount(chTestTitle), "Testcase_to_verify_the_functionality_of_interface_DsblHWIO_CPU_for_disabling_the_CPU4." );
  snprintf( chTestDescription, elCount(chTestDescription), "Purpose: Test case to verify the functionality of interface DsblHWIO_CPU for disabling the CPU4");
  TestCaseAddInfo( chTestTitle, "TC_L30SW_Q-36649770", chTestDescription );

  /***************************************************************************************************************/    
                                              // Start of Test Case
  /***************************************************************************************************************/
  
  /***************************************************************************************************************/    
                                              // Test Step 1 PRECONDITIONS
  /***************************************************************************************************************/
  
  snprintf( chActionText, elCount(chActionText), "Flash the Software and ECU is running"); 
  snprintf( chExpectedText, elCount(chExpectedText), "ECU should be in running state"); 
  TestStepAddActionExpected( chActionText, chExpectedText );

  A_DBGR_BreakpointDeleteAll();
  A_DBGR_RnGo();
  E_DBGR_CheckState(T32_State_Running);
  

   /***************************************************************************************************************/    
                      // Test Step 2 
                     // Check all cores are in running state
                    // stub Code to Check ISR Counter incrementing 
                   // Check all CPU States shall be running state = FALSE
                      
  /***************************************************************************************************************/
  
  //Check Core0 is running
  snprintf( chActionText, elCount(chActionText), "Check 1000ms Task Counter from Core0 "); 
  snprintf( chExpectedText, elCount(chExpectedText), "1000ms Counter from Core0 is incrementing"); 
  TestStepAddActionExpected( chActionText, chExpectedText );
  A_DBGR_VariableRead( "Task_Core0_1000ms_Count", taskvalue);
  E_DBGR_VariableCheck("Task_Core0_1000ms_Count", taskvalue, Greater);
  
  //Check Core1 is running
  snprintf( chActionText, elCount(chActionText), "Check 1000ms Task Counter from Core1 "); 
  snprintf( chExpectedText, elCount(chExpectedText), "1000ms Counter from Core1 is incrementing"); 
  TestStepAddActionExpected( chActionText, chExpectedText );
  A_DBGR_VariableRead( "Task_Core1_1000ms_Count", taskvalue);
  E_DBGR_VariableCheck("Task_Core1_1000ms_Count", taskvalue, Greater);
  
  //Check Core2 is running
  snprintf( chActionText, elCount(chActionText), "Check 1000ms Task Counter from Core2 "); 
  snprintf( chExpectedText, elCount(chExpectedText), "1000ms Counter from Core2 is incrementing"); 
  TestStepAddActionExpected( chActionText, chExpectedText );
  A_DBGR_VariableRead( "Task_Core2_1000ms_Count", taskvalue);
  E_DBGR_VariableCheck("Task_Core2_1000ms_Count", taskvalue, Greater);
    
  //Check Core3 is running
  snprintf( chActionText, elCount(chActionText), "Check 1000ms Task Counter from Core3 "); 
  snprintf( chExpectedText, elCount(chExpectedText), "1000ms Counter from Core3 is incrementing"); 
  TestStepAddActionExpected( chActionText, chExpectedText );
  A_DBGR_VariableRead( "Task_Core3_1000ms_Count", taskvalue);
  E_DBGR_VariableCheck("Task_Core3_1000ms_Count", taskvalue, Greater);
    
  //Check Core4 is running
  snprintf( chActionText, elCount(chActionText), "Check 1000ms Task Counter from Core4 "); 
  snprintf( chExpectedText, elCount(chExpectedText), "1000ms Counter from Core4 is incrementing"); 
  TestStepAddActionExpected( chActionText, chExpectedText );
  A_DBGR_VariableRead( "Task_Core4_1000ms_Count", taskvalue);
  E_DBGR_VariableCheck("Task_Core4_1000ms_Count", taskvalue, Greater);
    
  //Check Core5 is running
  snprintf( chActionText, elCount(chActionText), "Check 1000ms Task Counter from Core5 "); 
  snprintf( chExpectedText, elCount(chExpectedText), "1000ms Counter from Core5 is incrementing"); 
  TestStepAddActionExpected( chActionText, chExpectedText );
  A_DBGR_VariableRead( "Task_Core5_1000ms_Count", taskvalue);
  E_DBGR_VariableCheck("Task_Core5_1000ms_Count", taskvalue, Greater);
  
  //Check 2pt5 ms ISR Counter is Incrementing for each core
  snprintf( chActionText, elCount(chActionText), "Check 2pt5ms ISR Counter from Core0 "); 
  snprintf( chExpectedText, elCount(chExpectedText), "2pt5ms ISR Counter from Core0 is incrementing"); 
  TestStepAddActionExpected( chActionText, chExpectedText );
  A_DBGR_VariableRead( "Millisecond2pt5_ISR_count_core0", taskvalue);
  E_DBGR_VariableCheck("Millisecond2pt5_ISR_count_core0", taskvalue, NotEqual);
  
  snprintf( chActionText, elCount(chActionText), "Check 2pt5ms ISR Counter from Core1 "); 
  snprintf( chExpectedText, elCount(chExpectedText), "2pt5ms ISR Counter from Core1 is incrementing"); 
  TestStepAddActionExpected( chActionText, chExpectedText );
  A_DBGR_VariableRead( "Millisecond2pt5_ISR_count_core1", taskvalue);
  E_DBGR_VariableCheck("Millisecond2pt5_ISR_count_core1", taskvalue, NotEqual);
  
  snprintf( chActionText, elCount(chActionText), "Check 2pt5ms ISR Counter from Core2 "); 
  snprintf( chExpectedText, elCount(chExpectedText), "2pt5ms ISR Counter from Core2 is incrementing"); 
  TestStepAddActionExpected( chActionText, chExpectedText );
  A_DBGR_VariableRead( "Millisecond2pt5_ISR_count_core2", taskvalue);
  E_DBGR_VariableCheck("Millisecond2pt5_ISR_count_core2", taskvalue, NotEqual);
    
  snprintf( chActionText, elCount(chActionText), "Check 2pt5ms ISR Counter from Core3 "); 
  snprintf( chExpectedText, elCount(chExpectedText), "2pt5ms ISR Counter from Core3 is incrementing"); 
  TestStepAddActionExpected( chActionText, chExpectedText );
  A_DBGR_VariableRead( "Millisecond2pt5_ISR_count_core3", taskvalue);
  E_DBGR_VariableCheck("Millisecond2pt5_ISR_count_core3", taskvalue, NotEqual);
  
  snprintf( chActionText, elCount(chActionText), "Check 2pt5ms ISR Counter from Core4 "); 
  snprintf( chExpectedText, elCount(chExpectedText), "2pt5ms ISR Counter from Core4 is incrementing"); 
  TestStepAddActionExpected( chActionText, chExpectedText );
  A_DBGR_VariableRead( "Millisecond2pt5_ISR_count_core4", taskvalue);
  E_DBGR_VariableCheck("Millisecond2pt5_ISR_count_core4", taskvalue, NotEqual);
    
  snprintf( chActionText, elCount(chActionText), "Check 2pt5ms ISR Counter from Core5 "); 
  snprintf( chExpectedText, elCount(chExpectedText), "2pt5ms ISR Counter from Core5 is incrementing"); 
  TestStepAddActionExpected( chActionText, chExpectedText );
  A_DBGR_VariableRead( "Millisecond2pt5_ISR_count_core5", taskvalue);
  E_DBGR_VariableCheck("Millisecond2pt5_ISR_count_core5", taskvalue, NotEqual);
  
  // CPU State for All Cores
  snprintf( chActionText, elCount(chActionText), "Check CPU State for Core0 "); 
  snprintf( chExpectedText, elCount(chExpectedText), "CPU State for Core0 is 0"); 
  TestStepAddActionExpected( chActionText, chExpectedText );
  //A_DBGR_VariableRead( "disableCpu[0]", taskvalue);
  E_DBGR_VariableCheck("disableCpu[0]", 0, Equal);
  
  snprintf( chActionText, elCount(chActionText), "Check CPU State for Core1 "); 
  snprintf( chExpectedText, elCount(chExpectedText), "CPU State for Core1 is 0"); 
  TestStepAddActionExpected( chActionText, chExpectedText );
 // A_DBGR_VariableRead( "disableCpu[1]", taskvalue);
  E_DBGR_VariableCheck("disableCpu[1]", 0, Equal);
  
  snprintf( chActionText, elCount(chActionText), "Check CPU State for Core2 "); 
  snprintf( chExpectedText, elCount(chExpectedText), "CPU State for Core2 is 0"); 
  TestStepAddActionExpected( chActionText, chExpectedText );
 // A_DBGR_VariableRead( "disableCpu[2]", taskvalue);
  E_DBGR_VariableCheck("disableCpu[2]", 0, Equal);
  
  snprintf( chActionText, elCount(chActionText), "Check CPU State for Core3 "); 
  snprintf( chExpectedText, elCount(chExpectedText), "CPU State for Core3 is 0"); 
  TestStepAddActionExpected( chActionText, chExpectedText );
 // A_DBGR_VariableRead( "disableCpu[3]", taskvalue);
  E_DBGR_VariableCheck("disableCpu[3]", 0, Equal);
  
  snprintf( chActionText, elCount(chActionText), "Check CPU State for Core4 "); 
  snprintf( chExpectedText, elCount(chExpectedText), "CPU State for Core4 is 0"); 
  TestStepAddActionExpected( chActionText, chExpectedText );
 // A_DBGR_VariableRead( "disableCpu[4]", taskvalue);
  E_DBGR_VariableCheck("disableCpu[4]", 0, Equal);
  
  snprintf( chActionText, elCount(chActionText), "Check CPU State for Core5 "); 
  snprintf( chExpectedText, elCount(chExpectedText), "CPU State for Core5 is 0"); 
  TestStepAddActionExpected( chActionText, chExpectedText );
 // A_DBGR_VariableRead( "disableCpu[5]", taskvalue);
  E_DBGR_VariableCheck("disableCpu[5]", 0, Equal);
  
  /***************************************************************************************************************/    
    // Test Step 3: Disable CPU Core 4 with interface disableCPU[4] = TRUE
  /***************************************************************************************************************/

  snprintf( chActionText, elCount(chActionText), "Disable CPU4"); 
  snprintf( chExpectedText, elCount(chExpectedText), "CPU 4 disabled"); 
  TestStepAddActionExpected( chActionText, chExpectedText );
  A_DBGR_VariableSet("disableCpu[4]", "1");
  E_DBGR_VariableCheck("disableCpu[4]", 1, Equal);  
  
 /***************************************************************************************************************/    
                      // Test Step 4
                     // Check all cores are in running state except Core4
                    // stub Code to Check ISR Counter incrementing except Core4
                   // Check all CPU States shall be running state = FALSE, except Core[4] = TRUE
                      
  /***************************************************************************************************************/
  //Check All tasks of Core0 are running
  snprintf( chActionText, elCount(chActionText), "Check 2pt5ms Task Counter from Core0 "); 
  snprintf( chExpectedText, elCount(chExpectedText), "2pt5ms Counter from Core0 is incrementing"); 
  TestStepAddActionExpected( chActionText, chExpectedText );
  A_DBGR_VariableRead( "Task_Core0_2pt5ms_Count", taskvalue);
  E_DBGR_VariableCheck("Task_Core0_2pt5ms_Count", taskvalue, Greater);
  
  snprintf( chActionText, elCount(chActionText), "Check 5ms Task Counter from Core0 "); 
  snprintf( chExpectedText, elCount(chExpectedText), "5ms Counter from Core0 is incrementing"); 
  TestStepAddActionExpected( chActionText, chExpectedText );
  A_DBGR_VariableRead( "Task_Core0_5ms_Count", taskvalue);
  E_DBGR_VariableCheck("Task_Core0_5ms_Count", taskvalue, Greater);
  
  snprintf( chActionText, elCount(chActionText), "Check 10ms Task Counter from Core0 "); 
  snprintf( chExpectedText, elCount(chExpectedText), "10ms Counter from Core0 is incrementing"); 
  TestStepAddActionExpected( chActionText, chExpectedText );
  A_DBGR_VariableRead( "Task_Core0_10ms_Count", taskvalue);
  E_DBGR_VariableCheck("Task_Core0_10ms_Count", taskvalue, Greater);  
  
  snprintf( chActionText, elCount(chActionText), "Check 25ms Task Counter from Core0 "); 
  snprintf( chExpectedText, elCount(chExpectedText), "25ms Counter from Core0 is incrementing"); 
  TestStepAddActionExpected( chActionText, chExpectedText );
  A_DBGR_VariableRead( "Task_Core0_25ms_Count", taskvalue);
  E_DBGR_VariableCheck("Task_Core0_25ms_Count", taskvalue, Greater);  

  snprintf( chActionText, elCount(chActionText), "Check 50ms Task Counter from Core0 "); 
  snprintf( chExpectedText, elCount(chExpectedText), "50ms Counter from Core0 is incrementing"); 
  TestStepAddActionExpected( chActionText, chExpectedText );
  A_DBGR_VariableRead( "Task_Core0_50ms_Count", taskvalue);
  E_DBGR_VariableCheck("Task_Core0_50ms_Count", taskvalue, Greater);
  
  snprintf( chActionText, elCount(chActionText), "Check 100ms Task Counter from Core0 "); 
  snprintf( chExpectedText, elCount(chExpectedText), "100ms Counter from Core0 is incrementing"); 
  TestStepAddActionExpected( chActionText, chExpectedText );
  A_DBGR_VariableRead( "Task_Core0_100ms_Count", taskvalue);
  E_DBGR_VariableCheck("Task_Core0_100ms_Count", taskvalue, Greater); 
  
  snprintf( chActionText, elCount(chActionText), "Check 250ms Task Counter from Core0 "); 
  snprintf( chExpectedText, elCount(chExpectedText), "250ms Counter from Core0 is incrementing"); 
  TestStepAddActionExpected( chActionText, chExpectedText );
  A_DBGR_VariableRead( "Task_Core0_250ms_Count", taskvalue);
  E_DBGR_VariableCheck("Task_Core0_250ms_Count", taskvalue, Greater);
  
  snprintf( chActionText, elCount(chActionText), "Check 500ms Task Counter from Core0 "); 
  snprintf( chExpectedText, elCount(chExpectedText), "500ms Counter from Core0 is incrementing"); 
  TestStepAddActionExpected( chActionText, chExpectedText );
  A_DBGR_VariableRead( "Task_Core0_500ms_Count", taskvalue);
  E_DBGR_VariableCheck("Task_Core0_500ms_Count", taskvalue, Greater);
  
  snprintf( chActionText, elCount(chActionText), "Check 1000ms Task Counter from Core0 "); 
  snprintf( chExpectedText, elCount(chExpectedText), "1000ms Counter from Core0 is incrementing"); 
  TestStepAddActionExpected( chActionText, chExpectedText );
  A_DBGR_VariableRead( "Task_Core0_1000ms_Count", taskvalue);
  E_DBGR_VariableCheck("Task_Core0_1000ms_Count", taskvalue, Greater);
  
  
  //Check All tasks of Core1 are Running  
  snprintf( chActionText, elCount(chActionText), "Check 2pt5ms Task Counter from Core1 "); 
  snprintf( chExpectedText, elCount(chExpectedText), "2pt5ms Counter from Core1 is  incrementing"); 
  TestStepAddActionExpected( chActionText, chExpectedText );
  A_DBGR_VariableRead( "Task_Core1_2pt5ms_Count", taskvalue);
  E_DBGR_VariableCheck("Task_Core1_2pt5ms_Count", taskvalue, Greater);
  
  snprintf( chActionText, elCount(chActionText), "Check 5ms Task Counter from Core1 "); 
  snprintf( chExpectedText, elCount(chExpectedText), "5ms Counter from Core1 is  incrementing"); 
  TestStepAddActionExpected( chActionText, chExpectedText );
  A_DBGR_VariableRead( "Task_Core1_5ms_Count", taskvalue);
  E_DBGR_VariableCheck("Task_Core1_5ms_Count", taskvalue, Greater);
  
  snprintf( chActionText, elCount(chActionText), "Check 10ms Task Counter from Core1 "); 
  snprintf( chExpectedText, elCount(chExpectedText), "10ms Counter from Core1 is  incrementing"); 
  TestStepAddActionExpected( chActionText, chExpectedText );
  A_DBGR_VariableRead( "Task_Core1_10ms_Count", taskvalue);
  E_DBGR_VariableCheck("Task_Core1_10ms_Count", taskvalue, Greater);  
  
  snprintf( chActionText, elCount(chActionText), "Check 25ms Task Counter from Core1 "); 
  snprintf( chExpectedText, elCount(chExpectedText), "25ms Counter from Core1 is  incrementing"); 
  TestStepAddActionExpected( chActionText, chExpectedText );
  A_DBGR_VariableRead( "Task_Core1_25ms_Count", taskvalue);
  E_DBGR_VariableCheck("Task_Core1_25ms_Count", taskvalue, Greater); 
  
  snprintf( chActionText, elCount(chActionText), "Check 50ms Task Counter from Core1 "); 
  snprintf( chExpectedText, elCount(chExpectedText), "50ms Counter from Core1 is  incrementing"); 
  TestStepAddActionExpected( chActionText, chExpectedText );
  A_DBGR_VariableRead( "Task_Core1_50ms_Count", taskvalue);
  E_DBGR_VariableCheck("Task_Core1_50ms_Count", taskvalue, Greater);
    
  snprintf( chActionText, elCount(chActionText), "Check 100ms Task Counter from Core1 "); 
  snprintf( chExpectedText, elCount(chExpectedText), "100ms Counter from Core1 is  incrementing"); 
  TestStepAddActionExpected( chActionText, chExpectedText );
  A_DBGR_VariableRead( "Task_Core1_100ms_Count", taskvalue);
  E_DBGR_VariableCheck("Task_Core1_100ms_Count", taskvalue, Greater);

  snprintf( chActionText, elCount(chActionText), "Check 250ms Task Counter from Core1 "); 
  snprintf( chExpectedText, elCount(chExpectedText), "250ms Counter from Core1 is  incrementing"); 
  TestStepAddActionExpected( chActionText, chExpectedText );
  A_DBGR_VariableRead( "Task_Core1_250ms_Count", taskvalue);
  E_DBGR_VariableCheck("Task_Core1_250ms_Count", taskvalue, Greater);
  
  snprintf( chActionText, elCount(chActionText), "Check 500ms Task Counter from Core1 "); 
  snprintf( chExpectedText, elCount(chExpectedText), "500ms Counter from Core1 is  incrementing"); 
  TestStepAddActionExpected( chActionText, chExpectedText );
  A_DBGR_VariableRead( "Task_Core1_500ms_Count", taskvalue);
  E_DBGR_VariableCheck("Task_Core1_500ms_Count", taskvalue, Greater);

  snprintf( chActionText, elCount(chActionText), "Check 1000ms Task Counter from Core1 "); 
  snprintf( chExpectedText, elCount(chExpectedText), "1000ms Counter from Core1 is incrementing"); 
  TestStepAddActionExpected( chActionText, chExpectedText );
  A_DBGR_VariableRead( "Task_Core1_1000ms_Count", taskvalue);
  E_DBGR_VariableCheck("Task_Core1_1000ms_Count", taskvalue, Greater);
  
  
  //Check All tasks of Core2 are Running
  snprintf( chActionText, elCount(chActionText), "Check 2pt5ms Task Counter from Core2 "); 
  snprintf( chExpectedText, elCount(chExpectedText), "2pt5ms Counter from Core2 is  incrementing"); 
  TestStepAddActionExpected( chActionText, chExpectedText );
  A_DBGR_VariableRead( "Task_Core2_2pt5ms_Count", taskvalue);
  E_DBGR_VariableCheck("Task_Core2_2pt5ms_Count", taskvalue, Greater);
  
  snprintf( chActionText, elCount(chActionText), "Check 5ms Task Counter from Core2 "); 
  snprintf( chExpectedText, elCount(chExpectedText), "5ms Counter from Core2 is  incrementing"); 
  TestStepAddActionExpected( chActionText, chExpectedText );
  A_DBGR_VariableRead( "Task_Core2_5ms_Count", taskvalue);
  E_DBGR_VariableCheck("Task_Core2_5ms_Count", taskvalue, Greater);
  
  snprintf( chActionText, elCount(chActionText), "Check 10ms Task Counter from Core2 "); 
  snprintf( chExpectedText, elCount(chExpectedText), "10ms Counter from Core2 is  incrementing"); 
  TestStepAddActionExpected( chActionText, chExpectedText );
  A_DBGR_VariableRead( "Task_Core2_10ms_Count", taskvalue);
  E_DBGR_VariableCheck("Task_Core2_10ms_Count", taskvalue, Greater);  
  
  snprintf( chActionText, elCount(chActionText), "Check 25ms Task Counter from Core2 "); 
  snprintf( chExpectedText, elCount(chExpectedText), "25ms Counter from Core2 is  incrementing"); 
  TestStepAddActionExpected( chActionText, chExpectedText );
  A_DBGR_VariableRead( "Task_Core2_25ms_Count", taskvalue);
  E_DBGR_VariableCheck("Task_Core2_25ms_Count", taskvalue, Greater); 

  snprintf( chActionText, elCount(chActionText), "Check 50ms Task Counter from Core2 "); 
  snprintf( chExpectedText, elCount(chExpectedText), "50ms Counter from Core2 is  incrementing"); 
  TestStepAddActionExpected( chActionText, chExpectedText );
  A_DBGR_VariableRead( "Task_Core2_50ms_Count", taskvalue);
  E_DBGR_VariableCheck("Task_Core2_50ms_Count", taskvalue, Greater);
  
  snprintf( chActionText, elCount(chActionText), "Check 100ms Task Counter from Core2 "); 
  snprintf( chExpectedText, elCount(chExpectedText), "100ms Counter from Core2 is  incrementing"); 
  TestStepAddActionExpected( chActionText, chExpectedText );
  A_DBGR_VariableRead( "Task_Core2_100ms_Count", taskvalue);
  E_DBGR_VariableCheck("Task_Core2_100ms_Count", taskvalue, Greater); 
  
  snprintf( chActionText, elCount(chActionText), "Check 250ms Task Counter from Core2 "); 
  snprintf( chExpectedText, elCount(chExpectedText), "250ms Counter from Core2 is  incrementing"); 
  TestStepAddActionExpected( chActionText, chExpectedText );
  A_DBGR_VariableRead( "Task_Core2_250ms_Count", taskvalue);
  E_DBGR_VariableCheck("Task_Core2_250ms_Count", taskvalue, Greater);

  snprintf( chActionText, elCount(chActionText), "Check 500ms Task Counter from Core2 "); 
  snprintf( chExpectedText, elCount(chExpectedText), "500ms Counter from Core2 is  incrementing"); 
  TestStepAddActionExpected( chActionText, chExpectedText );
  A_DBGR_VariableRead( "Task_Core2_500ms_Count", taskvalue);
  E_DBGR_VariableCheck("Task_Core2_500ms_Count", taskvalue, Greater);

  snprintf( chActionText, elCount(chActionText), "Check 1000ms Task Counter from Core2 "); 
  snprintf( chExpectedText, elCount(chExpectedText), "1000ms Counter from Core2 is  incrementing"); 
  TestStepAddActionExpected( chActionText, chExpectedText );
  A_DBGR_VariableRead( "Task_Core2_1000ms_Count", taskvalue);
  E_DBGR_VariableCheck("Task_Core2_1000ms_Count", taskvalue, Greater);
  
  
    //Check All tasks of Core3 are Running
  snprintf( chActionText, elCount(chActionText), "Check 2pt5ms Task Counter from Core3 "); 
  snprintf( chExpectedText, elCount(chExpectedText), "2pt5ms Counter from Core3 is incrementing"); 
  TestStepAddActionExpected( chActionText, chExpectedText );
  A_DBGR_VariableRead( "Task_Core3_2pt5ms_Count", taskvalue);
  E_DBGR_VariableCheck("Task_Core3_2pt5ms_Count", taskvalue, Greater);
  
   snprintf( chActionText, elCount(chActionText), "Check 5ms Task Counter from Core3 "); 
  snprintf( chExpectedText, elCount(chExpectedText), "5ms Counter from Core3 is incrementing"); 
  TestStepAddActionExpected( chActionText, chExpectedText );
  A_DBGR_VariableRead( "Task_Core3_5ms_Count", taskvalue);
  E_DBGR_VariableCheck("Task_Core3_5ms_Count", taskvalue, Greater);
  
  snprintf( chActionText, elCount(chActionText), "Check 10ms Task Counter from Core3 "); 
  snprintf( chExpectedText, elCount(chExpectedText), "10ms Counter from Core3 is incrementing"); 
  TestStepAddActionExpected( chActionText, chExpectedText );
  A_DBGR_VariableRead( "Task_Core3_10ms_Count", taskvalue);
  E_DBGR_VariableCheck("Task_Core3_10ms_Count", taskvalue, Greater);  
  
  snprintf( chActionText, elCount(chActionText), "Check 25ms Task Counter from Core3 "); 
  snprintf( chExpectedText, elCount(chExpectedText), "25ms Counter from Core3 is incrementing"); 
  TestStepAddActionExpected( chActionText, chExpectedText );
  A_DBGR_VariableRead( "Task_Core3_25ms_Count", taskvalue);
  E_DBGR_VariableCheck("Task_Core3_25ms_Count", taskvalue, Greater);  
  
  snprintf( chActionText, elCount(chActionText), "Check 50ms Task Counter from Core3 "); 
  snprintf( chExpectedText, elCount(chExpectedText), "50ms Counter from Core3 is incrementing"); 
  TestStepAddActionExpected( chActionText, chExpectedText );
  A_DBGR_VariableRead( "Task_Core3_50ms_Count", taskvalue);
  E_DBGR_VariableCheck("Task_Core3_50ms_Count", taskvalue, Greater);

  snprintf( chActionText, elCount(chActionText), "Check 100ms Task Counter from Core3 "); 
  snprintf( chExpectedText, elCount(chExpectedText), "100ms Counter from Core3 is incrementing"); 
  TestStepAddActionExpected( chActionText, chExpectedText );
  A_DBGR_VariableRead( "Task_Core3_100ms_Count", taskvalue);
  E_DBGR_VariableCheck("Task_Core3_100ms_Count", taskvalue, Greater); 
  
  snprintf( chActionText, elCount(chActionText), "Check 250ms Task Counter from Core3 "); 
  snprintf( chExpectedText, elCount(chExpectedText), "250ms Counter from Core3 is incrementing"); 
  TestStepAddActionExpected( chActionText, chExpectedText );
  A_DBGR_VariableRead( "Task_Core3_250ms_Count", taskvalue);
  E_DBGR_VariableCheck("Task_Core3_250ms_Count", taskvalue, Greater);
  
  snprintf( chActionText, elCount(chActionText), "Check 1000ms Task Counter from Core3 "); 
  snprintf( chExpectedText, elCount(chExpectedText), "1000ms Counter from Core3 is incrementing"); 
  TestStepAddActionExpected( chActionText, chExpectedText );
  A_DBGR_VariableRead( "Task_Core3_1000ms_Count", taskvalue);
  E_DBGR_VariableCheck("Task_Core3_1000ms_Count", taskvalue, Greater);
  
    //Check task from Core4 is stopped
  snprintf( chActionText, elCount(chActionText), "Check 1000ms Task Counter from Core4 "); 
  snprintf( chExpectedText, elCount(chExpectedText), "1000ms Counter from Core4 is stop incrementing"); 
  TestStepAddActionExpected( chActionText, chExpectedText );
  A_DBGR_VariableRead( "Task_Core4_1000ms_Count", taskvalue);
  E_DBGR_VariableCheck("Task_Core4_1000ms_Count", taskvalue, Equal);
    
  //Check task from Core5 is running
  snprintf( chActionText, elCount(chActionText), "Check 1000ms Task Counter from Core5 "); 
  snprintf( chExpectedText, elCount(chExpectedText), "1000ms Counter from Core5 is  incrementing"); 
  TestStepAddActionExpected( chActionText, chExpectedText );
  A_DBGR_VariableRead( "Task_Core5_1000ms_Count", taskvalue);
  E_DBGR_VariableCheck("Task_Core5_1000ms_Count", taskvalue, Greater);
  
  
  //Check 2pt5 ms ISR Counter is Incrementing for each core except Core4
  snprintf( chActionText, elCount(chActionText), "Check 2pt5ms ISR Counter from Core0 "); 
  snprintf( chExpectedText, elCount(chExpectedText), "2pt5ms ISR Counter from Core0 is incrementing"); 
  TestStepAddActionExpected( chActionText, chExpectedText );
  A_DBGR_VariableRead( "Millisecond2pt5_ISR_count_core0", taskvalue);
  E_DBGR_VariableCheck("Millisecond2pt5_ISR_count_core0", taskvalue, NotEqual);
  
  snprintf( chActionText, elCount(chActionText), "Check 2pt5ms ISR Counter from Core1 "); 
  snprintf( chExpectedText, elCount(chExpectedText), "2pt5ms ISR Counter from Core1 is incrementing"); 
  TestStepAddActionExpected( chActionText, chExpectedText );
  A_DBGR_VariableRead( "Millisecond2pt5_ISR_count_core1", taskvalue);
  E_DBGR_VariableCheck("Millisecond2pt5_ISR_count_core1", taskvalue, NotEqual);
  
  snprintf( chActionText, elCount(chActionText), "Check 2pt5ms ISR Counter from Core2 "); 
  snprintf( chExpectedText, elCount(chExpectedText), "2pt5ms ISR Counter from Core2 is  incrementing"); 
  TestStepAddActionExpected( chActionText, chExpectedText );
  A_DBGR_VariableRead( "Millisecond2pt5_ISR_count_core2", taskvalue);
  E_DBGR_VariableCheck("Millisecond2pt5_ISR_count_core2", taskvalue, NotEqual);
    
  snprintf( chActionText, elCount(chActionText), "Check 2pt5ms ISR Counter from Core3 "); 
  snprintf( chExpectedText, elCount(chExpectedText), "2pt5ms ISR Counter from Core3 is  incrementing"); 
  TestStepAddActionExpected( chActionText, chExpectedText );
  A_DBGR_VariableRead( "Millisecond2pt5_ISR_count_core3", taskvalue);
  E_DBGR_VariableCheck("Millisecond2pt5_ISR_count_core3", taskvalue, NotEqual);
  
  snprintf( chActionText, elCount(chActionText), "Check 2pt5ms ISR Counter from Core4 "); 
  snprintf( chExpectedText, elCount(chExpectedText), "2pt5ms ISR Counter from Core4 is stop incrementing"); 
  TestStepAddActionExpected( chActionText, chExpectedText );
  A_DBGR_VariableRead( "Millisecond2pt5_ISR_count_core4", taskvalue);
  E_DBGR_VariableCheck("Millisecond2pt5_ISR_count_core4", taskvalue, Equal);
    
  snprintf( chActionText, elCount(chActionText), "Check 2pt5ms ISR Counter from Core5 "); 
  snprintf( chExpectedText, elCount(chExpectedText), "2pt5ms ISR Counter from Core5 is incrementing"); 
  TestStepAddActionExpected( chActionText, chExpectedText );
  A_DBGR_VariableRead( "Millisecond2pt5_ISR_count_core5", taskvalue);
  E_DBGR_VariableCheck("Millisecond2pt5_ISR_count_core5", taskvalue, NotEqual);
  
  // CPU State for All Cores shall be FALSE, Excepr Core4 = TRUE
  snprintf( chActionText, elCount(chActionText), "Check CPU State for Core0 "); 
  snprintf( chExpectedText, elCount(chExpectedText), "CPU State for Core0 is 0"); 
  TestStepAddActionExpected( chActionText, chExpectedText );
  //A_DBGR_VariableRead( "disableCpu[0]", taskvalue);
  E_DBGR_VariableCheck("disableCpu[0]", 0, Equal);
  
  snprintf( chActionText, elCount(chActionText), "Check CPU State for Core1 "); 
  snprintf( chExpectedText, elCount(chExpectedText), "CPU State for Core1 is 0"); 
  TestStepAddActionExpected( chActionText, chExpectedText );
  //A_DBGR_VariableRead( "disableCpu[1]", taskvalue);
  E_DBGR_VariableCheck("disableCpu[1]", 0, Equal);
  
  snprintf( chActionText, elCount(chActionText), "Check CPU State for Core2 "); 
  snprintf( chExpectedText, elCount(chExpectedText), "CPU State for Core2 is 0"); 
  TestStepAddActionExpected( chActionText, chExpectedText );
  //A_DBGR_VariableRead( "disableCpu[2]", taskvalue);
  E_DBGR_VariableCheck("disableCpu[2]", 0, Equal);
  
  snprintf( chActionText, elCount(chActionText), "Check CPU State for Core3 "); 
  snprintf( chExpectedText, elCount(chExpectedText), "CPU State for Core3 is 0"); 
  TestStepAddActionExpected( chActionText, chExpectedText );
 // A_DBGR_VariableRead( "disableCpu[3]", taskvalue);
  E_DBGR_VariableCheck("disableCpu[3]", 0, Equal);
  
  snprintf( chActionText, elCount(chActionText), "Check CPU State for Core4 "); 
  snprintf( chExpectedText, elCount(chExpectedText), "CPU State for Core4 is TRUE"); 
  TestStepAddActionExpected( chActionText, chExpectedText );
  //A_DBGR_VariableRead( "disableCpu[4]", taskvalue);
  E_DBGR_VariableCheck("disableCpu[4]", 1, Equal);
  
  snprintf( chActionText, elCount(chActionText), "Check CPU State for Core5 "); 
  snprintf( chExpectedText, elCount(chExpectedText), "CPU State for Core5 is 0"); 
  TestStepAddActionExpected( chActionText, chExpectedText );
  //A_DBGR_VariableRead( "disableCpu[5]", taskvalue);
  E_DBGR_VariableCheck("disableCpu[5]", 0, Equal);
}

/***************************************************************************************************
----------------------------------------------------------------------------------------------------
Test case name:  TC_L30SW_Q-36649769: Test case to verify the functinality of interface DsblHWIO_CPU for disabling the CPU5
----------------------------------------------------------------------------------------------------
Description:   Test case to verify the functionality of interface DsblHWIO_CPU for disabling the CPU5.

***************************************************************************************************/
testcase Testcase_to_verify_the_functionality_of_interface_DsblHWIO_CPU_for_disabling_the_CPU5()
{
  /***************************************************************************************************************/    
                                                // Variable Definition
  /***************************************************************************************************************/ 
  ;
  long taskvalue;
  
  /***************************************************************************************************************/    
                                               // Local Values
  /***************************************************************************************************************/ 
  

  
  /***************************************************************************************************************/    
                                              // Test Case Info
  /***************************************************************************************************************/
  setWriteDbgLevel(DebugOff);
  snprintf( chTestTitle, elCount(chTestTitle), "Testcase_to_verify_the_functionality_of_interface_DsblHWIO_CPU_for_disabling_the_CPU5." );
  snprintf( chTestDescription, elCount(chTestDescription), "Purpose: Test case to verify the functionality of interface DsblHWIO_CPU for disabling the CPU5");
  TestCaseAddInfo( chTestTitle, "TC_L30SW_Q-36649769", chTestDescription );

  /***************************************************************************************************************/    
                                              // Start of Test Case
  /***************************************************************************************************************/
  
  /***************************************************************************************************************/    
                                              // Test Step 1 PRECONDITIONS
  /***************************************************************************************************************/
  
  snprintf( chActionText, elCount(chActionText), "Flash the Software and ECU is running"); 
  snprintf( chExpectedText, elCount(chExpectedText), "ECU should be in running state"); 
  TestStepAddActionExpected( chActionText, chExpectedText );

  A_DBGR_BreakpointDeleteAll();
  A_DBGR_RnGo();
  E_DBGR_CheckState(T32_State_Running);
  

   /***************************************************************************************************************/    
                      // Test Step 2 
                     // Check all cores are in running state
                    // stub Code to Check ISR Counter incrementing 
                   // Check all CPU States shall be running state = FALSE
                      
  /***************************************************************************************************************/
  
  //Check Core0 is running
  snprintf( chActionText, elCount(chActionText), "Check 1000ms Task Counter from Core0 "); 
  snprintf( chExpectedText, elCount(chExpectedText), "1000ms Counter from Core0 is incrementing"); 
  TestStepAddActionExpected( chActionText, chExpectedText );
  A_DBGR_VariableRead( "Task_Core0_1000ms_Count", taskvalue);
  E_DBGR_VariableCheck("Task_Core0_1000ms_Count", taskvalue, Greater);
  
  //Check Core1 is running
  snprintf( chActionText, elCount(chActionText), "Check 1000ms Task Counter from Core1 "); 
  snprintf( chExpectedText, elCount(chExpectedText), "1000ms Counter from Core1 is incrementing"); 
  TestStepAddActionExpected( chActionText, chExpectedText );
  A_DBGR_VariableRead( "Task_Core1_1000ms_Count", taskvalue);
  E_DBGR_VariableCheck("Task_Core1_1000ms_Count", taskvalue, Greater);
  
  //Check Core2 is running
  snprintf( chActionText, elCount(chActionText), "Check 1000ms Task Counter from Core2 "); 
  snprintf( chExpectedText, elCount(chExpectedText), "1000ms Counter from Core2 is incrementing"); 
  TestStepAddActionExpected( chActionText, chExpectedText );
  A_DBGR_VariableRead( "Task_Core2_1000ms_Count", taskvalue);
  E_DBGR_VariableCheck("Task_Core2_1000ms_Count", taskvalue, Greater);
    
  //Check Core3 is running
  snprintf( chActionText, elCount(chActionText), "Check 1000ms Task Counter from Core3 "); 
  snprintf( chExpectedText, elCount(chExpectedText), "1000ms Counter from Core3 is incrementing"); 
  TestStepAddActionExpected( chActionText, chExpectedText );
  A_DBGR_VariableRead( "Task_Core3_1000ms_Count", taskvalue);
  E_DBGR_VariableCheck("Task_Core3_1000ms_Count", taskvalue, Greater);
    
  //Check Core4 is running
  snprintf( chActionText, elCount(chActionText), "Check 1000ms Task Counter from Core4 "); 
  snprintf( chExpectedText, elCount(chExpectedText), "1000ms Counter from Core4 is incrementing"); 
  TestStepAddActionExpected( chActionText, chExpectedText );
  A_DBGR_VariableRead( "Task_Core4_1000ms_Count", taskvalue);
  E_DBGR_VariableCheck("Task_Core4_1000ms_Count", taskvalue, Greater);
    
  //Check Core5 is running
  snprintf( chActionText, elCount(chActionText), "Check 1000ms Task Counter from Core5 "); 
  snprintf( chExpectedText, elCount(chExpectedText), "1000ms Counter from Core5 is incrementing"); 
  TestStepAddActionExpected( chActionText, chExpectedText );
  A_DBGR_VariableRead( "Task_Core5_1000ms_Count", taskvalue);
  E_DBGR_VariableCheck("Task_Core5_1000ms_Count", taskvalue, Greater);
  
  //Check 2pt5 ms ISR Counter is Incrementing for each core
  snprintf( chActionText, elCount(chActionText), "Check 2pt5ms ISR Counter from Core0 "); 
  snprintf( chExpectedText, elCount(chExpectedText), "2pt5ms ISR Counter from Core0 is incrementing"); 
  TestStepAddActionExpected( chActionText, chExpectedText );
  A_DBGR_VariableRead( "Millisecond2pt5_ISR_count_core0", taskvalue);
  E_DBGR_VariableCheck("Millisecond2pt5_ISR_count_core0", taskvalue, NotEqual);
  
  snprintf( chActionText, elCount(chActionText), "Check 2pt5ms ISR Counter from Core1 "); 
  snprintf( chExpectedText, elCount(chExpectedText), "2pt5ms ISR Counter from Core1 is incrementing"); 
  TestStepAddActionExpected( chActionText, chExpectedText );
  A_DBGR_VariableRead( "Millisecond2pt5_ISR_count_core1", taskvalue);
  E_DBGR_VariableCheck("Millisecond2pt5_ISR_count_core1", taskvalue, NotEqual);
  
  snprintf( chActionText, elCount(chActionText), "Check 2pt5ms ISR Counter from Core2 "); 
  snprintf( chExpectedText, elCount(chExpectedText), "2pt5ms ISR Counter from Core2 is incrementing"); 
  TestStepAddActionExpected( chActionText, chExpectedText );
  A_DBGR_VariableRead( "Millisecond2pt5_ISR_count_core2", taskvalue);
  E_DBGR_VariableCheck("Millisecond2pt5_ISR_count_core2", taskvalue, NotEqual);
    
  snprintf( chActionText, elCount(chActionText), "Check 2pt5ms ISR Counter from Core3 "); 
  snprintf( chExpectedText, elCount(chExpectedText), "2pt5ms ISR Counter from Core3 is incrementing"); 
  TestStepAddActionExpected( chActionText, chExpectedText );
  A_DBGR_VariableRead( "Millisecond2pt5_ISR_count_core3", taskvalue);
  E_DBGR_VariableCheck("Millisecond2pt5_ISR_count_core3", taskvalue, NotEqual);
  
  snprintf( chActionText, elCount(chActionText), "Check 2pt5ms ISR Counter from Core4 "); 
  snprintf( chExpectedText, elCount(chExpectedText), "2pt5ms ISR Counter from Core4 is incrementing"); 
  TestStepAddActionExpected( chActionText, chExpectedText );
  A_DBGR_VariableRead( "Millisecond2pt5_ISR_count_core4", taskvalue);
  E_DBGR_VariableCheck("Millisecond2pt5_ISR_count_core4", taskvalue, NotEqual);
    
  snprintf( chActionText, elCount(chActionText), "Check 2pt5ms ISR Counter from Core5 "); 
  snprintf( chExpectedText, elCount(chExpectedText), "2pt5ms ISR Counter from Core5 is incrementing"); 
  TestStepAddActionExpected( chActionText, chExpectedText );
  A_DBGR_VariableRead( "Millisecond2pt5_ISR_count_core5", taskvalue);
  E_DBGR_VariableCheck("Millisecond2pt5_ISR_count_core5", taskvalue, NotEqual);
  
  // CPU State for All Cores
  snprintf( chActionText, elCount(chActionText), "Check CPU State for Core0 "); 
  snprintf( chExpectedText, elCount(chExpectedText), "CPU State for Core0 is 0"); 
  TestStepAddActionExpected( chActionText, chExpectedText );
  //A_DBGR_VariableRead( "disableCpu[0]", taskvalue);
  E_DBGR_VariableCheck("disableCpu[0]", 0, Equal);
  
  snprintf( chActionText, elCount(chActionText), "Check CPU State for Core1 "); 
  snprintf( chExpectedText, elCount(chExpectedText), "CPU State for Core1 is 0"); 
  TestStepAddActionExpected( chActionText, chExpectedText );
 // A_DBGR_VariableRead( "disableCpu[1]", taskvalue);
  E_DBGR_VariableCheck("disableCpu[1]", 0, Equal);
  
  snprintf( chActionText, elCount(chActionText), "Check CPU State for Core2 "); 
  snprintf( chExpectedText, elCount(chExpectedText), "CPU State for Core2 is 0"); 
  TestStepAddActionExpected( chActionText, chExpectedText );
 // A_DBGR_VariableRead( "disableCpu[2]", taskvalue);
  E_DBGR_VariableCheck("disableCpu[2]", 0, Equal);
  
  snprintf( chActionText, elCount(chActionText), "Check CPU State for Core3 "); 
  snprintf( chExpectedText, elCount(chExpectedText), "CPU State for Core3 is 0"); 
  TestStepAddActionExpected( chActionText, chExpectedText );
 // A_DBGR_VariableRead( "disableCpu[3]", taskvalue);
  E_DBGR_VariableCheck("disableCpu[3]", 0, Equal);
  
  snprintf( chActionText, elCount(chActionText), "Check CPU State for Core4 "); 
  snprintf( chExpectedText, elCount(chExpectedText), "CPU State for Core4 is 0"); 
  TestStepAddActionExpected( chActionText, chExpectedText );
 // A_DBGR_VariableRead( "disableCpu[4]", taskvalue);
  E_DBGR_VariableCheck("disableCpu[4]", 0, Equal);
  
  snprintf( chActionText, elCount(chActionText), "Check CPU State for Core5 "); 
  snprintf( chExpectedText, elCount(chExpectedText), "CPU State for Core5 is 0"); 
  TestStepAddActionExpected( chActionText, chExpectedText );
 // A_DBGR_VariableRead( "disableCpu[5]", taskvalue);
  E_DBGR_VariableCheck("disableCpu[5]", 0, Equal);
  
  /***************************************************************************************************************/    
    // Test Step 3: Disable CPU Core 5 with interface disableCPU[5] = TRUE
  /***************************************************************************************************************/

  snprintf( chActionText, elCount(chActionText), "Disable CPU5"); 
  snprintf( chExpectedText, elCount(chExpectedText), "CPU 5 disabled"); 
  TestStepAddActionExpected( chActionText, chExpectedText );
  A_DBGR_VariableSet("disableCpu[5]", "1");
  E_DBGR_VariableCheck("disableCpu[5]", 1, Equal);  
  
 /***************************************************************************************************************/    
                      // Test Step 4
                     // Check all cores are in running state except Core5
                    // stub Code to Check ISR Counter incrementing except Core5
                   // Check all CPU States shall be running state = FALSE, except Core[5] = TRUE
                      
  /***************************************************************************************************************/
  //Check All tasks of Core0 are running
  snprintf( chActionText, elCount(chActionText), "Check 2pt5ms Task Counter from Core0 "); 
  snprintf( chExpectedText, elCount(chExpectedText), "2pt5ms Counter from Core0 is incrementing"); 
  TestStepAddActionExpected( chActionText, chExpectedText );
  A_DBGR_VariableRead( "Task_Core0_2pt5ms_Count", taskvalue);
  E_DBGR_VariableCheck("Task_Core0_2pt5ms_Count", taskvalue, Greater);
  
  snprintf( chActionText, elCount(chActionText), "Check 5ms Task Counter from Core0 "); 
  snprintf( chExpectedText, elCount(chExpectedText), "5ms Counter from Core0 is incrementing"); 
  TestStepAddActionExpected( chActionText, chExpectedText );
  A_DBGR_VariableRead( "Task_Core0_5ms_Count", taskvalue);
  E_DBGR_VariableCheck("Task_Core0_5ms_Count", taskvalue, Greater);
  
  snprintf( chActionText, elCount(chActionText), "Check 10ms Task Counter from Core0 "); 
  snprintf( chExpectedText, elCount(chExpectedText), "10ms Counter from Core0 is incrementing"); 
  TestStepAddActionExpected( chActionText, chExpectedText );
  A_DBGR_VariableRead( "Task_Core0_10ms_Count", taskvalue);
  E_DBGR_VariableCheck("Task_Core0_10ms_Count", taskvalue, Greater);  
  
  snprintf( chActionText, elCount(chActionText), "Check 25ms Task Counter from Core0 "); 
  snprintf( chExpectedText, elCount(chExpectedText), "25ms Counter from Core0 is incrementing"); 
  TestStepAddActionExpected( chActionText, chExpectedText );
  A_DBGR_VariableRead( "Task_Core0_25ms_Count", taskvalue);
  E_DBGR_VariableCheck("Task_Core0_25ms_Count", taskvalue, Greater);  

  snprintf( chActionText, elCount(chActionText), "Check 50ms Task Counter from Core0 "); 
  snprintf( chExpectedText, elCount(chExpectedText), "50ms Counter from Core0 is incrementing"); 
  TestStepAddActionExpected( chActionText, chExpectedText );
  A_DBGR_VariableRead( "Task_Core0_50ms_Count", taskvalue);
  E_DBGR_VariableCheck("Task_Core0_50ms_Count", taskvalue, Greater);
  
  snprintf( chActionText, elCount(chActionText), "Check 100ms Task Counter from Core0 "); 
  snprintf( chExpectedText, elCount(chExpectedText), "100ms Counter from Core0 is incrementing"); 
  TestStepAddActionExpected( chActionText, chExpectedText );
  A_DBGR_VariableRead( "Task_Core0_100ms_Count", taskvalue);
  E_DBGR_VariableCheck("Task_Core0_100ms_Count", taskvalue, Greater); 
  
  snprintf( chActionText, elCount(chActionText), "Check 250ms Task Counter from Core0 "); 
  snprintf( chExpectedText, elCount(chExpectedText), "250ms Counter from Core0 is incrementing"); 
  TestStepAddActionExpected( chActionText, chExpectedText );
  A_DBGR_VariableRead( "Task_Core0_250ms_Count", taskvalue);
  E_DBGR_VariableCheck("Task_Core0_250ms_Count", taskvalue, Greater);
  
  snprintf( chActionText, elCount(chActionText), "Check 500ms Task Counter from Core0 "); 
  snprintf( chExpectedText, elCount(chExpectedText), "500ms Counter from Core0 is incrementing"); 
  TestStepAddActionExpected( chActionText, chExpectedText );
  A_DBGR_VariableRead( "Task_Core0_500ms_Count", taskvalue);
  E_DBGR_VariableCheck("Task_Core0_500ms_Count", taskvalue, Greater);
  
  snprintf( chActionText, elCount(chActionText), "Check 1000ms Task Counter from Core0 "); 
  snprintf( chExpectedText, elCount(chExpectedText), "1000ms Counter from Core0 is incrementing"); 
  TestStepAddActionExpected( chActionText, chExpectedText );
  A_DBGR_VariableRead( "Task_Core0_1000ms_Count", taskvalue);
  E_DBGR_VariableCheck("Task_Core0_1000ms_Count", taskvalue, Greater);
  
  
  //Check All tasks of Core1 are Running  
  snprintf( chActionText, elCount(chActionText), "Check 2pt5ms Task Counter from Core1 "); 
  snprintf( chExpectedText, elCount(chExpectedText), "2pt5ms Counter from Core1 is  incrementing"); 
  TestStepAddActionExpected( chActionText, chExpectedText );
  A_DBGR_VariableRead( "Task_Core1_2pt5ms_Count", taskvalue);
  E_DBGR_VariableCheck("Task_Core1_2pt5ms_Count", taskvalue, Greater);
  
  snprintf( chActionText, elCount(chActionText), "Check 5ms Task Counter from Core1 "); 
  snprintf( chExpectedText, elCount(chExpectedText), "5ms Counter from Core1 is  incrementing"); 
  TestStepAddActionExpected( chActionText, chExpectedText );
  A_DBGR_VariableRead( "Task_Core1_5ms_Count", taskvalue);
  E_DBGR_VariableCheck("Task_Core1_5ms_Count", taskvalue, Greater);
  
  snprintf( chActionText, elCount(chActionText), "Check 10ms Task Counter from Core1 "); 
  snprintf( chExpectedText, elCount(chExpectedText), "10ms Counter from Core1 is  incrementing"); 
  TestStepAddActionExpected( chActionText, chExpectedText );
  A_DBGR_VariableRead( "Task_Core1_10ms_Count", taskvalue);
  E_DBGR_VariableCheck("Task_Core1_10ms_Count", taskvalue, Greater);  
  
  snprintf( chActionText, elCount(chActionText), "Check 25ms Task Counter from Core1 "); 
  snprintf( chExpectedText, elCount(chExpectedText), "25ms Counter from Core1 is  incrementing"); 
  TestStepAddActionExpected( chActionText, chExpectedText );
  A_DBGR_VariableRead( "Task_Core1_25ms_Count", taskvalue);
  E_DBGR_VariableCheck("Task_Core1_25ms_Count", taskvalue, Greater); 
  
  snprintf( chActionText, elCount(chActionText), "Check 50ms Task Counter from Core1 "); 
  snprintf( chExpectedText, elCount(chExpectedText), "50ms Counter from Core1 is  incrementing"); 
  TestStepAddActionExpected( chActionText, chExpectedText );
  A_DBGR_VariableRead( "Task_Core1_50ms_Count", taskvalue);
  E_DBGR_VariableCheck("Task_Core1_50ms_Count", taskvalue, Greater);
    
  snprintf( chActionText, elCount(chActionText), "Check 100ms Task Counter from Core1 "); 
  snprintf( chExpectedText, elCount(chExpectedText), "100ms Counter from Core1 is  incrementing"); 
  TestStepAddActionExpected( chActionText, chExpectedText );
  A_DBGR_VariableRead( "Task_Core1_100ms_Count", taskvalue);
  E_DBGR_VariableCheck("Task_Core1_100ms_Count", taskvalue, Greater);

  snprintf( chActionText, elCount(chActionText), "Check 250ms Task Counter from Core1 "); 
  snprintf( chExpectedText, elCount(chExpectedText), "250ms Counter from Core1 is  incrementing"); 
  TestStepAddActionExpected( chActionText, chExpectedText );
  A_DBGR_VariableRead( "Task_Core1_250ms_Count", taskvalue);
  E_DBGR_VariableCheck("Task_Core1_250ms_Count", taskvalue, Greater);
  
  snprintf( chActionText, elCount(chActionText), "Check 500ms Task Counter from Core1 "); 
  snprintf( chExpectedText, elCount(chExpectedText), "500ms Counter from Core1 is  incrementing"); 
  TestStepAddActionExpected( chActionText, chExpectedText );
  A_DBGR_VariableRead( "Task_Core1_500ms_Count", taskvalue);
  E_DBGR_VariableCheck("Task_Core1_500ms_Count", taskvalue, Greater);

  snprintf( chActionText, elCount(chActionText), "Check 1000ms Task Counter from Core1 "); 
  snprintf( chExpectedText, elCount(chExpectedText), "1000ms Counter from Core1 is incrementing"); 
  TestStepAddActionExpected( chActionText, chExpectedText );
  A_DBGR_VariableRead( "Task_Core1_1000ms_Count", taskvalue);
  E_DBGR_VariableCheck("Task_Core1_1000ms_Count", taskvalue, Greater);
  
  
  //Check All tasks of Core2 are Running
  snprintf( chActionText, elCount(chActionText), "Check 2pt5ms Task Counter from Core2 "); 
  snprintf( chExpectedText, elCount(chExpectedText), "2pt5ms Counter from Core2 is  incrementing"); 
  TestStepAddActionExpected( chActionText, chExpectedText );
  A_DBGR_VariableRead( "Task_Core2_2pt5ms_Count", taskvalue);
  E_DBGR_VariableCheck("Task_Core2_2pt5ms_Count", taskvalue, Greater);
  
  snprintf( chActionText, elCount(chActionText), "Check 5ms Task Counter from Core2 "); 
  snprintf( chExpectedText, elCount(chExpectedText), "5ms Counter from Core2 is  incrementing"); 
  TestStepAddActionExpected( chActionText, chExpectedText );
  A_DBGR_VariableRead( "Task_Core2_5ms_Count", taskvalue);
  E_DBGR_VariableCheck("Task_Core2_5ms_Count", taskvalue, Greater);
  
  snprintf( chActionText, elCount(chActionText), "Check 10ms Task Counter from Core2 "); 
  snprintf( chExpectedText, elCount(chExpectedText), "10ms Counter from Core2 is  incrementing"); 
  TestStepAddActionExpected( chActionText, chExpectedText );
  A_DBGR_VariableRead( "Task_Core2_10ms_Count", taskvalue);
  E_DBGR_VariableCheck("Task_Core2_10ms_Count", taskvalue, Greater);  
  
  snprintf( chActionText, elCount(chActionText), "Check 25ms Task Counter from Core2 "); 
  snprintf( chExpectedText, elCount(chExpectedText), "25ms Counter from Core2 is  incrementing"); 
  TestStepAddActionExpected( chActionText, chExpectedText );
  A_DBGR_VariableRead( "Task_Core2_25ms_Count", taskvalue);
  E_DBGR_VariableCheck("Task_Core2_25ms_Count", taskvalue, Greater); 

  snprintf( chActionText, elCount(chActionText), "Check 50ms Task Counter from Core2 "); 
  snprintf( chExpectedText, elCount(chExpectedText), "50ms Counter from Core2 is  incrementing"); 
  TestStepAddActionExpected( chActionText, chExpectedText );
  A_DBGR_VariableRead( "Task_Core2_50ms_Count", taskvalue);
  E_DBGR_VariableCheck("Task_Core2_50ms_Count", taskvalue, Greater);
  
  snprintf( chActionText, elCount(chActionText), "Check 100ms Task Counter from Core2 "); 
  snprintf( chExpectedText, elCount(chExpectedText), "100ms Counter from Core2 is  incrementing"); 
  TestStepAddActionExpected( chActionText, chExpectedText );
  A_DBGR_VariableRead( "Task_Core2_100ms_Count", taskvalue);
  E_DBGR_VariableCheck("Task_Core2_100ms_Count", taskvalue, Greater); 
  
  snprintf( chActionText, elCount(chActionText), "Check 250ms Task Counter from Core2 "); 
  snprintf( chExpectedText, elCount(chExpectedText), "250ms Counter from Core2 is  incrementing"); 
  TestStepAddActionExpected( chActionText, chExpectedText );
  A_DBGR_VariableRead( "Task_Core2_250ms_Count", taskvalue);
  E_DBGR_VariableCheck("Task_Core2_250ms_Count", taskvalue, Greater);

  snprintf( chActionText, elCount(chActionText), "Check 500ms Task Counter from Core2 "); 
  snprintf( chExpectedText, elCount(chExpectedText), "500ms Counter from Core2 is  incrementing"); 
  TestStepAddActionExpected( chActionText, chExpectedText );
  A_DBGR_VariableRead( "Task_Core2_500ms_Count", taskvalue);
  E_DBGR_VariableCheck("Task_Core2_500ms_Count", taskvalue, Greater);

  snprintf( chActionText, elCount(chActionText), "Check 1000ms Task Counter from Core2 "); 
  snprintf( chExpectedText, elCount(chExpectedText), "1000ms Counter from Core2 is  incrementing"); 
  TestStepAddActionExpected( chActionText, chExpectedText );
  A_DBGR_VariableRead( "Task_Core2_1000ms_Count", taskvalue);
  E_DBGR_VariableCheck("Task_Core2_1000ms_Count", taskvalue, Greater);
  
  
    //Check All tasks of Core3 are Running
  snprintf( chActionText, elCount(chActionText), "Check 2pt5ms Task Counter from Core3 "); 
  snprintf( chExpectedText, elCount(chExpectedText), "2pt5ms Counter from Core3 is incrementing"); 
  TestStepAddActionExpected( chActionText, chExpectedText );
  A_DBGR_VariableRead( "Task_Core3_2pt5ms_Count", taskvalue);
  E_DBGR_VariableCheck("Task_Core3_2pt5ms_Count", taskvalue, Greater);
  
   snprintf( chActionText, elCount(chActionText), "Check 5ms Task Counter from Core3 "); 
  snprintf( chExpectedText, elCount(chExpectedText), "5ms Counter from Core3 is incrementing"); 
  TestStepAddActionExpected( chActionText, chExpectedText );
  A_DBGR_VariableRead( "Task_Core3_5ms_Count", taskvalue);
  E_DBGR_VariableCheck("Task_Core3_5ms_Count", taskvalue, Greater);
  
  snprintf( chActionText, elCount(chActionText), "Check 10ms Task Counter from Core3 "); 
  snprintf( chExpectedText, elCount(chExpectedText), "10ms Counter from Core3 is incrementing"); 
  TestStepAddActionExpected( chActionText, chExpectedText );
  A_DBGR_VariableRead( "Task_Core3_10ms_Count", taskvalue);
  E_DBGR_VariableCheck("Task_Core3_10ms_Count", taskvalue, Greater);  
  
  snprintf( chActionText, elCount(chActionText), "Check 25ms Task Counter from Core3 "); 
  snprintf( chExpectedText, elCount(chExpectedText), "25ms Counter from Core3 is incrementing"); 
  TestStepAddActionExpected( chActionText, chExpectedText );
  A_DBGR_VariableRead( "Task_Core3_25ms_Count", taskvalue);
  E_DBGR_VariableCheck("Task_Core3_25ms_Count", taskvalue, Greater);  
  
  snprintf( chActionText, elCount(chActionText), "Check 50ms Task Counter from Core3 "); 
  snprintf( chExpectedText, elCount(chExpectedText), "50ms Counter from Core3 is incrementing"); 
  TestStepAddActionExpected( chActionText, chExpectedText );
  A_DBGR_VariableRead( "Task_Core3_50ms_Count", taskvalue);
  E_DBGR_VariableCheck("Task_Core3_50ms_Count", taskvalue, Greater);

  snprintf( chActionText, elCount(chActionText), "Check 100ms Task Counter from Core3 "); 
  snprintf( chExpectedText, elCount(chExpectedText), "100ms Counter from Core3 is incrementing"); 
  TestStepAddActionExpected( chActionText, chExpectedText );
  A_DBGR_VariableRead( "Task_Core3_100ms_Count", taskvalue);
  E_DBGR_VariableCheck("Task_Core3_100ms_Count", taskvalue, Greater); 
  
  snprintf( chActionText, elCount(chActionText), "Check 250ms Task Counter from Core3 "); 
  snprintf( chExpectedText, elCount(chExpectedText), "250ms Counter from Core3 is incrementing"); 
  TestStepAddActionExpected( chActionText, chExpectedText );
  A_DBGR_VariableRead( "Task_Core3_250ms_Count", taskvalue);
  E_DBGR_VariableCheck("Task_Core3_250ms_Count", taskvalue, Greater);
  
  snprintf( chActionText, elCount(chActionText), "Check 1000ms Task Counter from Core3 "); 
  snprintf( chExpectedText, elCount(chExpectedText), "1000ms Counter from Core3 is incrementing"); 
  TestStepAddActionExpected( chActionText, chExpectedText );
  A_DBGR_VariableRead( "Task_Core3_1000ms_Count", taskvalue);
  E_DBGR_VariableCheck("Task_Core3_1000ms_Count", taskvalue, Greater);
  
    //Check task from Core4 is running
  snprintf( chActionText, elCount(chActionText), "Check 1000ms Task Counter from Core4 "); 
  snprintf( chExpectedText, elCount(chExpectedText), "1000ms Counter from Core4 is  incrementing"); 
  TestStepAddActionExpected( chActionText, chExpectedText );
  A_DBGR_VariableRead( "Task_Core4_1000ms_Count", taskvalue);
  E_DBGR_VariableCheck("Task_Core4_1000ms_Count", taskvalue, Greater);
    
  //Check task from Core5 is stopped
  snprintf( chActionText, elCount(chActionText), "Check 1000ms Task Counter from Core5 "); 
  snprintf( chExpectedText, elCount(chExpectedText), "1000ms Counter from Core5 is stop incrementing"); 
  TestStepAddActionExpected( chActionText, chExpectedText );
  A_DBGR_VariableRead( "Task_Core5_1000ms_Count", taskvalue);
  E_DBGR_VariableCheck("Task_Core5_1000ms_Count", taskvalue, Equal);
  
  
  //Check 2pt5 ms ISR Counter is Incrementing for each core except Core5
  snprintf( chActionText, elCount(chActionText), "Check 2pt5ms ISR Counter from Core0 "); 
  snprintf( chExpectedText, elCount(chExpectedText), "2pt5ms ISR Counter from Core0 is incrementing"); 
  TestStepAddActionExpected( chActionText, chExpectedText );
  A_DBGR_VariableRead( "Millisecond2pt5_ISR_count_core0", taskvalue);
  E_DBGR_VariableCheck("Millisecond2pt5_ISR_count_core0", taskvalue, NotEqual);
  
  snprintf( chActionText, elCount(chActionText), "Check 2pt5ms ISR Counter from Core1 "); 
  snprintf( chExpectedText, elCount(chExpectedText), "2pt5ms ISR Counter from Core1 is incrementing"); 
  TestStepAddActionExpected( chActionText, chExpectedText );
  A_DBGR_VariableRead( "Millisecond2pt5_ISR_count_core1", taskvalue);
  E_DBGR_VariableCheck("Millisecond2pt5_ISR_count_core1", taskvalue, NotEqual);
  
  snprintf( chActionText, elCount(chActionText), "Check 2pt5ms ISR Counter from Core2 "); 
  snprintf( chExpectedText, elCount(chExpectedText), "2pt5ms ISR Counter from Core2 is  incrementing"); 
  TestStepAddActionExpected( chActionText, chExpectedText );
  A_DBGR_VariableRead( "Millisecond2pt5_ISR_count_core2", taskvalue);
  E_DBGR_VariableCheck("Millisecond2pt5_ISR_count_core2", taskvalue, NotEqual);
    
  snprintf( chActionText, elCount(chActionText), "Check 2pt5ms ISR Counter from Core3 "); 
  snprintf( chExpectedText, elCount(chExpectedText), "2pt5ms ISR Counter from Core3 is  incrementing"); 
  TestStepAddActionExpected( chActionText, chExpectedText );
  A_DBGR_VariableRead( "Millisecond2pt5_ISR_count_core3", taskvalue);
  E_DBGR_VariableCheck("Millisecond2pt5_ISR_count_core3", taskvalue, NotEqual);
  
  snprintf( chActionText, elCount(chActionText), "Check 2pt5ms ISR Counter from Core4 "); 
  snprintf( chExpectedText, elCount(chExpectedText), "2pt5ms ISR Counter from Core4 is  incrementing"); 
  TestStepAddActionExpected( chActionText, chExpectedText );
  A_DBGR_VariableRead( "Millisecond2pt5_ISR_count_core4", taskvalue);
  E_DBGR_VariableCheck("Millisecond2pt5_ISR_count_core4", taskvalue, NotEqual);
    
  snprintf( chActionText, elCount(chActionText), "Check 2pt5ms ISR Counter from Core5 "); 
  snprintf( chExpectedText, elCount(chExpectedText), "2pt5ms ISR Counter from Core5 is stop incrementing"); 
  TestStepAddActionExpected( chActionText, chExpectedText );
  A_DBGR_VariableRead( "Millisecond2pt5_ISR_count_core5", taskvalue);
  E_DBGR_VariableCheck("Millisecond2pt5_ISR_count_core5", taskvalue, Equal);
  
  // CPU State for All Cores shall be FALSE, Excepr Core5 = TRUE
  snprintf( chActionText, elCount(chActionText), "Check CPU State for Core0 "); 
  snprintf( chExpectedText, elCount(chExpectedText), "CPU State for Core0 is 0"); 
  TestStepAddActionExpected( chActionText, chExpectedText );
  //A_DBGR_VariableRead( "disableCpu[0]", taskvalue);
  E_DBGR_VariableCheck("disableCpu[0]", 0, Equal);
  
  snprintf( chActionText, elCount(chActionText), "Check CPU State for Core1 "); 
  snprintf( chExpectedText, elCount(chExpectedText), "CPU State for Core1 is 0"); 
  TestStepAddActionExpected( chActionText, chExpectedText );
  //A_DBGR_VariableRead( "disableCpu[1]", taskvalue);
  E_DBGR_VariableCheck("disableCpu[1]", 0, Equal);
  
  snprintf( chActionText, elCount(chActionText), "Check CPU State for Core2 "); 
  snprintf( chExpectedText, elCount(chExpectedText), "CPU State for Core2 is 0"); 
  TestStepAddActionExpected( chActionText, chExpectedText );
  //A_DBGR_VariableRead( "disableCpu[2]", taskvalue);
  E_DBGR_VariableCheck("disableCpu[2]", 0, Equal);
  
  snprintf( chActionText, elCount(chActionText), "Check CPU State for Core3 "); 
  snprintf( chExpectedText, elCount(chExpectedText), "CPU State for Core3 is 0"); 
  TestStepAddActionExpected( chActionText, chExpectedText );
 // A_DBGR_VariableRead( "disableCpu[3]", taskvalue);
  E_DBGR_VariableCheck("disableCpu[3]", 0, Equal);
  
  snprintf( chActionText, elCount(chActionText), "Check CPU State for Core4 "); 
  snprintf( chExpectedText, elCount(chExpectedText), "CPU State for Core4 is 0"); 
  TestStepAddActionExpected( chActionText, chExpectedText );
  //A_DBGR_VariableRead( "disableCpu[4]", taskvalue);
  E_DBGR_VariableCheck("disableCpu[4]", 0, Equal);
  
  snprintf( chActionText, elCount(chActionText), "Check CPU State for Core5 "); 
  snprintf( chExpectedText, elCount(chExpectedText), "CPU State for Core5 is TRUE"); 
  TestStepAddActionExpected( chActionText, chExpectedText );
  //A_DBGR_VariableRead( "disableCpu[5]", taskvalue);
  E_DBGR_VariableCheck("disableCpu[5]", 1, Equal);
}


/***************************************************************************************************
----------------------------------------------------------------------------------------------------
Test case name:  TC_L30SW_Q-36651094: Testcase to verify the functionality of interface GetHWIO_b_CPU_St to check the status after disabling CPU0
----------------------------------------------------------------------------------------------------
Description:   test case to verify the functionality of interface GetHWIO_b_CPU_St to check the status after disabling CPU0

***************************************************************************************************/
testcase Testcase_to_verify_the_functionality_of_interface_GetHWIO_b_CPU_St_to_check_the_status_after_disabling_CPU0()
{
  /***************************************************************************************************************/    
                                                // Variable Definition
  /***************************************************************************************************************/ 
  
  long taskvalue;
  
  /***************************************************************************************************************/    
                                               // Local Values
  /***************************************************************************************************************/ 
  

  
  /***************************************************************************************************************/    
                                              // Test Case Info
  /***************************************************************************************************************/
  setWriteDbgLevel(DebugOff);
  snprintf( chTestTitle, elCount(chTestTitle), "Testcase_to_verify_the_functionality_of_interface_GetHWIO_b_CPU_St_to_check_the_status_after_disabling_CPU0" );
  snprintf( chTestDescription, elCount(chTestDescription), "Purpose: test case to verify the functionality of interface GetHWIO_b_CPU_St to check the status after disabling CPU0");
  TestCaseAddInfo( chTestTitle, "TC_L30SW_QT_36651094", chTestDescription );

  /***************************************************************************************************************/    
                                              // Start of Test Case
  /***************************************************************************************************************/
  
  /***************************************************************************************************************/    
                                              // Test Step 1 PRECONDITIONS
  /***************************************************************************************************************/
  
  snprintf( chActionText, elCount(chActionText), "Flash the Software and ECU is running"); 
  snprintf( chExpectedText, elCount(chExpectedText), "ECU should be in running state"); 
  TestStepAddActionExpected( chActionText, chExpectedText );

  A_DBGR_BreakpointDeleteAll();
  A_DBGR_RnGo();
  E_DBGR_CheckState(T32_State_Running);
  

   /***************************************************************************************************************/    
                      // Test Step 2 Check all cores are in running state      
					 // Check cpuState for all Cores = CPU_Enabled
                                     
  /***************************************************************************************************************/
  
  //Check Core0 is running
  snprintf( chActionText, elCount(chActionText), "Check 1000ms Task Counter from Core0 "); 
  snprintf( chExpectedText, elCount(chExpectedText), "1000ms Counter from Core0 is incrementing"); 
  TestStepAddActionExpected( chActionText, chExpectedText );
  A_DBGR_VariableRead( "Task_Core0_1000ms_Count", taskvalue);
  E_DBGR_VariableCheck("Task_Core0_1000ms_Count", taskvalue, Greater);
  
  //Check Core1 is running
  snprintf( chActionText, elCount(chActionText), "Check 1000ms Task Counter from Core1 "); 
  snprintf( chExpectedText, elCount(chExpectedText), "1000ms Counter from Core1 is incrementing"); 
  TestStepAddActionExpected( chActionText, chExpectedText );
  A_DBGR_VariableRead( "Task_Core1_1000ms_Count", taskvalue);
  E_DBGR_VariableCheck("Task_Core1_1000ms_Count", taskvalue, Greater);
  
  //Check Core2 is running
  snprintf( chActionText, elCount(chActionText), "Check 1000ms Task Counter from Core2 "); 
  snprintf( chExpectedText, elCount(chExpectedText), "1000ms Counter from Core2 is incrementing"); 
  TestStepAddActionExpected( chActionText, chExpectedText );
  A_DBGR_VariableRead( "Task_Core2_1000ms_Count", taskvalue);
  E_DBGR_VariableCheck("Task_Core2_1000ms_Count", taskvalue, Greater);
    
  //Check Core3 is running
  snprintf( chActionText, elCount(chActionText), "Check 1000ms Task Counter from Core3 "); 
  snprintf( chExpectedText, elCount(chExpectedText), "1000ms Counter from Core3 is incrementing"); 
  TestStepAddActionExpected( chActionText, chExpectedText );
  A_DBGR_VariableRead( "Task_Core3_1000ms_Count", taskvalue);
  E_DBGR_VariableCheck("Task_Core3_1000ms_Count", taskvalue, Greater);
    
  //Check Core4 is running
  snprintf( chActionText, elCount(chActionText), "Check 1000ms Task Counter from Core4 "); 
  snprintf( chExpectedText, elCount(chExpectedText), "1000ms Counter from Core4 is incrementing"); 
  TestStepAddActionExpected( chActionText, chExpectedText );
  A_DBGR_VariableRead( "Task_Core4_1000ms_Count", taskvalue);
  E_DBGR_VariableCheck("Task_Core4_1000ms_Count", taskvalue, Greater);
    
  //Check Core5 is running
  snprintf( chActionText, elCount(chActionText), "Check 1000ms Task Counter from Core5 "); 
  snprintf( chExpectedText, elCount(chExpectedText), "1000ms Counter from Core5 is incrementing"); 
  TestStepAddActionExpected( chActionText, chExpectedText );
  A_DBGR_VariableRead( "Task_Core5_1000ms_Count", taskvalue);
  E_DBGR_VariableCheck("Task_Core5_1000ms_Count", taskvalue, Greater);
  
  
  //CPUState cpuState for all Cores shall be Enabled
  snprintf( chActionText, elCount(chActionText), "Check cpuState for Core0 "); 
  snprintf( chExpectedText, elCount(chExpectedText), "cpuState for Core0 is Enabled"); 
  TestStepAddActionExpected( chActionText, chExpectedText );
  E_DBGR_VariableCheck("cpuState[0]", 1 , Equal);
  
  snprintf( chActionText, elCount(chActionText), "Check cpuState for Core1 "); 
  snprintf( chExpectedText, elCount(chExpectedText), "cpuState for Core1 is Enabled"); 
  TestStepAddActionExpected( chActionText, chExpectedText );
  E_DBGR_VariableCheck("cpuState[1]", 1 , Equal);
  
  snprintf( chActionText, elCount(chActionText), "Check cpuState for Core2 "); 
  snprintf( chExpectedText, elCount(chExpectedText), "cpuState for Core2 is Enabled"); 
  TestStepAddActionExpected( chActionText, chExpectedText );
  E_DBGR_VariableCheck("cpuState[2]", 1 , Equal); 
  
   snprintf( chActionText, elCount(chActionText), "Check cpuState for Core3 "); 
  snprintf( chExpectedText, elCount(chExpectedText), "cpuState for Core3 is Enabled"); 
  TestStepAddActionExpected( chActionText, chExpectedText );
  E_DBGR_VariableCheck("cpuState[3]", 1 , Equal); 
  
  snprintf( chActionText, elCount(chActionText), "Check cpuState for Core4 "); 
  snprintf( chExpectedText, elCount(chExpectedText), "cpuState for Core4 is Enabled"); 
  TestStepAddActionExpected( chActionText, chExpectedText );
  E_DBGR_VariableCheck("cpuState[4]", 1 , Equal); 
 
  snprintf( chActionText, elCount(chActionText), "Check cpuState for Core5 "); 
  snprintf( chExpectedText, elCount(chExpectedText), "cpuState for Core5 is Enabled"); 
  TestStepAddActionExpected( chActionText, chExpectedText );
  E_DBGR_VariableCheck("cpuState[5]", 1 , Equal);  
  
  
  
  /***************************************************************************************************************/    
    // Test Step 3: Disable CPU Core 0 with interface disableCPU[0] = TRUE
  /***************************************************************************************************************/

  snprintf( chActionText, elCount(chActionText), "Disable core 0 tasks"); 
  snprintf( chExpectedText, elCount(chExpectedText), "core 0 disabled"); 
  TestStepAddActionExpected( chActionText, chExpectedText );
  A_DBGR_VariableSet("disableCpu[1]", "1");
  A_DBGR_VariableSet("disableCpu[2]", "1");
  A_DBGR_VariableSet("disableCpu[3]", "1");
  A_DBGR_VariableSet("disableCpu[4]", "1");
  A_DBGR_VariableSet("disableCpu[5]", "1");
  A_DBGR_VariableSet("disableCpu[0]", "1");
  E_DBGR_VariableCheck("disableCpu[0]", 1, Equal);  
  
  /***************************************************************************************************************/    
                      // Test Step 4: Check all cores are stopped
  /***************************************************************************************************************/
  
  //Check All tasks of Core0 are stopped
  snprintf( chActionText, elCount(chActionText), "Check 2pt5ms Task Counter from Core0 "); 
  snprintf( chExpectedText, elCount(chExpectedText), "2pt5ms Counter from Core0 is stop  incrementing"); 
  TestStepAddActionExpected( chActionText, chExpectedText );
  A_DBGR_VariableRead( "Task_Core0_2pt5ms_Count", taskvalue);
  E_DBGR_VariableCheck("Task_Core0_2pt5ms_Count", taskvalue, Equal);
  
  snprintf( chActionText, elCount(chActionText), "Check 5ms Task Counter from Core0 "); 
  snprintf( chExpectedText, elCount(chExpectedText), "5ms Counter from Core0 is stop  incrementing"); 
  TestStepAddActionExpected( chActionText, chExpectedText );
  A_DBGR_VariableRead( "Task_Core0_5ms_Count", taskvalue);
  E_DBGR_VariableCheck("Task_Core0_5ms_Count", taskvalue, Equal);
  
  snprintf( chActionText, elCount(chActionText), "Check 10ms Task Counter from Core0 "); 
  snprintf( chExpectedText, elCount(chExpectedText), "10ms Counter from Core0 is stop  incrementing"); 
  TestStepAddActionExpected( chActionText, chExpectedText );
  A_DBGR_VariableRead( "Task_Core0_10ms_Count", taskvalue);
  E_DBGR_VariableCheck("Task_Core0_10ms_Count", taskvalue, Equal);  
  
  snprintf( chActionText, elCount(chActionText), "Check 25ms Task Counter from Core0 "); 
  snprintf( chExpectedText, elCount(chExpectedText), "25ms Counter from Core0 is stop  incrementing"); 
  TestStepAddActionExpected( chActionText, chExpectedText );
  A_DBGR_VariableRead( "Task_Core0_25ms_Count", taskvalue);
  E_DBGR_VariableCheck("Task_Core0_25ms_Count", taskvalue, Equal);  

  snprintf( chActionText, elCount(chActionText), "Check 50ms Task Counter from Core0 "); 
  snprintf( chExpectedText, elCount(chExpectedText), "50ms Counter from Core0 is stop  incrementing"); 
  TestStepAddActionExpected( chActionText, chExpectedText );
  A_DBGR_VariableRead( "Task_Core0_50ms_Count", taskvalue);
  E_DBGR_VariableCheck("Task_Core0_50ms_Count", taskvalue, Equal);
  
  snprintf( chActionText, elCount(chActionText), "Check 250ms Task Counter from Core0 "); 
  snprintf( chExpectedText, elCount(chExpectedText), "250ms Counter from Core0 is stop  incrementing"); 
  TestStepAddActionExpected( chActionText, chExpectedText );
  A_DBGR_VariableRead( "Task_Core0_250ms_Count", taskvalue);
  E_DBGR_VariableCheck("Task_Core0_250ms_Count", taskvalue, Equal);
  
  snprintf( chActionText, elCount(chActionText), "Check 100ms Task Counter from Core0 "); 
  snprintf( chExpectedText, elCount(chExpectedText), "100ms Counter from Core0 is stop  incrementing"); 
  TestStepAddActionExpected( chActionText, chExpectedText );
  A_DBGR_VariableRead( "Task_Core0_100ms_Count", taskvalue);
  E_DBGR_VariableCheck("Task_Core0_100ms_Count", taskvalue, Equal); 

  snprintf( chActionText, elCount(chActionText), "Check 500ms Task Counter from Core0 "); 
  snprintf( chExpectedText, elCount(chExpectedText), "500ms Counter from Core0 is stop  incrementing"); 
  TestStepAddActionExpected( chActionText, chExpectedText );
  A_DBGR_VariableRead( "Task_Core0_500ms_Count", taskvalue);
  E_DBGR_VariableCheck("Task_Core0_500ms_Count", taskvalue, Equal);
  
  snprintf( chActionText, elCount(chActionText), "Check 1000ms Task Counter from Core0 "); 
  snprintf( chExpectedText, elCount(chExpectedText), "1000ms Counter from Core0 is stop  incrementing"); 
  TestStepAddActionExpected( chActionText, chExpectedText );
  A_DBGR_VariableRead( "Task_Core0_1000ms_Count", taskvalue);
  E_DBGR_VariableCheck("Task_Core0_1000ms_Count", taskvalue, Equal);
  
  
  //Check All tasks of Core1 are stopped
  snprintf( chActionText, elCount(chActionText), "Check 2pt5ms Task Counter from Core1 "); 
  snprintf( chExpectedText, elCount(chExpectedText), "2pt5ms Counter from Core1 is  incrementing"); 
  TestStepAddActionExpected( chActionText, chExpectedText );
  A_DBGR_VariableRead( "Task_Core1_2pt5ms_Count", taskvalue);
  E_DBGR_VariableCheck("Task_Core1_2pt5ms_Count", taskvalue, Equal);
  
  snprintf( chActionText, elCount(chActionText), "Check 5ms Task Counter from Core1 "); 
  snprintf( chExpectedText, elCount(chExpectedText), "5ms Counter from Core1 is  incrementing"); 
  TestStepAddActionExpected( chActionText, chExpectedText );
  A_DBGR_VariableRead( "Task_Core1_5ms_Count", taskvalue);
  E_DBGR_VariableCheck("Task_Core1_5ms_Count", taskvalue, Equal);
  
  snprintf( chActionText, elCount(chActionText), "Check 10ms Task Counter from Core1 "); 
  snprintf( chExpectedText, elCount(chExpectedText), "10ms Counter from Core1 is  incrementing"); 
  TestStepAddActionExpected( chActionText, chExpectedText );
  A_DBGR_VariableRead( "Task_Core1_10ms_Count", taskvalue);
  E_DBGR_VariableCheck("Task_Core1_10ms_Count", taskvalue, Equal);  
  
  snprintf( chActionText, elCount(chActionText), "Check 25ms Task Counter from Core1 "); 
  snprintf( chExpectedText, elCount(chExpectedText), "25ms Counter from Core1 is  incrementing"); 
  TestStepAddActionExpected( chActionText, chExpectedText );
  A_DBGR_VariableRead( "Task_Core1_25ms_Count", taskvalue);
  E_DBGR_VariableCheck("Task_Core1_25ms_Count", taskvalue, Equal); 
  
  snprintf( chActionText, elCount(chActionText), "Check 50ms Task Counter from Core1 "); 
  snprintf( chExpectedText, elCount(chExpectedText), "50ms Counter from Core1 is  incrementing"); 
  TestStepAddActionExpected( chActionText, chExpectedText );
  A_DBGR_VariableRead( "Task_Core1_50ms_Count", taskvalue);
  E_DBGR_VariableCheck("Task_Core1_50ms_Count", taskvalue, Equal);
    
  snprintf( chActionText, elCount(chActionText), "Check 100ms Task Counter from Core1 "); 
  snprintf( chExpectedText, elCount(chExpectedText), "100ms Counter from Core1 is  incrementing"); 
  TestStepAddActionExpected( chActionText, chExpectedText );
  A_DBGR_VariableRead( "Task_Core1_100ms_Count", taskvalue);
  E_DBGR_VariableCheck("Task_Core1_100ms_Count", taskvalue, Equal);

  snprintf( chActionText, elCount(chActionText), "Check 250ms Task Counter from Core1 "); 
  snprintf( chExpectedText, elCount(chExpectedText), "250ms Counter from Core1 is  incrementing"); 
  TestStepAddActionExpected( chActionText, chExpectedText );
  A_DBGR_VariableRead( "Task_Core1_250ms_Count", taskvalue);
  E_DBGR_VariableCheck("Task_Core1_250ms_Count", taskvalue, Equal);
  
  snprintf( chActionText, elCount(chActionText), "Check 500ms Task Counter from Core1 "); 
  snprintf( chExpectedText, elCount(chExpectedText), "500ms Counter from Core1 is  incrementing"); 
  TestStepAddActionExpected( chActionText, chExpectedText );
  A_DBGR_VariableRead( "Task_Core1_500ms_Count", taskvalue);
  E_DBGR_VariableCheck("Task_Core1_500ms_Count", taskvalue, Equal);

  snprintf( chActionText, elCount(chActionText), "Check 1000ms Task Counter from Core1 "); 
  snprintf( chExpectedText, elCount(chExpectedText), "1000ms Counter from Core1 is incrementing"); 
  TestStepAddActionExpected( chActionText, chExpectedText );
  A_DBGR_VariableRead( "Task_Core1_1000ms_Count", taskvalue);
  E_DBGR_VariableCheck("Task_Core1_1000ms_Count", taskvalue, Equal);
  
  
  //Check All tasks of Core2 are stopped
  snprintf( chActionText, elCount(chActionText), "Check 2pt5ms Task Counter from Core2 "); 
  snprintf( chExpectedText, elCount(chExpectedText), "2pt5ms Counter from Core2 is  incrementing"); 
  TestStepAddActionExpected( chActionText, chExpectedText );
  A_DBGR_VariableRead( "Task_Core2_2pt5ms_Count", taskvalue);
  E_DBGR_VariableCheck("Task_Core2_2pt5ms_Count", taskvalue, Equal);
  
  snprintf( chActionText, elCount(chActionText), "Check 5ms Task Counter from Core2 "); 
  snprintf( chExpectedText, elCount(chExpectedText), "5ms Counter from Core2 is  incrementing"); 
  TestStepAddActionExpected( chActionText, chExpectedText );
  A_DBGR_VariableRead( "Task_Core2_5ms_Count", taskvalue);
  E_DBGR_VariableCheck("Task_Core2_5ms_Count", taskvalue, Equal);
  
  snprintf( chActionText, elCount(chActionText), "Check 10ms Task Counter from Core2 "); 
  snprintf( chExpectedText, elCount(chExpectedText), "10ms Counter from Core2 is  incrementing"); 
  TestStepAddActionExpected( chActionText, chExpectedText );
  A_DBGR_VariableRead( "Task_Core2_10ms_Count", taskvalue);
  E_DBGR_VariableCheck("Task_Core2_10ms_Count", taskvalue, Equal);  
  
  snprintf( chActionText, elCount(chActionText), "Check 25ms Task Counter from Core2 "); 
  snprintf( chExpectedText, elCount(chExpectedText), "25ms Counter from Core2 is  incrementing"); 
  TestStepAddActionExpected( chActionText, chExpectedText );
  A_DBGR_VariableRead( "Task_Core2_25ms_Count", taskvalue);
  E_DBGR_VariableCheck("Task_Core2_25ms_Count", taskvalue, Equal); 

  snprintf( chActionText, elCount(chActionText), "Check 50ms Task Counter from Core2 "); 
  snprintf( chExpectedText, elCount(chExpectedText), "50ms Counter from Core2 is  incrementing"); 
  TestStepAddActionExpected( chActionText, chExpectedText );
  A_DBGR_VariableRead( "Task_Core2_50ms_Count", taskvalue);
  E_DBGR_VariableCheck("Task_Core2_50ms_Count", taskvalue, Equal);
  
  snprintf( chActionText, elCount(chActionText), "Check 100ms Task Counter from Core2 "); 
  snprintf( chExpectedText, elCount(chExpectedText), "100ms Counter from Core2 is  incrementing"); 
  TestStepAddActionExpected( chActionText, chExpectedText );
  A_DBGR_VariableRead( "Task_Core2_100ms_Count", taskvalue);
  E_DBGR_VariableCheck("Task_Core2_100ms_Count", taskvalue, Equal); 
  
  snprintf( chActionText, elCount(chActionText), "Check 250ms Task Counter from Core2 "); 
  snprintf( chExpectedText, elCount(chExpectedText), "250ms Counter from Core2 is  incrementing"); 
  TestStepAddActionExpected( chActionText, chExpectedText );
  A_DBGR_VariableRead( "Task_Core2_250ms_Count", taskvalue);
  E_DBGR_VariableCheck("Task_Core2_250ms_Count", taskvalue, Equal);

  snprintf( chActionText, elCount(chActionText), "Check 500ms Task Counter from Core2 "); 
  snprintf( chExpectedText, elCount(chExpectedText), "500ms Counter from Core2 is  incrementing"); 
  TestStepAddActionExpected( chActionText, chExpectedText );
  A_DBGR_VariableRead( "Task_Core2_500ms_Count", taskvalue);
  E_DBGR_VariableCheck("Task_Core2_500ms_Count", taskvalue, Equal);

  snprintf( chActionText, elCount(chActionText), "Check 1000ms Task Counter from Core2 "); 
  snprintf( chExpectedText, elCount(chExpectedText), "1000ms Counter from Core2 is  incrementing"); 
  TestStepAddActionExpected( chActionText, chExpectedText );
  A_DBGR_VariableRead( "Task_Core2_1000ms_Count", taskvalue);
  E_DBGR_VariableCheck("Task_Core2_1000ms_Count", taskvalue, Equal);
  
  
    //Check All tasks of Core3 are stopped
  snprintf( chActionText, elCount(chActionText), "Check 2pt5ms Task Counter from Core3 "); 
  snprintf( chExpectedText, elCount(chExpectedText), "2pt5ms Counter from Core3 is  incrementing"); 
  TestStepAddActionExpected( chActionText, chExpectedText );
  A_DBGR_VariableRead( "Task_Core3_2pt5ms_Count", taskvalue);
  E_DBGR_VariableCheck("Task_Core3_2pt5ms_Count", taskvalue, Equal);
  
   snprintf( chActionText, elCount(chActionText), "Check 5ms Task Counter from Core3 "); 
  snprintf( chExpectedText, elCount(chExpectedText), "5ms Counter from Core3 is  incrementing"); 
  TestStepAddActionExpected( chActionText, chExpectedText );
  A_DBGR_VariableRead( "Task_Core3_5ms_Count", taskvalue);
  E_DBGR_VariableCheck("Task_Core3_5ms_Count", taskvalue, Equal);
  
  snprintf( chActionText, elCount(chActionText), "Check 10ms Task Counter from Core3 "); 
  snprintf( chExpectedText, elCount(chExpectedText), "10ms Counter from Core3 is  incrementing"); 
  TestStepAddActionExpected( chActionText, chExpectedText );
  A_DBGR_VariableRead( "Task_Core3_10ms_Count", taskvalue);
  E_DBGR_VariableCheck("Task_Core3_10ms_Count", taskvalue, Equal);  
  
  snprintf( chActionText, elCount(chActionText), "Check 25ms Task Counter from Core3 "); 
  snprintf( chExpectedText, elCount(chExpectedText), "25ms Counter from Core3 is  incrementing"); 
  TestStepAddActionExpected( chActionText, chExpectedText );
  A_DBGR_VariableRead( "Task_Core3_25ms_Count", taskvalue);
  E_DBGR_VariableCheck("Task_Core3_25ms_Count", taskvalue, Equal);  
  
  snprintf( chActionText, elCount(chActionText), "Check 50ms Task Counter from Core3 "); 
  snprintf( chExpectedText, elCount(chExpectedText), "50ms Counter from Core3 is  incrementing"); 
  TestStepAddActionExpected( chActionText, chExpectedText );
  A_DBGR_VariableRead( "Task_Core3_50ms_Count", taskvalue);
  E_DBGR_VariableCheck("Task_Core3_50ms_Count", taskvalue, Equal);

  snprintf( chActionText, elCount(chActionText), "Check 100ms Task Counter from Core3 "); 
  snprintf( chExpectedText, elCount(chExpectedText), "100ms Counter from Core3 is  incrementing"); 
  TestStepAddActionExpected( chActionText, chExpectedText );
  A_DBGR_VariableRead( "Task_Core3_100ms_Count", taskvalue);
  E_DBGR_VariableCheck("Task_Core3_100ms_Count", taskvalue, Equal); 
  
  snprintf( chActionText, elCount(chActionText), "Check 250ms Task Counter from Core3 "); 
  snprintf( chExpectedText, elCount(chExpectedText), "250ms Counter from Core3 is  incrementing"); 
  TestStepAddActionExpected( chActionText, chExpectedText );
  A_DBGR_VariableRead( "Task_Core3_250ms_Count", taskvalue);
  E_DBGR_VariableCheck("Task_Core3_250ms_Count", taskvalue, Equal);
  
  snprintf( chActionText, elCount(chActionText), "Check 1000ms Task Counter from Core3 "); 
  snprintf( chExpectedText, elCount(chExpectedText), "1000ms Counter from Core3 is  incrementing"); 
  TestStepAddActionExpected( chActionText, chExpectedText );
  A_DBGR_VariableRead( "Task_Core3_1000ms_Count", taskvalue);
  E_DBGR_VariableCheck("Task_Core3_1000ms_Count", taskvalue, Equal);
  
    //Check task from Core4 is stopped
  snprintf( chActionText, elCount(chActionText), "Check 1000ms Task Counter from Core4 "); 
  snprintf( chExpectedText, elCount(chExpectedText), "1000ms Counter from Core4 is  incrementing"); 
  TestStepAddActionExpected( chActionText, chExpectedText );
  A_DBGR_VariableRead( "Task_Core4_1000ms_Count", taskvalue);
  E_DBGR_VariableCheck("Task_Core4_1000ms_Count", taskvalue, Equal);
    
  //Check task from Core5 is stopped
  snprintf( chActionText, elCount(chActionText), "Check 1000ms Task Counter from Core5 "); 
  snprintf( chExpectedText, elCount(chExpectedText), "1000ms Counter from Core5 is  incrementing"); 
  TestStepAddActionExpected( chActionText, chExpectedText );
  A_DBGR_VariableRead( "Task_Core5_1000ms_Count", taskvalue);
  E_DBGR_VariableCheck("Task_Core5_1000ms_Count", taskvalue, Equal);
  
 
  /***************************************************************************************************************/    
                      // Test Step 5: Check  cpuState[0] = CPU_DISABLED
  /***************************************************************************************************************/ 
  
  // Check cpuState for all Cores shall be Disabled
  
  snprintf( chActionText, elCount(chActionText), "Check cpuState for Core0 "); 
  snprintf( chExpectedText, elCount(chExpectedText), "cpuState for Core0 is Disabled"); 
  TestStepAddActionExpected( chActionText, chExpectedText );
  E_DBGR_VariableCheck("cpuState[0]", 0 , Equal);
  
  snprintf( chActionText, elCount(chActionText), "Check cpuState for Core1 "); 
  snprintf( chExpectedText, elCount(chExpectedText), "cpuState for Core1 is Disabled"); 
  TestStepAddActionExpected( chActionText, chExpectedText );
  E_DBGR_VariableCheck("cpuState[1]", 0 , Equal);
  
  snprintf( chActionText, elCount(chActionText), "Check cpuState for Core2 "); 
  snprintf( chExpectedText, elCount(chExpectedText), "cpuState for Core2 is Disabled"); 
  TestStepAddActionExpected( chActionText, chExpectedText );
  E_DBGR_VariableCheck("cpuState[2]", 0 , Equal); 
  
   snprintf( chActionText, elCount(chActionText), "Check cpuState for Core3 "); 
  snprintf( chExpectedText, elCount(chExpectedText), "cpuState for Core3 is Disabled"); 
  TestStepAddActionExpected( chActionText, chExpectedText );
  E_DBGR_VariableCheck("cpuState[3]", 0 , Equal); 
  
  snprintf( chActionText, elCount(chActionText), "Check cpuState for Core4 "); 
  snprintf( chExpectedText, elCount(chExpectedText), "cpuState for Core4 is Enabled"); 
  TestStepAddActionExpected( chActionText, chExpectedText );
  E_DBGR_VariableCheck("cpuState[4]", 0 , Equal); 
 
  snprintf( chActionText, elCount(chActionText), "Check cpuState for Core5 "); 
  snprintf( chExpectedText, elCount(chExpectedText), "cpuState for Core5 is Disabled"); 
  TestStepAddActionExpected( chActionText, chExpectedText );
  E_DBGR_VariableCheck("cpuState[5]", 0 , Equal);  

}

/***************************************************************************************************
----------------------------------------------------------------------------------------------------
Test case name:  TC_L30SW_Q-36651093: Testcase to verify the functionality of interface GetHWIO_b_CPU_St to check the status after disabling CPU1
----------------------------------------------------------------------------------------------------
Description:   test case to verify the functionality of interface GetHWIO_b_CPU_St to check the status after disabling CPU1

***************************************************************************************************/
testcase Testcase_to_verify_the_functionality_of_interface_GetHWIO_b_CPU_St_to_check_the_status_after_disabling_CPU1()
{
  /***************************************************************************************************************/    
                                                // Variable Definition
  /***************************************************************************************************************/ 
  
  long taskvalue;
  
  /***************************************************************************************************************/    
                                               // Local Values
  /***************************************************************************************************************/ 
  

  
  /***************************************************************************************************************/    
                                              // Test Case Info
  /***************************************************************************************************************/
  setWriteDbgLevel(DebugOff);
  snprintf( chTestTitle, elCount(chTestTitle), "Testcase_to_verify_the_functionality_of_interface_GetHWIO_b_CPU_St_to_check_the_status_after_disabling_CPU1" );
  snprintf( chTestDescription, elCount(chTestDescription), "Purpose: test case to verify the functionality of interface GetHWIO_b_CPU_St to check the status after disabling CPU1");
  TestCaseAddInfo( chTestTitle, "TC_L30SW_QT_36651093", chTestDescription );

  /***************************************************************************************************************/    
                                              // Start of Test Case
  /***************************************************************************************************************/
  
  /***************************************************************************************************************/    
                                              // Test Step 1 PRECONDITIONS
  /***************************************************************************************************************/
  
  snprintf( chActionText, elCount(chActionText), "Flash the Software and ECU is running"); 
  snprintf( chExpectedText, elCount(chExpectedText), "ECU should be in running state"); 
  TestStepAddActionExpected( chActionText, chExpectedText );

  A_DBGR_BreakpointDeleteAll();
  A_DBGR_RnGo();
  E_DBGR_CheckState(T32_State_Running);
  

   /***************************************************************************************************************/    
                      // Test Step 2 Check all cores are in running state      
					 // Check cpuState for all Cores = CPU_Enabled                                
  /***************************************************************************************************************/
  
  //Check Core0 is running
  snprintf( chActionText, elCount(chActionText), "Check 1000ms Task Counter from Core0 "); 
  snprintf( chExpectedText, elCount(chExpectedText), "1000ms Counter from Core0 is incrementing"); 
  TestStepAddActionExpected( chActionText, chExpectedText );
  A_DBGR_VariableRead( "Task_Core0_1000ms_Count", taskvalue);
  E_DBGR_VariableCheck("Task_Core0_1000ms_Count", taskvalue, Greater);
  
  //Check Core1 is running
  snprintf( chActionText, elCount(chActionText), "Check 1000ms Task Counter from Core1 "); 
  snprintf( chExpectedText, elCount(chExpectedText), "1000ms Counter from Core1 is incrementing"); 
  TestStepAddActionExpected( chActionText, chExpectedText );
  A_DBGR_VariableRead( "Task_Core1_1000ms_Count", taskvalue);
  E_DBGR_VariableCheck("Task_Core1_1000ms_Count", taskvalue, Greater);
  
  //Check Core2 is running
  snprintf( chActionText, elCount(chActionText), "Check 1000ms Task Counter from Core2 "); 
  snprintf( chExpectedText, elCount(chExpectedText), "1000ms Counter from Core2 is incrementing"); 
  TestStepAddActionExpected( chActionText, chExpectedText );
  A_DBGR_VariableRead( "Task_Core2_1000ms_Count", taskvalue);
  E_DBGR_VariableCheck("Task_Core2_1000ms_Count", taskvalue, Greater);
    
  //Check Core3 is running
  snprintf( chActionText, elCount(chActionText), "Check 1000ms Task Counter from Core3 "); 
  snprintf( chExpectedText, elCount(chExpectedText), "1000ms Counter from Core3 is incrementing"); 
  TestStepAddActionExpected( chActionText, chExpectedText );
  A_DBGR_VariableRead( "Task_Core3_1000ms_Count", taskvalue);
  E_DBGR_VariableCheck("Task_Core3_1000ms_Count", taskvalue, Greater);
    
  //Check Core4 is running
  snprintf( chActionText, elCount(chActionText), "Check 1000ms Task Counter from Core4 "); 
  snprintf( chExpectedText, elCount(chExpectedText), "1000ms Counter from Core4 is incrementing"); 
  TestStepAddActionExpected( chActionText, chExpectedText );
  A_DBGR_VariableRead( "Task_Core4_1000ms_Count", taskvalue);
  E_DBGR_VariableCheck("Task_Core4_1000ms_Count", taskvalue, Greater);
    
  //Check Core5 is running
  snprintf( chActionText, elCount(chActionText), "Check 1000ms Task Counter from Core5 "); 
  snprintf( chExpectedText, elCount(chExpectedText), "1000ms Counter from Core5 is incrementing"); 
  TestStepAddActionExpected( chActionText, chExpectedText );
  A_DBGR_VariableRead( "Task_Core5_1000ms_Count", taskvalue);
  E_DBGR_VariableCheck("Task_Core5_1000ms_Count", taskvalue, Greater);
  
  
  //CPUState cpuState for all Cores shall be Enabled
  snprintf( chActionText, elCount(chActionText), "Check cpuState for Core0 "); 
  snprintf( chExpectedText, elCount(chExpectedText), "cpuState for Core0 is Enabled"); 
  TestStepAddActionExpected( chActionText, chExpectedText );
  E_DBGR_VariableCheck("cpuState[0]", 1 , Equal);
  
  snprintf( chActionText, elCount(chActionText), "Check cpuState for Core1 "); 
  snprintf( chExpectedText, elCount(chExpectedText), "cpuState for Core1 is Enabled"); 
  TestStepAddActionExpected( chActionText, chExpectedText );
  E_DBGR_VariableCheck("cpuState[1]", 1 , Equal);
  
  snprintf( chActionText, elCount(chActionText), "Check cpuState for Core2 "); 
  snprintf( chExpectedText, elCount(chExpectedText), "cpuState for Core2 is Enabled"); 
  TestStepAddActionExpected( chActionText, chExpectedText );
  E_DBGR_VariableCheck("cpuState[2]", 1 , Equal); 
  
   snprintf( chActionText, elCount(chActionText), "Check cpuState for Core3 "); 
  snprintf( chExpectedText, elCount(chExpectedText), "cpuState for Core3 is Enabled"); 
  TestStepAddActionExpected( chActionText, chExpectedText );
  E_DBGR_VariableCheck("cpuState[3]", 1 , Equal); 
  
  snprintf( chActionText, elCount(chActionText), "Check cpuState for Core4 "); 
  snprintf( chExpectedText, elCount(chExpectedText), "cpuState for Core4 is Enabled"); 
  TestStepAddActionExpected( chActionText, chExpectedText );
  E_DBGR_VariableCheck("cpuState[4]", 1 , Equal); 
 
  snprintf( chActionText, elCount(chActionText), "Check cpuState for Core5 "); 
  snprintf( chExpectedText, elCount(chExpectedText), "cpuState for Core5 is Enabled"); 
  TestStepAddActionExpected( chActionText, chExpectedText );
  E_DBGR_VariableCheck("cpuState[5]", 1 , Equal);  
  
  
  /***************************************************************************************************************/    
    // Test Step 3: Disable CPU Core 1 with interface disableCPU[1] = TRUE
  /***************************************************************************************************************/

  snprintf( chActionText, elCount(chActionText), "Disable core 1 tasks"); 
  snprintf( chExpectedText, elCount(chExpectedText), "core 1 disabled"); 
  TestStepAddActionExpected( chActionText, chExpectedText );
  A_DBGR_VariableSet("disableCpu[1]", "1");
  E_DBGR_VariableCheck("disableCpu[1]", 1, Equal);  
  
  /***************************************************************************************************************/    
                      // Test Step 4: Check all cores are in running state except Core1
  /***************************************************************************************************************/
  
  //Check All tasks of Core0 are Running
  snprintf( chActionText, elCount(chActionText), "Check 2pt5ms Task Counter from Core0 "); 
  snprintf( chExpectedText, elCount(chExpectedText), "2pt5ms Counter from Core0 is  incrementing"); 
  TestStepAddActionExpected( chActionText, chExpectedText );
  A_DBGR_VariableRead( "Task_Core0_2pt5ms_Count", taskvalue);
  E_DBGR_VariableCheck("Task_Core0_2pt5ms_Count", taskvalue, Greater);
  
  snprintf( chActionText, elCount(chActionText), "Check 5ms Task Counter from Core0 "); 
  snprintf( chExpectedText, elCount(chExpectedText), "5ms Counter from Core0 is  incrementing"); 
  TestStepAddActionExpected( chActionText, chExpectedText );
  A_DBGR_VariableRead( "Task_Core0_5ms_Count", taskvalue);
  E_DBGR_VariableCheck("Task_Core0_5ms_Count", taskvalue, Greater);
  
  snprintf( chActionText, elCount(chActionText), "Check 10ms Task Counter from Core0 "); 
  snprintf( chExpectedText, elCount(chExpectedText), "10ms Counter from Core0 is  incrementing"); 
  TestStepAddActionExpected( chActionText, chExpectedText );
  A_DBGR_VariableRead( "Task_Core0_10ms_Count", taskvalue);
  E_DBGR_VariableCheck("Task_Core0_10ms_Count", taskvalue, Greater);  
  
  snprintf( chActionText, elCount(chActionText), "Check 25ms Task Counter from Core0 "); 
  snprintf( chExpectedText, elCount(chExpectedText), "25ms Counter from Core0 is  incrementing"); 
  TestStepAddActionExpected( chActionText, chExpectedText );
  A_DBGR_VariableRead( "Task_Core0_25ms_Count", taskvalue);
  E_DBGR_VariableCheck("Task_Core0_25ms_Count", taskvalue, Greater);  

  snprintf( chActionText, elCount(chActionText), "Check 50ms Task Counter from Core0 "); 
  snprintf( chExpectedText, elCount(chExpectedText), "50ms Counter from Core0 is  incrementing"); 
  TestStepAddActionExpected( chActionText, chExpectedText );
  A_DBGR_VariableRead( "Task_Core0_50ms_Count", taskvalue);
  E_DBGR_VariableCheck("Task_Core0_50ms_Count", taskvalue, Greater);
  
  snprintf( chActionText, elCount(chActionText), "Check 250ms Task Counter from Core0 "); 
  snprintf( chExpectedText, elCount(chExpectedText), "250ms Counter from Core0 is  incrementing"); 
  TestStepAddActionExpected( chActionText, chExpectedText );
  A_DBGR_VariableRead( "Task_Core0_250ms_Count", taskvalue);
  E_DBGR_VariableCheck("Task_Core0_250ms_Count", taskvalue, Greater);
  
  snprintf( chActionText, elCount(chActionText), "Check 100ms Task Counter from Core0 "); 
  snprintf( chExpectedText, elCount(chExpectedText), "100ms Counter from Core0 is  incrementing"); 
  TestStepAddActionExpected( chActionText, chExpectedText );
  A_DBGR_VariableRead( "Task_Core0_100ms_Count", taskvalue);
  E_DBGR_VariableCheck("Task_Core0_100ms_Count", taskvalue, Greater); 

  snprintf( chActionText, elCount(chActionText), "Check 500ms Task Counter from Core0 "); 
  snprintf( chExpectedText, elCount(chExpectedText), "500ms Counter from Core0 is  incrementing"); 
  TestStepAddActionExpected( chActionText, chExpectedText );
  A_DBGR_VariableRead( "Task_Core0_500ms_Count", taskvalue);
  E_DBGR_VariableCheck("Task_Core0_500ms_Count", taskvalue, Greater);
  
  snprintf( chActionText, elCount(chActionText), "Check 1000ms Task Counter from Core0 "); 
  snprintf( chExpectedText, elCount(chExpectedText), "1000ms Counter from Core0 is  incrementing"); 
  TestStepAddActionExpected( chActionText, chExpectedText );
  A_DBGR_VariableRead( "Task_Core0_1000ms_Count", taskvalue);
  E_DBGR_VariableCheck("Task_Core0_1000ms_Count", taskvalue, Greater);
  
  
  //Check All tasks of Core1 are Stopped
  snprintf( chActionText, elCount(chActionText), "Check 2pt5ms Task Counter from Core1 "); 
  snprintf( chExpectedText, elCount(chExpectedText), "2pt5ms Counter from Core1 is stop  incrementing"); 
  TestStepAddActionExpected( chActionText, chExpectedText );
  A_DBGR_VariableRead( "Task_Core1_2pt5ms_Count", taskvalue);
  E_DBGR_VariableCheck("Task_Core1_2pt5ms_Count", taskvalue, Equal);
  
  snprintf( chActionText, elCount(chActionText), "Check 5ms Task Counter from Core1 "); 
  snprintf( chExpectedText, elCount(chExpectedText), "5ms Counter from Core1 is stop  incrementing"); 
  TestStepAddActionExpected( chActionText, chExpectedText );
  A_DBGR_VariableRead( "Task_Core1_5ms_Count", taskvalue);
  E_DBGR_VariableCheck("Task_Core1_5ms_Count", taskvalue, Equal);
  
  snprintf( chActionText, elCount(chActionText), "Check 10ms Task Counter from Core1 "); 
  snprintf( chExpectedText, elCount(chExpectedText), "10ms Counter from Core1 is stop  incrementing"); 
  TestStepAddActionExpected( chActionText, chExpectedText );
  A_DBGR_VariableRead( "Task_Core1_10ms_Count", taskvalue);
  E_DBGR_VariableCheck("Task_Core1_10ms_Count", taskvalue, Equal);  
  
  snprintf( chActionText, elCount(chActionText), "Check 25ms Task Counter from Core1 "); 
  snprintf( chExpectedText, elCount(chExpectedText), "25ms Counter from Core1 is stop  incrementing"); 
  TestStepAddActionExpected( chActionText, chExpectedText );
  A_DBGR_VariableRead( "Task_Core1_25ms_Count", taskvalue);
  E_DBGR_VariableCheck("Task_Core1_25ms_Count", taskvalue, Equal); 
  
  snprintf( chActionText, elCount(chActionText), "Check 50ms Task Counter from Core1 "); 
  snprintf( chExpectedText, elCount(chExpectedText), "50ms Counter from Core1 is stop  incrementing"); 
  TestStepAddActionExpected( chActionText, chExpectedText );
  A_DBGR_VariableRead( "Task_Core1_50ms_Count", taskvalue);
  E_DBGR_VariableCheck("Task_Core1_50ms_Count", taskvalue, Equal);
    
  snprintf( chActionText, elCount(chActionText), "Check 100ms Task Counter from Core1 "); 
  snprintf( chExpectedText, elCount(chExpectedText), "100ms Counter from Core1 is stop  incrementing"); 
  TestStepAddActionExpected( chActionText, chExpectedText );
  A_DBGR_VariableRead( "Task_Core1_100ms_Count", taskvalue);
  E_DBGR_VariableCheck("Task_Core1_100ms_Count", taskvalue, Equal);

  snprintf( chActionText, elCount(chActionText), "Check 250ms Task Counter from Core1 "); 
  snprintf( chExpectedText, elCount(chExpectedText), "250ms Counter from Core1 is stop  incrementing"); 
  TestStepAddActionExpected( chActionText, chExpectedText );
  A_DBGR_VariableRead( "Task_Core1_250ms_Count", taskvalue);
  E_DBGR_VariableCheck("Task_Core1_250ms_Count", taskvalue, Equal);
  
  snprintf( chActionText, elCount(chActionText), "Check 500ms Task Counter from Core1 "); 
  snprintf( chExpectedText, elCount(chExpectedText), "500ms Counter from Core1 is stop  incrementing"); 
  TestStepAddActionExpected( chActionText, chExpectedText );
  A_DBGR_VariableRead( "Task_Core1_500ms_Count", taskvalue);
  E_DBGR_VariableCheck("Task_Core1_500ms_Count", taskvalue, Equal);

  snprintf( chActionText, elCount(chActionText), "Check 1000ms Task Counter from Core1 "); 
  snprintf( chExpectedText, elCount(chExpectedText), "1000ms Counter from Core1 is stop incrementing"); 
  TestStepAddActionExpected( chActionText, chExpectedText );
  A_DBGR_VariableRead( "Task_Core1_1000ms_Count", taskvalue);
  E_DBGR_VariableCheck("Task_Core1_1000ms_Count", taskvalue, Equal);
  
  
  //Check All tasks of Core2 are running
  snprintf( chActionText, elCount(chActionText), "Check 2pt5ms Task Counter from Core2 "); 
  snprintf( chExpectedText, elCount(chExpectedText), "2pt5ms Counter from Core2 is  incrementing"); 
  TestStepAddActionExpected( chActionText, chExpectedText );
  A_DBGR_VariableRead( "Task_Core2_2pt5ms_Count", taskvalue);
  E_DBGR_VariableCheck("Task_Core2_2pt5ms_Count", taskvalue, Greater);
  
  snprintf( chActionText, elCount(chActionText), "Check 5ms Task Counter from Core2 "); 
  snprintf( chExpectedText, elCount(chExpectedText), "5ms Counter from Core2 is  incrementing"); 
  TestStepAddActionExpected( chActionText, chExpectedText );
  A_DBGR_VariableRead( "Task_Core2_5ms_Count", taskvalue);
  E_DBGR_VariableCheck("Task_Core2_5ms_Count", taskvalue, Greater);
  
  snprintf( chActionText, elCount(chActionText), "Check 10ms Task Counter from Core2 "); 
  snprintf( chExpectedText, elCount(chExpectedText), "10ms Counter from Core2 is  incrementing"); 
  TestStepAddActionExpected( chActionText, chExpectedText );
  A_DBGR_VariableRead( "Task_Core2_10ms_Count", taskvalue);
  E_DBGR_VariableCheck("Task_Core2_10ms_Count", taskvalue, Greater);  
  
  snprintf( chActionText, elCount(chActionText), "Check 25ms Task Counter from Core2 "); 
  snprintf( chExpectedText, elCount(chExpectedText), "25ms Counter from Core2 is  incrementing"); 
  TestStepAddActionExpected( chActionText, chExpectedText );
  A_DBGR_VariableRead( "Task_Core2_25ms_Count", taskvalue);
  E_DBGR_VariableCheck("Task_Core2_25ms_Count", taskvalue, Greater); 

  snprintf( chActionText, elCount(chActionText), "Check 50ms Task Counter from Core2 "); 
  snprintf( chExpectedText, elCount(chExpectedText), "50ms Counter from Core2 is  incrementing"); 
  TestStepAddActionExpected( chActionText, chExpectedText );
  A_DBGR_VariableRead( "Task_Core2_50ms_Count", taskvalue);
  E_DBGR_VariableCheck("Task_Core2_50ms_Count", taskvalue, Greater);
  
  snprintf( chActionText, elCount(chActionText), "Check 100ms Task Counter from Core2 "); 
  snprintf( chExpectedText, elCount(chExpectedText), "100ms Counter from Core2 is  incrementing"); 
  TestStepAddActionExpected( chActionText, chExpectedText );
  A_DBGR_VariableRead( "Task_Core2_100ms_Count", taskvalue);
  E_DBGR_VariableCheck("Task_Core2_100ms_Count", taskvalue, Greater); 
  
  snprintf( chActionText, elCount(chActionText), "Check 250ms Task Counter from Core2 "); 
  snprintf( chExpectedText, elCount(chExpectedText), "250ms Counter from Core2 is  incrementing"); 
  TestStepAddActionExpected( chActionText, chExpectedText );
  A_DBGR_VariableRead( "Task_Core2_250ms_Count", taskvalue);
  E_DBGR_VariableCheck("Task_Core2_250ms_Count", taskvalue, Greater);

  snprintf( chActionText, elCount(chActionText), "Check 500ms Task Counter from Core2 "); 
  snprintf( chExpectedText, elCount(chExpectedText), "500ms Counter from Core2 is  incrementing"); 
  TestStepAddActionExpected( chActionText, chExpectedText );
  A_DBGR_VariableRead( "Task_Core2_500ms_Count", taskvalue);
  E_DBGR_VariableCheck("Task_Core2_500ms_Count", taskvalue, Greater);

  snprintf( chActionText, elCount(chActionText), "Check 1000ms Task Counter from Core2 "); 
  snprintf( chExpectedText, elCount(chExpectedText), "1000ms Counter from Core2 is  incrementing"); 
  TestStepAddActionExpected( chActionText, chExpectedText );
  A_DBGR_VariableRead( "Task_Core2_1000ms_Count", taskvalue);
  E_DBGR_VariableCheck("Task_Core2_1000ms_Count", taskvalue, Greater);
  
  
    //Check All tasks of Core3 are running
  snprintf( chActionText, elCount(chActionText), "Check 2pt5ms Task Counter from Core3 "); 
  snprintf( chExpectedText, elCount(chExpectedText), "2pt5ms Counter from Core3 is  incrementing"); 
  TestStepAddActionExpected( chActionText, chExpectedText );
  A_DBGR_VariableRead( "Task_Core3_2pt5ms_Count", taskvalue);
  E_DBGR_VariableCheck("Task_Core3_2pt5ms_Count", taskvalue, Greater);
  
   snprintf( chActionText, elCount(chActionText), "Check 5ms Task Counter from Core3 "); 
  snprintf( chExpectedText, elCount(chExpectedText), "5ms Counter from Core3 is  incrementing"); 
  TestStepAddActionExpected( chActionText, chExpectedText );
  A_DBGR_VariableRead( "Task_Core3_5ms_Count", taskvalue);
  E_DBGR_VariableCheck("Task_Core3_5ms_Count", taskvalue, Greater);
  
  snprintf( chActionText, elCount(chActionText), "Check 10ms Task Counter from Core3 "); 
  snprintf( chExpectedText, elCount(chExpectedText), "10ms Counter from Core3 is  incrementing"); 
  TestStepAddActionExpected( chActionText, chExpectedText );
  A_DBGR_VariableRead( "Task_Core3_10ms_Count", taskvalue);
  E_DBGR_VariableCheck("Task_Core3_10ms_Count", taskvalue, Greater);  
  
  snprintf( chActionText, elCount(chActionText), "Check 25ms Task Counter from Core3 "); 
  snprintf( chExpectedText, elCount(chExpectedText), "25ms Counter from Core3 is  incrementing"); 
  TestStepAddActionExpected( chActionText, chExpectedText );
  A_DBGR_VariableRead( "Task_Core3_25ms_Count", taskvalue);
  E_DBGR_VariableCheck("Task_Core3_25ms_Count", taskvalue, Greater);  
  
  snprintf( chActionText, elCount(chActionText), "Check 50ms Task Counter from Core3 "); 
  snprintf( chExpectedText, elCount(chExpectedText), "50ms Counter from Core3 is  incrementing"); 
  TestStepAddActionExpected( chActionText, chExpectedText );
  A_DBGR_VariableRead( "Task_Core3_50ms_Count", taskvalue);
  E_DBGR_VariableCheck("Task_Core3_50ms_Count", taskvalue, Greater);

  snprintf( chActionText, elCount(chActionText), "Check 100ms Task Counter from Core3 "); 
  snprintf( chExpectedText, elCount(chExpectedText), "100ms Counter from Core3 is  incrementing"); 
  TestStepAddActionExpected( chActionText, chExpectedText );
  A_DBGR_VariableRead( "Task_Core3_100ms_Count", taskvalue);
  E_DBGR_VariableCheck("Task_Core3_100ms_Count", taskvalue, Greater); 
  
  snprintf( chActionText, elCount(chActionText), "Check 250ms Task Counter from Core3 "); 
  snprintf( chExpectedText, elCount(chExpectedText), "250ms Counter from Core3 is  incrementing"); 
  TestStepAddActionExpected( chActionText, chExpectedText );
  A_DBGR_VariableRead( "Task_Core3_250ms_Count", taskvalue);
  E_DBGR_VariableCheck("Task_Core3_250ms_Count", taskvalue, Greater);
  
  snprintf( chActionText, elCount(chActionText), "Check 1000ms Task Counter from Core3 "); 
  snprintf( chExpectedText, elCount(chExpectedText), "1000ms Counter from Core3 is  incrementing"); 
  TestStepAddActionExpected( chActionText, chExpectedText );
  A_DBGR_VariableRead( "Task_Core3_1000ms_Count", taskvalue);
  E_DBGR_VariableCheck("Task_Core3_1000ms_Count", taskvalue, Greater);
  
    //Check task from Core4 is running
  snprintf( chActionText, elCount(chActionText), "Check 1000ms Task Counter from Core4 "); 
  snprintf( chExpectedText, elCount(chExpectedText), "1000ms Counter from Core4 is  incrementing"); 
  TestStepAddActionExpected( chActionText, chExpectedText );
  A_DBGR_VariableRead( "Task_Core4_1000ms_Count", taskvalue);
  E_DBGR_VariableCheck("Task_Core4_1000ms_Count", taskvalue, Greater);
    
  //Check task from Core5 is running
  snprintf( chActionText, elCount(chActionText), "Check 1000ms Task Counter from Core5 "); 
  snprintf( chExpectedText, elCount(chExpectedText), "1000ms Counter from Core5 is  incrementing"); 
  TestStepAddActionExpected( chActionText, chExpectedText );
  A_DBGR_VariableRead( "Task_Core5_1000ms_Count", taskvalue);
  E_DBGR_VariableCheck("Task_Core5_1000ms_Count", taskvalue, Greater);
  
 
  /***************************************************************************************************************/    
                      // Test Step 5: Check  cpuState[1] = CPU_DISABLED
  /***************************************************************************************************************/ 
  
  // Check cpuState for all Cores shall be Enabled except Core1
  
  snprintf( chActionText, elCount(chActionText), "Check cpuState for Core0 "); 
  snprintf( chExpectedText, elCount(chExpectedText), "cpuState for Core0 is Enabled"); 
  TestStepAddActionExpected( chActionText, chExpectedText );
  E_DBGR_VariableCheck("cpuState[0]", 1 , Equal);
  
  snprintf( chActionText, elCount(chActionText), "Check cpuState for Core1 "); 
  snprintf( chExpectedText, elCount(chExpectedText), "cpuState for Core1 is Disabled"); 
  TestStepAddActionExpected( chActionText, chExpectedText );
  E_DBGR_VariableCheck("cpuState[1]", 0 , Equal);
  
  snprintf( chActionText, elCount(chActionText), "Check cpuState for Core2 "); 
  snprintf( chExpectedText, elCount(chExpectedText), "cpuState for Core2 is Enabled"); 
  TestStepAddActionExpected( chActionText, chExpectedText );
  E_DBGR_VariableCheck("cpuState[2]", 1 , Equal); 
  
   snprintf( chActionText, elCount(chActionText), "Check cpuState for Core3 "); 
  snprintf( chExpectedText, elCount(chExpectedText), "cpuState for Core3 is Enabled"); 
  TestStepAddActionExpected( chActionText, chExpectedText );
  E_DBGR_VariableCheck("cpuState[3]", 1 , Equal); 
  
  snprintf( chActionText, elCount(chActionText), "Check cpuState for Core4 "); 
  snprintf( chExpectedText, elCount(chExpectedText), "cpuState for Core4 is Enabled"); 
  TestStepAddActionExpected( chActionText, chExpectedText );
  E_DBGR_VariableCheck("cpuState[4]", 1 , Equal); 
 
  snprintf( chActionText, elCount(chActionText), "Check cpuState for Core5 "); 
  snprintf( chExpectedText, elCount(chExpectedText), "cpuState for Core5 is Enabled"); 
  TestStepAddActionExpected( chActionText, chExpectedText );
  E_DBGR_VariableCheck("cpuState[5]", 1 , Equal);  

}

/***************************************************************************************************
----------------------------------------------------------------------------------------------------
Test case name:  TC_L30SW_Q-36651092: Testcase to verify the functionality of interface GetHWIO_b_CPU_St to check the status after disabling CPU2
----------------------------------------------------------------------------------------------------
Description:   test case to verify the functionality of interface GetHWIO_b_CPU_St to check the status after disabling CPU2

***************************************************************************************************/
testcase Testcase_to_verify_the_functionality_of_interface_GetHWIO_b_CPU_St_to_check_the_status_after_disabling_CPU2()
{
  /***************************************************************************************************************/    
                                                // Variable Definition
  /***************************************************************************************************************/ 
  
  long taskvalue;
  
  /***************************************************************************************************************/    
                                               // Local Values
  /***************************************************************************************************************/ 
  

  
  /***************************************************************************************************************/    
                                              // Test Case Info
  /***************************************************************************************************************/
  setWriteDbgLevel(DebugOff);
  snprintf( chTestTitle, elCount(chTestTitle), "Testcase_to_verify_the_functionality_of_interface_GetHWIO_b_CPU_St_to_check_the_status_after_disabling_CPU2" );
  snprintf( chTestDescription, elCount(chTestDescription), "Purpose: test case to verify the functionality of interface GetHWIO_b_CPU_St to check the status after disabling CPU2");
  TestCaseAddInfo( chTestTitle, "TC_L30SW_Q-36651092", chTestDescription );

  /***************************************************************************************************************/    
                                              // Start of Test Case
  /***************************************************************************************************************/
  
  /***************************************************************************************************************/    
                                              // Test Step 1 PRECONDITIONS
  /***************************************************************************************************************/
  
  snprintf( chActionText, elCount(chActionText), "Flash the Software and ECU is running"); 
  snprintf( chExpectedText, elCount(chExpectedText), "ECU should be in running state"); 
  TestStepAddActionExpected( chActionText, chExpectedText );

  A_DBGR_BreakpointDeleteAll();
  A_DBGR_RnGo();
  E_DBGR_CheckState(T32_State_Running);
  

   /***************************************************************************************************************/    
                      // Test Step 2 Check all cores are in running state      
					 // Check cpuState for all Cores = CPU_Enabled                                
  /***************************************************************************************************************/
  
  //Check Core0 is running
  snprintf( chActionText, elCount(chActionText), "Check 1000ms Task Counter from Core0 "); 
  snprintf( chExpectedText, elCount(chExpectedText), "1000ms Counter from Core0 is incrementing"); 
  TestStepAddActionExpected( chActionText, chExpectedText );
  A_DBGR_VariableRead( "Task_Core0_1000ms_Count", taskvalue);
  E_DBGR_VariableCheck("Task_Core0_1000ms_Count", taskvalue, Greater);
  
  //Check Core1 is running
  snprintf( chActionText, elCount(chActionText), "Check 1000ms Task Counter from Core1 "); 
  snprintf( chExpectedText, elCount(chExpectedText), "1000ms Counter from Core1 is incrementing"); 
  TestStepAddActionExpected( chActionText, chExpectedText );
  A_DBGR_VariableRead( "Task_Core1_1000ms_Count", taskvalue);
  E_DBGR_VariableCheck("Task_Core1_1000ms_Count", taskvalue, Greater);
  
  //Check Core2 is running
  snprintf( chActionText, elCount(chActionText), "Check 1000ms Task Counter from Core2 "); 
  snprintf( chExpectedText, elCount(chExpectedText), "1000ms Counter from Core2 is incrementing"); 
  TestStepAddActionExpected( chActionText, chExpectedText );
  A_DBGR_VariableRead( "Task_Core2_1000ms_Count", taskvalue);
  E_DBGR_VariableCheck("Task_Core2_1000ms_Count", taskvalue, Greater);
    
  //Check Core3 is running
  snprintf( chActionText, elCount(chActionText), "Check 1000ms Task Counter from Core3 "); 
  snprintf( chExpectedText, elCount(chExpectedText), "1000ms Counter from Core3 is incrementing"); 
  TestStepAddActionExpected( chActionText, chExpectedText );
  A_DBGR_VariableRead( "Task_Core3_1000ms_Count", taskvalue);
  E_DBGR_VariableCheck("Task_Core3_1000ms_Count", taskvalue, Greater);
    
  //Check Core4 is running
  snprintf( chActionText, elCount(chActionText), "Check 1000ms Task Counter from Core4 "); 
  snprintf( chExpectedText, elCount(chExpectedText), "1000ms Counter from Core4 is incrementing"); 
  TestStepAddActionExpected( chActionText, chExpectedText );
  A_DBGR_VariableRead( "Task_Core4_1000ms_Count", taskvalue);
  E_DBGR_VariableCheck("Task_Core4_1000ms_Count", taskvalue, Greater);
    
  //Check Core5 is running
  snprintf( chActionText, elCount(chActionText), "Check 1000ms Task Counter from Core5 "); 
  snprintf( chExpectedText, elCount(chExpectedText), "1000ms Counter from Core5 is incrementing"); 
  TestStepAddActionExpected( chActionText, chExpectedText );
  A_DBGR_VariableRead( "Task_Core5_1000ms_Count", taskvalue);
  E_DBGR_VariableCheck("Task_Core5_1000ms_Count", taskvalue, Greater);
  
  
  //CPUState cpuState for all Cores shall be Enabled
  snprintf( chActionText, elCount(chActionText), "Check cpuState for Core0 "); 
  snprintf( chExpectedText, elCount(chExpectedText), "cpuState for Core0 is Enabled"); 
  TestStepAddActionExpected( chActionText, chExpectedText );
  E_DBGR_VariableCheck("cpuState[0]", 1 , Equal);
  
  snprintf( chActionText, elCount(chActionText), "Check cpuState for Core1 "); 
  snprintf( chExpectedText, elCount(chExpectedText), "cpuState for Core1 is Enabled"); 
  TestStepAddActionExpected( chActionText, chExpectedText );
  E_DBGR_VariableCheck("cpuState[1]", 1 , Equal);
  
  snprintf( chActionText, elCount(chActionText), "Check cpuState for Core2 "); 
  snprintf( chExpectedText, elCount(chExpectedText), "cpuState for Core2 is Enabled"); 
  TestStepAddActionExpected( chActionText, chExpectedText );
  E_DBGR_VariableCheck("cpuState[2]", 1 , Equal); 
  
   snprintf( chActionText, elCount(chActionText), "Check cpuState for Core3 "); 
  snprintf( chExpectedText, elCount(chExpectedText), "cpuState for Core3 is Enabled"); 
  TestStepAddActionExpected( chActionText, chExpectedText );
  E_DBGR_VariableCheck("cpuState[3]", 1 , Equal); 
  
  snprintf( chActionText, elCount(chActionText), "Check cpuState for Core4 "); 
  snprintf( chExpectedText, elCount(chExpectedText), "cpuState for Core4 is Enabled"); 
  TestStepAddActionExpected( chActionText, chExpectedText );
  E_DBGR_VariableCheck("cpuState[4]", 1 , Equal); 
 
  snprintf( chActionText, elCount(chActionText), "Check cpuState for Core5 "); 
  snprintf( chExpectedText, elCount(chExpectedText), "cpuState for Core5 is Enabled"); 
  TestStepAddActionExpected( chActionText, chExpectedText );
  E_DBGR_VariableCheck("cpuState[5]", 1 , Equal);  
  
  
  /***************************************************************************************************************/    
    // Test Step 3: Disable CPU Core 2 with interface disableCPU[2] = TRUE
  /***************************************************************************************************************/

  snprintf( chActionText, elCount(chActionText), "Disable core 2 tasks"); 
  snprintf( chExpectedText, elCount(chExpectedText), "core 2 disabled"); 
  TestStepAddActionExpected( chActionText, chExpectedText );
  A_DBGR_VariableSet("disableCpu[2]", "1");
  E_DBGR_VariableCheck("disableCpu[2]", 1, Equal);  
  
  /***************************************************************************************************************/    
                      // Test Step 4: Check all cores are in running state except Core2
  /***************************************************************************************************************/
  
  //Check All tasks of Core0 are Running
  snprintf( chActionText, elCount(chActionText), "Check 2pt5ms Task Counter from Core0 "); 
  snprintf( chExpectedText, elCount(chExpectedText), "2pt5ms Counter from Core0 is  incrementing"); 
  TestStepAddActionExpected( chActionText, chExpectedText );
  A_DBGR_VariableRead( "Task_Core0_2pt5ms_Count", taskvalue);
  E_DBGR_VariableCheck("Task_Core0_2pt5ms_Count", taskvalue, Greater);
  
  snprintf( chActionText, elCount(chActionText), "Check 5ms Task Counter from Core0 "); 
  snprintf( chExpectedText, elCount(chExpectedText), "5ms Counter from Core0 is  incrementing"); 
  TestStepAddActionExpected( chActionText, chExpectedText );
  A_DBGR_VariableRead( "Task_Core0_5ms_Count", taskvalue);
  E_DBGR_VariableCheck("Task_Core0_5ms_Count", taskvalue, Greater);
  
  snprintf( chActionText, elCount(chActionText), "Check 10ms Task Counter from Core0 "); 
  snprintf( chExpectedText, elCount(chExpectedText), "10ms Counter from Core0 is  incrementing"); 
  TestStepAddActionExpected( chActionText, chExpectedText );
  A_DBGR_VariableRead( "Task_Core0_10ms_Count", taskvalue);
  E_DBGR_VariableCheck("Task_Core0_10ms_Count", taskvalue, Greater);  
  
  snprintf( chActionText, elCount(chActionText), "Check 25ms Task Counter from Core0 "); 
  snprintf( chExpectedText, elCount(chExpectedText), "25ms Counter from Core0 is  incrementing"); 
  TestStepAddActionExpected( chActionText, chExpectedText );
  A_DBGR_VariableRead( "Task_Core0_25ms_Count", taskvalue);
  E_DBGR_VariableCheck("Task_Core0_25ms_Count", taskvalue, Greater);  

  snprintf( chActionText, elCount(chActionText), "Check 50ms Task Counter from Core0 "); 
  snprintf( chExpectedText, elCount(chExpectedText), "50ms Counter from Core0 is  incrementing"); 
  TestStepAddActionExpected( chActionText, chExpectedText );
  A_DBGR_VariableRead( "Task_Core0_50ms_Count", taskvalue);
  E_DBGR_VariableCheck("Task_Core0_50ms_Count", taskvalue, Greater);
  
  snprintf( chActionText, elCount(chActionText), "Check 250ms Task Counter from Core0 "); 
  snprintf( chExpectedText, elCount(chExpectedText), "250ms Counter from Core0 is  incrementing"); 
  TestStepAddActionExpected( chActionText, chExpectedText );
  A_DBGR_VariableRead( "Task_Core0_250ms_Count", taskvalue);
  E_DBGR_VariableCheck("Task_Core0_250ms_Count", taskvalue, Greater);
  
  snprintf( chActionText, elCount(chActionText), "Check 100ms Task Counter from Core0 "); 
  snprintf( chExpectedText, elCount(chExpectedText), "100ms Counter from Core0 is  incrementing"); 
  TestStepAddActionExpected( chActionText, chExpectedText );
  A_DBGR_VariableRead( "Task_Core0_100ms_Count", taskvalue);
  E_DBGR_VariableCheck("Task_Core0_100ms_Count", taskvalue, Greater); 

  snprintf( chActionText, elCount(chActionText), "Check 500ms Task Counter from Core0 "); 
  snprintf( chExpectedText, elCount(chExpectedText), "500ms Counter from Core0 is  incrementing"); 
  TestStepAddActionExpected( chActionText, chExpectedText );
  A_DBGR_VariableRead( "Task_Core0_500ms_Count", taskvalue);
  E_DBGR_VariableCheck("Task_Core0_500ms_Count", taskvalue, Greater);
  
  snprintf( chActionText, elCount(chActionText), "Check 1000ms Task Counter from Core0 "); 
  snprintf( chExpectedText, elCount(chExpectedText), "1000ms Counter from Core0 is  incrementing"); 
  TestStepAddActionExpected( chActionText, chExpectedText );
  A_DBGR_VariableRead( "Task_Core0_1000ms_Count", taskvalue);
  E_DBGR_VariableCheck("Task_Core0_1000ms_Count", taskvalue, Greater);
  
  
  //Check All tasks of Core1 are Running
  snprintf( chActionText, elCount(chActionText), "Check 2pt5ms Task Counter from Core1 "); 
  snprintf( chExpectedText, elCount(chExpectedText), "2pt5ms Counter from Core1 is  incrementing"); 
  TestStepAddActionExpected( chActionText, chExpectedText );
  A_DBGR_VariableRead( "Task_Core1_2pt5ms_Count", taskvalue);
  E_DBGR_VariableCheck("Task_Core1_2pt5ms_Count", taskvalue, Greater);
  
  snprintf( chActionText, elCount(chActionText), "Check 5ms Task Counter from Core1 "); 
  snprintf( chExpectedText, elCount(chExpectedText), "5ms Counter from Core1 is  incrementing"); 
  TestStepAddActionExpected( chActionText, chExpectedText );
  A_DBGR_VariableRead( "Task_Core1_5ms_Count", taskvalue);
  E_DBGR_VariableCheck("Task_Core1_5ms_Count", taskvalue, Greater);
  
  snprintf( chActionText, elCount(chActionText), "Check 10ms Task Counter from Core1 "); 
  snprintf( chExpectedText, elCount(chExpectedText), "10ms Counter from Core1 is  incrementing"); 
  TestStepAddActionExpected( chActionText, chExpectedText );
  A_DBGR_VariableRead( "Task_Core1_10ms_Count", taskvalue);
  E_DBGR_VariableCheck("Task_Core1_10ms_Count", taskvalue, Greater);  
  
  snprintf( chActionText, elCount(chActionText), "Check 25ms Task Counter from Core1 "); 
  snprintf( chExpectedText, elCount(chExpectedText), "25ms Counter from Core1 is  incrementing"); 
  TestStepAddActionExpected( chActionText, chExpectedText );
  A_DBGR_VariableRead( "Task_Core1_25ms_Count", taskvalue);
  E_DBGR_VariableCheck("Task_Core1_25ms_Count", taskvalue, Greater); 
  
  snprintf( chActionText, elCount(chActionText), "Check 50ms Task Counter from Core1 "); 
  snprintf( chExpectedText, elCount(chExpectedText), "50ms Counter from Core1 is  incrementing"); 
  TestStepAddActionExpected( chActionText, chExpectedText );
  A_DBGR_VariableRead( "Task_Core1_50ms_Count", taskvalue);
  E_DBGR_VariableCheck("Task_Core1_50ms_Count", taskvalue, Greater);
    
  snprintf( chActionText, elCount(chActionText), "Check 100ms Task Counter from Core1 "); 
  snprintf( chExpectedText, elCount(chExpectedText), "100ms Counter from Core1 is  incrementing"); 
  TestStepAddActionExpected( chActionText, chExpectedText );
  A_DBGR_VariableRead( "Task_Core1_100ms_Count", taskvalue);
  E_DBGR_VariableCheck("Task_Core1_100ms_Count", taskvalue, Greater);

  snprintf( chActionText, elCount(chActionText), "Check 250ms Task Counter from Core1 "); 
  snprintf( chExpectedText, elCount(chExpectedText), "250ms Counter from Core1 is  incrementing"); 
  TestStepAddActionExpected( chActionText, chExpectedText );
  A_DBGR_VariableRead( "Task_Core1_250ms_Count", taskvalue);
  E_DBGR_VariableCheck("Task_Core1_250ms_Count", taskvalue, Greater);
  
  snprintf( chActionText, elCount(chActionText), "Check 500ms Task Counter from Core1 "); 
  snprintf( chExpectedText, elCount(chExpectedText), "500ms Counter from Core1 is  incrementing"); 
  TestStepAddActionExpected( chActionText, chExpectedText );
  A_DBGR_VariableRead( "Task_Core1_500ms_Count", taskvalue);
  E_DBGR_VariableCheck("Task_Core1_500ms_Count", taskvalue, Greater);

  snprintf( chActionText, elCount(chActionText), "Check 1000ms Task Counter from Core1 "); 
  snprintf( chExpectedText, elCount(chExpectedText), "1000ms Counter from Core1 is stop incrementing"); 
  TestStepAddActionExpected( chActionText, chExpectedText );
  A_DBGR_VariableRead( "Task_Core1_1000ms_Count", taskvalue);
  E_DBGR_VariableCheck("Task_Core1_1000ms_Count", taskvalue, Greater);
  
  
  //Check All tasks of Core2 are Stopped
  snprintf( chActionText, elCount(chActionText), "Check 2pt5ms Task Counter from Core2 "); 
  snprintf( chExpectedText, elCount(chExpectedText), "2pt5ms Counter from Core2 is  stop  incrementing"); 
  TestStepAddActionExpected( chActionText, chExpectedText );
  A_DBGR_VariableRead( "Task_Core2_2pt5ms_Count", taskvalue);
  E_DBGR_VariableCheck("Task_Core2_2pt5ms_Count", taskvalue, Equal);
  
  snprintf( chActionText, elCount(chActionText), "Check 5ms Task Counter from Core2 "); 
  snprintf( chExpectedText, elCount(chExpectedText), "5ms Counter from Core2 is  stop  incrementing"); 
  TestStepAddActionExpected( chActionText, chExpectedText );
  A_DBGR_VariableRead( "Task_Core2_5ms_Count", taskvalue);
  E_DBGR_VariableCheck("Task_Core2_5ms_Count", taskvalue, Equal);
  
  snprintf( chActionText, elCount(chActionText), "Check 10ms Task Counter from Core2 "); 
  snprintf( chExpectedText, elCount(chExpectedText), "10ms Counter from Core2 is  stop  incrementing"); 
  TestStepAddActionExpected( chActionText, chExpectedText );
  A_DBGR_VariableRead( "Task_Core2_10ms_Count", taskvalue);
  E_DBGR_VariableCheck("Task_Core2_10ms_Count", taskvalue, Equal);  
  
  snprintf( chActionText, elCount(chActionText), "Check 25ms Task Counter from Core2 "); 
  snprintf( chExpectedText, elCount(chExpectedText), "25ms Counter from Core2 is  stop  incrementing"); 
  TestStepAddActionExpected( chActionText, chExpectedText );
  A_DBGR_VariableRead( "Task_Core2_25ms_Count", taskvalue);
  E_DBGR_VariableCheck("Task_Core2_25ms_Count", taskvalue, Equal); 

  snprintf( chActionText, elCount(chActionText), "Check 50ms Task Counter from Core2 "); 
  snprintf( chExpectedText, elCount(chExpectedText), "50ms Counter from Core2 is  stop  incrementing"); 
  TestStepAddActionExpected( chActionText, chExpectedText );
  A_DBGR_VariableRead( "Task_Core2_50ms_Count", taskvalue);
  E_DBGR_VariableCheck("Task_Core2_50ms_Count", taskvalue, Equal);
  
  snprintf( chActionText, elCount(chActionText), "Check 100ms Task Counter from Core2 "); 
  snprintf( chExpectedText, elCount(chExpectedText), "100ms Counter from Core2 is  stop  incrementing"); 
  TestStepAddActionExpected( chActionText, chExpectedText );
  A_DBGR_VariableRead( "Task_Core2_100ms_Count", taskvalue);
  E_DBGR_VariableCheck("Task_Core2_100ms_Count", taskvalue, Equal); 
  
  snprintf( chActionText, elCount(chActionText), "Check 250ms Task Counter from Core2 "); 
  snprintf( chExpectedText, elCount(chExpectedText), "250ms Counter from Core2 is  stop  incrementing"); 
  TestStepAddActionExpected( chActionText, chExpectedText );
  A_DBGR_VariableRead( "Task_Core2_250ms_Count", taskvalue);
  E_DBGR_VariableCheck("Task_Core2_250ms_Count", taskvalue, Equal);

  snprintf( chActionText, elCount(chActionText), "Check 500ms Task Counter from Core2 "); 
  snprintf( chExpectedText, elCount(chExpectedText), "500ms Counter from Core2 is  stop  incrementing"); 
  TestStepAddActionExpected( chActionText, chExpectedText );
  A_DBGR_VariableRead( "Task_Core2_500ms_Count", taskvalue);
  E_DBGR_VariableCheck("Task_Core2_500ms_Count", taskvalue, Equal);

  snprintf( chActionText, elCount(chActionText), "Check 1000ms Task Counter from Core2 "); 
  snprintf( chExpectedText, elCount(chExpectedText), "1000ms Counter from Core2 is  stop  incrementing"); 
  TestStepAddActionExpected( chActionText, chExpectedText );
  A_DBGR_VariableRead( "Task_Core2_1000ms_Count", taskvalue);
  E_DBGR_VariableCheck("Task_Core2_1000ms_Count", taskvalue, Equal);
  
  
    //Check All tasks of Core3 are running
  snprintf( chActionText, elCount(chActionText), "Check 2pt5ms Task Counter from Core3 "); 
  snprintf( chExpectedText, elCount(chExpectedText), "2pt5ms Counter from Core3 is  incrementing"); 
  TestStepAddActionExpected( chActionText, chExpectedText );
  A_DBGR_VariableRead( "Task_Core3_2pt5ms_Count", taskvalue);
  E_DBGR_VariableCheck("Task_Core3_2pt5ms_Count", taskvalue, Greater);
  
   snprintf( chActionText, elCount(chActionText), "Check 5ms Task Counter from Core3 "); 
  snprintf( chExpectedText, elCount(chExpectedText), "5ms Counter from Core3 is  incrementing"); 
  TestStepAddActionExpected( chActionText, chExpectedText );
  A_DBGR_VariableRead( "Task_Core3_5ms_Count", taskvalue);
  E_DBGR_VariableCheck("Task_Core3_5ms_Count", taskvalue, Greater);
  
  snprintf( chActionText, elCount(chActionText), "Check 10ms Task Counter from Core3 "); 
  snprintf( chExpectedText, elCount(chExpectedText), "10ms Counter from Core3 is  incrementing"); 
  TestStepAddActionExpected( chActionText, chExpectedText );
  A_DBGR_VariableRead( "Task_Core3_10ms_Count", taskvalue);
  E_DBGR_VariableCheck("Task_Core3_10ms_Count", taskvalue, Greater);  
  
  snprintf( chActionText, elCount(chActionText), "Check 25ms Task Counter from Core3 "); 
  snprintf( chExpectedText, elCount(chExpectedText), "25ms Counter from Core3 is  incrementing"); 
  TestStepAddActionExpected( chActionText, chExpectedText );
  A_DBGR_VariableRead( "Task_Core3_25ms_Count", taskvalue);
  E_DBGR_VariableCheck("Task_Core3_25ms_Count", taskvalue, Greater);  
  
  snprintf( chActionText, elCount(chActionText), "Check 50ms Task Counter from Core3 "); 
  snprintf( chExpectedText, elCount(chExpectedText), "50ms Counter from Core3 is  incrementing"); 
  TestStepAddActionExpected( chActionText, chExpectedText );
  A_DBGR_VariableRead( "Task_Core3_50ms_Count", taskvalue);
  E_DBGR_VariableCheck("Task_Core3_50ms_Count", taskvalue, Greater);

  snprintf( chActionText, elCount(chActionText), "Check 100ms Task Counter from Core3 "); 
  snprintf( chExpectedText, elCount(chExpectedText), "100ms Counter from Core3 is  incrementing"); 
  TestStepAddActionExpected( chActionText, chExpectedText );
  A_DBGR_VariableRead( "Task_Core3_100ms_Count", taskvalue);
  E_DBGR_VariableCheck("Task_Core3_100ms_Count", taskvalue, Greater); 
  
  snprintf( chActionText, elCount(chActionText), "Check 250ms Task Counter from Core3 "); 
  snprintf( chExpectedText, elCount(chExpectedText), "250ms Counter from Core3 is  incrementing"); 
  TestStepAddActionExpected( chActionText, chExpectedText );
  A_DBGR_VariableRead( "Task_Core3_250ms_Count", taskvalue);
  E_DBGR_VariableCheck("Task_Core3_250ms_Count", taskvalue, Greater);
  
  snprintf( chActionText, elCount(chActionText), "Check 1000ms Task Counter from Core3 "); 
  snprintf( chExpectedText, elCount(chExpectedText), "1000ms Counter from Core3 is  incrementing"); 
  TestStepAddActionExpected( chActionText, chExpectedText );
  A_DBGR_VariableRead( "Task_Core3_1000ms_Count", taskvalue);
  E_DBGR_VariableCheck("Task_Core3_1000ms_Count", taskvalue, Greater);
  
    //Check task from Core4 is running
  snprintf( chActionText, elCount(chActionText), "Check 1000ms Task Counter from Core4 "); 
  snprintf( chExpectedText, elCount(chExpectedText), "1000ms Counter from Core4 is  incrementing"); 
  TestStepAddActionExpected( chActionText, chExpectedText );
  A_DBGR_VariableRead( "Task_Core4_1000ms_Count", taskvalue);
  E_DBGR_VariableCheck("Task_Core4_1000ms_Count", taskvalue, Greater);
    
  //Check task from Core5 is running
  snprintf( chActionText, elCount(chActionText), "Check 1000ms Task Counter from Core5 "); 
  snprintf( chExpectedText, elCount(chExpectedText), "1000ms Counter from Core5 is  incrementing"); 
  TestStepAddActionExpected( chActionText, chExpectedText );
  A_DBGR_VariableRead( "Task_Core5_1000ms_Count", taskvalue);
  E_DBGR_VariableCheck("Task_Core5_1000ms_Count", taskvalue, Greater);
  
 
  /***************************************************************************************************************/    
                      // Test Step 5: Check  cpuState[2] = CPU_DISABLED
  /***************************************************************************************************************/ 
  
  // Check cpuState for all Cores shall be Enabled except Core2
  
  snprintf( chActionText, elCount(chActionText), "Check cpuState for Core0 "); 
  snprintf( chExpectedText, elCount(chExpectedText), "cpuState for Core0 is Enabled"); 
  TestStepAddActionExpected( chActionText, chExpectedText );
  E_DBGR_VariableCheck("cpuState[0]", 1 , Equal);
  
  snprintf( chActionText, elCount(chActionText), "Check cpuState for Core1 "); 
  snprintf( chExpectedText, elCount(chExpectedText), "cpuState for Core1 is Enabled"); 
  TestStepAddActionExpected( chActionText, chExpectedText );
  E_DBGR_VariableCheck("cpuState[1]", 1 , Equal);
  
  snprintf( chActionText, elCount(chActionText), "Check cpuState for Core2 "); 
  snprintf( chExpectedText, elCount(chExpectedText), "cpuState for Core2 is Disabled"); 
  TestStepAddActionExpected( chActionText, chExpectedText );
  E_DBGR_VariableCheck("cpuState[2]", 0 , Equal); 
  
   snprintf( chActionText, elCount(chActionText), "Check cpuState for Core3 "); 
  snprintf( chExpectedText, elCount(chExpectedText), "cpuState for Core3 is Enabled"); 
  TestStepAddActionExpected( chActionText, chExpectedText );
  E_DBGR_VariableCheck("cpuState[3]", 1 , Equal); 
  
  snprintf( chActionText, elCount(chActionText), "Check cpuState for Core4 "); 
  snprintf( chExpectedText, elCount(chExpectedText), "cpuState for Core4 is Enabled"); 
  TestStepAddActionExpected( chActionText, chExpectedText );
  E_DBGR_VariableCheck("cpuState[4]", 1 , Equal); 
 
  snprintf( chActionText, elCount(chActionText), "Check cpuState for Core5 "); 
  snprintf( chExpectedText, elCount(chExpectedText), "cpuState for Core5 is Enabled"); 
  TestStepAddActionExpected( chActionText, chExpectedText );
  E_DBGR_VariableCheck("cpuState[5]", 1 , Equal);  

}


/***************************************************************************************************
----------------------------------------------------------------------------------------------------
Test case name:  TC_L30SW_Q-36651091: Testcase to verify the functionality of interface GetHWIO_b_CPU_St to check the status after disabling CPU3
----------------------------------------------------------------------------------------------------
Description:   test case to verify the functionality of interface GetHWIO_b_CPU_St to check the status after disabling CPU3

***************************************************************************************************/
testcase Testcase_to_verify_the_functionality_of_interface_GetHWIO_b_CPU_St_to_check_the_status_after_disabling_CPU3()
{
  /***************************************************************************************************************/    
                                                // Variable Definition
  /***************************************************************************************************************/ 
  
  long taskvalue;
  
  /***************************************************************************************************************/    
                                               // Local Values
  /***************************************************************************************************************/ 
  

  
  /***************************************************************************************************************/    
                                              // Test Case Info
  /***************************************************************************************************************/
  setWriteDbgLevel(DebugOff);
  snprintf( chTestTitle, elCount(chTestTitle), "Testcase_to_verify_the_functionality_of_interface_GetHWIO_b_CPU_St_to_check_the_status_after_disabling_CPU3" );
  snprintf( chTestDescription, elCount(chTestDescription), "Purpose: test case to verify the functionality of interface GetHWIO_b_CPU_St to check the status after disabling CPU3");
  TestCaseAddInfo( chTestTitle, "TC_L30SW_Q-36651091", chTestDescription );

  /***************************************************************************************************************/    
                                              // Start of Test Case
  /***************************************************************************************************************/
  
  /***************************************************************************************************************/    
                                              // Test Step 1 PRECONDITIONS
  /***************************************************************************************************************/
  
  snprintf( chActionText, elCount(chActionText), "Flash the Software and ECU is running"); 
  snprintf( chExpectedText, elCount(chExpectedText), "ECU should be in running state"); 
  TestStepAddActionExpected( chActionText, chExpectedText );

  A_DBGR_BreakpointDeleteAll();
  A_DBGR_RnGo();
  E_DBGR_CheckState(T32_State_Running);
  

   /***************************************************************************************************************/    
            // Test Step 2 Check all cores are in running state      
					 // Check cpuState for all Cores = CPU_Enabled                                
  /***************************************************************************************************************/
  
  //Check Core0 is running
  snprintf( chActionText, elCount(chActionText), "Check 1000ms Task Counter from Core0 "); 
  snprintf( chExpectedText, elCount(chExpectedText), "1000ms Counter from Core0 is incrementing"); 
  TestStepAddActionExpected( chActionText, chExpectedText );
  A_DBGR_VariableRead( "Task_Core0_1000ms_Count", taskvalue);
  E_DBGR_VariableCheck("Task_Core0_1000ms_Count", taskvalue, Greater);
  
  //Check Core1 is running
  snprintf( chActionText, elCount(chActionText), "Check 1000ms Task Counter from Core1 "); 
  snprintf( chExpectedText, elCount(chExpectedText), "1000ms Counter from Core1 is incrementing"); 
  TestStepAddActionExpected( chActionText, chExpectedText );
  A_DBGR_VariableRead( "Task_Core1_1000ms_Count", taskvalue);
  E_DBGR_VariableCheck("Task_Core1_1000ms_Count", taskvalue, Greater);
  
  //Check Core2 is running
  snprintf( chActionText, elCount(chActionText), "Check 1000ms Task Counter from Core2 "); 
  snprintf( chExpectedText, elCount(chExpectedText), "1000ms Counter from Core2 is incrementing"); 
  TestStepAddActionExpected( chActionText, chExpectedText );
  A_DBGR_VariableRead( "Task_Core2_1000ms_Count", taskvalue);
  E_DBGR_VariableCheck("Task_Core2_1000ms_Count", taskvalue, Greater);
    
  //Check Core3 is running
  snprintf( chActionText, elCount(chActionText), "Check 1000ms Task Counter from Core3 "); 
  snprintf( chExpectedText, elCount(chExpectedText), "1000ms Counter from Core3 is incrementing"); 
  TestStepAddActionExpected( chActionText, chExpectedText );
  A_DBGR_VariableRead( "Task_Core3_1000ms_Count", taskvalue);
  E_DBGR_VariableCheck("Task_Core3_1000ms_Count", taskvalue, Greater);
    
  //Check Core4 is running
  snprintf( chActionText, elCount(chActionText), "Check 1000ms Task Counter from Core4 "); 
  snprintf( chExpectedText, elCount(chExpectedText), "1000ms Counter from Core4 is incrementing"); 
  TestStepAddActionExpected( chActionText, chExpectedText );
  A_DBGR_VariableRead( "Task_Core4_1000ms_Count", taskvalue);
  E_DBGR_VariableCheck("Task_Core4_1000ms_Count", taskvalue, Greater);
    
  //Check Core5 is running
  snprintf( chActionText, elCount(chActionText), "Check 1000ms Task Counter from Core5 "); 
  snprintf( chExpectedText, elCount(chExpectedText), "1000ms Counter from Core5 is incrementing"); 
  TestStepAddActionExpected( chActionText, chExpectedText );
  A_DBGR_VariableRead( "Task_Core5_1000ms_Count", taskvalue);
  E_DBGR_VariableCheck("Task_Core5_1000ms_Count", taskvalue, Greater);
  
  
  //CPUState cpuState for all Cores shall be Enabled
  snprintf( chActionText, elCount(chActionText), "Check cpuState for Core0 "); 
  snprintf( chExpectedText, elCount(chExpectedText), "cpuState for Core0 is Enabled"); 
  TestStepAddActionExpected( chActionText, chExpectedText );
  E_DBGR_VariableCheck("cpuState[0]", 1 , Equal);
  
  snprintf( chActionText, elCount(chActionText), "Check cpuState for Core1 "); 
  snprintf( chExpectedText, elCount(chExpectedText), "cpuState for Core1 is Enabled"); 
  TestStepAddActionExpected( chActionText, chExpectedText );
  E_DBGR_VariableCheck("cpuState[1]", 1 , Equal);
  
  snprintf( chActionText, elCount(chActionText), "Check cpuState for Core2 "); 
  snprintf( chExpectedText, elCount(chExpectedText), "cpuState for Core2 is Enabled"); 
  TestStepAddActionExpected( chActionText, chExpectedText );
  E_DBGR_VariableCheck("cpuState[2]", 1 , Equal); 
  
   snprintf( chActionText, elCount(chActionText), "Check cpuState for Core3 "); 
  snprintf( chExpectedText, elCount(chExpectedText), "cpuState for Core3 is Enabled"); 
  TestStepAddActionExpected( chActionText, chExpectedText );
  E_DBGR_VariableCheck("cpuState[3]", 1 , Equal); 
  
  snprintf( chActionText, elCount(chActionText), "Check cpuState for Core4 "); 
  snprintf( chExpectedText, elCount(chExpectedText), "cpuState for Core4 is Enabled"); 
  TestStepAddActionExpected( chActionText, chExpectedText );
  E_DBGR_VariableCheck("cpuState[4]", 1 , Equal); 
 
  snprintf( chActionText, elCount(chActionText), "Check cpuState for Core5 "); 
  snprintf( chExpectedText, elCount(chExpectedText), "cpuState for Core5 is Enabled"); 
  TestStepAddActionExpected( chActionText, chExpectedText );
  E_DBGR_VariableCheck("cpuState[5]", 1 , Equal);  
  
  
  /***************************************************************************************************************/    
    // Test Step 3: Disable CPU Core 1 with interface disableCPU[3] = TRUE
  /***************************************************************************************************************/

  snprintf( chActionText, elCount(chActionText), "Disable core 3 tasks"); 
  snprintf( chExpectedText, elCount(chExpectedText), "core 3 disabled"); 
  TestStepAddActionExpected( chActionText, chExpectedText );
  A_DBGR_VariableSet("disableCpu[3]", "1");
  E_DBGR_VariableCheck("disableCpu[3]", 1, Equal);  
  
  /***************************************************************************************************************/    
     // Test Step 4: Check all cores are in running state except Core3
  /***************************************************************************************************************/
  
  //Check All tasks of Core0 are Running
  snprintf( chActionText, elCount(chActionText), "Check 2pt5ms Task Counter from Core0 "); 
  snprintf( chExpectedText, elCount(chExpectedText), "2pt5ms Counter from Core0 is  incrementing"); 
  TestStepAddActionExpected( chActionText, chExpectedText );
  A_DBGR_VariableRead( "Task_Core0_2pt5ms_Count", taskvalue);
  E_DBGR_VariableCheck("Task_Core0_2pt5ms_Count", taskvalue, Greater);
  
  snprintf( chActionText, elCount(chActionText), "Check 5ms Task Counter from Core0 "); 
  snprintf( chExpectedText, elCount(chExpectedText), "5ms Counter from Core0 is  incrementing"); 
  TestStepAddActionExpected( chActionText, chExpectedText );
  A_DBGR_VariableRead( "Task_Core0_5ms_Count", taskvalue);
  E_DBGR_VariableCheck("Task_Core0_5ms_Count", taskvalue, Greater);
  
  snprintf( chActionText, elCount(chActionText), "Check 10ms Task Counter from Core0 "); 
  snprintf( chExpectedText, elCount(chExpectedText), "10ms Counter from Core0 is  incrementing"); 
  TestStepAddActionExpected( chActionText, chExpectedText );
  A_DBGR_VariableRead( "Task_Core0_10ms_Count", taskvalue);
  E_DBGR_VariableCheck("Task_Core0_10ms_Count", taskvalue, Greater);  
  
  snprintf( chActionText, elCount(chActionText), "Check 25ms Task Counter from Core0 "); 
  snprintf( chExpectedText, elCount(chExpectedText), "25ms Counter from Core0 is  incrementing"); 
  TestStepAddActionExpected( chActionText, chExpectedText );
  A_DBGR_VariableRead( "Task_Core0_25ms_Count", taskvalue);
  E_DBGR_VariableCheck("Task_Core0_25ms_Count", taskvalue, Greater);  

  snprintf( chActionText, elCount(chActionText), "Check 50ms Task Counter from Core0 "); 
  snprintf( chExpectedText, elCount(chExpectedText), "50ms Counter from Core0 is  incrementing"); 
  TestStepAddActionExpected( chActionText, chExpectedText );
  A_DBGR_VariableRead( "Task_Core0_50ms_Count", taskvalue);
  E_DBGR_VariableCheck("Task_Core0_50ms_Count", taskvalue, Greater);
  
  snprintf( chActionText, elCount(chActionText), "Check 250ms Task Counter from Core0 "); 
  snprintf( chExpectedText, elCount(chExpectedText), "250ms Counter from Core0 is  incrementing"); 
  TestStepAddActionExpected( chActionText, chExpectedText );
  A_DBGR_VariableRead( "Task_Core0_250ms_Count", taskvalue);
  E_DBGR_VariableCheck("Task_Core0_250ms_Count", taskvalue, Greater);
  
  snprintf( chActionText, elCount(chActionText), "Check 100ms Task Counter from Core0 "); 
  snprintf( chExpectedText, elCount(chExpectedText), "100ms Counter from Core0 is  incrementing"); 
  TestStepAddActionExpected( chActionText, chExpectedText );
  A_DBGR_VariableRead( "Task_Core0_100ms_Count", taskvalue);
  E_DBGR_VariableCheck("Task_Core0_100ms_Count", taskvalue, Greater); 

  snprintf( chActionText, elCount(chActionText), "Check 500ms Task Counter from Core0 "); 
  snprintf( chExpectedText, elCount(chExpectedText), "500ms Counter from Core0 is  incrementing"); 
  TestStepAddActionExpected( chActionText, chExpectedText );
  A_DBGR_VariableRead( "Task_Core0_500ms_Count", taskvalue);
  E_DBGR_VariableCheck("Task_Core0_500ms_Count", taskvalue, Greater);
  
  snprintf( chActionText, elCount(chActionText), "Check 1000ms Task Counter from Core0 "); 
  snprintf( chExpectedText, elCount(chExpectedText), "1000ms Counter from Core0 is  incrementing"); 
  TestStepAddActionExpected( chActionText, chExpectedText );
  A_DBGR_VariableRead( "Task_Core0_1000ms_Count", taskvalue);
  E_DBGR_VariableCheck("Task_Core0_1000ms_Count", taskvalue, Greater);
  
  
  //Check All tasks of Core1 are Running
  snprintf( chActionText, elCount(chActionText), "Check 2pt5ms Task Counter from Core1 "); 
  snprintf( chExpectedText, elCount(chExpectedText), "2pt5ms Counter from Core1 is  incrementing"); 
  TestStepAddActionExpected( chActionText, chExpectedText );
  A_DBGR_VariableRead( "Task_Core1_2pt5ms_Count", taskvalue);
  E_DBGR_VariableCheck("Task_Core1_2pt5ms_Count", taskvalue, Greater);
  
  snprintf( chActionText, elCount(chActionText), "Check 5ms Task Counter from Core1 "); 
  snprintf( chExpectedText, elCount(chExpectedText), "5ms Counter from Core1 is  incrementing"); 
  TestStepAddActionExpected( chActionText, chExpectedText );
  A_DBGR_VariableRead( "Task_Core1_5ms_Count", taskvalue);
  E_DBGR_VariableCheck("Task_Core1_5ms_Count", taskvalue, Greater);
  
  snprintf( chActionText, elCount(chActionText), "Check 10ms Task Counter from Core1 "); 
  snprintf( chExpectedText, elCount(chExpectedText), "10ms Counter from Core1 is  incrementing"); 
  TestStepAddActionExpected( chActionText, chExpectedText );
  A_DBGR_VariableRead( "Task_Core1_10ms_Count", taskvalue);
  E_DBGR_VariableCheck("Task_Core1_10ms_Count", taskvalue, Greater);  
  
  snprintf( chActionText, elCount(chActionText), "Check 25ms Task Counter from Core1 "); 
  snprintf( chExpectedText, elCount(chExpectedText), "25ms Counter from Core1 is  incrementing"); 
  TestStepAddActionExpected( chActionText, chExpectedText );
  A_DBGR_VariableRead( "Task_Core1_25ms_Count", taskvalue);
  E_DBGR_VariableCheck("Task_Core1_25ms_Count", taskvalue, Greater); 
  
  snprintf( chActionText, elCount(chActionText), "Check 50ms Task Counter from Core1 "); 
  snprintf( chExpectedText, elCount(chExpectedText), "50ms Counter from Core1 is  incrementing"); 
  TestStepAddActionExpected( chActionText, chExpectedText );
  A_DBGR_VariableRead( "Task_Core1_50ms_Count", taskvalue);
  E_DBGR_VariableCheck("Task_Core1_50ms_Count", taskvalue, Greater);
    
  snprintf( chActionText, elCount(chActionText), "Check 100ms Task Counter from Core1 "); 
  snprintf( chExpectedText, elCount(chExpectedText), "100ms Counter from Core1 is  incrementing"); 
  TestStepAddActionExpected( chActionText, chExpectedText );
  A_DBGR_VariableRead( "Task_Core1_100ms_Count", taskvalue);
  E_DBGR_VariableCheck("Task_Core1_100ms_Count", taskvalue, Greater);

  snprintf( chActionText, elCount(chActionText), "Check 250ms Task Counter from Core1 "); 
  snprintf( chExpectedText, elCount(chExpectedText), "250ms Counter from Core1 is  incrementing"); 
  TestStepAddActionExpected( chActionText, chExpectedText );
  A_DBGR_VariableRead( "Task_Core1_250ms_Count", taskvalue);
  E_DBGR_VariableCheck("Task_Core1_250ms_Count", taskvalue, Greater);
  
  snprintf( chActionText, elCount(chActionText), "Check 500ms Task Counter from Core1 "); 
  snprintf( chExpectedText, elCount(chExpectedText), "500ms Counter from Core1 is  incrementing"); 
  TestStepAddActionExpected( chActionText, chExpectedText );
  A_DBGR_VariableRead( "Task_Core1_500ms_Count", taskvalue);
  E_DBGR_VariableCheck("Task_Core1_500ms_Count", taskvalue, Greater);

  snprintf( chActionText, elCount(chActionText), "Check 1000ms Task Counter from Core1 "); 
  snprintf( chExpectedText, elCount(chExpectedText), "1000ms Counter from Core1 is stop incrementing"); 
  TestStepAddActionExpected( chActionText, chExpectedText );
  A_DBGR_VariableRead( "Task_Core1_1000ms_Count", taskvalue);
  E_DBGR_VariableCheck("Task_Core1_1000ms_Count", taskvalue, Greater);
  
  
  //Check All tasks of Core2 are Running
  snprintf( chActionText, elCount(chActionText), "Check 2pt5ms Task Counter from Core2 "); 
  snprintf( chExpectedText, elCount(chExpectedText), "2pt5ms Counter from Core2 is   incrementing"); 
  TestStepAddActionExpected( chActionText, chExpectedText );
  A_DBGR_VariableRead( "Task_Core2_2pt5ms_Count", taskvalue);
  E_DBGR_VariableCheck("Task_Core2_2pt5ms_Count", taskvalue, Greater);
  
  snprintf( chActionText, elCount(chActionText), "Check 5ms Task Counter from Core2 "); 
  snprintf( chExpectedText, elCount(chExpectedText), "5ms Counter from Core2 is   incrementing"); 
  TestStepAddActionExpected( chActionText, chExpectedText );
  A_DBGR_VariableRead( "Task_Core2_5ms_Count", taskvalue);
  E_DBGR_VariableCheck("Task_Core2_5ms_Count", taskvalue, Greater);
  
  snprintf( chActionText, elCount(chActionText), "Check 10ms Task Counter from Core2 "); 
  snprintf( chExpectedText, elCount(chExpectedText), "10ms Counter from Core2 is   incrementing"); 
  TestStepAddActionExpected( chActionText, chExpectedText );
  A_DBGR_VariableRead( "Task_Core2_10ms_Count", taskvalue);
  E_DBGR_VariableCheck("Task_Core2_10ms_Count", taskvalue, Greater);  
  
  snprintf( chActionText, elCount(chActionText), "Check 25ms Task Counter from Core2 "); 
  snprintf( chExpectedText, elCount(chExpectedText), "25ms Counter from Core2 is   incrementing"); 
  TestStepAddActionExpected( chActionText, chExpectedText );
  A_DBGR_VariableRead( "Task_Core2_25ms_Count", taskvalue);
  E_DBGR_VariableCheck("Task_Core2_25ms_Count", taskvalue, Greater); 

  snprintf( chActionText, elCount(chActionText), "Check 50ms Task Counter from Core2 "); 
  snprintf( chExpectedText, elCount(chExpectedText), "50ms Counter from Core2 is   incrementing"); 
  TestStepAddActionExpected( chActionText, chExpectedText );
  A_DBGR_VariableRead( "Task_Core2_50ms_Count", taskvalue);
  E_DBGR_VariableCheck("Task_Core2_50ms_Count", taskvalue, Greater);
  
  snprintf( chActionText, elCount(chActionText), "Check 100ms Task Counter from Core2 "); 
  snprintf( chExpectedText, elCount(chExpectedText), "100ms Counter from Core2 is   incrementing"); 
  TestStepAddActionExpected( chActionText, chExpectedText );
  A_DBGR_VariableRead( "Task_Core2_100ms_Count", taskvalue);
  E_DBGR_VariableCheck("Task_Core2_100ms_Count", taskvalue, Greater); 
  
  snprintf( chActionText, elCount(chActionText), "Check 250ms Task Counter from Core2 "); 
  snprintf( chExpectedText, elCount(chExpectedText), "250ms Counter from Core2 is   incrementing"); 
  TestStepAddActionExpected( chActionText, chExpectedText );
  A_DBGR_VariableRead( "Task_Core2_250ms_Count", taskvalue);
  E_DBGR_VariableCheck("Task_Core2_250ms_Count", taskvalue, Greater);

  snprintf( chActionText, elCount(chActionText), "Check 500ms Task Counter from Core2 "); 
  snprintf( chExpectedText, elCount(chExpectedText), "500ms Counter from Core2 is   incrementing"); 
  TestStepAddActionExpected( chActionText, chExpectedText );
  A_DBGR_VariableRead( "Task_Core2_500ms_Count", taskvalue);
  E_DBGR_VariableCheck("Task_Core2_500ms_Count", taskvalue, Greater);

  snprintf( chActionText, elCount(chActionText), "Check 1000ms Task Counter from Core2 "); 
  snprintf( chExpectedText, elCount(chExpectedText), "1000ms Counter from Core2 is   incrementing"); 
  TestStepAddActionExpected( chActionText, chExpectedText );
  A_DBGR_VariableRead( "Task_Core2_1000ms_Count", taskvalue);
  E_DBGR_VariableCheck("Task_Core2_1000ms_Count", taskvalue, Greater);
  
  
    //Check All tasks of Core3 are stopped
  snprintf( chActionText, elCount(chActionText), "Check 2pt5ms Task Counter from Core3 "); 
  snprintf( chExpectedText, elCount(chExpectedText), "2pt5ms Counter from Core3 is stop incrementing"); 
  TestStepAddActionExpected( chActionText, chExpectedText );
  A_DBGR_VariableRead( "Task_Core3_2pt5ms_Count", taskvalue);
  E_DBGR_VariableCheck("Task_Core3_2pt5ms_Count", taskvalue, Equal);
  
   snprintf( chActionText, elCount(chActionText), "Check 5ms Task Counter from Core3 "); 
  snprintf( chExpectedText, elCount(chExpectedText), "5ms Counter from Core3 is stop incrementing"); 
  TestStepAddActionExpected( chActionText, chExpectedText );
  A_DBGR_VariableRead( "Task_Core3_5ms_Count", taskvalue);
  E_DBGR_VariableCheck("Task_Core3_5ms_Count", taskvalue, Equal);
  
  snprintf( chActionText, elCount(chActionText), "Check 10ms Task Counter from Core3 "); 
  snprintf( chExpectedText, elCount(chExpectedText), "10ms Counter from Core3 is stop  incrementing"); 
  TestStepAddActionExpected( chActionText, chExpectedText );
  A_DBGR_VariableRead( "Task_Core3_10ms_Count", taskvalue);
  E_DBGR_VariableCheck("Task_Core3_10ms_Count", taskvalue, Equal);  
  
  snprintf( chActionText, elCount(chActionText), "Check 25ms Task Counter from Core3 "); 
  snprintf( chExpectedText, elCount(chExpectedText), "25ms Counter from Core3 is stop incrementing"); 
  TestStepAddActionExpected( chActionText, chExpectedText );
  A_DBGR_VariableRead( "Task_Core3_25ms_Count", taskvalue);
  E_DBGR_VariableCheck("Task_Core3_25ms_Count", taskvalue, Equal);  
  
  snprintf( chActionText, elCount(chActionText), "Check 50ms Task Counter from Core3 "); 
  snprintf( chExpectedText, elCount(chExpectedText), "50ms Counter from Core3 is stop incrementing"); 
  TestStepAddActionExpected( chActionText, chExpectedText );
  A_DBGR_VariableRead( "Task_Core3_50ms_Count", taskvalue);
  E_DBGR_VariableCheck("Task_Core3_50ms_Count", taskvalue, Equal);

  snprintf( chActionText, elCount(chActionText), "Check 100ms Task Counter from Core3 "); 
  snprintf( chExpectedText, elCount(chExpectedText), "100ms Counter from Core3 is stop incrementing"); 
  TestStepAddActionExpected( chActionText, chExpectedText );
  A_DBGR_VariableRead( "Task_Core3_100ms_Count", taskvalue);
  E_DBGR_VariableCheck("Task_Core3_100ms_Count", taskvalue, Equal); 
  
  snprintf( chActionText, elCount(chActionText), "Check 250ms Task Counter from Core3 "); 
  snprintf( chExpectedText, elCount(chExpectedText), "250ms Counter from Core3 is stop incrementing"); 
  TestStepAddActionExpected( chActionText, chExpectedText );
  A_DBGR_VariableRead( "Task_Core3_250ms_Count", taskvalue);
  E_DBGR_VariableCheck("Task_Core3_250ms_Count", taskvalue, Equal);
  
  snprintf( chActionText, elCount(chActionText), "Check 500ms Task Counter from Core3 "); 
  snprintf( chExpectedText, elCount(chExpectedText), "500ms Counter from Core3 is stop incrementing"); 
  TestStepAddActionExpected( chActionText, chExpectedText );
  A_DBGR_VariableRead( "Task_Core3_500ms_Count", taskvalue);
  E_DBGR_VariableCheck("Task_Core3_500ms_Count", taskvalue, Equal);
  
  snprintf( chActionText, elCount(chActionText), "Check 1000ms Task Counter from Core3 "); 
  snprintf( chExpectedText, elCount(chExpectedText), "1000ms Counter from Core3 is stop incrementing"); 
  TestStepAddActionExpected( chActionText, chExpectedText );
  A_DBGR_VariableRead( "Task_Core3_1000ms_Count", taskvalue);
  E_DBGR_VariableCheck("Task_Core3_1000ms_Count", taskvalue, Equal);
  
    //Check task from Core4 is running
  snprintf( chActionText, elCount(chActionText), "Check 1000ms Task Counter from Core4 "); 
  snprintf( chExpectedText, elCount(chExpectedText), "1000ms Counter from Core4 is  incrementing"); 
  TestStepAddActionExpected( chActionText, chExpectedText );
  A_DBGR_VariableRead( "Task_Core4_1000ms_Count", taskvalue);
  E_DBGR_VariableCheck("Task_Core4_1000ms_Count", taskvalue, Greater);
    
  //Check task from Core5 is running
  snprintf( chActionText, elCount(chActionText), "Check 1000ms Task Counter from Core5 "); 
  snprintf( chExpectedText, elCount(chExpectedText), "1000ms Counter from Core5 is  incrementing"); 
  TestStepAddActionExpected( chActionText, chExpectedText );
  A_DBGR_VariableRead( "Task_Core5_1000ms_Count", taskvalue);
  E_DBGR_VariableCheck("Task_Core5_1000ms_Count", taskvalue, Greater);
  
 
  /***************************************************************************************************************/    
                      // Test Step 5: Check  cpuState[3] = CPU_DISABLED
  /***************************************************************************************************************/ 
  
  // Check cpuState for all Cores shall be Enabled except Core3
  
  snprintf( chActionText, elCount(chActionText), "Check cpuState for Core0 "); 
  snprintf( chExpectedText, elCount(chExpectedText), "cpuState for Core0 is Enabled"); 
  TestStepAddActionExpected( chActionText, chExpectedText );
  E_DBGR_VariableCheck("cpuState[0]", 1 , Equal);
  
  snprintf( chActionText, elCount(chActionText), "Check cpuState for Core1 "); 
  snprintf( chExpectedText, elCount(chExpectedText), "cpuState for Core1 is Enabled"); 
  TestStepAddActionExpected( chActionText, chExpectedText );
  E_DBGR_VariableCheck("cpuState[1]", 1 , Equal);
  
  snprintf( chActionText, elCount(chActionText), "Check cpuState for Core2 "); 
  snprintf( chExpectedText, elCount(chExpectedText), "cpuState for Core2 is Enabled"); 
  TestStepAddActionExpected( chActionText, chExpectedText );
  E_DBGR_VariableCheck("cpuState[2]", 1 , Equal); 
  
   snprintf( chActionText, elCount(chActionText), "Check cpuState for Core3 "); 
  snprintf( chExpectedText, elCount(chExpectedText), "cpuState for Core3 is Disabled"); 
  TestStepAddActionExpected( chActionText, chExpectedText );
  E_DBGR_VariableCheck("cpuState[3]", 0 , Equal); 
  
  snprintf( chActionText, elCount(chActionText), "Check cpuState for Core4 "); 
  snprintf( chExpectedText, elCount(chExpectedText), "cpuState for Core4 is Enabled"); 
  TestStepAddActionExpected( chActionText, chExpectedText );
  E_DBGR_VariableCheck("cpuState[4]", 1 , Equal); 
 
  snprintf( chActionText, elCount(chActionText), "Check cpuState for Core5 "); 
  snprintf( chExpectedText, elCount(chExpectedText), "cpuState for Core5 is Enabled"); 
  TestStepAddActionExpected( chActionText, chExpectedText );
  E_DBGR_VariableCheck("cpuState[5]", 1 , Equal);  

}


/***************************************************************************************************
----------------------------------------------------------------------------------------------------
Test case name:  TC_L30SW_Q-36651090: Testcase to verify the functionality of interface GetHWIO_b_CPU_St to check the status after disabling CPU4
----------------------------------------------------------------------------------------------------
Description:   test case to verify the functionality of interface GetHWIO_b_CPU_St to check the status after disabling CPU4

***************************************************************************************************/
testcase Testcase_to_verify_the_functionality_of_interface_GetHWIO_b_CPU_St_to_check_the_status_after_disabling_CPU4()
{
  /***************************************************************************************************************/    
                                                // Variable Definition
  /***************************************************************************************************************/ 
  
  long taskvalue;
  
  /***************************************************************************************************************/    
                                               // Local Values
  /***************************************************************************************************************/ 
  

  
  /***************************************************************************************************************/    
                                              // Test Case Info
  /***************************************************************************************************************/
  setWriteDbgLevel(DebugOff);
  snprintf( chTestTitle, elCount(chTestTitle), "Testcase_to_verify_the_functionality_of_interface_GetHWIO_b_CPU_St_to_check_the_status_after_disabling_CPU4" );
  snprintf( chTestDescription, elCount(chTestDescription), "Purpose: test case to verify the functionality of interface GetHWIO_b_CPU_St to check the status after disabling CPU4");
  TestCaseAddInfo( chTestTitle, "TC_L30SW_Q-36651090", chTestDescription );

  /***************************************************************************************************************/    
                                              // Start of Test Case
  /***************************************************************************************************************/
  
  /***************************************************************************************************************/    
                                              // Test Step 1 PRECONDITIONS
  /***************************************************************************************************************/
  
  snprintf( chActionText, elCount(chActionText), "Flash the Software and ECU is running"); 
  snprintf( chExpectedText, elCount(chExpectedText), "ECU should be in running state"); 
  TestStepAddActionExpected( chActionText, chExpectedText );

  A_DBGR_BreakpointDeleteAll();
  A_DBGR_RnGo();
  E_DBGR_CheckState(T32_State_Running);
  

   /***************************************************************************************************************/    
            // Test Step 2 Check all cores are in running state      
					 // Check cpuState for all Cores = CPU_Enabled                                
  /***************************************************************************************************************/
  
  //Check Core0 is running
  snprintf( chActionText, elCount(chActionText), "Check 1000ms Task Counter from Core0 "); 
  snprintf( chExpectedText, elCount(chExpectedText), "1000ms Counter from Core0 is incrementing"); 
  TestStepAddActionExpected( chActionText, chExpectedText );
  A_DBGR_VariableRead( "Task_Core0_1000ms_Count", taskvalue);
  E_DBGR_VariableCheck("Task_Core0_1000ms_Count", taskvalue, Greater);
  
  //Check Core1 is running
  snprintf( chActionText, elCount(chActionText), "Check 1000ms Task Counter from Core1 "); 
  snprintf( chExpectedText, elCount(chExpectedText), "1000ms Counter from Core1 is incrementing"); 
  TestStepAddActionExpected( chActionText, chExpectedText );
  A_DBGR_VariableRead( "Task_Core1_1000ms_Count", taskvalue);
  E_DBGR_VariableCheck("Task_Core1_1000ms_Count", taskvalue, Greater);
  
  //Check Core2 is running
  snprintf( chActionText, elCount(chActionText), "Check 1000ms Task Counter from Core2 "); 
  snprintf( chExpectedText, elCount(chExpectedText), "1000ms Counter from Core2 is incrementing"); 
  TestStepAddActionExpected( chActionText, chExpectedText );
  A_DBGR_VariableRead( "Task_Core2_1000ms_Count", taskvalue);
  E_DBGR_VariableCheck("Task_Core2_1000ms_Count", taskvalue, Greater);
    
  //Check Core3 is running
  snprintf( chActionText, elCount(chActionText), "Check 1000ms Task Counter from Core3 "); 
  snprintf( chExpectedText, elCount(chExpectedText), "1000ms Counter from Core3 is incrementing"); 
  TestStepAddActionExpected( chActionText, chExpectedText );
  A_DBGR_VariableRead( "Task_Core3_1000ms_Count", taskvalue);
  E_DBGR_VariableCheck("Task_Core3_1000ms_Count", taskvalue, Greater);
    
  //Check Core4 is running
  snprintf( chActionText, elCount(chActionText), "Check 1000ms Task Counter from Core4 "); 
  snprintf( chExpectedText, elCount(chExpectedText), "1000ms Counter from Core4 is incrementing"); 
  TestStepAddActionExpected( chActionText, chExpectedText );
  A_DBGR_VariableRead( "Task_Core4_1000ms_Count", taskvalue);
  E_DBGR_VariableCheck("Task_Core4_1000ms_Count", taskvalue, Greater);
    
  //Check Core5 is running
  snprintf( chActionText, elCount(chActionText), "Check 1000ms Task Counter from Core5 "); 
  snprintf( chExpectedText, elCount(chExpectedText), "1000ms Counter from Core5 is incrementing"); 
  TestStepAddActionExpected( chActionText, chExpectedText );
  A_DBGR_VariableRead( "Task_Core5_1000ms_Count", taskvalue);
  E_DBGR_VariableCheck("Task_Core5_1000ms_Count", taskvalue, Greater);
  
  
  //CPUState cpuState for all Cores shall be Enabled
  snprintf( chActionText, elCount(chActionText), "Check cpuState for Core0 "); 
  snprintf( chExpectedText, elCount(chExpectedText), "cpuState for Core0 is Enabled"); 
  TestStepAddActionExpected( chActionText, chExpectedText );
  E_DBGR_VariableCheck("cpuState[0]", 1 , Equal);
  
  snprintf( chActionText, elCount(chActionText), "Check cpuState for Core1 "); 
  snprintf( chExpectedText, elCount(chExpectedText), "cpuState for Core1 is Enabled"); 
  TestStepAddActionExpected( chActionText, chExpectedText );
  E_DBGR_VariableCheck("cpuState[1]", 1 , Equal);
  
  snprintf( chActionText, elCount(chActionText), "Check cpuState for Core2 "); 
  snprintf( chExpectedText, elCount(chExpectedText), "cpuState for Core2 is Enabled"); 
  TestStepAddActionExpected( chActionText, chExpectedText );
  E_DBGR_VariableCheck("cpuState[2]", 1 , Equal); 
  
   snprintf( chActionText, elCount(chActionText), "Check cpuState for Core3 "); 
  snprintf( chExpectedText, elCount(chExpectedText), "cpuState for Core3 is Enabled"); 
  TestStepAddActionExpected( chActionText, chExpectedText );
  E_DBGR_VariableCheck("cpuState[3]", 1 , Equal); 
  
  snprintf( chActionText, elCount(chActionText), "Check cpuState for Core4 "); 
  snprintf( chExpectedText, elCount(chExpectedText), "cpuState for Core4 is Enabled"); 
  TestStepAddActionExpected( chActionText, chExpectedText );
  E_DBGR_VariableCheck("cpuState[4]", 1 , Equal); 
 
  snprintf( chActionText, elCount(chActionText), "Check cpuState for Core5 "); 
  snprintf( chExpectedText, elCount(chExpectedText), "cpuState for Core5 is Enabled"); 
  TestStepAddActionExpected( chActionText, chExpectedText );
  E_DBGR_VariableCheck("cpuState[5]", 1 , Equal);  
  
  
  /***************************************************************************************************************/    
    // Test Step 3: Disable CPU Core 4 with interface disableCPU[4] = TRUE
  /***************************************************************************************************************/

  snprintf( chActionText, elCount(chActionText), "Disable core 4 tasks"); 
  snprintf( chExpectedText, elCount(chExpectedText), "core 4 disabled"); 
  TestStepAddActionExpected( chActionText, chExpectedText );
  A_DBGR_VariableSet("disableCpu[4]", "1");
  E_DBGR_VariableCheck("disableCpu[4]", 1, Equal);  
  
  /***************************************************************************************************************/    
     // Test Step 4: Check all cores are in running state except Core4
  /***************************************************************************************************************/
  
  //Check All tasks of Core0 are Running
  snprintf( chActionText, elCount(chActionText), "Check 2pt5ms Task Counter from Core0 "); 
  snprintf( chExpectedText, elCount(chExpectedText), "2pt5ms Counter from Core0 is  incrementing"); 
  TestStepAddActionExpected( chActionText, chExpectedText );
  A_DBGR_VariableRead( "Task_Core0_2pt5ms_Count", taskvalue);
  E_DBGR_VariableCheck("Task_Core0_2pt5ms_Count", taskvalue, Greater);
  
  snprintf( chActionText, elCount(chActionText), "Check 5ms Task Counter from Core0 "); 
  snprintf( chExpectedText, elCount(chExpectedText), "5ms Counter from Core0 is  incrementing"); 
  TestStepAddActionExpected( chActionText, chExpectedText );
  A_DBGR_VariableRead( "Task_Core0_5ms_Count", taskvalue);
  E_DBGR_VariableCheck("Task_Core0_5ms_Count", taskvalue, Greater);
  
  snprintf( chActionText, elCount(chActionText), "Check 10ms Task Counter from Core0 "); 
  snprintf( chExpectedText, elCount(chExpectedText), "10ms Counter from Core0 is  incrementing"); 
  TestStepAddActionExpected( chActionText, chExpectedText );
  A_DBGR_VariableRead( "Task_Core0_10ms_Count", taskvalue);
  E_DBGR_VariableCheck("Task_Core0_10ms_Count", taskvalue, Greater);  
  
  snprintf( chActionText, elCount(chActionText), "Check 25ms Task Counter from Core0 "); 
  snprintf( chExpectedText, elCount(chExpectedText), "25ms Counter from Core0 is  incrementing"); 
  TestStepAddActionExpected( chActionText, chExpectedText );
  A_DBGR_VariableRead( "Task_Core0_25ms_Count", taskvalue);
  E_DBGR_VariableCheck("Task_Core0_25ms_Count", taskvalue, Greater);  

  snprintf( chActionText, elCount(chActionText), "Check 50ms Task Counter from Core0 "); 
  snprintf( chExpectedText, elCount(chExpectedText), "50ms Counter from Core0 is  incrementing"); 
  TestStepAddActionExpected( chActionText, chExpectedText );
  A_DBGR_VariableRead( "Task_Core0_50ms_Count", taskvalue);
  E_DBGR_VariableCheck("Task_Core0_50ms_Count", taskvalue, Greater);
  
  snprintf( chActionText, elCount(chActionText), "Check 250ms Task Counter from Core0 "); 
  snprintf( chExpectedText, elCount(chExpectedText), "250ms Counter from Core0 is  incrementing"); 
  TestStepAddActionExpected( chActionText, chExpectedText );
  A_DBGR_VariableRead( "Task_Core0_250ms_Count", taskvalue);
  E_DBGR_VariableCheck("Task_Core0_250ms_Count", taskvalue, Greater);
  
  snprintf( chActionText, elCount(chActionText), "Check 100ms Task Counter from Core0 "); 
  snprintf( chExpectedText, elCount(chExpectedText), "100ms Counter from Core0 is  incrementing"); 
  TestStepAddActionExpected( chActionText, chExpectedText );
  A_DBGR_VariableRead( "Task_Core0_100ms_Count", taskvalue);
  E_DBGR_VariableCheck("Task_Core0_100ms_Count", taskvalue, Greater); 

  snprintf( chActionText, elCount(chActionText), "Check 500ms Task Counter from Core0 "); 
  snprintf( chExpectedText, elCount(chExpectedText), "500ms Counter from Core0 is  incrementing"); 
  TestStepAddActionExpected( chActionText, chExpectedText );
  A_DBGR_VariableRead( "Task_Core0_500ms_Count", taskvalue);
  E_DBGR_VariableCheck("Task_Core0_500ms_Count", taskvalue, Greater);
  
  snprintf( chActionText, elCount(chActionText), "Check 1000ms Task Counter from Core0 "); 
  snprintf( chExpectedText, elCount(chExpectedText), "1000ms Counter from Core0 is  incrementing"); 
  TestStepAddActionExpected( chActionText, chExpectedText );
  A_DBGR_VariableRead( "Task_Core0_1000ms_Count", taskvalue);
  E_DBGR_VariableCheck("Task_Core0_1000ms_Count", taskvalue, Greater);
  
  
  //Check All tasks of Core1 are Running
  snprintf( chActionText, elCount(chActionText), "Check 2pt5ms Task Counter from Core1 "); 
  snprintf( chExpectedText, elCount(chExpectedText), "2pt5ms Counter from Core1 is  incrementing"); 
  TestStepAddActionExpected( chActionText, chExpectedText );
  A_DBGR_VariableRead( "Task_Core1_2pt5ms_Count", taskvalue);
  E_DBGR_VariableCheck("Task_Core1_2pt5ms_Count", taskvalue, Greater);
  
  snprintf( chActionText, elCount(chActionText), "Check 5ms Task Counter from Core1 "); 
  snprintf( chExpectedText, elCount(chExpectedText), "5ms Counter from Core1 is  incrementing"); 
  TestStepAddActionExpected( chActionText, chExpectedText );
  A_DBGR_VariableRead( "Task_Core1_5ms_Count", taskvalue);
  E_DBGR_VariableCheck("Task_Core1_5ms_Count", taskvalue, Greater);
  
  snprintf( chActionText, elCount(chActionText), "Check 10ms Task Counter from Core1 "); 
  snprintf( chExpectedText, elCount(chExpectedText), "10ms Counter from Core1 is  incrementing"); 
  TestStepAddActionExpected( chActionText, chExpectedText );
  A_DBGR_VariableRead( "Task_Core1_10ms_Count", taskvalue);
  E_DBGR_VariableCheck("Task_Core1_10ms_Count", taskvalue, Greater);  
  
  snprintf( chActionText, elCount(chActionText), "Check 25ms Task Counter from Core1 "); 
  snprintf( chExpectedText, elCount(chExpectedText), "25ms Counter from Core1 is  incrementing"); 
  TestStepAddActionExpected( chActionText, chExpectedText );
  A_DBGR_VariableRead( "Task_Core1_25ms_Count", taskvalue);
  E_DBGR_VariableCheck("Task_Core1_25ms_Count", taskvalue, Greater); 
  
  snprintf( chActionText, elCount(chActionText), "Check 50ms Task Counter from Core1 "); 
  snprintf( chExpectedText, elCount(chExpectedText), "50ms Counter from Core1 is  incrementing"); 
  TestStepAddActionExpected( chActionText, chExpectedText );
  A_DBGR_VariableRead( "Task_Core1_50ms_Count", taskvalue);
  E_DBGR_VariableCheck("Task_Core1_50ms_Count", taskvalue, Greater);
    
  snprintf( chActionText, elCount(chActionText), "Check 100ms Task Counter from Core1 "); 
  snprintf( chExpectedText, elCount(chExpectedText), "100ms Counter from Core1 is  incrementing"); 
  TestStepAddActionExpected( chActionText, chExpectedText );
  A_DBGR_VariableRead( "Task_Core1_100ms_Count", taskvalue);
  E_DBGR_VariableCheck("Task_Core1_100ms_Count", taskvalue, Greater);

  snprintf( chActionText, elCount(chActionText), "Check 250ms Task Counter from Core1 "); 
  snprintf( chExpectedText, elCount(chExpectedText), "250ms Counter from Core1 is  incrementing"); 
  TestStepAddActionExpected( chActionText, chExpectedText );
  A_DBGR_VariableRead( "Task_Core1_250ms_Count", taskvalue);
  E_DBGR_VariableCheck("Task_Core1_250ms_Count", taskvalue, Greater);
  
  snprintf( chActionText, elCount(chActionText), "Check 500ms Task Counter from Core1 "); 
  snprintf( chExpectedText, elCount(chExpectedText), "500ms Counter from Core1 is  incrementing"); 
  TestStepAddActionExpected( chActionText, chExpectedText );
  A_DBGR_VariableRead( "Task_Core1_500ms_Count", taskvalue);
  E_DBGR_VariableCheck("Task_Core1_500ms_Count", taskvalue, Greater);

  snprintf( chActionText, elCount(chActionText), "Check 1000ms Task Counter from Core1 "); 
  snprintf( chExpectedText, elCount(chExpectedText), "1000ms Counter from Core1 is stop incrementing"); 
  TestStepAddActionExpected( chActionText, chExpectedText );
  A_DBGR_VariableRead( "Task_Core1_1000ms_Count", taskvalue);
  E_DBGR_VariableCheck("Task_Core1_1000ms_Count", taskvalue, Greater);
  
  
  //Check All tasks of Core2 are Running
  snprintf( chActionText, elCount(chActionText), "Check 2pt5ms Task Counter from Core2 "); 
  snprintf( chExpectedText, elCount(chExpectedText), "2pt5ms Counter from Core2 is   incrementing"); 
  TestStepAddActionExpected( chActionText, chExpectedText );
  A_DBGR_VariableRead( "Task_Core2_2pt5ms_Count", taskvalue);
  E_DBGR_VariableCheck("Task_Core2_2pt5ms_Count", taskvalue, Greater);
  
  snprintf( chActionText, elCount(chActionText), "Check 5ms Task Counter from Core2 "); 
  snprintf( chExpectedText, elCount(chExpectedText), "5ms Counter from Core2 is   incrementing"); 
  TestStepAddActionExpected( chActionText, chExpectedText );
  A_DBGR_VariableRead( "Task_Core2_5ms_Count", taskvalue);
  E_DBGR_VariableCheck("Task_Core2_5ms_Count", taskvalue, Greater);
  
  snprintf( chActionText, elCount(chActionText), "Check 10ms Task Counter from Core2 "); 
  snprintf( chExpectedText, elCount(chExpectedText), "10ms Counter from Core2 is   incrementing"); 
  TestStepAddActionExpected( chActionText, chExpectedText );
  A_DBGR_VariableRead( "Task_Core2_10ms_Count", taskvalue);
  E_DBGR_VariableCheck("Task_Core2_10ms_Count", taskvalue, Greater);  
  
  snprintf( chActionText, elCount(chActionText), "Check 25ms Task Counter from Core2 "); 
  snprintf( chExpectedText, elCount(chExpectedText), "25ms Counter from Core2 is   incrementing"); 
  TestStepAddActionExpected( chActionText, chExpectedText );
  A_DBGR_VariableRead( "Task_Core2_25ms_Count", taskvalue);
  E_DBGR_VariableCheck("Task_Core2_25ms_Count", taskvalue, Greater); 

  snprintf( chActionText, elCount(chActionText), "Check 50ms Task Counter from Core2 "); 
  snprintf( chExpectedText, elCount(chExpectedText), "50ms Counter from Core2 is   incrementing"); 
  TestStepAddActionExpected( chActionText, chExpectedText );
  A_DBGR_VariableRead( "Task_Core2_50ms_Count", taskvalue);
  E_DBGR_VariableCheck("Task_Core2_50ms_Count", taskvalue, Greater);
  
  snprintf( chActionText, elCount(chActionText), "Check 100ms Task Counter from Core2 "); 
  snprintf( chExpectedText, elCount(chExpectedText), "100ms Counter from Core2 is   incrementing"); 
  TestStepAddActionExpected( chActionText, chExpectedText );
  A_DBGR_VariableRead( "Task_Core2_100ms_Count", taskvalue);
  E_DBGR_VariableCheck("Task_Core2_100ms_Count", taskvalue, Greater); 
  
  snprintf( chActionText, elCount(chActionText), "Check 250ms Task Counter from Core2 "); 
  snprintf( chExpectedText, elCount(chExpectedText), "250ms Counter from Core2 is   incrementing"); 
  TestStepAddActionExpected( chActionText, chExpectedText );
  A_DBGR_VariableRead( "Task_Core2_250ms_Count", taskvalue);
  E_DBGR_VariableCheck("Task_Core2_250ms_Count", taskvalue, Greater);

  snprintf( chActionText, elCount(chActionText), "Check 500ms Task Counter from Core2 "); 
  snprintf( chExpectedText, elCount(chExpectedText), "500ms Counter from Core2 is   incrementing"); 
  TestStepAddActionExpected( chActionText, chExpectedText );
  A_DBGR_VariableRead( "Task_Core2_500ms_Count", taskvalue);
  E_DBGR_VariableCheck("Task_Core2_500ms_Count", taskvalue, Greater);

  snprintf( chActionText, elCount(chActionText), "Check 1000ms Task Counter from Core2 "); 
  snprintf( chExpectedText, elCount(chExpectedText), "1000ms Counter from Core2 is   incrementing"); 
  TestStepAddActionExpected( chActionText, chExpectedText );
  A_DBGR_VariableRead( "Task_Core2_1000ms_Count", taskvalue);
  E_DBGR_VariableCheck("Task_Core2_1000ms_Count", taskvalue, Greater);
  
  
    //Check All tasks of Core3 are stopped
  snprintf( chActionText, elCount(chActionText), "Check 2pt5ms Task Counter from Core3 "); 
  snprintf( chExpectedText, elCount(chExpectedText), "2pt5ms Counter from Core3 is  incrementing"); 
  TestStepAddActionExpected( chActionText, chExpectedText );
  A_DBGR_VariableRead( "Task_Core3_2pt5ms_Count", taskvalue);
  E_DBGR_VariableCheck("Task_Core3_2pt5ms_Count", taskvalue, Greater);
  
   snprintf( chActionText, elCount(chActionText), "Check 5ms Task Counter from Core3 "); 
  snprintf( chExpectedText, elCount(chExpectedText), "5ms Counter from Core3 is  incrementing"); 
  TestStepAddActionExpected( chActionText, chExpectedText );
  A_DBGR_VariableRead( "Task_Core3_5ms_Count", taskvalue);
  E_DBGR_VariableCheck("Task_Core3_5ms_Count", taskvalue, Greater);
  
  snprintf( chActionText, elCount(chActionText), "Check 10ms Task Counter from Core3 "); 
  snprintf( chExpectedText, elCount(chExpectedText), "10ms Counter from Core3 is   incrementing"); 
  TestStepAddActionExpected( chActionText, chExpectedText );
  A_DBGR_VariableRead( "Task_Core3_10ms_Count", taskvalue);
  E_DBGR_VariableCheck("Task_Core3_10ms_Count", taskvalue, Greater);  
  
  snprintf( chActionText, elCount(chActionText), "Check 25ms Task Counter from Core3 "); 
  snprintf( chExpectedText, elCount(chExpectedText), "25ms Counter from Core3 is incrementing"); 
  TestStepAddActionExpected( chActionText, chExpectedText );
  A_DBGR_VariableRead( "Task_Core3_25ms_Count", taskvalue);
  E_DBGR_VariableCheck("Task_Core3_25ms_Count", taskvalue, Greater);  
  
  snprintf( chActionText, elCount(chActionText), "Check 50ms Task Counter from Core3 "); 
  snprintf( chExpectedText, elCount(chExpectedText), "50ms Counter from Core3 is incrementing"); 
  TestStepAddActionExpected( chActionText, chExpectedText );
  A_DBGR_VariableRead( "Task_Core3_50ms_Count", taskvalue);
  E_DBGR_VariableCheck("Task_Core3_50ms_Count", taskvalue, Greater);

  snprintf( chActionText, elCount(chActionText), "Check 100ms Task Counter from Core3 "); 
  snprintf( chExpectedText, elCount(chExpectedText), "100ms Counter from Core3 is incrementing"); 
  TestStepAddActionExpected( chActionText, chExpectedText );
  A_DBGR_VariableRead( "Task_Core3_100ms_Count", taskvalue);
  E_DBGR_VariableCheck("Task_Core3_100ms_Count", taskvalue, Greater); 
  
  snprintf( chActionText, elCount(chActionText), "Check 250ms Task Counter from Core3 "); 
  snprintf( chExpectedText, elCount(chExpectedText), "250ms Counter from Core3 is incrementing"); 
  TestStepAddActionExpected( chActionText, chExpectedText );
  A_DBGR_VariableRead( "Task_Core3_250ms_Count", taskvalue);
  E_DBGR_VariableCheck("Task_Core3_250ms_Count", taskvalue, Greater);
  
  snprintf( chActionText, elCount(chActionText), "Check 500ms Task Counter from Core3 "); 
  snprintf( chExpectedText, elCount(chExpectedText), "500ms Counter from Core3 is stop incrementing"); 
  TestStepAddActionExpected( chActionText, chExpectedText );
  A_DBGR_VariableRead( "Task_Core3_500ms_Count", taskvalue);
  E_DBGR_VariableCheck("Task_Core3_500ms_Count", taskvalue, Greater);
  
  snprintf( chActionText, elCount(chActionText), "Check 1000ms Task Counter from Core3 "); 
  snprintf( chExpectedText, elCount(chExpectedText), "1000ms Counter from Core3 is incrementing"); 
  TestStepAddActionExpected( chActionText, chExpectedText );
  A_DBGR_VariableRead( "Task_Core3_1000ms_Count", taskvalue);
  E_DBGR_VariableCheck("Task_Core3_1000ms_Count", taskvalue, Greater);
  
    //Check task from Core4 is stopped
  snprintf( chActionText, elCount(chActionText), "Check 1000ms Task Counter from Core4 "); 
  snprintf( chExpectedText, elCount(chExpectedText), "1000ms Counter from Core4 is stop incrementing"); 
  TestStepAddActionExpected( chActionText, chExpectedText );
  A_DBGR_VariableRead( "Task_Core4_1000ms_Count", taskvalue);
  E_DBGR_VariableCheck("Task_Core4_1000ms_Count", taskvalue, Equal);
    
  //Check task from Core5 is running
  snprintf( chActionText, elCount(chActionText), "Check 1000ms Task Counter from Core5 "); 
  snprintf( chExpectedText, elCount(chExpectedText), "1000ms Counter from Core5 is  incrementing"); 
  TestStepAddActionExpected( chActionText, chExpectedText );
  A_DBGR_VariableRead( "Task_Core5_1000ms_Count", taskvalue);
  E_DBGR_VariableCheck("Task_Core5_1000ms_Count", taskvalue, Greater);
  
 
  /***************************************************************************************************************/    
                      // Test Step 5: Check  cpuState[4] = CPU_DISABLED
  /***************************************************************************************************************/ 
  
  // Check cpuState for all Cores shall be Enabled except Core4
  
  snprintf( chActionText, elCount(chActionText), "Check cpuState for Core0 "); 
  snprintf( chExpectedText, elCount(chExpectedText), "cpuState for Core0 is Enabled"); 
  TestStepAddActionExpected( chActionText, chExpectedText );
  E_DBGR_VariableCheck("cpuState[0]", 1 , Equal);
  
  snprintf( chActionText, elCount(chActionText), "Check cpuState for Core1 "); 
  snprintf( chExpectedText, elCount(chExpectedText), "cpuState for Core1 is Enabled"); 
  TestStepAddActionExpected( chActionText, chExpectedText );
  E_DBGR_VariableCheck("cpuState[1]", 1 , Equal);
  
  snprintf( chActionText, elCount(chActionText), "Check cpuState for Core2 "); 
  snprintf( chExpectedText, elCount(chExpectedText), "cpuState for Core2 is Enabled"); 
  TestStepAddActionExpected( chActionText, chExpectedText );
  E_DBGR_VariableCheck("cpuState[2]", 1 , Equal); 
  
   snprintf( chActionText, elCount(chActionText), "Check cpuState for Core3 "); 
  snprintf( chExpectedText, elCount(chExpectedText), "cpuState for Core3 is Enabled"); 
  TestStepAddActionExpected( chActionText, chExpectedText );
  E_DBGR_VariableCheck("cpuState[3]", 1 , Equal); 
  
  snprintf( chActionText, elCount(chActionText), "Check cpuState for Core4 "); 
  snprintf( chExpectedText, elCount(chExpectedText), "cpuState for Core4 is Disabled"); 
  TestStepAddActionExpected( chActionText, chExpectedText );
  E_DBGR_VariableCheck("cpuState[4]", 0 , Equal); 
 
  snprintf( chActionText, elCount(chActionText), "Check cpuState for Core5 "); 
  snprintf( chExpectedText, elCount(chExpectedText), "cpuState for Core5 is Enabled"); 
  TestStepAddActionExpected( chActionText, chExpectedText );
  E_DBGR_VariableCheck("cpuState[5]", 1 , Equal);  

}



/***************************************************************************************************
----------------------------------------------------------------------------------------------------
Test case name:  TC_L30SW_Q-36651089: Testcase to verify the functionality of interface GetHWIO_b_CPU_St to check the status after disabling CPU5
----------------------------------------------------------------------------------------------------
Description:   test case to verify the functionality of interface GetHWIO_b_CPU_St to check the status after disabling CPU5

***************************************************************************************************/
testcase Testcase_to_verify_the_functionality_of_interface_GetHWIO_b_CPU_St_to_check_the_status_after_disabling_CPU5()
{
  /***************************************************************************************************************/    
                                                // Variable Definition
  /***************************************************************************************************************/ 
  
  long taskvalue;
  
  /***************************************************************************************************************/    
                                               // Local Values
  /***************************************************************************************************************/ 
  

  
  /***************************************************************************************************************/    
                                              // Test Case Info
  /***************************************************************************************************************/
  setWriteDbgLevel(DebugOff);
  snprintf( chTestTitle, elCount(chTestTitle), "Testcase_to_verify_the_functionality_of_interface_GetHWIO_b_CPU_St_to_check_the_status_after_disabling_CPU5" );
  snprintf( chTestDescription, elCount(chTestDescription), "Purpose: test case to verify the functionality of interface GetHWIO_b_CPU_St to check the status after disabling CPU5");
  TestCaseAddInfo( chTestTitle, "TC_L30SW_Q-36651089", chTestDescription );

  /***************************************************************************************************************/    
                                              // Start of Test Case
  /***************************************************************************************************************/
  
  /***************************************************************************************************************/    
                                              // Test Step 1 PRECONDITIONS
  /***************************************************************************************************************/
  
  snprintf( chActionText, elCount(chActionText), "Flash the Software and ECU is running"); 
  snprintf( chExpectedText, elCount(chExpectedText), "ECU should be in running state"); 
  TestStepAddActionExpected( chActionText, chExpectedText );

  A_DBGR_BreakpointDeleteAll();
  A_DBGR_RnGo();
  E_DBGR_CheckState(T32_State_Running);
  

   /***************************************************************************************************************/    
            // Test Step 2 Check all cores are in running state      
					 // Check cpuState for all Cores = CPU_Enabled                                
  /***************************************************************************************************************/
  
  //Check Core0 is running
  snprintf( chActionText, elCount(chActionText), "Check 1000ms Task Counter from Core0 "); 
  snprintf( chExpectedText, elCount(chExpectedText), "1000ms Counter from Core0 is incrementing"); 
  TestStepAddActionExpected( chActionText, chExpectedText );
  A_DBGR_VariableRead( "Task_Core0_1000ms_Count", taskvalue);
  E_DBGR_VariableCheck("Task_Core0_1000ms_Count", taskvalue, Greater);
  
  //Check Core1 is running
  snprintf( chActionText, elCount(chActionText), "Check 1000ms Task Counter from Core1 "); 
  snprintf( chExpectedText, elCount(chExpectedText), "1000ms Counter from Core1 is incrementing"); 
  TestStepAddActionExpected( chActionText, chExpectedText );
  A_DBGR_VariableRead( "Task_Core1_1000ms_Count", taskvalue);
  E_DBGR_VariableCheck("Task_Core1_1000ms_Count", taskvalue, Greater);
  
  //Check Core2 is running
  snprintf( chActionText, elCount(chActionText), "Check 1000ms Task Counter from Core2 "); 
  snprintf( chExpectedText, elCount(chExpectedText), "1000ms Counter from Core2 is incrementing"); 
  TestStepAddActionExpected( chActionText, chExpectedText );
  A_DBGR_VariableRead( "Task_Core2_1000ms_Count", taskvalue);
  E_DBGR_VariableCheck("Task_Core2_1000ms_Count", taskvalue, Greater);
    
  //Check Core3 is running
  snprintf( chActionText, elCount(chActionText), "Check 1000ms Task Counter from Core3 "); 
  snprintf( chExpectedText, elCount(chExpectedText), "1000ms Counter from Core3 is incrementing"); 
  TestStepAddActionExpected( chActionText, chExpectedText );
  A_DBGR_VariableRead( "Task_Core3_1000ms_Count", taskvalue);
  E_DBGR_VariableCheck("Task_Core3_1000ms_Count", taskvalue, Greater);
    
  //Check Core4 is running
  snprintf( chActionText, elCount(chActionText), "Check 1000ms Task Counter from Core4 "); 
  snprintf( chExpectedText, elCount(chExpectedText), "1000ms Counter from Core4 is incrementing"); 
  TestStepAddActionExpected( chActionText, chExpectedText );
  A_DBGR_VariableRead( "Task_Core4_1000ms_Count", taskvalue);
  E_DBGR_VariableCheck("Task_Core4_1000ms_Count", taskvalue, Greater);
    
  //Check Core5 is running
  snprintf( chActionText, elCount(chActionText), "Check 1000ms Task Counter from Core5 "); 
  snprintf( chExpectedText, elCount(chExpectedText), "1000ms Counter from Core5 is incrementing"); 
  TestStepAddActionExpected( chActionText, chExpectedText );
  A_DBGR_VariableRead( "Task_Core5_1000ms_Count", taskvalue);
  E_DBGR_VariableCheck("Task_Core5_1000ms_Count", taskvalue, Greater);
  
  
  //CPUState cpuState for all Cores shall be Enabled
  snprintf( chActionText, elCount(chActionText), "Check cpuState for Core0 "); 
  snprintf( chExpectedText, elCount(chExpectedText), "cpuState for Core0 is Enabled"); 
  TestStepAddActionExpected( chActionText, chExpectedText );
  E_DBGR_VariableCheck("cpuState[0]", 1 , Equal);
  
  snprintf( chActionText, elCount(chActionText), "Check cpuState for Core1 "); 
  snprintf( chExpectedText, elCount(chExpectedText), "cpuState for Core1 is Enabled"); 
  TestStepAddActionExpected( chActionText, chExpectedText );
  E_DBGR_VariableCheck("cpuState[1]", 1 , Equal);
  
  snprintf( chActionText, elCount(chActionText), "Check cpuState for Core2 "); 
  snprintf( chExpectedText, elCount(chExpectedText), "cpuState for Core2 is Enabled"); 
  TestStepAddActionExpected( chActionText, chExpectedText );
  E_DBGR_VariableCheck("cpuState[2]", 1 , Equal); 
  
   snprintf( chActionText, elCount(chActionText), "Check cpuState for Core3 "); 
  snprintf( chExpectedText, elCount(chExpectedText), "cpuState for Core3 is Enabled"); 
  TestStepAddActionExpected( chActionText, chExpectedText );
  E_DBGR_VariableCheck("cpuState[3]", 1 , Equal); 
  
  snprintf( chActionText, elCount(chActionText), "Check cpuState for Core4 "); 
  snprintf( chExpectedText, elCount(chExpectedText), "cpuState for Core4 is Enabled"); 
  TestStepAddActionExpected( chActionText, chExpectedText );
  E_DBGR_VariableCheck("cpuState[4]", 1 , Equal); 
 
  snprintf( chActionText, elCount(chActionText), "Check cpuState for Core5 "); 
  snprintf( chExpectedText, elCount(chExpectedText), "cpuState for Core5 is Enabled"); 
  TestStepAddActionExpected( chActionText, chExpectedText );
  E_DBGR_VariableCheck("cpuState[5]", 1 , Equal);  
  
  
  /***************************************************************************************************************/    
    // Test Step 3: Disable CPU Core 5 with interface disableCPU[5] = TRUE
  /***************************************************************************************************************/

  snprintf( chActionText, elCount(chActionText), "Disable core 5 tasks"); 
  snprintf( chExpectedText, elCount(chExpectedText), "core 5 disabled"); 
  TestStepAddActionExpected( chActionText, chExpectedText );
  A_DBGR_VariableSet("disableCpu[5]", "1");
  E_DBGR_VariableCheck("disableCpu[5]", 1, Equal);  
  
  /***************************************************************************************************************/    
     // Test Step 4: Check all cores are in running state except Core5
  /***************************************************************************************************************/
  
  //Check All tasks of Core0 are Running
  snprintf( chActionText, elCount(chActionText), "Check 2pt5ms Task Counter from Core0 "); 
  snprintf( chExpectedText, elCount(chExpectedText), "2pt5ms Counter from Core0 is  incrementing"); 
  TestStepAddActionExpected( chActionText, chExpectedText );
  A_DBGR_VariableRead( "Task_Core0_2pt5ms_Count", taskvalue);
  E_DBGR_VariableCheck("Task_Core0_2pt5ms_Count", taskvalue, Greater);
  
  snprintf( chActionText, elCount(chActionText), "Check 5ms Task Counter from Core0 "); 
  snprintf( chExpectedText, elCount(chExpectedText), "5ms Counter from Core0 is  incrementing"); 
  TestStepAddActionExpected( chActionText, chExpectedText );
  A_DBGR_VariableRead( "Task_Core0_5ms_Count", taskvalue);
  E_DBGR_VariableCheck("Task_Core0_5ms_Count", taskvalue, Greater);
  
  snprintf( chActionText, elCount(chActionText), "Check 10ms Task Counter from Core0 "); 
  snprintf( chExpectedText, elCount(chExpectedText), "10ms Counter from Core0 is  incrementing"); 
  TestStepAddActionExpected( chActionText, chExpectedText );
  A_DBGR_VariableRead( "Task_Core0_10ms_Count", taskvalue);
  E_DBGR_VariableCheck("Task_Core0_10ms_Count", taskvalue, Greater);  
  
  snprintf( chActionText, elCount(chActionText), "Check 25ms Task Counter from Core0 "); 
  snprintf( chExpectedText, elCount(chExpectedText), "25ms Counter from Core0 is  incrementing"); 
  TestStepAddActionExpected( chActionText, chExpectedText );
  A_DBGR_VariableRead( "Task_Core0_25ms_Count", taskvalue);
  E_DBGR_VariableCheck("Task_Core0_25ms_Count", taskvalue, Greater);  

  snprintf( chActionText, elCount(chActionText), "Check 50ms Task Counter from Core0 "); 
  snprintf( chExpectedText, elCount(chExpectedText), "50ms Counter from Core0 is  incrementing"); 
  TestStepAddActionExpected( chActionText, chExpectedText );
  A_DBGR_VariableRead( "Task_Core0_50ms_Count", taskvalue);
  E_DBGR_VariableCheck("Task_Core0_50ms_Count", taskvalue, Greater);
  
  snprintf( chActionText, elCount(chActionText), "Check 250ms Task Counter from Core0 "); 
  snprintf( chExpectedText, elCount(chExpectedText), "250ms Counter from Core0 is  incrementing"); 
  TestStepAddActionExpected( chActionText, chExpectedText );
  A_DBGR_VariableRead( "Task_Core0_250ms_Count", taskvalue);
  E_DBGR_VariableCheck("Task_Core0_250ms_Count", taskvalue, Greater);
  
  snprintf( chActionText, elCount(chActionText), "Check 100ms Task Counter from Core0 "); 
  snprintf( chExpectedText, elCount(chExpectedText), "100ms Counter from Core0 is  incrementing"); 
  TestStepAddActionExpected( chActionText, chExpectedText );
  A_DBGR_VariableRead( "Task_Core0_100ms_Count", taskvalue);
  E_DBGR_VariableCheck("Task_Core0_100ms_Count", taskvalue, Greater); 

  snprintf( chActionText, elCount(chActionText), "Check 500ms Task Counter from Core0 "); 
  snprintf( chExpectedText, elCount(chExpectedText), "500ms Counter from Core0 is  incrementing"); 
  TestStepAddActionExpected( chActionText, chExpectedText );
  A_DBGR_VariableRead( "Task_Core0_500ms_Count", taskvalue);
  E_DBGR_VariableCheck("Task_Core0_500ms_Count", taskvalue, Greater);
  
  snprintf( chActionText, elCount(chActionText), "Check 1000ms Task Counter from Core0 "); 
  snprintf( chExpectedText, elCount(chExpectedText), "1000ms Counter from Core0 is  incrementing"); 
  TestStepAddActionExpected( chActionText, chExpectedText );
  A_DBGR_VariableRead( "Task_Core0_1000ms_Count", taskvalue);
  E_DBGR_VariableCheck("Task_Core0_1000ms_Count", taskvalue, Greater);
  
  
  //Check All tasks of Core1 are Running
  snprintf( chActionText, elCount(chActionText), "Check 2pt5ms Task Counter from Core1 "); 
  snprintf( chExpectedText, elCount(chExpectedText), "2pt5ms Counter from Core1 is  incrementing"); 
  TestStepAddActionExpected( chActionText, chExpectedText );
  A_DBGR_VariableRead( "Task_Core1_2pt5ms_Count", taskvalue);
  E_DBGR_VariableCheck("Task_Core1_2pt5ms_Count", taskvalue, Greater);
  
  snprintf( chActionText, elCount(chActionText), "Check 5ms Task Counter from Core1 "); 
  snprintf( chExpectedText, elCount(chExpectedText), "5ms Counter from Core1 is  incrementing"); 
  TestStepAddActionExpected( chActionText, chExpectedText );
  A_DBGR_VariableRead( "Task_Core1_5ms_Count", taskvalue);
  E_DBGR_VariableCheck("Task_Core1_5ms_Count", taskvalue, Greater);
  
  snprintf( chActionText, elCount(chActionText), "Check 10ms Task Counter from Core1 "); 
  snprintf( chExpectedText, elCount(chExpectedText), "10ms Counter from Core1 is  incrementing"); 
  TestStepAddActionExpected( chActionText, chExpectedText );
  A_DBGR_VariableRead( "Task_Core1_10ms_Count", taskvalue);
  E_DBGR_VariableCheck("Task_Core1_10ms_Count", taskvalue, Greater);  
  
  snprintf( chActionText, elCount(chActionText), "Check 25ms Task Counter from Core1 "); 
  snprintf( chExpectedText, elCount(chExpectedText), "25ms Counter from Core1 is  incrementing"); 
  TestStepAddActionExpected( chActionText, chExpectedText );
  A_DBGR_VariableRead( "Task_Core1_25ms_Count", taskvalue);
  E_DBGR_VariableCheck("Task_Core1_25ms_Count", taskvalue, Greater); 
  
  snprintf( chActionText, elCount(chActionText), "Check 50ms Task Counter from Core1 "); 
  snprintf( chExpectedText, elCount(chExpectedText), "50ms Counter from Core1 is  incrementing"); 
  TestStepAddActionExpected( chActionText, chExpectedText );
  A_DBGR_VariableRead( "Task_Core1_50ms_Count", taskvalue);
  E_DBGR_VariableCheck("Task_Core1_50ms_Count", taskvalue, Greater);
    
  snprintf( chActionText, elCount(chActionText), "Check 100ms Task Counter from Core1 "); 
  snprintf( chExpectedText, elCount(chExpectedText), "100ms Counter from Core1 is  incrementing"); 
  TestStepAddActionExpected( chActionText, chExpectedText );
  A_DBGR_VariableRead( "Task_Core1_100ms_Count", taskvalue);
  E_DBGR_VariableCheck("Task_Core1_100ms_Count", taskvalue, Greater);

  snprintf( chActionText, elCount(chActionText), "Check 250ms Task Counter from Core1 "); 
  snprintf( chExpectedText, elCount(chExpectedText), "250ms Counter from Core1 is  incrementing"); 
  TestStepAddActionExpected( chActionText, chExpectedText );
  A_DBGR_VariableRead( "Task_Core1_250ms_Count", taskvalue);
  E_DBGR_VariableCheck("Task_Core1_250ms_Count", taskvalue, Greater);
  
  snprintf( chActionText, elCount(chActionText), "Check 500ms Task Counter from Core1 "); 
  snprintf( chExpectedText, elCount(chExpectedText), "500ms Counter from Core1 is  incrementing"); 
  TestStepAddActionExpected( chActionText, chExpectedText );
  A_DBGR_VariableRead( "Task_Core1_500ms_Count", taskvalue);
  E_DBGR_VariableCheck("Task_Core1_500ms_Count", taskvalue, Greater);

  snprintf( chActionText, elCount(chActionText), "Check 1000ms Task Counter from Core1 "); 
  snprintf( chExpectedText, elCount(chExpectedText), "1000ms Counter from Core1 is stop incrementing"); 
  TestStepAddActionExpected( chActionText, chExpectedText );
  A_DBGR_VariableRead( "Task_Core1_1000ms_Count", taskvalue);
  E_DBGR_VariableCheck("Task_Core1_1000ms_Count", taskvalue, Greater);
  
  
  //Check All tasks of Core2 are Running
  snprintf( chActionText, elCount(chActionText), "Check 2pt5ms Task Counter from Core2 "); 
  snprintf( chExpectedText, elCount(chExpectedText), "2pt5ms Counter from Core2 is   incrementing"); 
  TestStepAddActionExpected( chActionText, chExpectedText );
  A_DBGR_VariableRead( "Task_Core2_2pt5ms_Count", taskvalue);
  E_DBGR_VariableCheck("Task_Core2_2pt5ms_Count", taskvalue, Greater);
  
  snprintf( chActionText, elCount(chActionText), "Check 5ms Task Counter from Core2 "); 
  snprintf( chExpectedText, elCount(chExpectedText), "5ms Counter from Core2 is   incrementing"); 
  TestStepAddActionExpected( chActionText, chExpectedText );
  A_DBGR_VariableRead( "Task_Core2_5ms_Count", taskvalue);
  E_DBGR_VariableCheck("Task_Core2_5ms_Count", taskvalue, Greater);
  
  snprintf( chActionText, elCount(chActionText), "Check 10ms Task Counter from Core2 "); 
  snprintf( chExpectedText, elCount(chExpectedText), "10ms Counter from Core2 is   incrementing"); 
  TestStepAddActionExpected( chActionText, chExpectedText );
  A_DBGR_VariableRead( "Task_Core2_10ms_Count", taskvalue);
  E_DBGR_VariableCheck("Task_Core2_10ms_Count", taskvalue, Greater);  
  
  snprintf( chActionText, elCount(chActionText), "Check 25ms Task Counter from Core2 "); 
  snprintf( chExpectedText, elCount(chExpectedText), "25ms Counter from Core2 is   incrementing"); 
  TestStepAddActionExpected( chActionText, chExpectedText );
  A_DBGR_VariableRead( "Task_Core2_25ms_Count", taskvalue);
  E_DBGR_VariableCheck("Task_Core2_25ms_Count", taskvalue, Greater); 

  snprintf( chActionText, elCount(chActionText), "Check 50ms Task Counter from Core2 "); 
  snprintf( chExpectedText, elCount(chExpectedText), "50ms Counter from Core2 is   incrementing"); 
  TestStepAddActionExpected( chActionText, chExpectedText );
  A_DBGR_VariableRead( "Task_Core2_50ms_Count", taskvalue);
  E_DBGR_VariableCheck("Task_Core2_50ms_Count", taskvalue, Greater);
  
  snprintf( chActionText, elCount(chActionText), "Check 100ms Task Counter from Core2 "); 
  snprintf( chExpectedText, elCount(chExpectedText), "100ms Counter from Core2 is   incrementing"); 
  TestStepAddActionExpected( chActionText, chExpectedText );
  A_DBGR_VariableRead( "Task_Core2_100ms_Count", taskvalue);
  E_DBGR_VariableCheck("Task_Core2_100ms_Count", taskvalue, Greater); 
  
  snprintf( chActionText, elCount(chActionText), "Check 250ms Task Counter from Core2 "); 
  snprintf( chExpectedText, elCount(chExpectedText), "250ms Counter from Core2 is   incrementing"); 
  TestStepAddActionExpected( chActionText, chExpectedText );
  A_DBGR_VariableRead( "Task_Core2_250ms_Count", taskvalue);
  E_DBGR_VariableCheck("Task_Core2_250ms_Count", taskvalue, Greater);

  snprintf( chActionText, elCount(chActionText), "Check 500ms Task Counter from Core2 "); 
  snprintf( chExpectedText, elCount(chExpectedText), "500ms Counter from Core2 is   incrementing"); 
  TestStepAddActionExpected( chActionText, chExpectedText );
  A_DBGR_VariableRead( "Task_Core2_500ms_Count", taskvalue);
  E_DBGR_VariableCheck("Task_Core2_500ms_Count", taskvalue, Greater);

  snprintf( chActionText, elCount(chActionText), "Check 1000ms Task Counter from Core2 "); 
  snprintf( chExpectedText, elCount(chExpectedText), "1000ms Counter from Core2 is   incrementing"); 
  TestStepAddActionExpected( chActionText, chExpectedText );
  A_DBGR_VariableRead( "Task_Core2_1000ms_Count", taskvalue);
  E_DBGR_VariableCheck("Task_Core2_1000ms_Count", taskvalue, Greater);
  
  
    //Check All tasks of Core3 are stopped
  snprintf( chActionText, elCount(chActionText), "Check 2pt5ms Task Counter from Core3 "); 
  snprintf( chExpectedText, elCount(chExpectedText), "2pt5ms Counter from Core3 is  incrementing"); 
  TestStepAddActionExpected( chActionText, chExpectedText );
  A_DBGR_VariableRead( "Task_Core3_2pt5ms_Count", taskvalue);
  E_DBGR_VariableCheck("Task_Core3_2pt5ms_Count", taskvalue, Greater);
  
   snprintf( chActionText, elCount(chActionText), "Check 5ms Task Counter from Core3 "); 
  snprintf( chExpectedText, elCount(chExpectedText), "5ms Counter from Core3 is  incrementing"); 
  TestStepAddActionExpected( chActionText, chExpectedText );
  A_DBGR_VariableRead( "Task_Core3_5ms_Count", taskvalue);
  E_DBGR_VariableCheck("Task_Core3_5ms_Count", taskvalue, Greater);
  
  snprintf( chActionText, elCount(chActionText), "Check 10ms Task Counter from Core3 "); 
  snprintf( chExpectedText, elCount(chExpectedText), "10ms Counter from Core3 is   incrementing"); 
  TestStepAddActionExpected( chActionText, chExpectedText );
  A_DBGR_VariableRead( "Task_Core3_10ms_Count", taskvalue);
  E_DBGR_VariableCheck("Task_Core3_10ms_Count", taskvalue, Greater);  
  
  snprintf( chActionText, elCount(chActionText), "Check 25ms Task Counter from Core3 "); 
  snprintf( chExpectedText, elCount(chExpectedText), "25ms Counter from Core3 is incrementing"); 
  TestStepAddActionExpected( chActionText, chExpectedText );
  A_DBGR_VariableRead( "Task_Core3_25ms_Count", taskvalue);
  E_DBGR_VariableCheck("Task_Core3_25ms_Count", taskvalue, Greater);  
  
  snprintf( chActionText, elCount(chActionText), "Check 50ms Task Counter from Core3 "); 
  snprintf( chExpectedText, elCount(chExpectedText), "50ms Counter from Core3 is incrementing"); 
  TestStepAddActionExpected( chActionText, chExpectedText );
  A_DBGR_VariableRead( "Task_Core3_50ms_Count", taskvalue);
  E_DBGR_VariableCheck("Task_Core3_50ms_Count", taskvalue, Greater);

  snprintf( chActionText, elCount(chActionText), "Check 100ms Task Counter from Core3 "); 
  snprintf( chExpectedText, elCount(chExpectedText), "100ms Counter from Core3 is incrementing"); 
  TestStepAddActionExpected( chActionText, chExpectedText );
  A_DBGR_VariableRead( "Task_Core3_100ms_Count", taskvalue);
  E_DBGR_VariableCheck("Task_Core3_100ms_Count", taskvalue, Greater); 
  
  snprintf( chActionText, elCount(chActionText), "Check 250ms Task Counter from Core3 "); 
  snprintf( chExpectedText, elCount(chExpectedText), "250ms Counter from Core3 is incrementing"); 
  TestStepAddActionExpected( chActionText, chExpectedText );
  A_DBGR_VariableRead( "Task_Core3_250ms_Count", taskvalue);
  E_DBGR_VariableCheck("Task_Core3_250ms_Count", taskvalue, Greater);
  
  snprintf( chActionText, elCount(chActionText), "Check 500ms Task Counter from Core3 "); 
  snprintf( chExpectedText, elCount(chExpectedText), "500ms Counter from Core3 is stop incrementing"); 
  TestStepAddActionExpected( chActionText, chExpectedText );
  A_DBGR_VariableRead( "Task_Core3_500ms_Count", taskvalue);
  E_DBGR_VariableCheck("Task_Core3_500ms_Count", taskvalue, Greater);
  
  snprintf( chActionText, elCount(chActionText), "Check 1000ms Task Counter from Core3 "); 
  snprintf( chExpectedText, elCount(chExpectedText), "1000ms Counter from Core3 is incrementing"); 
  TestStepAddActionExpected( chActionText, chExpectedText );
  A_DBGR_VariableRead( "Task_Core3_1000ms_Count", taskvalue);
  E_DBGR_VariableCheck("Task_Core3_1000ms_Count", taskvalue, Greater);
  
    //Check task from Core4 is running
  snprintf( chActionText, elCount(chActionText), "Check 1000ms Task Counter from Core4 "); 
  snprintf( chExpectedText, elCount(chExpectedText), "1000ms Counter from Core4 is incrementing"); 
  TestStepAddActionExpected( chActionText, chExpectedText );
  A_DBGR_VariableRead( "Task_Core4_1000ms_Count", taskvalue);
  E_DBGR_VariableCheck("Task_Core4_1000ms_Count", taskvalue, Greater);
    
  //Check task from Core5 is stopped
  snprintf( chActionText, elCount(chActionText), "Check 1000ms Task Counter from Core5 "); 
  snprintf( chExpectedText, elCount(chExpectedText), "1000ms Counter from Core5 is stop incrementing"); 
  TestStepAddActionExpected( chActionText, chExpectedText );
  A_DBGR_VariableRead( "Task_Core5_1000ms_Count", taskvalue);
  E_DBGR_VariableCheck("Task_Core5_1000ms_Count", taskvalue, Equal);
  
 
  /***************************************************************************************************************/    
                      // Test Step 5: Check  cpuState[5] = CPU_DISABLED
  /***************************************************************************************************************/ 
  
  // Check cpuState for all Cores shall be Enabled except Core5
  
  snprintf( chActionText, elCount(chActionText), "Check cpuState for Core0 "); 
  snprintf( chExpectedText, elCount(chExpectedText), "cpuState for Core0 is Enabled"); 
  TestStepAddActionExpected( chActionText, chExpectedText );
  E_DBGR_VariableCheck("cpuState[0]", 1 , Equal);
  
  snprintf( chActionText, elCount(chActionText), "Check cpuState for Core1 "); 
  snprintf( chExpectedText, elCount(chExpectedText), "cpuState for Core1 is Enabled"); 
  TestStepAddActionExpected( chActionText, chExpectedText );
  E_DBGR_VariableCheck("cpuState[1]", 1 , Equal);
  
  snprintf( chActionText, elCount(chActionText), "Check cpuState for Core2 "); 
  snprintf( chExpectedText, elCount(chExpectedText), "cpuState for Core2 is Enabled"); 
  TestStepAddActionExpected( chActionText, chExpectedText );
  E_DBGR_VariableCheck("cpuState[2]", 1 , Equal); 
  
   snprintf( chActionText, elCount(chActionText), "Check cpuState for Core3 "); 
  snprintf( chExpectedText, elCount(chExpectedText), "cpuState for Core3 is Enabled"); 
  TestStepAddActionExpected( chActionText, chExpectedText );
  E_DBGR_VariableCheck("cpuState[3]", 1 , Equal); 
  
  snprintf( chActionText, elCount(chActionText), "Check cpuState for Core4 "); 
  snprintf( chExpectedText, elCount(chExpectedText), "cpuState for Core4 is Enabled"); 
  TestStepAddActionExpected( chActionText, chExpectedText );
  E_DBGR_VariableCheck("cpuState[4]", 1 , Equal); 
 
  snprintf( chActionText, elCount(chActionText), "Check cpuState for Core5 "); 
  snprintf( chExpectedText, elCount(chExpectedText), "cpuState for Core5 is Disabled"); 
  TestStepAddActionExpected( chActionText, chExpectedText );
  E_DBGR_VariableCheck("cpuState[5]", 0 , Equal);  

}


/***************************************************************************************************
----------------------------------------------------------------------------------------------------
Test case name:  TC_L30SW_Q-36651184: Testcase to verify the functionality of interface TeHWIO_e_OS_Task GetHWIO_e_TaskID( void )() to check the task_id for CPU0 task.
----------------------------------------------------------------------------------------------------
Description:   test case to verify the functionality of interface TeHWIO_e_OS_Task GetHWIO_e_TaskID( void )() to check the task_id for CPU0 task.

***************************************************************************************************/
testcase Testcase_to_verify_the_functionality_of_interface_TeHWIO_e_OS_Task_GetHWIO_e_TaskID_to_check_the_task_id_for_CPU0_task()
{
  /***************************************************************************************************************/    
                                                // Variable Definition
  /***************************************************************************************************************/ 
  
  long taskvalue;
  
  /***************************************************************************************************************/    
                                               // Local Values
  /***************************************************************************************************************/ 
  

  
  /***************************************************************************************************************/    
                                              // Test Case Info
  /***************************************************************************************************************/
  setWriteDbgLevel(DebugOff);
  snprintf( chTestTitle, elCount(chTestTitle), "Testcase_to_verify_the_functionality_of_interface_TeHWIO_e_OS_Task_GetHWIO_e_TaskID_to_check_the_task_id_for_CPU0_task" );
  snprintf( chTestDescription, elCount(chTestDescription), "Purpose: Testcase to verify the functionality of interface TeHWIO_e_OS_Task GetHWIO_e_TaskID( void )() to check the task_id for CPU0 task.");
  TestCaseAddInfo( chTestTitle, "TC_L30SW_Q-36651184", chTestDescription );

  /***************************************************************************************************************/    
                                              // Start of Test Case
  /***************************************************************************************************************/
  
  /***************************************************************************************************************/    
                                              // Test Step 1 PRECONDITIONS
  /***************************************************************************************************************/
  
  snprintf( chActionText, elCount(chActionText), "Flash the Software and ECU is running"); 
  snprintf( chExpectedText, elCount(chExpectedText), "ECU should be in running state"); 
  TestStepAddActionExpected( chActionText, chExpectedText );

  A_DBGR_BreakpointDeleteAll();
  A_DBGR_RnGo();
  E_DBGR_CheckState(T32_State_Running);
  

   /***************************************************************************************************************/    
            // Test Step 2: Check all cores are in running state                                   
  /***************************************************************************************************************/
  
  //Check Core0 is running
  snprintf( chActionText, elCount(chActionText), "Check 1000ms Task Counter from Core0 "); 
  snprintf( chExpectedText, elCount(chExpectedText), "1000ms Counter from Core0 is incrementing"); 
  TestStepAddActionExpected( chActionText, chExpectedText );
  A_DBGR_VariableRead( "Task_Core0_1000ms_Count", taskvalue);
  E_DBGR_VariableCheck("Task_Core0_1000ms_Count", taskvalue, Greater);
  
  //Check Core1 is running
  snprintf( chActionText, elCount(chActionText), "Check 1000ms Task Counter from Core1 "); 
  snprintf( chExpectedText, elCount(chExpectedText), "1000ms Counter from Core1 is incrementing"); 
  TestStepAddActionExpected( chActionText, chExpectedText );
  A_DBGR_VariableRead( "Task_Core1_1000ms_Count", taskvalue);
  E_DBGR_VariableCheck("Task_Core1_1000ms_Count", taskvalue, Greater);
  
  //Check Core2 is running
  snprintf( chActionText, elCount(chActionText), "Check 1000ms Task Counter from Core2 "); 
  snprintf( chExpectedText, elCount(chExpectedText), "1000ms Counter from Core2 is incrementing"); 
  TestStepAddActionExpected( chActionText, chExpectedText );
  A_DBGR_VariableRead( "Task_Core2_1000ms_Count", taskvalue);
  E_DBGR_VariableCheck("Task_Core2_1000ms_Count", taskvalue, Greater);
    
  //Check Core3 is running
  snprintf( chActionText, elCount(chActionText), "Check 1000ms Task Counter from Core3 "); 
  snprintf( chExpectedText, elCount(chExpectedText), "1000ms Counter from Core3 is incrementing"); 
  TestStepAddActionExpected( chActionText, chExpectedText );
  A_DBGR_VariableRead( "Task_Core3_1000ms_Count", taskvalue);
  E_DBGR_VariableCheck("Task_Core3_1000ms_Count", taskvalue, Greater);
    
  //Check Core4 is running
  snprintf( chActionText, elCount(chActionText), "Check 1000ms Task Counter from Core4 "); 
  snprintf( chExpectedText, elCount(chExpectedText), "1000ms Counter from Core4 is incrementing"); 
  TestStepAddActionExpected( chActionText, chExpectedText );
  A_DBGR_VariableRead( "Task_Core4_1000ms_Count", taskvalue);
  E_DBGR_VariableCheck("Task_Core4_1000ms_Count", taskvalue, Greater);
    
  //Check Core5 is running
  snprintf( chActionText, elCount(chActionText), "Check 1000ms Task Counter from Core5 "); 
  snprintf( chExpectedText, elCount(chExpectedText), "1000ms Counter from Core5 is incrementing"); 
  TestStepAddActionExpected( chActionText, chExpectedText );
  A_DBGR_VariableRead( "Task_Core5_1000ms_Count", taskvalue);
  E_DBGR_VariableCheck("Task_Core5_1000ms_Count", taskvalue, Greater);
  

  /***************************************************************************************************************/    
    // Test Step 3: Check Running Task ID for Core0
  /***************************************************************************************************************/

  //Task ID for 2.5ms Task for core0
  snprintf( chActionText, elCount(chActionText), "Check Task ID for 2.5ms Task for core0 "); 
  snprintf( chExpectedText, elCount(chExpectedText), "Task ID for 2.5ms Task for core0 shall be 8 "); 
  TestStepAddActionExpected( chActionText, chExpectedText );
  E_DBGR_VariableCheck("core0_task_2_p_5", 8, Equal);  

  //Task ID for 5ms Task for core0
  snprintf( chActionText, elCount(chActionText), "Check Task ID for 5ms Task for core0 "); 
  snprintf( chExpectedText, elCount(chExpectedText), "Task ID for 5ms Task for core0 shall be 7 "); 
  TestStepAddActionExpected( chActionText, chExpectedText );
  E_DBGR_VariableCheck("core0_task_5", 7, Equal);  

  //Task ID for 10ms Task for core0
  snprintf( chActionText, elCount(chActionText), "Check Task ID for 10ms Task for core0 "); 
  snprintf( chExpectedText, elCount(chExpectedText), "Task ID for 10ms Task for core0 shall be 6 "); 
  TestStepAddActionExpected( chActionText, chExpectedText );
  E_DBGR_VariableCheck("core0_task_10", 6, Equal);  

  //Task ID for 25ms Task for core0
  snprintf( chActionText, elCount(chActionText), "Check Task ID for 25ms Task for core0 "); 
  snprintf( chExpectedText, elCount(chExpectedText), "Task ID for 25ms Task for core0 shall be 5 "); 
  TestStepAddActionExpected( chActionText, chExpectedText );
  E_DBGR_VariableCheck("core0_task_25", 5, Equal);  

  //Task ID for 50ms Task for core0
  snprintf( chActionText, elCount(chActionText), "Check Task ID for 50ms Task for core0 "); 
  snprintf( chExpectedText, elCount(chExpectedText), "Task ID for 50ms Task for core0 shall be 4 "); 
  TestStepAddActionExpected( chActionText, chExpectedText );
  E_DBGR_VariableCheck("core0_task_50", 4, Equal);  

  //Task ID for 100ms Task for core0
  snprintf( chActionText, elCount(chActionText), "Check Task ID for 100ms Task for core0 "); 
  snprintf( chExpectedText, elCount(chExpectedText), "Task ID for 100ms Task for core0 shall be 3 "); 
  TestStepAddActionExpected( chActionText, chExpectedText );
  E_DBGR_VariableCheck("core0_task_100", 3, Equal);  

  //Task ID for 250ms Task for core0
  snprintf( chActionText, elCount(chActionText), "Check Task ID for 250ms Task for core0 "); 
  snprintf( chExpectedText, elCount(chExpectedText), "Task ID for 250ms Task for core0 shall be 2 "); 
  TestStepAddActionExpected( chActionText, chExpectedText );
  E_DBGR_VariableCheck("core0_task_250", 2, Equal);  

  //Task ID for 500ms Task for core0
  snprintf( chActionText, elCount(chActionText), "Check Task ID for 500ms Task for core0 "); 
  snprintf( chExpectedText, elCount(chExpectedText), "Task ID for 500ms Task for core0 shall be 1 "); 
  TestStepAddActionExpected( chActionText, chExpectedText );
  E_DBGR_VariableCheck("core0_task_500", 1, Equal);  

  //Task ID for 1000ms Task for core0
  snprintf( chActionText, elCount(chActionText), "Check Task ID for 1000ms Task for core0 "); 
  snprintf( chExpectedText, elCount(chExpectedText), "Task ID for 1000ms Task for core0 shall be 0 "); 
  TestStepAddActionExpected( chActionText, chExpectedText );
  E_DBGR_VariableCheck("core0_task_1000", 0, Equal);    
  
}



/***************************************************************************************************
----------------------------------------------------------------------------------------------------
Test case name:  TC_L30SW_Q-36651179: Testcase to verify the functionality of interface TeHWIO_e_OS_Task GetHWIO_e_TaskID( void )() to check the task_id for CPU1 task.
----------------------------------------------------------------------------------------------------
Description:   test case to verify the functionality of interface TeHWIO_e_OS_Task GetHWIO_e_TaskID( void )() to check the task_id for CPU1 task.

***************************************************************************************************/
testcase Testcase_to_verify_the_functionality_of_interface_TeHWIO_e_OS_Task_GetHWIO_e_TaskID_to_check_the_task_id_for_CPU1_task()
{
  /***************************************************************************************************************/    
                                                // Variable Definition
  /***************************************************************************************************************/ 
  
  long taskvalue;
  
  /***************************************************************************************************************/    
                                               // Local Values
  /***************************************************************************************************************/ 
  

  
  /***************************************************************************************************************/    
                                              // Test Case Info
  /***************************************************************************************************************/
  setWriteDbgLevel(DebugOff);
  snprintf( chTestTitle, elCount(chTestTitle), "Testcase_to_verify_the_functionality_of_interface_TeHWIO_e_OS_Task_GetHWIO_e_TaskID_to_check_the_task_id_for_CPU1_task" );
  snprintf( chTestDescription, elCount(chTestDescription), "Purpose: Testcase to verify the functionality of interface TeHWIO_e_OS_Task GetHWIO_e_TaskID( void )() to check the task_id for CPU1 task.");
  TestCaseAddInfo( chTestTitle, "TC_L30SW_Q-36651179", chTestDescription );

  /***************************************************************************************************************/    
                                              // Start of Test Case
  /***************************************************************************************************************/
  
  /***************************************************************************************************************/    
                                              // Test Step 1 PRECONDITIONS
  /***************************************************************************************************************/
  
  snprintf( chActionText, elCount(chActionText), "Flash the Software and ECU is running"); 
  snprintf( chExpectedText, elCount(chExpectedText), "ECU should be in running state"); 
  TestStepAddActionExpected( chActionText, chExpectedText );

  A_DBGR_BreakpointDeleteAll();
  A_DBGR_RnGo();
  E_DBGR_CheckState(T32_State_Running);
  

   /***************************************************************************************************************/    
            // Test Step 2: Check all cores are in running state                                   
  /***************************************************************************************************************/
  
  //Check Core0 is running
  snprintf( chActionText, elCount(chActionText), "Check 1000ms Task Counter from Core0 "); 
  snprintf( chExpectedText, elCount(chExpectedText), "1000ms Counter from Core0 is incrementing"); 
  TestStepAddActionExpected( chActionText, chExpectedText );
  A_DBGR_VariableRead( "Task_Core0_1000ms_Count", taskvalue);
  E_DBGR_VariableCheck("Task_Core0_1000ms_Count", taskvalue, Greater);
  
  //Check Core1 is running
  snprintf( chActionText, elCount(chActionText), "Check 1000ms Task Counter from Core1 "); 
  snprintf( chExpectedText, elCount(chExpectedText), "1000ms Counter from Core1 is incrementing"); 
  TestStepAddActionExpected( chActionText, chExpectedText );
  A_DBGR_VariableRead( "Task_Core1_1000ms_Count", taskvalue);
  E_DBGR_VariableCheck("Task_Core1_1000ms_Count", taskvalue, Greater);
  
  //Check Core2 is running
  snprintf( chActionText, elCount(chActionText), "Check 1000ms Task Counter from Core2 "); 
  snprintf( chExpectedText, elCount(chExpectedText), "1000ms Counter from Core2 is incrementing"); 
  TestStepAddActionExpected( chActionText, chExpectedText );
  A_DBGR_VariableRead( "Task_Core2_1000ms_Count", taskvalue);
  E_DBGR_VariableCheck("Task_Core2_1000ms_Count", taskvalue, Greater);
    
  //Check Core3 is running
  snprintf( chActionText, elCount(chActionText), "Check 1000ms Task Counter from Core3 "); 
  snprintf( chExpectedText, elCount(chExpectedText), "1000ms Counter from Core3 is incrementing"); 
  TestStepAddActionExpected( chActionText, chExpectedText );
  A_DBGR_VariableRead( "Task_Core3_1000ms_Count", taskvalue);
  E_DBGR_VariableCheck("Task_Core3_1000ms_Count", taskvalue, Greater);
    
  //Check Core4 is running
  snprintf( chActionText, elCount(chActionText), "Check 1000ms Task Counter from Core4 "); 
  snprintf( chExpectedText, elCount(chExpectedText), "1000ms Counter from Core4 is incrementing"); 
  TestStepAddActionExpected( chActionText, chExpectedText );
  A_DBGR_VariableRead( "Task_Core4_1000ms_Count", taskvalue);
  E_DBGR_VariableCheck("Task_Core4_1000ms_Count", taskvalue, Greater);
    
  //Check Core5 is running
  snprintf( chActionText, elCount(chActionText), "Check 1000ms Task Counter from Core5 "); 
  snprintf( chExpectedText, elCount(chExpectedText), "1000ms Counter from Core5 is incrementing"); 
  TestStepAddActionExpected( chActionText, chExpectedText );
  A_DBGR_VariableRead( "Task_Core5_1000ms_Count", taskvalue);
  E_DBGR_VariableCheck("Task_Core5_1000ms_Count", taskvalue, Greater);
  

  /***************************************************************************************************************/    
    // Test Step 3: Check Running Task ID for Core1
  /***************************************************************************************************************/

  //Task ID for 2.5ms Task for core1
  snprintf( chActionText, elCount(chActionText), "Check Task ID for 2.5ms Task for core1 "); 
  snprintf( chExpectedText, elCount(chExpectedText), "Task ID for 2.5ms Task for core1 shall be 8 "); 
  TestStepAddActionExpected( chActionText, chExpectedText );
  E_DBGR_VariableCheck("core1_task_2_p_5", 8, Equal);  

  //Task ID for 5ms Task for core1
  snprintf( chActionText, elCount(chActionText), "Check Task ID for 5ms Task for core1 "); 
  snprintf( chExpectedText, elCount(chExpectedText), "Task ID for 5ms Task for core1 shall be 7 "); 
  TestStepAddActionExpected( chActionText, chExpectedText );
  E_DBGR_VariableCheck("core1_task_5", 7, Equal);  

  //Task ID for 10ms Task for core1
  snprintf( chActionText, elCount(chActionText), "Check Task ID for 10ms Task for core1 "); 
  snprintf( chExpectedText, elCount(chExpectedText), "Task ID for 10ms Task for core1 shall be 6 "); 
  TestStepAddActionExpected( chActionText, chExpectedText );
  E_DBGR_VariableCheck("core1_task_10", 6, Equal);  

  //Task ID for 25ms Task for core1
  snprintf( chActionText, elCount(chActionText), "Check Task ID for 25ms Task for core1 "); 
  snprintf( chExpectedText, elCount(chExpectedText), "Task ID for 25ms Task for core1 shall be 5 "); 
  TestStepAddActionExpected( chActionText, chExpectedText );
  E_DBGR_VariableCheck("core1_task_25", 5, Equal);  

  //Task ID for 50ms Task for core1
  snprintf( chActionText, elCount(chActionText), "Check Task ID for 50ms Task for core1 "); 
  snprintf( chExpectedText, elCount(chExpectedText), "Task ID for 50ms Task for core1 shall be 4 "); 
  TestStepAddActionExpected( chActionText, chExpectedText );
  E_DBGR_VariableCheck("core1_task_50", 4, Equal);  

  //Task ID for 100ms Task for core1
  snprintf( chActionText, elCount(chActionText), "Check Task ID for 100ms Task for core1 "); 
  snprintf( chExpectedText, elCount(chExpectedText), "Task ID for 100ms Task for core1 shall be 3 "); 
  TestStepAddActionExpected( chActionText, chExpectedText );
  E_DBGR_VariableCheck("core1_task_100", 3, Equal);  

  //Task ID for 250ms Task for core1
  snprintf( chActionText, elCount(chActionText), "Check Task ID for 250ms Task for core1 "); 
  snprintf( chExpectedText, elCount(chExpectedText), "Task ID for 250ms Task for core1 shall be 2 "); 
  TestStepAddActionExpected( chActionText, chExpectedText );
  E_DBGR_VariableCheck("core1_task_250", 2, Equal);  

  //Task ID for 500ms Task for core1
  snprintf( chActionText, elCount(chActionText), "Check Task ID for 500ms Task for core1 "); 
  snprintf( chExpectedText, elCount(chExpectedText), "Task ID for 500ms Task for core1 shall be 1 "); 
  TestStepAddActionExpected( chActionText, chExpectedText );
  E_DBGR_VariableCheck("core1_task_500", 1, Equal);  

  //Task ID for 1000ms Task for core1
  snprintf( chActionText, elCount(chActionText), "Check Task ID for 1000ms Task for core1 "); 
  snprintf( chExpectedText, elCount(chExpectedText), "Task ID for 1000ms Task for core1 shall be 0 "); 
  TestStepAddActionExpected( chActionText, chExpectedText );
  E_DBGR_VariableCheck("core1_task_1000", 0, Equal);    
  
}


/***************************************************************************************************
----------------------------------------------------------------------------------------------------
Test case name:  TC_L30SW_Q-36651179: Testcase to verify the functionality of interface TeHWIO_e_OS_Task GetHWIO_e_TaskID( void )() to check the task_id for CPU2 task.
----------------------------------------------------------------------------------------------------
Description:   test case to verify the functionality of interface TeHWIO_e_OS_Task GetHWIO_e_TaskID( void )() to check the task_id for CPU2 task.

***************************************************************************************************/
testcase Testcase_to_verify_the_functionality_of_interface_TeHWIO_e_OS_Task_GetHWIO_e_TaskID_to_check_the_task_id_for_CPU2_task()
{
  /***************************************************************************************************************/    
                                                // Variable Definition
  /***************************************************************************************************************/ 
  
  long taskvalue;
  
  /***************************************************************************************************************/    
                                               // Local Values
  /***************************************************************************************************************/ 
  

  
  /***************************************************************************************************************/    
                                              // Test Case Info
  /***************************************************************************************************************/
  setWriteDbgLevel(DebugOff);
  snprintf( chTestTitle, elCount(chTestTitle), "Testcase_to_verify_the_functionality_of_interface_TeHWIO_e_OS_Task_GetHWIO_e_TaskID_to_check_the_task_id_for_CPU2_task" );
  snprintf( chTestDescription, elCount(chTestDescription), "Purpose: Testcase to verify the functionality of interface TeHWIO_e_OS_Task GetHWIO_e_TaskID( void )() to check the task_id for CPU2 task.");
  TestCaseAddInfo( chTestTitle, "TC_L30SW_Q-36651180", chTestDescription );

  /***************************************************************************************************************/    
                                              // Start of Test Case
  /***************************************************************************************************************/
  
  /***************************************************************************************************************/    
                                              // Test Step 1 PRECONDITIONS
  /***************************************************************************************************************/
  
  snprintf( chActionText, elCount(chActionText), "Flash the Software and ECU is running"); 
  snprintf( chExpectedText, elCount(chExpectedText), "ECU should be in running state"); 
  TestStepAddActionExpected( chActionText, chExpectedText );

  A_DBGR_BreakpointDeleteAll();
  A_DBGR_RnGo();
  E_DBGR_CheckState(T32_State_Running);
  

   /***************************************************************************************************************/    
            // Test Step 2: Check all cores are in running state                                   
  /***************************************************************************************************************/
  
  //Check Core0 is running
  snprintf( chActionText, elCount(chActionText), "Check 1000ms Task Counter from Core0 "); 
  snprintf( chExpectedText, elCount(chExpectedText), "1000ms Counter from Core0 is incrementing"); 
  TestStepAddActionExpected( chActionText, chExpectedText );
  A_DBGR_VariableRead( "Task_Core0_1000ms_Count", taskvalue);
  E_DBGR_VariableCheck("Task_Core0_1000ms_Count", taskvalue, Greater);
  
  //Check Core1 is running
  snprintf( chActionText, elCount(chActionText), "Check 1000ms Task Counter from Core1 "); 
  snprintf( chExpectedText, elCount(chExpectedText), "1000ms Counter from Core1 is incrementing"); 
  TestStepAddActionExpected( chActionText, chExpectedText );
  A_DBGR_VariableRead( "Task_Core1_1000ms_Count", taskvalue);
  E_DBGR_VariableCheck("Task_Core1_1000ms_Count", taskvalue, Greater);
  
  //Check Core2 is running
  snprintf( chActionText, elCount(chActionText), "Check 1000ms Task Counter from Core2 "); 
  snprintf( chExpectedText, elCount(chExpectedText), "1000ms Counter from Core2 is incrementing"); 
  TestStepAddActionExpected( chActionText, chExpectedText );
  A_DBGR_VariableRead( "Task_Core2_1000ms_Count", taskvalue);
  E_DBGR_VariableCheck("Task_Core2_1000ms_Count", taskvalue, Greater);
    
  //Check Core3 is running
  snprintf( chActionText, elCount(chActionText), "Check 1000ms Task Counter from Core3 "); 
  snprintf( chExpectedText, elCount(chExpectedText), "1000ms Counter from Core3 is incrementing"); 
  TestStepAddActionExpected( chActionText, chExpectedText );
  A_DBGR_VariableRead( "Task_Core3_1000ms_Count", taskvalue);
  E_DBGR_VariableCheck("Task_Core3_1000ms_Count", taskvalue, Greater);
    
  //Check Core4 is running
  snprintf( chActionText, elCount(chActionText), "Check 1000ms Task Counter from Core4 "); 
  snprintf( chExpectedText, elCount(chExpectedText), "1000ms Counter from Core4 is incrementing"); 
  TestStepAddActionExpected( chActionText, chExpectedText );
  A_DBGR_VariableRead( "Task_Core4_1000ms_Count", taskvalue);
  E_DBGR_VariableCheck("Task_Core4_1000ms_Count", taskvalue, Greater);
    
  //Check Core5 is running
  snprintf( chActionText, elCount(chActionText), "Check 1000ms Task Counter from Core5 "); 
  snprintf( chExpectedText, elCount(chExpectedText), "1000ms Counter from Core5 is incrementing"); 
  TestStepAddActionExpected( chActionText, chExpectedText );
  A_DBGR_VariableRead( "Task_Core5_1000ms_Count", taskvalue);
  E_DBGR_VariableCheck("Task_Core5_1000ms_Count", taskvalue, Greater);
  

  /***************************************************************************************************************/    
    // Test Step 3: Check Running Task ID for Core2
  /***************************************************************************************************************/

  //Task ID for 2.5ms Task for core2
  snprintf( chActionText, elCount(chActionText), "Check Task ID for 2.5ms Task for core2 "); 
  snprintf( chExpectedText, elCount(chExpectedText), "Task ID for 2.5ms Task for core2 shall be 8 "); 
  TestStepAddActionExpected( chActionText, chExpectedText );
  E_DBGR_VariableCheck("core2_task_2_p_5", 8, Equal);  

  //Task ID for 5ms Task for core2
  snprintf( chActionText, elCount(chActionText), "Check Task ID for 5ms Task for core2 "); 
  snprintf( chExpectedText, elCount(chExpectedText), "Task ID for 5ms Task for core2 shall be 7 "); 
  TestStepAddActionExpected( chActionText, chExpectedText );
  E_DBGR_VariableCheck("core2_task_5", 7, Equal);  

  //Task ID for 10ms Task for core2
  snprintf( chActionText, elCount(chActionText), "Check Task ID for 10ms Task for core2 "); 
  snprintf( chExpectedText, elCount(chExpectedText), "Task ID for 10ms Task for core2 shall be 6 "); 
  TestStepAddActionExpected( chActionText, chExpectedText );
  E_DBGR_VariableCheck("core2_task_10", 6, Equal);  

  //Task ID for 25ms Task for core2
  snprintf( chActionText, elCount(chActionText), "Check Task ID for 25ms Task for core2 "); 
  snprintf( chExpectedText, elCount(chExpectedText), "Task ID for 25ms Task for core2 shall be 5 "); 
  TestStepAddActionExpected( chActionText, chExpectedText );
  E_DBGR_VariableCheck("core2_task_25", 5, Equal);  

  //Task ID for 50ms Task for core2
  snprintf( chActionText, elCount(chActionText), "Check Task ID for 50ms Task for core2 "); 
  snprintf( chExpectedText, elCount(chExpectedText), "Task ID for 50ms Task for core2 shall be 4 "); 
  TestStepAddActionExpected( chActionText, chExpectedText );
  E_DBGR_VariableCheck("core2_task_50", 4, Equal);  

  //Task ID for 100ms Task for core2
  snprintf( chActionText, elCount(chActionText), "Check Task ID for 100ms Task for core2 "); 
  snprintf( chExpectedText, elCount(chExpectedText), "Task ID for 100ms Task for core2 shall be 3 "); 
  TestStepAddActionExpected( chActionText, chExpectedText );
  E_DBGR_VariableCheck("core2_task_100", 3, Equal);  

  //Task ID for 250ms Task for core2
  snprintf( chActionText, elCount(chActionText), "Check Task ID for 250ms Task for core2 "); 
  snprintf( chExpectedText, elCount(chExpectedText), "Task ID for 250ms Task for core2 shall be 2 "); 
  TestStepAddActionExpected( chActionText, chExpectedText );
  E_DBGR_VariableCheck("core2_task_250", 2, Equal);  

  //Task ID for 500ms Task for core2
  snprintf( chActionText, elCount(chActionText), "Check Task ID for 500ms Task for core2 "); 
  snprintf( chExpectedText, elCount(chExpectedText), "Task ID for 500ms Task for core2 shall be 1 "); 
  TestStepAddActionExpected( chActionText, chExpectedText );
  E_DBGR_VariableCheck("core2_task_500", 1, Equal);  

  //Task ID for 1000ms Task for core2
  snprintf( chActionText, elCount(chActionText), "Check Task ID for 1000ms Task for core2 "); 
  snprintf( chExpectedText, elCount(chExpectedText), "Task ID for 1000ms Task for core2 shall be 0 "); 
  TestStepAddActionExpected( chActionText, chExpectedText );
  E_DBGR_VariableCheck("core2_task_1000", 0, Equal);    
  
}


/***************************************************************************************************
----------------------------------------------------------------------------------------------------
Test case name:  TC_L30SW_Q-36651181: Testcase to verify the functionality of interface TeHWIO_e_OS_Task GetHWIO_e_TaskID( void )() to check the task_id for CPU3 task.
----------------------------------------------------------------------------------------------------
Description:   test case to verify the functionality of interface TeHWIO_e_OS_Task GetHWIO_e_TaskID( void )() to check the task_id for CPU3 task.

***************************************************************************************************/
testcase Testcase_to_verify_the_functionality_of_interface_TeHWIO_e_OS_Task_GetHWIO_e_TaskID_to_check_the_task_id_for_CPU3_task()
{
  /***************************************************************************************************************/    
                                                // Variable Definition
  /***************************************************************************************************************/ 
  
  long taskvalue;
  
  /***************************************************************************************************************/    
                                               // Local Values
  /***************************************************************************************************************/ 
  

  
  /***************************************************************************************************************/    
                                              // Test Case Info
  /***************************************************************************************************************/
  setWriteDbgLevel(DebugOff);
  snprintf( chTestTitle, elCount(chTestTitle), "Testcase_to_verify_the_functionality_of_interface_TeHWIO_e_OS_Task_GetHWIO_e_TaskID_to_check_the_task_id_for_CPU3_task" );
  snprintf( chTestDescription, elCount(chTestDescription), "Purpose: Testcase to verify the functionality of interface TeHWIO_e_OS_Task GetHWIO_e_TaskID( void )() to check the task_id for CPU3 task.");
  TestCaseAddInfo( chTestTitle, "TC_L30SW_Q-36651181", chTestDescription );

  /***************************************************************************************************************/    
                                              // Start of Test Case
  /***************************************************************************************************************/
  
  /***************************************************************************************************************/    
                                              // Test Step 1 PRECONDITIONS
  /***************************************************************************************************************/
  
  snprintf( chActionText, elCount(chActionText), "Flash the Software and ECU is running"); 
  snprintf( chExpectedText, elCount(chExpectedText), "ECU should be in running state"); 
  TestStepAddActionExpected( chActionText, chExpectedText );

  A_DBGR_BreakpointDeleteAll();
  A_DBGR_RnGo();
  E_DBGR_CheckState(T32_State_Running);
  

   /***************************************************************************************************************/    
            // Test Step 2: Check all cores are in running state                                   
  /***************************************************************************************************************/
  
  //Check Core0 is running
  snprintf( chActionText, elCount(chActionText), "Check 1000ms Task Counter from Core0 "); 
  snprintf( chExpectedText, elCount(chExpectedText), "1000ms Counter from Core0 is incrementing"); 
  TestStepAddActionExpected( chActionText, chExpectedText );
  A_DBGR_VariableRead( "Task_Core0_1000ms_Count", taskvalue);
  E_DBGR_VariableCheck("Task_Core0_1000ms_Count", taskvalue, Greater);
  
  //Check Core1 is running
  snprintf( chActionText, elCount(chActionText), "Check 1000ms Task Counter from Core1 "); 
  snprintf( chExpectedText, elCount(chExpectedText), "1000ms Counter from Core1 is incrementing"); 
  TestStepAddActionExpected( chActionText, chExpectedText );
  A_DBGR_VariableRead( "Task_Core1_1000ms_Count", taskvalue);
  E_DBGR_VariableCheck("Task_Core1_1000ms_Count", taskvalue, Greater);
  
  //Check Core2 is running
  snprintf( chActionText, elCount(chActionText), "Check 1000ms Task Counter from Core2 "); 
  snprintf( chExpectedText, elCount(chExpectedText), "1000ms Counter from Core2 is incrementing"); 
  TestStepAddActionExpected( chActionText, chExpectedText );
  A_DBGR_VariableRead( "Task_Core2_1000ms_Count", taskvalue);
  E_DBGR_VariableCheck("Task_Core2_1000ms_Count", taskvalue, Greater);
    
  //Check Core3 is running
  snprintf( chActionText, elCount(chActionText), "Check 1000ms Task Counter from Core3 "); 
  snprintf( chExpectedText, elCount(chExpectedText), "1000ms Counter from Core3 is incrementing"); 
  TestStepAddActionExpected( chActionText, chExpectedText );
  A_DBGR_VariableRead( "Task_Core3_1000ms_Count", taskvalue);
  E_DBGR_VariableCheck("Task_Core3_1000ms_Count", taskvalue, Greater);
    
  //Check Core4 is running
  snprintf( chActionText, elCount(chActionText), "Check 1000ms Task Counter from Core4 "); 
  snprintf( chExpectedText, elCount(chExpectedText), "1000ms Counter from Core4 is incrementing"); 
  TestStepAddActionExpected( chActionText, chExpectedText );
  A_DBGR_VariableRead( "Task_Core4_1000ms_Count", taskvalue);
  E_DBGR_VariableCheck("Task_Core4_1000ms_Count", taskvalue, Greater);
    
  //Check Core5 is running
  snprintf( chActionText, elCount(chActionText), "Check 1000ms Task Counter from Core5 "); 
  snprintf( chExpectedText, elCount(chExpectedText), "1000ms Counter from Core5 is incrementing"); 
  TestStepAddActionExpected( chActionText, chExpectedText );
  A_DBGR_VariableRead( "Task_Core5_1000ms_Count", taskvalue);
  E_DBGR_VariableCheck("Task_Core5_1000ms_Count", taskvalue, Greater);
  

  /***************************************************************************************************************/    
    // Test Step 3: Check Running Task ID for Core3
  /***************************************************************************************************************/

  //Task ID for 2.5ms Task for core3
  snprintf( chActionText, elCount(chActionText), "Check Task ID for 2.5ms Task for core3 "); 
  snprintf( chExpectedText, elCount(chExpectedText), "Task ID for 2.5ms Task for core3 shall be 8 "); 
  TestStepAddActionExpected( chActionText, chExpectedText );
  E_DBGR_VariableCheck("core3_task_2_p_5", 8, Equal);  

  //Task ID for 5ms Task for core3
  snprintf( chActionText, elCount(chActionText), "Check Task ID for 5ms Task for core3 "); 
  snprintf( chExpectedText, elCount(chExpectedText), "Task ID for 5ms Task for core3 shall be 7 "); 
  TestStepAddActionExpected( chActionText, chExpectedText );
  E_DBGR_VariableCheck("core3_task_5", 7, Equal);  

  //Task ID for 10ms Task for core3
  snprintf( chActionText, elCount(chActionText), "Check Task ID for 10ms Task for core3 "); 
  snprintf( chExpectedText, elCount(chExpectedText), "Task ID for 10ms Task for core3 shall be 6 "); 
  TestStepAddActionExpected( chActionText, chExpectedText );
  E_DBGR_VariableCheck("core3_task_10", 6, Equal);  

  //Task ID for 25ms Task for core3
  snprintf( chActionText, elCount(chActionText), "Check Task ID for 25ms Task for core3 "); 
  snprintf( chExpectedText, elCount(chExpectedText), "Task ID for 25ms Task for core3 shall be 5 "); 
  TestStepAddActionExpected( chActionText, chExpectedText );
  E_DBGR_VariableCheck("core3_task_25", 5, Equal);  

  //Task ID for 50ms Task for core3
  snprintf( chActionText, elCount(chActionText), "Check Task ID for 50ms Task for core3 "); 
  snprintf( chExpectedText, elCount(chExpectedText), "Task ID for 50ms Task for core3 shall be 4 "); 
  TestStepAddActionExpected( chActionText, chExpectedText );
  E_DBGR_VariableCheck("core3_task_50", 4, Equal);  

  //Task ID for 100ms Task for core3
  snprintf( chActionText, elCount(chActionText), "Check Task ID for 100ms Task for core3 "); 
  snprintf( chExpectedText, elCount(chExpectedText), "Task ID for 100ms Task for core3 shall be 3 "); 
  TestStepAddActionExpected( chActionText, chExpectedText );
  E_DBGR_VariableCheck("core3_task_100", 3, Equal);  

  //Task ID for 250ms Task for core3
  snprintf( chActionText, elCount(chActionText), "Check Task ID for 250ms Task for core3 "); 
  snprintf( chExpectedText, elCount(chExpectedText), "Task ID for 250ms Task for core3 shall be 2 "); 
  TestStepAddActionExpected( chActionText, chExpectedText );
  E_DBGR_VariableCheck("core3_task_250", 2, Equal);  

  //Task ID for 500ms Task for core3
  snprintf( chActionText, elCount(chActionText), "Check Task ID for 500ms Task for core3 "); 
  snprintf( chExpectedText, elCount(chExpectedText), "Task ID for 500ms Task for core3 shall be 1 "); 
  TestStepAddActionExpected( chActionText, chExpectedText );
  E_DBGR_VariableCheck("core3_task_500", 1, Equal);  

  //Task ID for 1000ms Task for core3
  snprintf( chActionText, elCount(chActionText), "Check Task ID for 1000ms Task for core3 "); 
  snprintf( chExpectedText, elCount(chExpectedText), "Task ID for 1000ms Task for core3 shall be 0 "); 
  TestStepAddActionExpected( chActionText, chExpectedText );
  E_DBGR_VariableCheck("core3_task_1000", 0, Equal);    
  
}


/***************************************************************************************************
----------------------------------------------------------------------------------------------------
Test case name:  TC_L30SW_Q-36651182: Testcase to verify the functionality of interface TeHWIO_e_OS_Task GetHWIO_e_TaskID( void )() to check the task_id for CPU4 task.
----------------------------------------------------------------------------------------------------
Description:   test case to verify the functionality of interface TeHWIO_e_OS_Task GetHWIO_e_TaskID( void )() to check the task_id for CPU4 task.

***************************************************************************************************/
testcase Testcase_to_verify_the_functionality_of_interface_TeHWIO_e_OS_Task_GetHWIO_e_TaskID_to_check_the_task_id_for_CPU4_task()
{
  /***************************************************************************************************************/    
                                                // Variable Definition
  /***************************************************************************************************************/ 
  
  long taskvalue;
  
  /***************************************************************************************************************/    
                                               // Local Values
  /***************************************************************************************************************/ 
  

  
  /***************************************************************************************************************/    
                                              // Test Case Info
  /***************************************************************************************************************/
  setWriteDbgLevel(DebugOff);
  snprintf( chTestTitle, elCount(chTestTitle), "Testcase_to_verify_the_functionality_of_interface_TeHWIO_e_OS_Task_GetHWIO_e_TaskID_to_check_the_task_id_for_CPU4_task" );
  snprintf( chTestDescription, elCount(chTestDescription), "Purpose: Testcase to verify the functionality of interface TeHWIO_e_OS_Task GetHWIO_e_TaskID( void )() to check the task_id for CPU4 task.");
  TestCaseAddInfo( chTestTitle, "TC_L30SW_Q-36651182", chTestDescription );

  /***************************************************************************************************************/    
                                              // Start of Test Case
  /***************************************************************************************************************/
  
  /***************************************************************************************************************/    
                                              // Test Step 1 PRECONDITIONS
  /***************************************************************************************************************/
  
  snprintf( chActionText, elCount(chActionText), "Flash the Software and ECU is running"); 
  snprintf( chExpectedText, elCount(chExpectedText), "ECU should be in running state"); 
  TestStepAddActionExpected( chActionText, chExpectedText );

  A_DBGR_BreakpointDeleteAll();
  A_DBGR_RnGo();
  E_DBGR_CheckState(T32_State_Running);
  

   /***************************************************************************************************************/    
            // Test Step 2: Check all cores are in running state                                   
  /***************************************************************************************************************/
  
  //Check Core0 is running
  snprintf( chActionText, elCount(chActionText), "Check 1000ms Task Counter from Core0 "); 
  snprintf( chExpectedText, elCount(chExpectedText), "1000ms Counter from Core0 is incrementing"); 
  TestStepAddActionExpected( chActionText, chExpectedText );
  A_DBGR_VariableRead( "Task_Core0_1000ms_Count", taskvalue);
  E_DBGR_VariableCheck("Task_Core0_1000ms_Count", taskvalue, Greater);
  
  //Check Core1 is running
  snprintf( chActionText, elCount(chActionText), "Check 1000ms Task Counter from Core1 "); 
  snprintf( chExpectedText, elCount(chExpectedText), "1000ms Counter from Core1 is incrementing"); 
  TestStepAddActionExpected( chActionText, chExpectedText );
  A_DBGR_VariableRead( "Task_Core1_1000ms_Count", taskvalue);
  E_DBGR_VariableCheck("Task_Core1_1000ms_Count", taskvalue, Greater);
  
  //Check Core2 is running
  snprintf( chActionText, elCount(chActionText), "Check 1000ms Task Counter from Core2 "); 
  snprintf( chExpectedText, elCount(chExpectedText), "1000ms Counter from Core2 is incrementing"); 
  TestStepAddActionExpected( chActionText, chExpectedText );
  A_DBGR_VariableRead( "Task_Core2_1000ms_Count", taskvalue);
  E_DBGR_VariableCheck("Task_Core2_1000ms_Count", taskvalue, Greater);
    
  //Check Core3 is running
  snprintf( chActionText, elCount(chActionText), "Check 1000ms Task Counter from Core3 "); 
  snprintf( chExpectedText, elCount(chExpectedText), "1000ms Counter from Core3 is incrementing"); 
  TestStepAddActionExpected( chActionText, chExpectedText );
  A_DBGR_VariableRead( "Task_Core3_1000ms_Count", taskvalue);
  E_DBGR_VariableCheck("Task_Core3_1000ms_Count", taskvalue, Greater);
    
  //Check Core4 is running
  snprintf( chActionText, elCount(chActionText), "Check 1000ms Task Counter from Core4 "); 
  snprintf( chExpectedText, elCount(chExpectedText), "1000ms Counter from Core4 is incrementing"); 
  TestStepAddActionExpected( chActionText, chExpectedText );
  A_DBGR_VariableRead( "Task_Core4_1000ms_Count", taskvalue);
  E_DBGR_VariableCheck("Task_Core4_1000ms_Count", taskvalue, Greater);
    
  //Check Core5 is running
  snprintf( chActionText, elCount(chActionText), "Check 1000ms Task Counter from Core5 "); 
  snprintf( chExpectedText, elCount(chExpectedText), "1000ms Counter from Core5 is incrementing"); 
  TestStepAddActionExpected( chActionText, chExpectedText );
  A_DBGR_VariableRead( "Task_Core5_1000ms_Count", taskvalue);
  E_DBGR_VariableCheck("Task_Core5_1000ms_Count", taskvalue, Greater);
  

  /***************************************************************************************************************/    
    // Test Step 3: Check Running Task ID for Core4
  /***************************************************************************************************************/

  //Task ID for 1000ms Task for core4
  snprintf( chActionText, elCount(chActionText), "Check Task ID for 1000ms Task for core4 "); 
  snprintf( chExpectedText, elCount(chExpectedText), "Task ID for 1000ms Task for core4 shall be 0 "); 
  TestStepAddActionExpected( chActionText, chExpectedText );
  E_DBGR_VariableCheck("core4_task_1000", 0, Equal);    
  
}


/***************************************************************************************************
----------------------------------------------------------------------------------------------------
Test case name:  TC_L30SW_Q-36651183: Testcase to verify the functionality of interface TeHWIO_e_OS_Task GetHWIO_e_TaskID( void )() to check the task_id for CPU5 task.
----------------------------------------------------------------------------------------------------
Description:   test case to verify the functionality of interface TeHWIO_e_OS_Task GetHWIO_e_TaskID( void )() to check the task_id for CPU5 task.

***************************************************************************************************/
testcase Testcase_to_verify_the_functionality_of_interface_TeHWIO_e_OS_Task_GetHWIO_e_TaskID_to_check_the_task_id_for_CPU5_task()
{
  /***************************************************************************************************************/    
                                                // Variable Definition
  /***************************************************************************************************************/ 
  
  long taskvalue;
  
  /***************************************************************************************************************/    
                                               // Local Values
  /***************************************************************************************************************/ 
  

  
  /***************************************************************************************************************/    
                                              // Test Case Info
  /***************************************************************************************************************/
  setWriteDbgLevel(DebugOff);
  snprintf( chTestTitle, elCount(chTestTitle), "Testcase_to_verify_the_functionality_of_interface_TeHWIO_e_OS_Task_GetHWIO_e_TaskID_to_check_the_task_id_for_CPU5_task" );
  snprintf( chTestDescription, elCount(chTestDescription), "Purpose: Testcase to verify the functionality of interface TeHWIO_e_OS_Task GetHWIO_e_TaskID( void )() to check the task_id for CPU5 task.");
  TestCaseAddInfo( chTestTitle, "TC_L30SW_Q-36651183", chTestDescription );

  /***************************************************************************************************************/    
                                              // Start of Test Case
  /***************************************************************************************************************/
  
  /***************************************************************************************************************/    
                                              // Test Step 1 PRECONDITIONS
  /***************************************************************************************************************/
  
  snprintf( chActionText, elCount(chActionText), "Flash the Software and ECU is running"); 
  snprintf( chExpectedText, elCount(chExpectedText), "ECU should be in running state"); 
  TestStepAddActionExpected( chActionText, chExpectedText );

  A_DBGR_BreakpointDeleteAll();
  A_DBGR_RnGo();
  E_DBGR_CheckState(T32_State_Running);
  

   /***************************************************************************************************************/    
            // Test Step 2: Check all cores are in running state                                   
  /***************************************************************************************************************/
  
  //Check Core0 is running
  snprintf( chActionText, elCount(chActionText), "Check 1000ms Task Counter from Core0 "); 
  snprintf( chExpectedText, elCount(chExpectedText), "1000ms Counter from Core0 is incrementing"); 
  TestStepAddActionExpected( chActionText, chExpectedText );
  A_DBGR_VariableRead( "Task_Core0_1000ms_Count", taskvalue);
  E_DBGR_VariableCheck("Task_Core0_1000ms_Count", taskvalue, Greater);
  
  //Check Core1 is running
  snprintf( chActionText, elCount(chActionText), "Check 1000ms Task Counter from Core1 "); 
  snprintf( chExpectedText, elCount(chExpectedText), "1000ms Counter from Core1 is incrementing"); 
  TestStepAddActionExpected( chActionText, chExpectedText );
  A_DBGR_VariableRead( "Task_Core1_1000ms_Count", taskvalue);
  E_DBGR_VariableCheck("Task_Core1_1000ms_Count", taskvalue, Greater);
  
  //Check Core2 is running
  snprintf( chActionText, elCount(chActionText), "Check 1000ms Task Counter from Core2 "); 
  snprintf( chExpectedText, elCount(chExpectedText), "1000ms Counter from Core2 is incrementing"); 
  TestStepAddActionExpected( chActionText, chExpectedText );
  A_DBGR_VariableRead( "Task_Core2_1000ms_Count", taskvalue);
  E_DBGR_VariableCheck("Task_Core2_1000ms_Count", taskvalue, Greater);
    
  //Check Core3 is running
  snprintf( chActionText, elCount(chActionText), "Check 1000ms Task Counter from Core3 "); 
  snprintf( chExpectedText, elCount(chExpectedText), "1000ms Counter from Core3 is incrementing"); 
  TestStepAddActionExpected( chActionText, chExpectedText );
  A_DBGR_VariableRead( "Task_Core3_1000ms_Count", taskvalue);
  E_DBGR_VariableCheck("Task_Core3_1000ms_Count", taskvalue, Greater);
    
  //Check Core4 is running
  snprintf( chActionText, elCount(chActionText), "Check 1000ms Task Counter from Core4 "); 
  snprintf( chExpectedText, elCount(chExpectedText), "1000ms Counter from Core4 is incrementing"); 
  TestStepAddActionExpected( chActionText, chExpectedText );
  A_DBGR_VariableRead( "Task_Core4_1000ms_Count", taskvalue);
  E_DBGR_VariableCheck("Task_Core4_1000ms_Count", taskvalue, Greater);
    
  //Check Core5 is running
  snprintf( chActionText, elCount(chActionText), "Check 1000ms Task Counter from Core5 "); 
  snprintf( chExpectedText, elCount(chExpectedText), "1000ms Counter from Core5 is incrementing"); 
  TestStepAddActionExpected( chActionText, chExpectedText );
  A_DBGR_VariableRead( "Task_Core5_1000ms_Count", taskvalue);
  E_DBGR_VariableCheck("Task_Core5_1000ms_Count", taskvalue, Greater);
  

  /***************************************************************************************************************/    
    // Test Step 3: Check Running Task ID for Core5
  /***************************************************************************************************************/

  //Task ID for 1000ms Task for core5
  snprintf( chActionText, elCount(chActionText), "Check Task ID for 1000ms Task for core5 "); 
  snprintf( chExpectedText, elCount(chExpectedText), "Task ID for 1000ms Task for core5 shall be 0 "); 
  TestStepAddActionExpected( chActionText, chExpectedText );
  E_DBGR_VariableCheck("core5_task_1000", 0, Equal);    
  
}



/***************************************************************************************************
----------------------------------------------------------------------------------------------------
Test case name:  TC_L30SW_Q-36651185: Testcase to verify the functionality of interface GetHWIO_e_CPU() to check the ActiveCPU_ID for currently executing CPU0.
----------------------------------------------------------------------------------------------------
Description:   Test case to verify the functionality of interface GetHWIO_e_CPU() to check the ActiveCPU_ID for currently executing CPU0.

***************************************************************************************************/
testcase Testcase_to_verify_the_functionality_of_interface_GetHWIO_e_CPU_to_check_the_ActiveCPU_ID_for_currently_executing_CPU0()
{
  /***************************************************************************************************************/    
                                                // Variable Definition
  /***************************************************************************************************************/ 
  
  long taskvalue;
  
  /***************************************************************************************************************/    
                                               // Local Values
  /***************************************************************************************************************/ 
  

  
  /***************************************************************************************************************/    
                                              // Test Case Info
  /***************************************************************************************************************/
  setWriteDbgLevel(DebugOff);
  snprintf( chTestTitle, elCount(chTestTitle), "Testcase_to_verify_the_functionality_of_interface_GetHWIO_e_CPU_to_check_the_ActiveCPU_ID_for_currently_executing_CPU0" );
  snprintf( chTestDescription, elCount(chTestDescription), "Test case to verify the functionality of interface GetHWIO_e_CPU() to check the ActiveCPU_ID for currently executing CPU0");
  TestCaseAddInfo( chTestTitle, "TC_L30SW_Q-36651185", chTestDescription );

  /***************************************************************************************************************/    
                                              // Start of Test Case
  /***************************************************************************************************************/
  
  /***************************************************************************************************************/    
                                              // Test Step 1 PRECONDITIONS
  /***************************************************************************************************************/
  
  snprintf( chActionText, elCount(chActionText), "Flash the Software and ECU is running"); 
  snprintf( chExpectedText, elCount(chExpectedText), "ECU should be in running state"); 
  TestStepAddActionExpected( chActionText, chExpectedText );

  A_DBGR_BreakpointDeleteAll();
  A_DBGR_RnGo();
  E_DBGR_CheckState(T32_State_Running);
  

   /***************************************************************************************************************/    
            // Test Step 2: Check all cores are in running state                                   
  /***************************************************************************************************************/
  
  //Check Core0 is running
  snprintf( chActionText, elCount(chActionText), "Check 1000ms Task Counter from Core0 "); 
  snprintf( chExpectedText, elCount(chExpectedText), "1000ms Counter from Core0 is incrementing"); 
  TestStepAddActionExpected( chActionText, chExpectedText );
  A_DBGR_VariableRead( "Task_Core0_1000ms_Count", taskvalue);
  E_DBGR_VariableCheck("Task_Core0_1000ms_Count", taskvalue, Greater);
  
  //Check Core1 is running
  snprintf( chActionText, elCount(chActionText), "Check 1000ms Task Counter from Core1 "); 
  snprintf( chExpectedText, elCount(chExpectedText), "1000ms Counter from Core1 is incrementing"); 
  TestStepAddActionExpected( chActionText, chExpectedText );
  A_DBGR_VariableRead( "Task_Core1_1000ms_Count", taskvalue);
  E_DBGR_VariableCheck("Task_Core1_1000ms_Count", taskvalue, Greater);
  
  //Check Core2 is running
  snprintf( chActionText, elCount(chActionText), "Check 1000ms Task Counter from Core2 "); 
  snprintf( chExpectedText, elCount(chExpectedText), "1000ms Counter from Core2 is incrementing"); 
  TestStepAddActionExpected( chActionText, chExpectedText );
  A_DBGR_VariableRead( "Task_Core2_1000ms_Count", taskvalue);
  E_DBGR_VariableCheck("Task_Core2_1000ms_Count", taskvalue, Greater);
    
  //Check Core3 is running
  snprintf( chActionText, elCount(chActionText), "Check 1000ms Task Counter from Core3 "); 
  snprintf( chExpectedText, elCount(chExpectedText), "1000ms Counter from Core3 is incrementing"); 
  TestStepAddActionExpected( chActionText, chExpectedText );
  A_DBGR_VariableRead( "Task_Core3_1000ms_Count", taskvalue);
  E_DBGR_VariableCheck("Task_Core3_1000ms_Count", taskvalue, Greater);
    
  //Check Core4 is running
  snprintf( chActionText, elCount(chActionText), "Check 1000ms Task Counter from Core4 "); 
  snprintf( chExpectedText, elCount(chExpectedText), "1000ms Counter from Core4 is incrementing"); 
  TestStepAddActionExpected( chActionText, chExpectedText );
  A_DBGR_VariableRead( "Task_Core4_1000ms_Count", taskvalue);
  E_DBGR_VariableCheck("Task_Core4_1000ms_Count", taskvalue, Greater);
    
  //Check Core5 is running
  snprintf( chActionText, elCount(chActionText), "Check 1000ms Task Counter from Core5 "); 
  snprintf( chExpectedText, elCount(chExpectedText), "1000ms Counter from Core5 is incrementing"); 
  TestStepAddActionExpected( chActionText, chExpectedText );
  A_DBGR_VariableRead( "Task_Core5_1000ms_Count", taskvalue);
  E_DBGR_VariableCheck("Task_Core5_1000ms_Count", taskvalue, Greater);
  

  /***************************************************************************************************************/    
    // Test Step 3: Active CPU ID interface GetHWIO_e_CPU() for Core0
  /***************************************************************************************************************/

  snprintf( chActionText, elCount(chActionText), "Check Active CPU ID for 1000ms Task for core0 "); 
  snprintf( chExpectedText, elCount(chExpectedText), "Active CPU ID for 1000ms Task for core0 shall be 0 "); 
  TestStepAddActionExpected( chActionText, chExpectedText );
  E_DBGR_VariableCheck("cpu_id_core0", 0, Equal);    
  
}


/***************************************************************************************************
----------------------------------------------------------------------------------------------------
Test case name:  TC_L30SW_Q-36651186: Testcase to verify the functionality of interface GetHWIO_e_CPU() to check the ActiveCPU_ID for currently executing CPU1.
----------------------------------------------------------------------------------------------------
Description:   Test case to verify the functionality of interface GetHWIO_e_CPU() to check the ActiveCPU_ID for currently executing CPU1.

***************************************************************************************************/
testcase Testcase_to_verify_the_functionality_of_interface_GetHWIO_e_CPU_to_check_the_ActiveCPU_ID_for_currently_executing_CPU1()
{
  /***************************************************************************************************************/    
                                                // Variable Definition
  /***************************************************************************************************************/ 
  
  long taskvalue;
  
  /***************************************************************************************************************/    
                                               // Local Values
  /***************************************************************************************************************/ 
  

  
  /***************************************************************************************************************/    
                                              // Test Case Info
  /***************************************************************************************************************/
  setWriteDbgLevel(DebugOff);
  snprintf( chTestTitle, elCount(chTestTitle), "Testcase_to_verify_the_functionality_of_interface_GetHWIO_e_CPU_to_check_the_ActiveCPU_ID_for_currently_executing_CPU1" );
  snprintf( chTestDescription, elCount(chTestDescription), "Test case to verify the functionality of interface GetHWIO_e_CPU() to check the ActiveCPU_ID for currently executing CPU1");
  TestCaseAddInfo( chTestTitle, "TC_L30SW_Q-36651186", chTestDescription );

  /***************************************************************************************************************/    
                                              // Start of Test Case
  /***************************************************************************************************************/
  
  /***************************************************************************************************************/    
                                              // Test Step 1 PRECONDITIONS
  /***************************************************************************************************************/
  
  snprintf( chActionText, elCount(chActionText), "Flash the Software and ECU is running"); 
  snprintf( chExpectedText, elCount(chExpectedText), "ECU should be in running state"); 
  TestStepAddActionExpected( chActionText, chExpectedText );

  A_DBGR_BreakpointDeleteAll();
  A_DBGR_RnGo();
  E_DBGR_CheckState(T32_State_Running);
  

   /***************************************************************************************************************/    
            // Test Step 2: Check all cores are in running state                                   
  /***************************************************************************************************************/
  
  //Check Core0 is running
  snprintf( chActionText, elCount(chActionText), "Check 1000ms Task Counter from Core0 "); 
  snprintf( chExpectedText, elCount(chExpectedText), "1000ms Counter from Core0 is incrementing"); 
  TestStepAddActionExpected( chActionText, chExpectedText );
  A_DBGR_VariableRead( "Task_Core0_1000ms_Count", taskvalue);
  E_DBGR_VariableCheck("Task_Core0_1000ms_Count", taskvalue, Greater);
  
  //Check Core1 is running
  snprintf( chActionText, elCount(chActionText), "Check 1000ms Task Counter from Core1 "); 
  snprintf( chExpectedText, elCount(chExpectedText), "1000ms Counter from Core1 is incrementing"); 
  TestStepAddActionExpected( chActionText, chExpectedText );
  A_DBGR_VariableRead( "Task_Core1_1000ms_Count", taskvalue);
  E_DBGR_VariableCheck("Task_Core1_1000ms_Count", taskvalue, Greater);
  
  //Check Core2 is running
  snprintf( chActionText, elCount(chActionText), "Check 1000ms Task Counter from Core2 "); 
  snprintf( chExpectedText, elCount(chExpectedText), "1000ms Counter from Core2 is incrementing"); 
  TestStepAddActionExpected( chActionText, chExpectedText );
  A_DBGR_VariableRead( "Task_Core2_1000ms_Count", taskvalue);
  E_DBGR_VariableCheck("Task_Core2_1000ms_Count", taskvalue, Greater);
    
  //Check Core3 is running
  snprintf( chActionText, elCount(chActionText), "Check 1000ms Task Counter from Core3 "); 
  snprintf( chExpectedText, elCount(chExpectedText), "1000ms Counter from Core3 is incrementing"); 
  TestStepAddActionExpected( chActionText, chExpectedText );
  A_DBGR_VariableRead( "Task_Core3_1000ms_Count", taskvalue);
  E_DBGR_VariableCheck("Task_Core3_1000ms_Count", taskvalue, Greater);
    
  //Check Core4 is running
  snprintf( chActionText, elCount(chActionText), "Check 1000ms Task Counter from Core4 "); 
  snprintf( chExpectedText, elCount(chExpectedText), "1000ms Counter from Core4 is incrementing"); 
  TestStepAddActionExpected( chActionText, chExpectedText );
  A_DBGR_VariableRead( "Task_Core4_1000ms_Count", taskvalue);
  E_DBGR_VariableCheck("Task_Core4_1000ms_Count", taskvalue, Greater);
    
  //Check Core5 is running
  snprintf( chActionText, elCount(chActionText), "Check 1000ms Task Counter from Core5 "); 
  snprintf( chExpectedText, elCount(chExpectedText), "1000ms Counter from Core5 is incrementing"); 
  TestStepAddActionExpected( chActionText, chExpectedText );
  A_DBGR_VariableRead( "Task_Core5_1000ms_Count", taskvalue);
  E_DBGR_VariableCheck("Task_Core5_1000ms_Count", taskvalue, Greater);
  

  /***************************************************************************************************************/    
    // Test Step 3: Active CPU ID interface GetHWIO_e_CPU() for Core1
  /***************************************************************************************************************/

  snprintf( chActionText, elCount(chActionText), "Check Active CPU ID for 1000ms Task for core1 "); 
  snprintf( chExpectedText, elCount(chExpectedText), "Active CPU ID for 1000ms Task for core1 shall be 1 "); 
  TestStepAddActionExpected( chActionText, chExpectedText );
  E_DBGR_VariableCheck("cpu_id_core1", 1, Equal);    
  
}


/***************************************************************************************************
----------------------------------------------------------------------------------------------------
Test case name:  TC_L30SW_Q-36651187: Testcase to verify the functionality of interface GetHWIO_e_CPU() to check the ActiveCPU_ID for currently executing CPU2.
----------------------------------------------------------------------------------------------------
Description:   Test case to verify the functionality of interface GetHWIO_e_CPU() to check the ActiveCPU_ID for currently executing CPU2.

***************************************************************************************************/
testcase Testcase_to_verify_the_functionality_of_interface_GetHWIO_e_CPU_to_check_the_ActiveCPU_ID_for_currently_executing_CPU2()
{
  /***************************************************************************************************************/    
                                                // Variable Definition
  /***************************************************************************************************************/ 
  
  long taskvalue;
  
  /***************************************************************************************************************/    
                                               // Local Values
  /***************************************************************************************************************/ 
  

  
  /***************************************************************************************************************/    
                                              // Test Case Info
  /***************************************************************************************************************/
  setWriteDbgLevel(DebugOff);
  snprintf( chTestTitle, elCount(chTestTitle), "Testcase_to_verify_the_functionality_of_interface_GetHWIO_e_CPU_to_check_the_ActiveCPU_ID_for_currently_executing_CPU2" );
  snprintf( chTestDescription, elCount(chTestDescription), "Test case to verify the functionality of interface GetHWIO_e_CPU() to check the ActiveCPU_ID for currently executing CPU2");
  TestCaseAddInfo( chTestTitle, "TC_L30SW_Q-36651187", chTestDescription );

  /***************************************************************************************************************/    
                                              // Start of Test Case
  /***************************************************************************************************************/
  
  /***************************************************************************************************************/    
                                              // Test Step 1 PRECONDITIONS
  /***************************************************************************************************************/
  
  snprintf( chActionText, elCount(chActionText), "Flash the Software and ECU is running"); 
  snprintf( chExpectedText, elCount(chExpectedText), "ECU should be in running state"); 
  TestStepAddActionExpected( chActionText, chExpectedText );

  A_DBGR_BreakpointDeleteAll();
  A_DBGR_RnGo();
  E_DBGR_CheckState(T32_State_Running);
  

   /***************************************************************************************************************/    
            // Test Step 2: Check all cores are in running state                                   
  /***************************************************************************************************************/
  
  //Check Core0 is running
  snprintf( chActionText, elCount(chActionText), "Check 1000ms Task Counter from Core0 "); 
  snprintf( chExpectedText, elCount(chExpectedText), "1000ms Counter from Core0 is incrementing"); 
  TestStepAddActionExpected( chActionText, chExpectedText );
  A_DBGR_VariableRead( "Task_Core0_1000ms_Count", taskvalue);
  E_DBGR_VariableCheck("Task_Core0_1000ms_Count", taskvalue, Greater);
  
  //Check Core1 is running
  snprintf( chActionText, elCount(chActionText), "Check 1000ms Task Counter from Core1 "); 
  snprintf( chExpectedText, elCount(chExpectedText), "1000ms Counter from Core1 is incrementing"); 
  TestStepAddActionExpected( chActionText, chExpectedText );
  A_DBGR_VariableRead( "Task_Core1_1000ms_Count", taskvalue);
  E_DBGR_VariableCheck("Task_Core1_1000ms_Count", taskvalue, Greater);
  
  //Check Core2 is running
  snprintf( chActionText, elCount(chActionText), "Check 1000ms Task Counter from Core2 "); 
  snprintf( chExpectedText, elCount(chExpectedText), "1000ms Counter from Core2 is incrementing"); 
  TestStepAddActionExpected( chActionText, chExpectedText );
  A_DBGR_VariableRead( "Task_Core2_1000ms_Count", taskvalue);
  E_DBGR_VariableCheck("Task_Core2_1000ms_Count", taskvalue, Greater);
    
  //Check Core3 is running
  snprintf( chActionText, elCount(chActionText), "Check 1000ms Task Counter from Core3 "); 
  snprintf( chExpectedText, elCount(chExpectedText), "1000ms Counter from Core3 is incrementing"); 
  TestStepAddActionExpected( chActionText, chExpectedText );
  A_DBGR_VariableRead( "Task_Core3_1000ms_Count", taskvalue);
  E_DBGR_VariableCheck("Task_Core3_1000ms_Count", taskvalue, Greater);
    
  //Check Core4 is running
  snprintf( chActionText, elCount(chActionText), "Check 1000ms Task Counter from Core4 "); 
  snprintf( chExpectedText, elCount(chExpectedText), "1000ms Counter from Core4 is incrementing"); 
  TestStepAddActionExpected( chActionText, chExpectedText );
  A_DBGR_VariableRead( "Task_Core4_1000ms_Count", taskvalue);
  E_DBGR_VariableCheck("Task_Core4_1000ms_Count", taskvalue, Greater);
    
  //Check Core5 is running
  snprintf( chActionText, elCount(chActionText), "Check 1000ms Task Counter from Core5 "); 
  snprintf( chExpectedText, elCount(chExpectedText), "1000ms Counter from Core5 is incrementing"); 
  TestStepAddActionExpected( chActionText, chExpectedText );
  A_DBGR_VariableRead( "Task_Core5_1000ms_Count", taskvalue);
  E_DBGR_VariableCheck("Task_Core5_1000ms_Count", taskvalue, Greater);
  

  /***************************************************************************************************************/    
    // Test Step 3: Active CPU ID interface GetHWIO_e_CPU() for Core2
  /***************************************************************************************************************/

  snprintf( chActionText, elCount(chActionText), "Check Active CPU ID for 1000ms Task for core2 "); 
  snprintf( chExpectedText, elCount(chExpectedText), "Active CPU ID for 1000ms Task for core2 shall be 2 "); 
  TestStepAddActionExpected( chActionText, chExpectedText );
  E_DBGR_VariableCheck("cpu_id_core2", 2, Equal);    
  
}


/***************************************************************************************************
----------------------------------------------------------------------------------------------------
Test case name:  TC_L30SW_Q-36651188: Testcase to verify the functionality of interface GetHWIO_e_CPU() to check the ActiveCPU_ID for currently executing CPU3.
----------------------------------------------------------------------------------------------------
Description:   Test case to verify the functionality of interface GetHWIO_e_CPU() to check the ActiveCPU_ID for currently executing CPU3.

***************************************************************************************************/
testcase Testcase_to_verify_the_functionality_of_interface_GetHWIO_e_CPU_to_check_the_ActiveCPU_ID_for_currently_executing_CPU3()
{
  /***************************************************************************************************************/    
                                                // Variable Definition
  /***************************************************************************************************************/ 
  
  long taskvalue;
  
  /***************************************************************************************************************/    
                                               // Local Values
  /***************************************************************************************************************/ 
  

  
  /***************************************************************************************************************/    
                                              // Test Case Info
  /***************************************************************************************************************/
  setWriteDbgLevel(DebugOff);
  snprintf( chTestTitle, elCount(chTestTitle), "Testcase_to_verify_the_functionality_of_interface_GetHWIO_e_CPU_to_check_the_ActiveCPU_ID_for_currently_executing_CPU3" );
  snprintf( chTestDescription, elCount(chTestDescription), "Test case to verify the functionality of interface GetHWIO_e_CPU() to check the ActiveCPU_ID for currently executing CPU3");
  TestCaseAddInfo( chTestTitle, "TC_L30SW_Q-36651188", chTestDescription );

  /***************************************************************************************************************/    
                                              // Start of Test Case
  /***************************************************************************************************************/
  
  /***************************************************************************************************************/    
                                              // Test Step 1 PRECONDITIONS
  /***************************************************************************************************************/
  
  snprintf( chActionText, elCount(chActionText), "Flash the Software and ECU is running"); 
  snprintf( chExpectedText, elCount(chExpectedText), "ECU should be in running state"); 
  TestStepAddActionExpected( chActionText, chExpectedText );

  A_DBGR_BreakpointDeleteAll();
  A_DBGR_RnGo();
  E_DBGR_CheckState(T32_State_Running);
  

   /***************************************************************************************************************/    
            // Test Step 2: Check all cores are in running state                                   
  /***************************************************************************************************************/
  
  //Check Core0 is running
  snprintf( chActionText, elCount(chActionText), "Check 1000ms Task Counter from Core0 "); 
  snprintf( chExpectedText, elCount(chExpectedText), "1000ms Counter from Core0 is incrementing"); 
  TestStepAddActionExpected( chActionText, chExpectedText );
  A_DBGR_VariableRead( "Task_Core0_1000ms_Count", taskvalue);
  E_DBGR_VariableCheck("Task_Core0_1000ms_Count", taskvalue, Greater);
  
  //Check Core1 is running
  snprintf( chActionText, elCount(chActionText), "Check 1000ms Task Counter from Core1 "); 
  snprintf( chExpectedText, elCount(chExpectedText), "1000ms Counter from Core1 is incrementing"); 
  TestStepAddActionExpected( chActionText, chExpectedText );
  A_DBGR_VariableRead( "Task_Core1_1000ms_Count", taskvalue);
  E_DBGR_VariableCheck("Task_Core1_1000ms_Count", taskvalue, Greater);
  
  //Check Core2 is running
  snprintf( chActionText, elCount(chActionText), "Check 1000ms Task Counter from Core2 "); 
  snprintf( chExpectedText, elCount(chExpectedText), "1000ms Counter from Core2 is incrementing"); 
  TestStepAddActionExpected( chActionText, chExpectedText );
  A_DBGR_VariableRead( "Task_Core2_1000ms_Count", taskvalue);
  E_DBGR_VariableCheck("Task_Core2_1000ms_Count", taskvalue, Greater);
    
  //Check Core3 is running
  snprintf( chActionText, elCount(chActionText), "Check 1000ms Task Counter from Core3 "); 
  snprintf( chExpectedText, elCount(chExpectedText), "1000ms Counter from Core3 is incrementing"); 
  TestStepAddActionExpected( chActionText, chExpectedText );
  A_DBGR_VariableRead( "Task_Core3_1000ms_Count", taskvalue);
  E_DBGR_VariableCheck("Task_Core3_1000ms_Count", taskvalue, Greater);
    
  //Check Core4 is running
  snprintf( chActionText, elCount(chActionText), "Check 1000ms Task Counter from Core4 "); 
  snprintf( chExpectedText, elCount(chExpectedText), "1000ms Counter from Core4 is incrementing"); 
  TestStepAddActionExpected( chActionText, chExpectedText );
  A_DBGR_VariableRead( "Task_Core4_1000ms_Count", taskvalue);
  E_DBGR_VariableCheck("Task_Core4_1000ms_Count", taskvalue, Greater);
    
  //Check Core5 is running
  snprintf( chActionText, elCount(chActionText), "Check 1000ms Task Counter from Core5 "); 
  snprintf( chExpectedText, elCount(chExpectedText), "1000ms Counter from Core5 is incrementing"); 
  TestStepAddActionExpected( chActionText, chExpectedText );
  A_DBGR_VariableRead( "Task_Core5_1000ms_Count", taskvalue);
  E_DBGR_VariableCheck("Task_Core5_1000ms_Count", taskvalue, Greater);
  

  /***************************************************************************************************************/    
    // Test Step 3: Active CPU ID interface GetHWIO_e_CPU() for Core3
  /***************************************************************************************************************/

  snprintf( chActionText, elCount(chActionText), "Check Active CPU ID for 1000ms Task for core3 "); 
  snprintf( chExpectedText, elCount(chExpectedText), "Active CPU ID for 1000ms Task for core3 shall be 3 "); 
  TestStepAddActionExpected( chActionText, chExpectedText );
  E_DBGR_VariableCheck("cpu_id_core3", 3, Equal);    
  
}


/***************************************************************************************************
----------------------------------------------------------------------------------------------------
Test case name:  TC_L30SW_Q-36651189: Testcase to verify the functionality of interface GetHWIO_e_CPU() to check the ActiveCPU_ID for currently executing CPU4.
----------------------------------------------------------------------------------------------------
Description:   Test case to verify the functionality of interface GetHWIO_e_CPU() to check the ActiveCPU_ID for currently executing CPU4.

***************************************************************************************************/
testcase Testcase_to_verify_the_functionality_of_interface_GetHWIO_e_CPU_to_check_the_ActiveCPU_ID_for_currently_executing_CPU4()
{
  /***************************************************************************************************************/    
                                                // Variable Definition
  /***************************************************************************************************************/ 
  
  long taskvalue;
  
  /***************************************************************************************************************/    
                                               // Local Values
  /***************************************************************************************************************/ 
  

  
  /***************************************************************************************************************/    
                                              // Test Case Info
  /***************************************************************************************************************/
  setWriteDbgLevel(DebugOff);
  snprintf( chTestTitle, elCount(chTestTitle), "Testcase_to_verify_the_functionality_of_interface_GetHWIO_e_CPU_to_check_the_ActiveCPU_ID_for_currently_executing_CPU4" );
  snprintf( chTestDescription, elCount(chTestDescription), "Test case to verify the functionality of interface GetHWIO_e_CPU() to check the ActiveCPU_ID for currently executing CPU4");
  TestCaseAddInfo( chTestTitle, "TC_L30SW_Q-36651189", chTestDescription );

  /***************************************************************************************************************/    
                                              // Start of Test Case
  /***************************************************************************************************************/
  
  /***************************************************************************************************************/    
                                              // Test Step 1 PRECONDITIONS
  /***************************************************************************************************************/
  
  snprintf( chActionText, elCount(chActionText), "Flash the Software and ECU is running"); 
  snprintf( chExpectedText, elCount(chExpectedText), "ECU should be in running state"); 
  TestStepAddActionExpected( chActionText, chExpectedText );

  A_DBGR_BreakpointDeleteAll();
  A_DBGR_RnGo();
  E_DBGR_CheckState(T32_State_Running);
  

   /***************************************************************************************************************/    
            // Test Step 2: Check all cores are in running state                                   
  /***************************************************************************************************************/
  
  //Check Core0 is running
  snprintf( chActionText, elCount(chActionText), "Check 1000ms Task Counter from Core0 "); 
  snprintf( chExpectedText, elCount(chExpectedText), "1000ms Counter from Core0 is incrementing"); 
  TestStepAddActionExpected( chActionText, chExpectedText );
  A_DBGR_VariableRead( "Task_Core0_1000ms_Count", taskvalue);
  E_DBGR_VariableCheck("Task_Core0_1000ms_Count", taskvalue, Greater);
  
  //Check Core1 is running
  snprintf( chActionText, elCount(chActionText), "Check 1000ms Task Counter from Core1 "); 
  snprintf( chExpectedText, elCount(chExpectedText), "1000ms Counter from Core1 is incrementing"); 
  TestStepAddActionExpected( chActionText, chExpectedText );
  A_DBGR_VariableRead( "Task_Core1_1000ms_Count", taskvalue);
  E_DBGR_VariableCheck("Task_Core1_1000ms_Count", taskvalue, Greater);
  
  //Check Core2 is running
  snprintf( chActionText, elCount(chActionText), "Check 1000ms Task Counter from Core2 "); 
  snprintf( chExpectedText, elCount(chExpectedText), "1000ms Counter from Core2 is incrementing"); 
  TestStepAddActionExpected( chActionText, chExpectedText );
  A_DBGR_VariableRead( "Task_Core2_1000ms_Count", taskvalue);
  E_DBGR_VariableCheck("Task_Core2_1000ms_Count", taskvalue, Greater);
    
  //Check Core3 is running
  snprintf( chActionText, elCount(chActionText), "Check 1000ms Task Counter from Core3 "); 
  snprintf( chExpectedText, elCount(chExpectedText), "1000ms Counter from Core3 is incrementing"); 
  TestStepAddActionExpected( chActionText, chExpectedText );
  A_DBGR_VariableRead( "Task_Core3_1000ms_Count", taskvalue);
  E_DBGR_VariableCheck("Task_Core3_1000ms_Count", taskvalue, Greater);
    
  //Check Core4 is running
  snprintf( chActionText, elCount(chActionText), "Check 1000ms Task Counter from Core4 "); 
  snprintf( chExpectedText, elCount(chExpectedText), "1000ms Counter from Core4 is incrementing"); 
  TestStepAddActionExpected( chActionText, chExpectedText );
  A_DBGR_VariableRead( "Task_Core4_1000ms_Count", taskvalue);
  E_DBGR_VariableCheck("Task_Core4_1000ms_Count", taskvalue, Greater);
    
  //Check Core5 is running
  snprintf( chActionText, elCount(chActionText), "Check 1000ms Task Counter from Core5 "); 
  snprintf( chExpectedText, elCount(chExpectedText), "1000ms Counter from Core5 is incrementing"); 
  TestStepAddActionExpected( chActionText, chExpectedText );
  A_DBGR_VariableRead( "Task_Core5_1000ms_Count", taskvalue);
  E_DBGR_VariableCheck("Task_Core5_1000ms_Count", taskvalue, Greater);
  

  /***************************************************************************************************************/    
    // Test Step 3: Active CPU ID interface GetHWIO_e_CPU() for Core4
  /***************************************************************************************************************/

  snprintf( chActionText, elCount(chActionText), "Check Active CPU ID for 1000ms Task for core4 "); 
  snprintf( chExpectedText, elCount(chExpectedText), "Active CPU ID for 1000ms Task for core4 shall be 4 "); 
  TestStepAddActionExpected( chActionText, chExpectedText );
  E_DBGR_VariableCheck("cpu_id_core4", 4, Equal);    
  
}


/***************************************************************************************************
----------------------------------------------------------------------------------------------------
Test case name:  TC_L30SW_Q-36651190: Testcase to verify the functionality of interface GetHWIO_e_CPU() to check the ActiveCPU_ID for currently executing CPU5.
----------------------------------------------------------------------------------------------------
Description:   Test case to verify the functionality of interface GetHWIO_e_CPU() to check the ActiveCPU_ID for currently executing CPU5.

***************************************************************************************************/
testcase Testcase_to_verify_the_functionality_of_interface_GetHWIO_e_CPU_to_check_the_ActiveCPU_ID_for_currently_executing_CPU5()
{
  /***************************************************************************************************************/    
                                                // Variable Definition
  /***************************************************************************************************************/ 
  
  long taskvalue;
  
  /***************************************************************************************************************/    
                                               // Local Values
  /***************************************************************************************************************/ 
  

  
  /***************************************************************************************************************/    
                                              // Test Case Info
  /***************************************************************************************************************/
  setWriteDbgLevel(DebugOff);
  snprintf( chTestTitle, elCount(chTestTitle), "Testcase_to_verify_the_functionality_of_interface_GetHWIO_e_CPU_to_check_the_ActiveCPU_ID_for_currently_executing_CPU5" );
  snprintf( chTestDescription, elCount(chTestDescription), "Test case to verify the functionality of interface GetHWIO_e_CPU() to check the ActiveCPU_ID for currently executing CPU5");
  TestCaseAddInfo( chTestTitle, "TC_L30SW_Q-36651190", chTestDescription );

  /***************************************************************************************************************/    
                                              // Start of Test Case
  /***************************************************************************************************************/
  
  /***************************************************************************************************************/    
                                              // Test Step 1 PRECONDITIONS
  /***************************************************************************************************************/
  
  snprintf( chActionText, elCount(chActionText), "Flash the Software and ECU is running"); 
  snprintf( chExpectedText, elCount(chExpectedText), "ECU should be in running state"); 
  TestStepAddActionExpected( chActionText, chExpectedText );

  A_DBGR_BreakpointDeleteAll();
  A_DBGR_RnGo();
  E_DBGR_CheckState(T32_State_Running);
  

   /***************************************************************************************************************/    
            // Test Step 2: Check all cores are in running state                                   
  /***************************************************************************************************************/
  
  //Check Core0 is running
  snprintf( chActionText, elCount(chActionText), "Check 1000ms Task Counter from Core0 "); 
  snprintf( chExpectedText, elCount(chExpectedText), "1000ms Counter from Core0 is incrementing"); 
  TestStepAddActionExpected( chActionText, chExpectedText );
  A_DBGR_VariableRead( "Task_Core0_1000ms_Count", taskvalue);
  E_DBGR_VariableCheck("Task_Core0_1000ms_Count", taskvalue, Greater);
  
  //Check Core1 is running
  snprintf( chActionText, elCount(chActionText), "Check 1000ms Task Counter from Core1 "); 
  snprintf( chExpectedText, elCount(chExpectedText), "1000ms Counter from Core1 is incrementing"); 
  TestStepAddActionExpected( chActionText, chExpectedText );
  A_DBGR_VariableRead( "Task_Core1_1000ms_Count", taskvalue);
  E_DBGR_VariableCheck("Task_Core1_1000ms_Count", taskvalue, Greater);
  
  //Check Core2 is running
  snprintf( chActionText, elCount(chActionText), "Check 1000ms Task Counter from Core2 "); 
  snprintf( chExpectedText, elCount(chExpectedText), "1000ms Counter from Core2 is incrementing"); 
  TestStepAddActionExpected( chActionText, chExpectedText );
  A_DBGR_VariableRead( "Task_Core2_1000ms_Count", taskvalue);
  E_DBGR_VariableCheck("Task_Core2_1000ms_Count", taskvalue, Greater);
    
  //Check Core3 is running
  snprintf( chActionText, elCount(chActionText), "Check 1000ms Task Counter from Core3 "); 
  snprintf( chExpectedText, elCount(chExpectedText), "1000ms Counter from Core3 is incrementing"); 
  TestStepAddActionExpected( chActionText, chExpectedText );
  A_DBGR_VariableRead( "Task_Core3_1000ms_Count", taskvalue);
  E_DBGR_VariableCheck("Task_Core3_1000ms_Count", taskvalue, Greater);
    
  //Check Core4 is running
  snprintf( chActionText, elCount(chActionText), "Check 1000ms Task Counter from Core4 "); 
  snprintf( chExpectedText, elCount(chExpectedText), "1000ms Counter from Core4 is incrementing"); 
  TestStepAddActionExpected( chActionText, chExpectedText );
  A_DBGR_VariableRead( "Task_Core4_1000ms_Count", taskvalue);
  E_DBGR_VariableCheck("Task_Core4_1000ms_Count", taskvalue, Greater);
    
  //Check Core5 is running
  snprintf( chActionText, elCount(chActionText), "Check 1000ms Task Counter from Core5 "); 
  snprintf( chExpectedText, elCount(chExpectedText), "1000ms Counter from Core5 is incrementing"); 
  TestStepAddActionExpected( chActionText, chExpectedText );
  A_DBGR_VariableRead( "Task_Core5_1000ms_Count", taskvalue);
  E_DBGR_VariableCheck("Task_Core5_1000ms_Count", taskvalue, Greater);
  

  /***************************************************************************************************************/    
    // Test Step 3: Active CPU ID interface GetHWIO_e_CPU() for Core5
  /***************************************************************************************************************/

  snprintf( chActionText, elCount(chActionText), "Check Active CPU ID for 1000ms Task for core5 "); 
  snprintf( chExpectedText, elCount(chExpectedText), "Active CPU ID for 1000ms Task for core5 shall be 5 "); 
  TestStepAddActionExpected( chActionText, chExpectedText );
  E_DBGR_VariableCheck("cpu_id_core5", 5, Equal);    
  
}



/***************************************************************************************************
----------------------------------------------------------------------------------------------------
Test case name:  TC_L30SW_Q-36684438: Testcase_to_verify_the_functionality_of_interface_DsblHWIO_GM_TaskInits_to_prohibits_all_application_defined_RTOS_tasks_and_application_ISRs_from_pre_empting_the_current_task_or_ISR_on_the_CPU0.
----------------------------------------------------------------------------------------------------
Description:   Test case to verify the functionality of interface GetHWIO_e_CPU() to check the ActiveCPU_ID for currently executing CPU0.

***************************************************************************************************/
testcase Testcase_to_verify_DsblHWIO_GM_TaskInits_to_prohibits_all_RTOS_tasks_and_ISRs_from_preempting_current_task_or_ISR_on_the_CPU0()
{
  /***************************************************************************************************************/    
                                                // Variable Definition
  /***************************************************************************************************************/ 
  
  long taskvalue;
  
  /***************************************************************************************************************/    
                                               // Local Values
  /***************************************************************************************************************/ 
  

  
  /***************************************************************************************************************/    
                                              // Test Case Info
  /***************************************************************************************************************/
  setWriteDbgLevel(DebugOff);
  snprintf( chTestTitle, elCount(chTestTitle), "Testcase_to_verify_the_functionality_of_interface_DsblHWIO_GM_TaskInits_to_prohibits_all_application_defined_RTOS_tasks_and_application_ISRs_from_pre_empting_the_current_task_or_ISR_on_the_CPU0" );
  snprintf( chTestDescription, elCount(chTestDescription), "Purpose: test case to verify the functionality of interface DsblHWIO_GM_TaskInits to to prohibits all application defined RTOS tasks and application ISRs from pre-empting the current task or ISR on the CPU0.");
  TestCaseAddInfo( chTestTitle, "TC_L30SW_Q-36684438", chTestDescription );

  /***************************************************************************************************************/    
                                              // Start of Test Case
  /***************************************************************************************************************/
  
  /***************************************************************************************************************/    
                                              // Test Step 1 PRECONDITIONS
  /***************************************************************************************************************/
  
  snprintf( chActionText, elCount(chActionText), "Flash the Software and ECU is running"); 
  snprintf( chExpectedText, elCount(chExpectedText), "ECU should be in running state"); 
  TestStepAddActionExpected( chActionText, chExpectedText );

  A_DBGR_BreakpointDeleteAll();
  A_DBGR_RnGo();
  E_DBGR_CheckState(T32_State_Running);
  

   /***************************************************************************************************************/    
            // Test Step 2: Check all cores are in running state                                   
  /***************************************************************************************************************/
  
  //Check Core0 is running
  snprintf( chActionText, elCount(chActionText), "Check 1000ms Task Counter from Core0 "); 
  snprintf( chExpectedText, elCount(chExpectedText), "1000ms Counter from Core0 is incrementing"); 
  TestStepAddActionExpected( chActionText, chExpectedText );
  A_DBGR_VariableRead( "Task_Core0_1000ms_Count", taskvalue);
  E_DBGR_VariableCheck("Task_Core0_1000ms_Count", taskvalue, Greater);
  
  //Check Core1 is running
  snprintf( chActionText, elCount(chActionText), "Check 1000ms Task Counter from Core1 "); 
  snprintf( chExpectedText, elCount(chExpectedText), "1000ms Counter from Core1 is incrementing"); 
  TestStepAddActionExpected( chActionText, chExpectedText );
  A_DBGR_VariableRead( "Task_Core1_1000ms_Count", taskvalue);
  E_DBGR_VariableCheck("Task_Core1_1000ms_Count", taskvalue, Greater);
  
  //Check Core2 is running
  snprintf( chActionText, elCount(chActionText), "Check 1000ms Task Counter from Core2 "); 
  snprintf( chExpectedText, elCount(chExpectedText), "1000ms Counter from Core2 is incrementing"); 
  TestStepAddActionExpected( chActionText, chExpectedText );
  A_DBGR_VariableRead( "Task_Core2_1000ms_Count", taskvalue);
  E_DBGR_VariableCheck("Task_Core2_1000ms_Count", taskvalue, Greater);
    
  //Check Core3 is running
  snprintf( chActionText, elCount(chActionText), "Check 1000ms Task Counter from Core3 "); 
  snprintf( chExpectedText, elCount(chExpectedText), "1000ms Counter from Core3 is incrementing"); 
  TestStepAddActionExpected( chActionText, chExpectedText );
  A_DBGR_VariableRead( "Task_Core3_1000ms_Count", taskvalue);
  E_DBGR_VariableCheck("Task_Core3_1000ms_Count", taskvalue, Greater);
    
  //Check Core4 is running
  snprintf( chActionText, elCount(chActionText), "Check 1000ms Task Counter from Core4 "); 
  snprintf( chExpectedText, elCount(chExpectedText), "1000ms Counter from Core4 is incrementing"); 
  TestStepAddActionExpected( chActionText, chExpectedText );
  A_DBGR_VariableRead( "Task_Core4_1000ms_Count", taskvalue);
  E_DBGR_VariableCheck("Task_Core4_1000ms_Count", taskvalue, Greater);
    
  //Check Core5 is running
  snprintf( chActionText, elCount(chActionText), "Check 1000ms Task Counter from Core5 "); 
  snprintf( chExpectedText, elCount(chExpectedText), "1000ms Counter from Core5 is incrementing"); 
  TestStepAddActionExpected( chActionText, chExpectedText );
  A_DBGR_VariableRead( "Task_Core5_1000ms_Count", taskvalue);
  E_DBGR_VariableCheck("Task_Core5_1000ms_Count", taskvalue, Greater);
  

  /***************************************************************************************************************/    
    // Test Step 3: Disable Interface DsblHWIO_GM_TaskInits for Core0
  /***************************************************************************************************************/

  snprintf( chActionText, elCount(chActionText), "Disable Interface DsblHWIO_GM_TaskInits for 1000ms Task for core0 "); 
  snprintf( chExpectedText, elCount(chExpectedText), "Check Interface DsblHWIO_GM_TaskInits 1000ms Task for core0 shall set to 0 "); 
  TestStepAddActionExpected( chActionText, chExpectedText );
  A_DBGR_VariableSet("test_disable_task_initiator_core0", "1");
  E_DBGR_VariableCheck("test_disable_task_initiator_core0", 1, Equal);    


  /***************************************************************************************************************/    
    // Test Step 4: Check all Cores are running except core 0 shall be disabled
  /***************************************************************************************************************/

//Check All tasks of Core0 are stopped
  snprintf( chActionText, elCount(chActionText), "Check 2pt5ms Task Counter from Core0 "); 
  snprintf( chExpectedText, elCount(chExpectedText), "2pt5ms Counter from Core0 is stop  incrementing"); 
  TestStepAddActionExpected( chActionText, chExpectedText );
  A_DBGR_VariableRead( "Task_Core0_2pt5ms_Count", taskvalue);
  E_DBGR_VariableCheck("Task_Core0_2pt5ms_Count", taskvalue, Equal);
  
  snprintf( chActionText, elCount(chActionText), "Check 5ms Task Counter from Core0 "); 
  snprintf( chExpectedText, elCount(chExpectedText), "5ms Counter from Core0 is stop  incrementing"); 
  TestStepAddActionExpected( chActionText, chExpectedText );
  A_DBGR_VariableRead( "Task_Core0_5ms_Count", taskvalue);
  E_DBGR_VariableCheck("Task_Core0_5ms_Count", taskvalue, Equal);
  
  snprintf( chActionText, elCount(chActionText), "Check 10ms Task Counter from Core0 "); 
  snprintf( chExpectedText, elCount(chExpectedText), "10ms Counter from Core0 is stop  incrementing"); 
  TestStepAddActionExpected( chActionText, chExpectedText );
  A_DBGR_VariableRead( "Task_Core0_10ms_Count", taskvalue);
  E_DBGR_VariableCheck("Task_Core0_10ms_Count", taskvalue, Equal);  
  
  snprintf( chActionText, elCount(chActionText), "Check 25ms Task Counter from Core0 "); 
  snprintf( chExpectedText, elCount(chExpectedText), "25ms Counter from Core0 is stop  incrementing"); 
  TestStepAddActionExpected( chActionText, chExpectedText );
  A_DBGR_VariableRead( "Task_Core0_25ms_Count", taskvalue);
  E_DBGR_VariableCheck("Task_Core0_25ms_Count", taskvalue, Equal);  

  snprintf( chActionText, elCount(chActionText), "Check 50ms Task Counter from Core0 "); 
  snprintf( chExpectedText, elCount(chExpectedText), "50ms Counter from Core0 is stop  incrementing"); 
  TestStepAddActionExpected( chActionText, chExpectedText );
  A_DBGR_VariableRead( "Task_Core0_50ms_Count", taskvalue);
  E_DBGR_VariableCheck("Task_Core0_50ms_Count", taskvalue, Equal);
  
  snprintf( chActionText, elCount(chActionText), "Check 250ms Task Counter from Core0 "); 
  snprintf( chExpectedText, elCount(chExpectedText), "250ms Counter from Core0 is stop  incrementing"); 
  TestStepAddActionExpected( chActionText, chExpectedText );
  A_DBGR_VariableRead( "Task_Core0_250ms_Count", taskvalue);
  E_DBGR_VariableCheck("Task_Core0_250ms_Count", taskvalue, Equal);
  
  snprintf( chActionText, elCount(chActionText), "Check 100ms Task Counter from Core0 "); 
  snprintf( chExpectedText, elCount(chExpectedText), "100ms Counter from Core0 is stop  incrementing"); 
  TestStepAddActionExpected( chActionText, chExpectedText );
  A_DBGR_VariableRead( "Task_Core0_100ms_Count", taskvalue);
  E_DBGR_VariableCheck("Task_Core0_100ms_Count", taskvalue, Equal); 

  snprintf( chActionText, elCount(chActionText), "Check 500ms Task Counter from Core0 "); 
  snprintf( chExpectedText, elCount(chExpectedText), "500ms Counter from Core0 is stop  incrementing"); 
  TestStepAddActionExpected( chActionText, chExpectedText );
  A_DBGR_VariableRead( "Task_Core0_500ms_Count", taskvalue);
  E_DBGR_VariableCheck("Task_Core0_500ms_Count", taskvalue, Equal);
  
  snprintf( chActionText, elCount(chActionText), "Check 1000ms Task Counter from Core0 "); 
  snprintf( chExpectedText, elCount(chExpectedText), "1000ms Counter from Core0 is stop  incrementing"); 
  TestStepAddActionExpected( chActionText, chExpectedText );
  A_DBGR_VariableRead( "Task_Core0_1000ms_Count", taskvalue);
  E_DBGR_VariableCheck("Task_Core0_1000ms_Count", taskvalue, Equal);
  
  
  //Check All tasks of Core1 are running
  snprintf( chActionText, elCount(chActionText), "Check 2pt5ms Task Counter from Core1 "); 
  snprintf( chExpectedText, elCount(chExpectedText), "2pt5ms Counter from Core1 is  incrementing"); 
  TestStepAddActionExpected( chActionText, chExpectedText );
  A_DBGR_VariableRead( "Task_Core1_2pt5ms_Count", taskvalue);
  E_DBGR_VariableCheck("Task_Core1_2pt5ms_Count", taskvalue, Greater);
  
  snprintf( chActionText, elCount(chActionText), "Check 5ms Task Counter from Core1 "); 
  snprintf( chExpectedText, elCount(chExpectedText), "5ms Counter from Core1 is  incrementing"); 
  TestStepAddActionExpected( chActionText, chExpectedText );
  A_DBGR_VariableRead( "Task_Core1_5ms_Count", taskvalue);
  E_DBGR_VariableCheck("Task_Core1_5ms_Count", taskvalue, Greater);
  
  snprintf( chActionText, elCount(chActionText), "Check 10ms Task Counter from Core1 "); 
  snprintf( chExpectedText, elCount(chExpectedText), "10ms Counter from Core1 is  incrementing"); 
  TestStepAddActionExpected( chActionText, chExpectedText );
  A_DBGR_VariableRead( "Task_Core1_10ms_Count", taskvalue);
  E_DBGR_VariableCheck("Task_Core1_10ms_Count", taskvalue, Greater);  
  
  snprintf( chActionText, elCount(chActionText), "Check 25ms Task Counter from Core1 "); 
  snprintf( chExpectedText, elCount(chExpectedText), "25ms Counter from Core1 is  incrementing"); 
  TestStepAddActionExpected( chActionText, chExpectedText );
  A_DBGR_VariableRead( "Task_Core1_25ms_Count", taskvalue);
  E_DBGR_VariableCheck("Task_Core1_25ms_Count", taskvalue, Greater); 
  
  snprintf( chActionText, elCount(chActionText), "Check 50ms Task Counter from Core1 "); 
  snprintf( chExpectedText, elCount(chExpectedText), "50ms Counter from Core1 is  incrementing"); 
  TestStepAddActionExpected( chActionText, chExpectedText );
  A_DBGR_VariableRead( "Task_Core1_50ms_Count", taskvalue);
  E_DBGR_VariableCheck("Task_Core1_50ms_Count", taskvalue, Greater);
    
  snprintf( chActionText, elCount(chActionText), "Check 100ms Task Counter from Core1 "); 
  snprintf( chExpectedText, elCount(chExpectedText), "100ms Counter from Core1 is  incrementing"); 
  TestStepAddActionExpected( chActionText, chExpectedText );
  A_DBGR_VariableRead( "Task_Core1_100ms_Count", taskvalue);
  E_DBGR_VariableCheck("Task_Core1_100ms_Count", taskvalue, Greater);

  snprintf( chActionText, elCount(chActionText), "Check 250ms Task Counter from Core1 "); 
  snprintf( chExpectedText, elCount(chExpectedText), "250ms Counter from Core1 is  incrementing"); 
  TestStepAddActionExpected( chActionText, chExpectedText );
  A_DBGR_VariableRead( "Task_Core1_250ms_Count", taskvalue);
  E_DBGR_VariableCheck("Task_Core1_250ms_Count", taskvalue, Greater);
  
  snprintf( chActionText, elCount(chActionText), "Check 500ms Task Counter from Core1 "); 
  snprintf( chExpectedText, elCount(chExpectedText), "500ms Counter from Core1 is  incrementing"); 
  TestStepAddActionExpected( chActionText, chExpectedText );
  A_DBGR_VariableRead( "Task_Core1_500ms_Count", taskvalue);
  E_DBGR_VariableCheck("Task_Core1_500ms_Count", taskvalue, Greater);

  snprintf( chActionText, elCount(chActionText), "Check 1000ms Task Counter from Core1 "); 
  snprintf( chExpectedText, elCount(chExpectedText), "1000ms Counter from Core1 is incrementing"); 
  TestStepAddActionExpected( chActionText, chExpectedText );
  A_DBGR_VariableRead( "Task_Core1_1000ms_Count", taskvalue);
  E_DBGR_VariableCheck("Task_Core1_1000ms_Count", taskvalue, Greater);
  
  
  //Check All tasks of Core2 are running
  snprintf( chActionText, elCount(chActionText), "Check 2pt5ms Task Counter from Core2 "); 
  snprintf( chExpectedText, elCount(chExpectedText), "2pt5ms Counter from Core2 is  incrementing"); 
  TestStepAddActionExpected( chActionText, chExpectedText );
  A_DBGR_VariableRead( "Task_Core2_2pt5ms_Count", taskvalue);
  E_DBGR_VariableCheck("Task_Core2_2pt5ms_Count", taskvalue, Greater);
  
  snprintf( chActionText, elCount(chActionText), "Check 5ms Task Counter from Core2 "); 
  snprintf( chExpectedText, elCount(chExpectedText), "5ms Counter from Core2 is  incrementing"); 
  TestStepAddActionExpected( chActionText, chExpectedText );
  A_DBGR_VariableRead( "Task_Core2_5ms_Count", taskvalue);
  E_DBGR_VariableCheck("Task_Core2_5ms_Count", taskvalue, Greater);
  
  snprintf( chActionText, elCount(chActionText), "Check 10ms Task Counter from Core2 "); 
  snprintf( chExpectedText, elCount(chExpectedText), "10ms Counter from Core2 is  incrementing"); 
  TestStepAddActionExpected( chActionText, chExpectedText );
  A_DBGR_VariableRead( "Task_Core2_10ms_Count", taskvalue);
  E_DBGR_VariableCheck("Task_Core2_10ms_Count", taskvalue, Greater);  
  
  snprintf( chActionText, elCount(chActionText), "Check 25ms Task Counter from Core2 "); 
  snprintf( chExpectedText, elCount(chExpectedText), "25ms Counter from Core2 is  incrementing"); 
  TestStepAddActionExpected( chActionText, chExpectedText );
  A_DBGR_VariableRead( "Task_Core2_25ms_Count", taskvalue);
  E_DBGR_VariableCheck("Task_Core2_25ms_Count", taskvalue, Greater); 

  snprintf( chActionText, elCount(chActionText), "Check 50ms Task Counter from Core2 "); 
  snprintf( chExpectedText, elCount(chExpectedText), "50ms Counter from Core2 is  incrementing"); 
  TestStepAddActionExpected( chActionText, chExpectedText );
  A_DBGR_VariableRead( "Task_Core2_50ms_Count", taskvalue);
  E_DBGR_VariableCheck("Task_Core2_50ms_Count", taskvalue, Greater);
  
  snprintf( chActionText, elCount(chActionText), "Check 100ms Task Counter from Core2 "); 
  snprintf( chExpectedText, elCount(chExpectedText), "100ms Counter from Core2 is  incrementing"); 
  TestStepAddActionExpected( chActionText, chExpectedText );
  A_DBGR_VariableRead( "Task_Core2_100ms_Count", taskvalue);
  E_DBGR_VariableCheck("Task_Core2_100ms_Count", taskvalue, Greater); 
  
  snprintf( chActionText, elCount(chActionText), "Check 250ms Task Counter from Core2 "); 
  snprintf( chExpectedText, elCount(chExpectedText), "250ms Counter from Core2 is  incrementing"); 
  TestStepAddActionExpected( chActionText, chExpectedText );
  A_DBGR_VariableRead( "Task_Core2_250ms_Count", taskvalue);
  E_DBGR_VariableCheck("Task_Core2_250ms_Count", taskvalue, Greater);

  snprintf( chActionText, elCount(chActionText), "Check 500ms Task Counter from Core2 "); 
  snprintf( chExpectedText, elCount(chExpectedText), "500ms Counter from Core2 is  incrementing"); 
  TestStepAddActionExpected( chActionText, chExpectedText );
  A_DBGR_VariableRead( "Task_Core2_500ms_Count", taskvalue);
  E_DBGR_VariableCheck("Task_Core2_500ms_Count", taskvalue, Greater);

  snprintf( chActionText, elCount(chActionText), "Check 1000ms Task Counter from Core2 "); 
  snprintf( chExpectedText, elCount(chExpectedText), "1000ms Counter from Core2 is  incrementing"); 
  TestStepAddActionExpected( chActionText, chExpectedText );
  A_DBGR_VariableRead( "Task_Core2_1000ms_Count", taskvalue);
  E_DBGR_VariableCheck("Task_Core2_1000ms_Count", taskvalue, Greater);
  
  
    //Check All tasks of Core3 are running
  snprintf( chActionText, elCount(chActionText), "Check 2pt5ms Task Counter from Core3 "); 
  snprintf( chExpectedText, elCount(chExpectedText), "2pt5ms Counter from Core3 is  incrementing"); 
  TestStepAddActionExpected( chActionText, chExpectedText );
  A_DBGR_VariableRead( "Task_Core3_2pt5ms_Count", taskvalue);
  E_DBGR_VariableCheck("Task_Core3_2pt5ms_Count", taskvalue, Greater);
  
   snprintf( chActionText, elCount(chActionText), "Check 5ms Task Counter from Core3 "); 
  snprintf( chExpectedText, elCount(chExpectedText), "5ms Counter from Core3 is  incrementing"); 
  TestStepAddActionExpected( chActionText, chExpectedText );
  A_DBGR_VariableRead( "Task_Core3_5ms_Count", taskvalue);
  E_DBGR_VariableCheck("Task_Core3_5ms_Count", taskvalue, Greater);
  
  snprintf( chActionText, elCount(chActionText), "Check 10ms Task Counter from Core3 "); 
  snprintf( chExpectedText, elCount(chExpectedText), "10ms Counter from Core3 is  incrementing"); 
  TestStepAddActionExpected( chActionText, chExpectedText );
  A_DBGR_VariableRead( "Task_Core3_10ms_Count", taskvalue);
  E_DBGR_VariableCheck("Task_Core3_10ms_Count", taskvalue, Greater);  
  
  snprintf( chActionText, elCount(chActionText), "Check 25ms Task Counter from Core3 "); 
  snprintf( chExpectedText, elCount(chExpectedText), "25ms Counter from Core3 is  incrementing"); 
  TestStepAddActionExpected( chActionText, chExpectedText );
  A_DBGR_VariableRead( "Task_Core3_25ms_Count", taskvalue);
  E_DBGR_VariableCheck("Task_Core3_25ms_Count", taskvalue, Greater);  
  
  snprintf( chActionText, elCount(chActionText), "Check 50ms Task Counter from Core3 "); 
  snprintf( chExpectedText, elCount(chExpectedText), "50ms Counter from Core3 is  incrementing"); 
  TestStepAddActionExpected( chActionText, chExpectedText );
  A_DBGR_VariableRead( "Task_Core3_50ms_Count", taskvalue);
  E_DBGR_VariableCheck("Task_Core3_50ms_Count", taskvalue, Greater);

  snprintf( chActionText, elCount(chActionText), "Check 100ms Task Counter from Core3 "); 
  snprintf( chExpectedText, elCount(chExpectedText), "100ms Counter from Core3 is  incrementing"); 
  TestStepAddActionExpected( chActionText, chExpectedText );
  A_DBGR_VariableRead( "Task_Core3_100ms_Count", taskvalue);
  E_DBGR_VariableCheck("Task_Core3_100ms_Count", taskvalue, Greater); 
  
  snprintf( chActionText, elCount(chActionText), "Check 250ms Task Counter from Core3 "); 
  snprintf( chExpectedText, elCount(chExpectedText), "250ms Counter from Core3 is  incrementing"); 
  TestStepAddActionExpected( chActionText, chExpectedText );
  A_DBGR_VariableRead( "Task_Core3_250ms_Count", taskvalue);
  E_DBGR_VariableCheck("Task_Core3_250ms_Count", taskvalue, Greater);
  
  snprintf( chActionText, elCount(chActionText), "Check 1000ms Task Counter from Core3 "); 
  snprintf( chExpectedText, elCount(chExpectedText), "1000ms Counter from Core3 is  incrementing"); 
  TestStepAddActionExpected( chActionText, chExpectedText );
  A_DBGR_VariableRead( "Task_Core3_1000ms_Count", taskvalue);
  E_DBGR_VariableCheck("Task_Core3_1000ms_Count", taskvalue, Greater);
  
    //Check task from Core4 is running
  snprintf( chActionText, elCount(chActionText), "Check 1000ms Task Counter from Core4 "); 
  snprintf( chExpectedText, elCount(chExpectedText), "1000ms Counter from Core4 is  incrementing"); 
  TestStepAddActionExpected( chActionText, chExpectedText );
  A_DBGR_VariableRead( "Task_Core4_1000ms_Count", taskvalue);
  E_DBGR_VariableCheck("Task_Core4_1000ms_Count", taskvalue, Greater);
    
  //Check task from Core5 is running
  snprintf( chActionText, elCount(chActionText), "Check 1000ms Task Counter from Core5 "); 
  snprintf( chExpectedText, elCount(chExpectedText), "1000ms Counter from Core5 is  incrementing"); 
  TestStepAddActionExpected( chActionText, chExpectedText );
  A_DBGR_VariableRead( "Task_Core5_1000ms_Count", taskvalue);
  E_DBGR_VariableCheck("Task_Core5_1000ms_Count", taskvalue, Greater);

  
}



/***************************************************************************************************
----------------------------------------------------------------------------------------------------
Test case name:  TC_L30SW_Q-36684439: Testcase_to_verify_the_functionality_of_interface_DsblHWIO_GM_TaskInits_to_prohibits_all_application_defined_RTOS_tasks_and_application_ISRs_from_pre_empting_the_current_task_or_ISR_on_the_CPU1.
----------------------------------------------------------------------------------------------------
Description:   Test case to verify the functionality of interface GetHWIO_e_CPU() to check the ActiveCPU_ID for currently executing CPU1.

***************************************************************************************************/
testcase Testcase_to_verify_DsblHWIO_GM_TaskInits_to_prohibits_all_RTOS_tasks_and_ISRs_from_preempting_current_task_or_ISR_on_the_CPU1()
{
  /***************************************************************************************************************/    
                                                // Variable Definition
  /***************************************************************************************************************/ 
  
  long taskvalue;
  
  /***************************************************************************************************************/    
                                               // Local Values
  /***************************************************************************************************************/ 
  

  
  /***************************************************************************************************************/    
                                              // Test Case Info
  /***************************************************************************************************************/
  setWriteDbgLevel(DebugOff);
  snprintf( chTestTitle, elCount(chTestTitle), "Testcase_to_verify_the_functionality_of_interface_DsblHWIO_GM_TaskInits_to_prohibits_all_application_defined_RTOS_tasks_and_application_ISRs_from_pre_empting_the_current_task_or_ISR_on_the_CPU1" );
  snprintf( chTestDescription, elCount(chTestDescription), "Purpose: test case to verify the functionality of interface DsblHWIO_GM_TaskInits to to prohibits all application defined RTOS tasks and application ISRs from pre-empting the current task or ISR on the CPU1.");
  TestCaseAddInfo( chTestTitle, "TC_L30SW_Q-36684439", chTestDescription );

  /***************************************************************************************************************/    
                                              // Start of Test Case
  /***************************************************************************************************************/
  
  /***************************************************************************************************************/    
                                              // Test Step 1 PRECONDITIONS
  /***************************************************************************************************************/
  
  snprintf( chActionText, elCount(chActionText), "Flash the Software and ECU is running"); 
  snprintf( chExpectedText, elCount(chExpectedText), "ECU should be in running state"); 
  TestStepAddActionExpected( chActionText, chExpectedText );

  A_DBGR_BreakpointDeleteAll();
  A_DBGR_RnGo();
  E_DBGR_CheckState(T32_State_Running);
  

   /***************************************************************************************************************/    
            // Test Step 2: Check all cores are in running state                                   
  /***************************************************************************************************************/
  
  //Check Core0 is running
  snprintf( chActionText, elCount(chActionText), "Check 1000ms Task Counter from Core0 "); 
  snprintf( chExpectedText, elCount(chExpectedText), "1000ms Counter from Core0 is incrementing"); 
  TestStepAddActionExpected( chActionText, chExpectedText );
  A_DBGR_VariableRead( "Task_Core0_1000ms_Count", taskvalue);
  E_DBGR_VariableCheck("Task_Core0_1000ms_Count", taskvalue, Greater);
  
  //Check Core1 is running
  snprintf( chActionText, elCount(chActionText), "Check 1000ms Task Counter from Core1 "); 
  snprintf( chExpectedText, elCount(chExpectedText), "1000ms Counter from Core1 is incrementing"); 
  TestStepAddActionExpected( chActionText, chExpectedText );
  A_DBGR_VariableRead( "Task_Core1_1000ms_Count", taskvalue);
  E_DBGR_VariableCheck("Task_Core1_1000ms_Count", taskvalue, Greater);
  
  //Check Core2 is running
  snprintf( chActionText, elCount(chActionText), "Check 1000ms Task Counter from Core2 "); 
  snprintf( chExpectedText, elCount(chExpectedText), "1000ms Counter from Core2 is incrementing"); 
  TestStepAddActionExpected( chActionText, chExpectedText );
  A_DBGR_VariableRead( "Task_Core2_1000ms_Count", taskvalue);
  E_DBGR_VariableCheck("Task_Core2_1000ms_Count", taskvalue, Greater);
    
  //Check Core3 is running
  snprintf( chActionText, elCount(chActionText), "Check 1000ms Task Counter from Core3 "); 
  snprintf( chExpectedText, elCount(chExpectedText), "1000ms Counter from Core3 is incrementing"); 
  TestStepAddActionExpected( chActionText, chExpectedText );
  A_DBGR_VariableRead( "Task_Core3_1000ms_Count", taskvalue);
  E_DBGR_VariableCheck("Task_Core3_1000ms_Count", taskvalue, Greater);
    
  //Check Core4 is running
  snprintf( chActionText, elCount(chActionText), "Check 1000ms Task Counter from Core4 "); 
  snprintf( chExpectedText, elCount(chExpectedText), "1000ms Counter from Core4 is incrementing"); 
  TestStepAddActionExpected( chActionText, chExpectedText );
  A_DBGR_VariableRead( "Task_Core4_1000ms_Count", taskvalue);
  E_DBGR_VariableCheck("Task_Core4_1000ms_Count", taskvalue, Greater);
    
  //Check Core5 is running
  snprintf( chActionText, elCount(chActionText), "Check 1000ms Task Counter from Core5 "); 
  snprintf( chExpectedText, elCount(chExpectedText), "1000ms Counter from Core5 is incrementing"); 
  TestStepAddActionExpected( chActionText, chExpectedText );
  A_DBGR_VariableRead( "Task_Core5_1000ms_Count", taskvalue);
  E_DBGR_VariableCheck("Task_Core5_1000ms_Count", taskvalue, Greater);
  

  /***************************************************************************************************************/    
    // Test Step 3: Disable Interface DsblHWIO_GM_TaskInits for Core1
  /***************************************************************************************************************/

  snprintf( chActionText, elCount(chActionText), "Disable Interface DsblHWIO_GM_TaskInits for 1000ms Task for core1 "); 
  snprintf( chExpectedText, elCount(chExpectedText), "Check Interface DsblHWIO_GM_TaskInits 1000ms Task for core1 shall set to 1 "); 
  TestStepAddActionExpected( chActionText, chExpectedText );
  A_DBGR_VariableSet("test_disable_task_initiator_core1", "1");
  E_DBGR_VariableCheck("test_disable_task_initiator_core1", 1, Equal);    


  /***************************************************************************************************************/    
    // Test Step 4: Check all Cores are running except core 1, shall be disabled
  /***************************************************************************************************************/


  //Check All tasks of Core0 are Running
  snprintf( chActionText, elCount(chActionText), "Check 2pt5ms Task Counter from Core0 "); 
  snprintf( chExpectedText, elCount(chExpectedText), "2pt5ms Counter from Core0 is  incrementing"); 
  TestStepAddActionExpected( chActionText, chExpectedText );
  A_DBGR_VariableRead( "Task_Core0_2pt5ms_Count", taskvalue);
  E_DBGR_VariableCheck("Task_Core0_2pt5ms_Count", taskvalue, Greater);
  
  snprintf( chActionText, elCount(chActionText), "Check 5ms Task Counter from Core0 "); 
  snprintf( chExpectedText, elCount(chExpectedText), "5ms Counter from Core0 is  incrementing"); 
  TestStepAddActionExpected( chActionText, chExpectedText );
  A_DBGR_VariableRead( "Task_Core0_5ms_Count", taskvalue);
  E_DBGR_VariableCheck("Task_Core0_5ms_Count", taskvalue, Greater);
  
  snprintf( chActionText, elCount(chActionText), "Check 10ms Task Counter from Core0 "); 
  snprintf( chExpectedText, elCount(chExpectedText), "10ms Counter from Core0 is  incrementing"); 
  TestStepAddActionExpected( chActionText, chExpectedText );
  A_DBGR_VariableRead( "Task_Core0_10ms_Count", taskvalue);
  E_DBGR_VariableCheck("Task_Core0_10ms_Count", taskvalue, Greater);  
  
  snprintf( chActionText, elCount(chActionText), "Check 25ms Task Counter from Core0 "); 
  snprintf( chExpectedText, elCount(chExpectedText), "25ms Counter from Core0 is  incrementing"); 
  TestStepAddActionExpected( chActionText, chExpectedText );
  A_DBGR_VariableRead( "Task_Core0_25ms_Count", taskvalue);
  E_DBGR_VariableCheck("Task_Core0_25ms_Count", taskvalue, Greater);  

  snprintf( chActionText, elCount(chActionText), "Check 50ms Task Counter from Core0 "); 
  snprintf( chExpectedText, elCount(chExpectedText), "50ms Counter from Core0 is  incrementing"); 
  TestStepAddActionExpected( chActionText, chExpectedText );
  A_DBGR_VariableRead( "Task_Core0_50ms_Count", taskvalue);
  E_DBGR_VariableCheck("Task_Core0_50ms_Count", taskvalue, Greater);
  
  snprintf( chActionText, elCount(chActionText), "Check 250ms Task Counter from Core0 "); 
  snprintf( chExpectedText, elCount(chExpectedText), "250ms Counter from Core0 is  incrementing"); 
  TestStepAddActionExpected( chActionText, chExpectedText );
  A_DBGR_VariableRead( "Task_Core0_250ms_Count", taskvalue);
  E_DBGR_VariableCheck("Task_Core0_250ms_Count", taskvalue, Greater);
  
  snprintf( chActionText, elCount(chActionText), "Check 100ms Task Counter from Core0 "); 
  snprintf( chExpectedText, elCount(chExpectedText), "100ms Counter from Core0 is  incrementing"); 
  TestStepAddActionExpected( chActionText, chExpectedText );
  A_DBGR_VariableRead( "Task_Core0_100ms_Count", taskvalue);
  E_DBGR_VariableCheck("Task_Core0_100ms_Count", taskvalue, Greater); 

  snprintf( chActionText, elCount(chActionText), "Check 500ms Task Counter from Core0 "); 
  snprintf( chExpectedText, elCount(chExpectedText), "500ms Counter from Core0 is  incrementing"); 
  TestStepAddActionExpected( chActionText, chExpectedText );
  A_DBGR_VariableRead( "Task_Core0_500ms_Count", taskvalue);
  E_DBGR_VariableCheck("Task_Core0_500ms_Count", taskvalue, Greater);
  
  snprintf( chActionText, elCount(chActionText), "Check 1000ms Task Counter from Core0 "); 
  snprintf( chExpectedText, elCount(chExpectedText), "1000ms Counter from Core0 is  incrementing"); 
  TestStepAddActionExpected( chActionText, chExpectedText );
  A_DBGR_VariableRead( "Task_Core0_1000ms_Count", taskvalue);
  E_DBGR_VariableCheck("Task_Core0_1000ms_Count", taskvalue, Greater);
  
  
  //Check All tasks of Core1 are Stopped
  snprintf( chActionText, elCount(chActionText), "Check 2pt5ms Task Counter from Core1 "); 
  snprintf( chExpectedText, elCount(chExpectedText), "2pt5ms Counter from Core1 is stop  incrementing"); 
  TestStepAddActionExpected( chActionText, chExpectedText );
  A_DBGR_VariableRead( "Task_Core1_2pt5ms_Count", taskvalue);
  E_DBGR_VariableCheck("Task_Core1_2pt5ms_Count", taskvalue, Equal);
  
  snprintf( chActionText, elCount(chActionText), "Check 5ms Task Counter from Core1 "); 
  snprintf( chExpectedText, elCount(chExpectedText), "5ms Counter from Core1 is stop  incrementing"); 
  TestStepAddActionExpected( chActionText, chExpectedText );
  A_DBGR_VariableRead( "Task_Core1_5ms_Count", taskvalue);
  E_DBGR_VariableCheck("Task_Core1_5ms_Count", taskvalue, Equal);
  
  snprintf( chActionText, elCount(chActionText), "Check 10ms Task Counter from Core1 "); 
  snprintf( chExpectedText, elCount(chExpectedText), "10ms Counter from Core1 is stop  incrementing"); 
  TestStepAddActionExpected( chActionText, chExpectedText );
  A_DBGR_VariableRead( "Task_Core1_10ms_Count", taskvalue);
  E_DBGR_VariableCheck("Task_Core1_10ms_Count", taskvalue, Equal);  
  
  snprintf( chActionText, elCount(chActionText), "Check 25ms Task Counter from Core1 "); 
  snprintf( chExpectedText, elCount(chExpectedText), "25ms Counter from Core1 is stop  incrementing"); 
  TestStepAddActionExpected( chActionText, chExpectedText );
  A_DBGR_VariableRead( "Task_Core1_25ms_Count", taskvalue);
  E_DBGR_VariableCheck("Task_Core1_25ms_Count", taskvalue, Equal); 
  
  snprintf( chActionText, elCount(chActionText), "Check 50ms Task Counter from Core1 "); 
  snprintf( chExpectedText, elCount(chExpectedText), "50ms Counter from Core1 is stop  incrementing"); 
  TestStepAddActionExpected( chActionText, chExpectedText );
  A_DBGR_VariableRead( "Task_Core1_50ms_Count", taskvalue);
  E_DBGR_VariableCheck("Task_Core1_50ms_Count", taskvalue, Equal);
    
  snprintf( chActionText, elCount(chActionText), "Check 100ms Task Counter from Core1 "); 
  snprintf( chExpectedText, elCount(chExpectedText), "100ms Counter from Core1 is stop  incrementing"); 
  TestStepAddActionExpected( chActionText, chExpectedText );
  A_DBGR_VariableRead( "Task_Core1_100ms_Count", taskvalue);
  E_DBGR_VariableCheck("Task_Core1_100ms_Count", taskvalue, Equal);

  snprintf( chActionText, elCount(chActionText), "Check 250ms Task Counter from Core1 "); 
  snprintf( chExpectedText, elCount(chExpectedText), "250ms Counter from Core1 is stop  incrementing"); 
  TestStepAddActionExpected( chActionText, chExpectedText );
  A_DBGR_VariableRead( "Task_Core1_250ms_Count", taskvalue);
  E_DBGR_VariableCheck("Task_Core1_250ms_Count", taskvalue, Equal);
  
  snprintf( chActionText, elCount(chActionText), "Check 500ms Task Counter from Core1 "); 
  snprintf( chExpectedText, elCount(chExpectedText), "500ms Counter from Core1 is stop  incrementing"); 
  TestStepAddActionExpected( chActionText, chExpectedText );
  A_DBGR_VariableRead( "Task_Core1_500ms_Count", taskvalue);
  E_DBGR_VariableCheck("Task_Core1_500ms_Count", taskvalue, Equal);

  snprintf( chActionText, elCount(chActionText), "Check 1000ms Task Counter from Core1 "); 
  snprintf( chExpectedText, elCount(chExpectedText), "1000ms Counter from Core1 is stop incrementing"); 
  TestStepAddActionExpected( chActionText, chExpectedText );
  A_DBGR_VariableRead( "Task_Core1_1000ms_Count", taskvalue);
  E_DBGR_VariableCheck("Task_Core1_1000ms_Count", taskvalue, Equal);
  
  
  //Check All tasks of Core2 are running
  snprintf( chActionText, elCount(chActionText), "Check 2pt5ms Task Counter from Core2 "); 
  snprintf( chExpectedText, elCount(chExpectedText), "2pt5ms Counter from Core2 is  incrementing"); 
  TestStepAddActionExpected( chActionText, chExpectedText );
  A_DBGR_VariableRead( "Task_Core2_2pt5ms_Count", taskvalue);
  E_DBGR_VariableCheck("Task_Core2_2pt5ms_Count", taskvalue, Greater);
  
  snprintf( chActionText, elCount(chActionText), "Check 5ms Task Counter from Core2 "); 
  snprintf( chExpectedText, elCount(chExpectedText), "5ms Counter from Core2 is  incrementing"); 
  TestStepAddActionExpected( chActionText, chExpectedText );
  A_DBGR_VariableRead( "Task_Core2_5ms_Count", taskvalue);
  E_DBGR_VariableCheck("Task_Core2_5ms_Count", taskvalue, Greater);
  
  snprintf( chActionText, elCount(chActionText), "Check 10ms Task Counter from Core2 "); 
  snprintf( chExpectedText, elCount(chExpectedText), "10ms Counter from Core2 is  incrementing"); 
  TestStepAddActionExpected( chActionText, chExpectedText );
  A_DBGR_VariableRead( "Task_Core2_10ms_Count", taskvalue);
  E_DBGR_VariableCheck("Task_Core2_10ms_Count", taskvalue, Greater);  
  
  snprintf( chActionText, elCount(chActionText), "Check 25ms Task Counter from Core2 "); 
  snprintf( chExpectedText, elCount(chExpectedText), "25ms Counter from Core2 is  incrementing"); 
  TestStepAddActionExpected( chActionText, chExpectedText );
  A_DBGR_VariableRead( "Task_Core2_25ms_Count", taskvalue);
  E_DBGR_VariableCheck("Task_Core2_25ms_Count", taskvalue, Greater); 

  snprintf( chActionText, elCount(chActionText), "Check 50ms Task Counter from Core2 "); 
  snprintf( chExpectedText, elCount(chExpectedText), "50ms Counter from Core2 is  incrementing"); 
  TestStepAddActionExpected( chActionText, chExpectedText );
  A_DBGR_VariableRead( "Task_Core2_50ms_Count", taskvalue);
  E_DBGR_VariableCheck("Task_Core2_50ms_Count", taskvalue, Greater);
  
  snprintf( chActionText, elCount(chActionText), "Check 100ms Task Counter from Core2 "); 
  snprintf( chExpectedText, elCount(chExpectedText), "100ms Counter from Core2 is  incrementing"); 
  TestStepAddActionExpected( chActionText, chExpectedText );
  A_DBGR_VariableRead( "Task_Core2_100ms_Count", taskvalue);
  E_DBGR_VariableCheck("Task_Core2_100ms_Count", taskvalue, Greater); 
  
  snprintf( chActionText, elCount(chActionText), "Check 250ms Task Counter from Core2 "); 
  snprintf( chExpectedText, elCount(chExpectedText), "250ms Counter from Core2 is  incrementing"); 
  TestStepAddActionExpected( chActionText, chExpectedText );
  A_DBGR_VariableRead( "Task_Core2_250ms_Count", taskvalue);
  E_DBGR_VariableCheck("Task_Core2_250ms_Count", taskvalue, Greater);

  snprintf( chActionText, elCount(chActionText), "Check 500ms Task Counter from Core2 "); 
  snprintf( chExpectedText, elCount(chExpectedText), "500ms Counter from Core2 is  incrementing"); 
  TestStepAddActionExpected( chActionText, chExpectedText );
  A_DBGR_VariableRead( "Task_Core2_500ms_Count", taskvalue);
  E_DBGR_VariableCheck("Task_Core2_500ms_Count", taskvalue, Greater);

  snprintf( chActionText, elCount(chActionText), "Check 1000ms Task Counter from Core2 "); 
  snprintf( chExpectedText, elCount(chExpectedText), "1000ms Counter from Core2 is  incrementing"); 
  TestStepAddActionExpected( chActionText, chExpectedText );
  A_DBGR_VariableRead( "Task_Core2_1000ms_Count", taskvalue);
  E_DBGR_VariableCheck("Task_Core2_1000ms_Count", taskvalue, Greater);
  
  
    //Check All tasks of Core3 are running
  snprintf( chActionText, elCount(chActionText), "Check 2pt5ms Task Counter from Core3 "); 
  snprintf( chExpectedText, elCount(chExpectedText), "2pt5ms Counter from Core3 is  incrementing"); 
  TestStepAddActionExpected( chActionText, chExpectedText );
  A_DBGR_VariableRead( "Task_Core3_2pt5ms_Count", taskvalue);
  E_DBGR_VariableCheck("Task_Core3_2pt5ms_Count", taskvalue, Greater);
  
   snprintf( chActionText, elCount(chActionText), "Check 5ms Task Counter from Core3 "); 
  snprintf( chExpectedText, elCount(chExpectedText), "5ms Counter from Core3 is  incrementing"); 
  TestStepAddActionExpected( chActionText, chExpectedText );
  A_DBGR_VariableRead( "Task_Core3_5ms_Count", taskvalue);
  E_DBGR_VariableCheck("Task_Core3_5ms_Count", taskvalue, Greater);
  
  snprintf( chActionText, elCount(chActionText), "Check 10ms Task Counter from Core3 "); 
  snprintf( chExpectedText, elCount(chExpectedText), "10ms Counter from Core3 is  incrementing"); 
  TestStepAddActionExpected( chActionText, chExpectedText );
  A_DBGR_VariableRead( "Task_Core3_10ms_Count", taskvalue);
  E_DBGR_VariableCheck("Task_Core3_10ms_Count", taskvalue, Greater);  
  
  snprintf( chActionText, elCount(chActionText), "Check 25ms Task Counter from Core3 "); 
  snprintf( chExpectedText, elCount(chExpectedText), "25ms Counter from Core3 is  incrementing"); 
  TestStepAddActionExpected( chActionText, chExpectedText );
  A_DBGR_VariableRead( "Task_Core3_25ms_Count", taskvalue);
  E_DBGR_VariableCheck("Task_Core3_25ms_Count", taskvalue, Greater);  
  
  snprintf( chActionText, elCount(chActionText), "Check 50ms Task Counter from Core3 "); 
  snprintf( chExpectedText, elCount(chExpectedText), "50ms Counter from Core3 is  incrementing"); 
  TestStepAddActionExpected( chActionText, chExpectedText );
  A_DBGR_VariableRead( "Task_Core3_50ms_Count", taskvalue);
  E_DBGR_VariableCheck("Task_Core3_50ms_Count", taskvalue, Greater);

  snprintf( chActionText, elCount(chActionText), "Check 100ms Task Counter from Core3 "); 
  snprintf( chExpectedText, elCount(chExpectedText), "100ms Counter from Core3 is  incrementing"); 
  TestStepAddActionExpected( chActionText, chExpectedText );
  A_DBGR_VariableRead( "Task_Core3_100ms_Count", taskvalue);
  E_DBGR_VariableCheck("Task_Core3_100ms_Count", taskvalue, Greater); 
  
  snprintf( chActionText, elCount(chActionText), "Check 250ms Task Counter from Core3 "); 
  snprintf( chExpectedText, elCount(chExpectedText), "250ms Counter from Core3 is  incrementing"); 
  TestStepAddActionExpected( chActionText, chExpectedText );
  A_DBGR_VariableRead( "Task_Core3_250ms_Count", taskvalue);
  E_DBGR_VariableCheck("Task_Core3_250ms_Count", taskvalue, Greater);
  
  snprintf( chActionText, elCount(chActionText), "Check 1000ms Task Counter from Core3 "); 
  snprintf( chExpectedText, elCount(chExpectedText), "1000ms Counter from Core3 is  incrementing"); 
  TestStepAddActionExpected( chActionText, chExpectedText );
  A_DBGR_VariableRead( "Task_Core3_1000ms_Count", taskvalue);
  E_DBGR_VariableCheck("Task_Core3_1000ms_Count", taskvalue, Greater);
  
    //Check task from Core4 is running
  snprintf( chActionText, elCount(chActionText), "Check 1000ms Task Counter from Core4 "); 
  snprintf( chExpectedText, elCount(chExpectedText), "1000ms Counter from Core4 is  incrementing"); 
  TestStepAddActionExpected( chActionText, chExpectedText );
  A_DBGR_VariableRead( "Task_Core4_1000ms_Count", taskvalue);
  E_DBGR_VariableCheck("Task_Core4_1000ms_Count", taskvalue, Greater);
    
  //Check task from Core5 is running
  snprintf( chActionText, elCount(chActionText), "Check 1000ms Task Counter from Core5 "); 
  snprintf( chExpectedText, elCount(chExpectedText), "1000ms Counter from Core5 is  incrementing"); 
  TestStepAddActionExpected( chActionText, chExpectedText );
  A_DBGR_VariableRead( "Task_Core5_1000ms_Count", taskvalue);
  E_DBGR_VariableCheck("Task_Core5_1000ms_Count", taskvalue, Greater);
  
  

  
}



/***************************************************************************************************
----------------------------------------------------------------------------------------------------
Test case name:  TC_L30SW_Q-36684437: Testcase_to_verify_the_functionality_of_interface_DsblHWIO_GM_TaskInits_to_prohibits_all_application_defined_RTOS_tasks_and_application_ISRs_from_pre_empting_the_current_task_or_ISR_on_the_CPU1.
----------------------------------------------------------------------------------------------------
Description:   Test case to verify the functionality of interface GetHWIO_e_CPU() to check the ActiveCPU_ID for currently executing CPU1.

***************************************************************************************************/
testcase Testcase_to_verify_DsblHWIO_GM_TaskInits_to_prohibits_all_RTOS_tasks_and_ISRs_from_preempting_current_task_or_ISR_on_the_CPU2()
{
  /***************************************************************************************************************/    
                                                // Variable Definition
  /***************************************************************************************************************/ 
  
  long taskvalue;
  
  /***************************************************************************************************************/    
                                               // Local Values
  /***************************************************************************************************************/ 
  

  
  /***************************************************************************************************************/    
                                              // Test Case Info
  /***************************************************************************************************************/
  setWriteDbgLevel(DebugOff);
  snprintf( chTestTitle, elCount(chTestTitle), "Testcase_to_verify_the_functionality_of_interface_DsblHWIO_GM_TaskInits_to_prohibits_all_application_defined_RTOS_tasks_and_application_ISRs_from_pre_empting_the_current_task_or_ISR_on_the_CPU1" );
  snprintf( chTestDescription, elCount(chTestDescription), "Purpose: test case to verify the functionality of interface DsblHWIO_GM_TaskInits to to prohibits all application defined RTOS tasks and application ISRs from pre-empting the current task or ISR on the CPU1.");
  TestCaseAddInfo( chTestTitle, "TC_L30SW_Q-36684437", chTestDescription );

  /***************************************************************************************************************/    
                                              // Start of Test Case
  /***************************************************************************************************************/
  
  /***************************************************************************************************************/    
                                              // Test Step 1 PRECONDITIONS
  /***************************************************************************************************************/
  
  snprintf( chActionText, elCount(chActionText), "Flash the Software and ECU is running"); 
  snprintf( chExpectedText, elCount(chExpectedText), "ECU should be in running state"); 
  TestStepAddActionExpected( chActionText, chExpectedText );

  A_DBGR_BreakpointDeleteAll();
  A_DBGR_RnGo();
  E_DBGR_CheckState(T32_State_Running);
  

   /***************************************************************************************************************/    
            // Test Step 2: Check all cores are in running state                                   
  /***************************************************************************************************************/
  
  //Check Core0 is running
  snprintf( chActionText, elCount(chActionText), "Check 1000ms Task Counter from Core0 "); 
  snprintf( chExpectedText, elCount(chExpectedText), "1000ms Counter from Core0 is incrementing"); 
  TestStepAddActionExpected( chActionText, chExpectedText );
  A_DBGR_VariableRead( "Task_Core0_1000ms_Count", taskvalue);
  E_DBGR_VariableCheck("Task_Core0_1000ms_Count", taskvalue, Greater);
  
  //Check Core1 is running
  snprintf( chActionText, elCount(chActionText), "Check 1000ms Task Counter from Core1 "); 
  snprintf( chExpectedText, elCount(chExpectedText), "1000ms Counter from Core1 is incrementing"); 
  TestStepAddActionExpected( chActionText, chExpectedText );
  A_DBGR_VariableRead( "Task_Core1_1000ms_Count", taskvalue);
  E_DBGR_VariableCheck("Task_Core1_1000ms_Count", taskvalue, Greater);
  
  //Check Core2 is running
  snprintf( chActionText, elCount(chActionText), "Check 1000ms Task Counter from Core2 "); 
  snprintf( chExpectedText, elCount(chExpectedText), "1000ms Counter from Core2 is incrementing"); 
  TestStepAddActionExpected( chActionText, chExpectedText );
  A_DBGR_VariableRead( "Task_Core2_1000ms_Count", taskvalue);
  E_DBGR_VariableCheck("Task_Core2_1000ms_Count", taskvalue, Greater);
    
  //Check Core3 is running
  snprintf( chActionText, elCount(chActionText), "Check 1000ms Task Counter from Core3 "); 
  snprintf( chExpectedText, elCount(chExpectedText), "1000ms Counter from Core3 is incrementing"); 
  TestStepAddActionExpected( chActionText, chExpectedText );
  A_DBGR_VariableRead( "Task_Core3_1000ms_Count", taskvalue);
  E_DBGR_VariableCheck("Task_Core3_1000ms_Count", taskvalue, Greater);
    
  //Check Core4 is running
  snprintf( chActionText, elCount(chActionText), "Check 1000ms Task Counter from Core4 "); 
  snprintf( chExpectedText, elCount(chExpectedText), "1000ms Counter from Core4 is incrementing"); 
  TestStepAddActionExpected( chActionText, chExpectedText );
  A_DBGR_VariableRead( "Task_Core4_1000ms_Count", taskvalue);
  E_DBGR_VariableCheck("Task_Core4_1000ms_Count", taskvalue, Greater);
    
  //Check Core5 is running
  snprintf( chActionText, elCount(chActionText), "Check 1000ms Task Counter from Core5 "); 
  snprintf( chExpectedText, elCount(chExpectedText), "1000ms Counter from Core5 is incrementing"); 
  TestStepAddActionExpected( chActionText, chExpectedText );
  A_DBGR_VariableRead( "Task_Core5_1000ms_Count", taskvalue);
  E_DBGR_VariableCheck("Task_Core5_1000ms_Count", taskvalue, Greater);
  

  /***************************************************************************************************************/    
    // Test Step 3: Disable Interface DsblHWIO_GM_TaskInits for Core2
  /***************************************************************************************************************/

  snprintf( chActionText, elCount(chActionText), "Disable Interface DsblHWIO_GM_TaskInits for 1000ms Task for core2 "); 
  snprintf( chExpectedText, elCount(chExpectedText), "Check Interface DsblHWIO_GM_TaskInits 1000ms Task for core2 shall set to 1 "); 
  TestStepAddActionExpected( chActionText, chExpectedText );
  A_DBGR_VariableSet("test_disable_task_initiator_core2", "1");
  E_DBGR_VariableCheck("test_disable_task_initiator_core2", 1, Equal);    


  /***************************************************************************************************************/    
    // Test Step 4: Check all Cores are running except core 2, shall be disabled
  /***************************************************************************************************************/
 
   
  //Check All tasks of Core0 are Running
  snprintf( chActionText, elCount(chActionText), "Check 2pt5ms Task Counter from Core0 "); 
  snprintf( chExpectedText, elCount(chExpectedText), "2pt5ms Counter from Core0 is  incrementing"); 
  TestStepAddActionExpected( chActionText, chExpectedText );
  A_DBGR_VariableRead( "Task_Core0_2pt5ms_Count", taskvalue);
  E_DBGR_VariableCheck("Task_Core0_2pt5ms_Count", taskvalue, Greater);
  
  snprintf( chActionText, elCount(chActionText), "Check 5ms Task Counter from Core0 "); 
  snprintf( chExpectedText, elCount(chExpectedText), "5ms Counter from Core0 is  incrementing"); 
  TestStepAddActionExpected( chActionText, chExpectedText );
  A_DBGR_VariableRead( "Task_Core0_5ms_Count", taskvalue);
  E_DBGR_VariableCheck("Task_Core0_5ms_Count", taskvalue, Greater);
  
  snprintf( chActionText, elCount(chActionText), "Check 10ms Task Counter from Core0 "); 
  snprintf( chExpectedText, elCount(chExpectedText), "10ms Counter from Core0 is  incrementing"); 
  TestStepAddActionExpected( chActionText, chExpectedText );
  A_DBGR_VariableRead( "Task_Core0_10ms_Count", taskvalue);
  E_DBGR_VariableCheck("Task_Core0_10ms_Count", taskvalue, Greater);  
  
  snprintf( chActionText, elCount(chActionText), "Check 25ms Task Counter from Core0 "); 
  snprintf( chExpectedText, elCount(chExpectedText), "25ms Counter from Core0 is  incrementing"); 
  TestStepAddActionExpected( chActionText, chExpectedText );
  A_DBGR_VariableRead( "Task_Core0_25ms_Count", taskvalue);
  E_DBGR_VariableCheck("Task_Core0_25ms_Count", taskvalue, Greater);  

  snprintf( chActionText, elCount(chActionText), "Check 50ms Task Counter from Core0 "); 
  snprintf( chExpectedText, elCount(chExpectedText), "50ms Counter from Core0 is  incrementing"); 
  TestStepAddActionExpected( chActionText, chExpectedText );
  A_DBGR_VariableRead( "Task_Core0_50ms_Count", taskvalue);
  E_DBGR_VariableCheck("Task_Core0_50ms_Count", taskvalue, Greater);
  
  snprintf( chActionText, elCount(chActionText), "Check 250ms Task Counter from Core0 "); 
  snprintf( chExpectedText, elCount(chExpectedText), "250ms Counter from Core0 is  incrementing"); 
  TestStepAddActionExpected( chActionText, chExpectedText );
  A_DBGR_VariableRead( "Task_Core0_250ms_Count", taskvalue);
  E_DBGR_VariableCheck("Task_Core0_250ms_Count", taskvalue, Greater);
  
  snprintf( chActionText, elCount(chActionText), "Check 100ms Task Counter from Core0 "); 
  snprintf( chExpectedText, elCount(chExpectedText), "100ms Counter from Core0 is  incrementing"); 
  TestStepAddActionExpected( chActionText, chExpectedText );
  A_DBGR_VariableRead( "Task_Core0_100ms_Count", taskvalue);
  E_DBGR_VariableCheck("Task_Core0_100ms_Count", taskvalue, Greater); 

  snprintf( chActionText, elCount(chActionText), "Check 500ms Task Counter from Core0 "); 
  snprintf( chExpectedText, elCount(chExpectedText), "500ms Counter from Core0 is  incrementing"); 
  TestStepAddActionExpected( chActionText, chExpectedText );
  A_DBGR_VariableRead( "Task_Core0_500ms_Count", taskvalue);
  E_DBGR_VariableCheck("Task_Core0_500ms_Count", taskvalue, Greater);
  
  snprintf( chActionText, elCount(chActionText), "Check 1000ms Task Counter from Core0 "); 
  snprintf( chExpectedText, elCount(chExpectedText), "1000ms Counter from Core0 is  incrementing"); 
  TestStepAddActionExpected( chActionText, chExpectedText );
  A_DBGR_VariableRead( "Task_Core0_1000ms_Count", taskvalue);
  E_DBGR_VariableCheck("Task_Core0_1000ms_Count", taskvalue, Greater);
  
  
  //Check All tasks of Core1 are Running
  snprintf( chActionText, elCount(chActionText), "Check 2pt5ms Task Counter from Core1 "); 
  snprintf( chExpectedText, elCount(chExpectedText), "2pt5ms Counter from Core1 is  incrementing"); 
  TestStepAddActionExpected( chActionText, chExpectedText );
  A_DBGR_VariableRead( "Task_Core1_2pt5ms_Count", taskvalue);
  E_DBGR_VariableCheck("Task_Core1_2pt5ms_Count", taskvalue, Greater);
  
  snprintf( chActionText, elCount(chActionText), "Check 5ms Task Counter from Core1 "); 
  snprintf( chExpectedText, elCount(chExpectedText), "5ms Counter from Core1 is  incrementing"); 
  TestStepAddActionExpected( chActionText, chExpectedText );
  A_DBGR_VariableRead( "Task_Core1_5ms_Count", taskvalue);
  E_DBGR_VariableCheck("Task_Core1_5ms_Count", taskvalue, Greater);
  
  snprintf( chActionText, elCount(chActionText), "Check 10ms Task Counter from Core1 "); 
  snprintf( chExpectedText, elCount(chExpectedText), "10ms Counter from Core1 is  incrementing"); 
  TestStepAddActionExpected( chActionText, chExpectedText );
  A_DBGR_VariableRead( "Task_Core1_10ms_Count", taskvalue);
  E_DBGR_VariableCheck("Task_Core1_10ms_Count", taskvalue, Greater);  
  
  snprintf( chActionText, elCount(chActionText), "Check 25ms Task Counter from Core1 "); 
  snprintf( chExpectedText, elCount(chExpectedText), "25ms Counter from Core1 is  incrementing"); 
  TestStepAddActionExpected( chActionText, chExpectedText );
  A_DBGR_VariableRead( "Task_Core1_25ms_Count", taskvalue);
  E_DBGR_VariableCheck("Task_Core1_25ms_Count", taskvalue, Greater); 
  
  snprintf( chActionText, elCount(chActionText), "Check 50ms Task Counter from Core1 "); 
  snprintf( chExpectedText, elCount(chExpectedText), "50ms Counter from Core1 is  incrementing"); 
  TestStepAddActionExpected( chActionText, chExpectedText );
  A_DBGR_VariableRead( "Task_Core1_50ms_Count", taskvalue);
  E_DBGR_VariableCheck("Task_Core1_50ms_Count", taskvalue, Greater);
    
  snprintf( chActionText, elCount(chActionText), "Check 100ms Task Counter from Core1 "); 
  snprintf( chExpectedText, elCount(chExpectedText), "100ms Counter from Core1 is  incrementing"); 
  TestStepAddActionExpected( chActionText, chExpectedText );
  A_DBGR_VariableRead( "Task_Core1_100ms_Count", taskvalue);
  E_DBGR_VariableCheck("Task_Core1_100ms_Count", taskvalue, Greater);

  snprintf( chActionText, elCount(chActionText), "Check 250ms Task Counter from Core1 "); 
  snprintf( chExpectedText, elCount(chExpectedText), "250ms Counter from Core1 is  incrementing"); 
  TestStepAddActionExpected( chActionText, chExpectedText );
  A_DBGR_VariableRead( "Task_Core1_250ms_Count", taskvalue);
  E_DBGR_VariableCheck("Task_Core1_250ms_Count", taskvalue, Greater);
  
  snprintf( chActionText, elCount(chActionText), "Check 500ms Task Counter from Core1 "); 
  snprintf( chExpectedText, elCount(chExpectedText), "500ms Counter from Core1 is  incrementing"); 
  TestStepAddActionExpected( chActionText, chExpectedText );
  A_DBGR_VariableRead( "Task_Core1_500ms_Count", taskvalue);
  E_DBGR_VariableCheck("Task_Core1_500ms_Count", taskvalue, Greater);

  snprintf( chActionText, elCount(chActionText), "Check 1000ms Task Counter from Core1 "); 
  snprintf( chExpectedText, elCount(chExpectedText), "1000ms Counter from Core1 is stop incrementing"); 
  TestStepAddActionExpected( chActionText, chExpectedText );
  A_DBGR_VariableRead( "Task_Core1_1000ms_Count", taskvalue);
  E_DBGR_VariableCheck("Task_Core1_1000ms_Count", taskvalue, Greater);
  
  
  //Check All tasks of Core2 are Stopped
  snprintf( chActionText, elCount(chActionText), "Check 2pt5ms Task Counter from Core2 "); 
  snprintf( chExpectedText, elCount(chExpectedText), "2pt5ms Counter from Core2 is  stop  incrementing"); 
  TestStepAddActionExpected( chActionText, chExpectedText );
  A_DBGR_VariableRead( "Task_Core2_2pt5ms_Count", taskvalue);
  E_DBGR_VariableCheck("Task_Core2_2pt5ms_Count", taskvalue, Equal);
  
  snprintf( chActionText, elCount(chActionText), "Check 5ms Task Counter from Core2 "); 
  snprintf( chExpectedText, elCount(chExpectedText), "5ms Counter from Core2 is  stop  incrementing"); 
  TestStepAddActionExpected( chActionText, chExpectedText );
  A_DBGR_VariableRead( "Task_Core2_5ms_Count", taskvalue);
  E_DBGR_VariableCheck("Task_Core2_5ms_Count", taskvalue, Equal);
  
  snprintf( chActionText, elCount(chActionText), "Check 10ms Task Counter from Core2 "); 
  snprintf( chExpectedText, elCount(chExpectedText), "10ms Counter from Core2 is  stop  incrementing"); 
  TestStepAddActionExpected( chActionText, chExpectedText );
  A_DBGR_VariableRead( "Task_Core2_10ms_Count", taskvalue);
  E_DBGR_VariableCheck("Task_Core2_10ms_Count", taskvalue, Equal);  
  
  snprintf( chActionText, elCount(chActionText), "Check 25ms Task Counter from Core2 "); 
  snprintf( chExpectedText, elCount(chExpectedText), "25ms Counter from Core2 is  stop  incrementing"); 
  TestStepAddActionExpected( chActionText, chExpectedText );
  A_DBGR_VariableRead( "Task_Core2_25ms_Count", taskvalue);
  E_DBGR_VariableCheck("Task_Core2_25ms_Count", taskvalue, Equal); 

  snprintf( chActionText, elCount(chActionText), "Check 50ms Task Counter from Core2 "); 
  snprintf( chExpectedText, elCount(chExpectedText), "50ms Counter from Core2 is  stop  incrementing"); 
  TestStepAddActionExpected( chActionText, chExpectedText );
  A_DBGR_VariableRead( "Task_Core2_50ms_Count", taskvalue);
  E_DBGR_VariableCheck("Task_Core2_50ms_Count", taskvalue, Equal);
  
  snprintf( chActionText, elCount(chActionText), "Check 100ms Task Counter from Core2 "); 
  snprintf( chExpectedText, elCount(chExpectedText), "100ms Counter from Core2 is  stop  incrementing"); 
  TestStepAddActionExpected( chActionText, chExpectedText );
  A_DBGR_VariableRead( "Task_Core2_100ms_Count", taskvalue);
  E_DBGR_VariableCheck("Task_Core2_100ms_Count", taskvalue, Equal); 
  
  snprintf( chActionText, elCount(chActionText), "Check 250ms Task Counter from Core2 "); 
  snprintf( chExpectedText, elCount(chExpectedText), "250ms Counter from Core2 is  stop  incrementing"); 
  TestStepAddActionExpected( chActionText, chExpectedText );
  A_DBGR_VariableRead( "Task_Core2_250ms_Count", taskvalue);
  E_DBGR_VariableCheck("Task_Core2_250ms_Count", taskvalue, Equal);

  snprintf( chActionText, elCount(chActionText), "Check 500ms Task Counter from Core2 "); 
  snprintf( chExpectedText, elCount(chExpectedText), "500ms Counter from Core2 is  stop  incrementing"); 
  TestStepAddActionExpected( chActionText, chExpectedText );
  A_DBGR_VariableRead( "Task_Core2_500ms_Count", taskvalue);
  E_DBGR_VariableCheck("Task_Core2_500ms_Count", taskvalue, Equal);

  snprintf( chActionText, elCount(chActionText), "Check 1000ms Task Counter from Core2 "); 
  snprintf( chExpectedText, elCount(chExpectedText), "1000ms Counter from Core2 is  stop  incrementing"); 
  TestStepAddActionExpected( chActionText, chExpectedText );
  A_DBGR_VariableRead( "Task_Core2_1000ms_Count", taskvalue);
  E_DBGR_VariableCheck("Task_Core2_1000ms_Count", taskvalue, Equal);
  
  
    //Check All tasks of Core3 are running
  snprintf( chActionText, elCount(chActionText), "Check 2pt5ms Task Counter from Core3 "); 
  snprintf( chExpectedText, elCount(chExpectedText), "2pt5ms Counter from Core3 is  incrementing"); 
  TestStepAddActionExpected( chActionText, chExpectedText );
  A_DBGR_VariableRead( "Task_Core3_2pt5ms_Count", taskvalue);
  E_DBGR_VariableCheck("Task_Core3_2pt5ms_Count", taskvalue, Greater);
  
   snprintf( chActionText, elCount(chActionText), "Check 5ms Task Counter from Core3 "); 
  snprintf( chExpectedText, elCount(chExpectedText), "5ms Counter from Core3 is  incrementing"); 
  TestStepAddActionExpected( chActionText, chExpectedText );
  A_DBGR_VariableRead( "Task_Core3_5ms_Count", taskvalue);
  E_DBGR_VariableCheck("Task_Core3_5ms_Count", taskvalue, Greater);
  
  snprintf( chActionText, elCount(chActionText), "Check 10ms Task Counter from Core3 "); 
  snprintf( chExpectedText, elCount(chExpectedText), "10ms Counter from Core3 is  incrementing"); 
  TestStepAddActionExpected( chActionText, chExpectedText );
  A_DBGR_VariableRead( "Task_Core3_10ms_Count", taskvalue);
  E_DBGR_VariableCheck("Task_Core3_10ms_Count", taskvalue, Greater);  
  
  snprintf( chActionText, elCount(chActionText), "Check 25ms Task Counter from Core3 "); 
  snprintf( chExpectedText, elCount(chExpectedText), "25ms Counter from Core3 is  incrementing"); 
  TestStepAddActionExpected( chActionText, chExpectedText );
  A_DBGR_VariableRead( "Task_Core3_25ms_Count", taskvalue);
  E_DBGR_VariableCheck("Task_Core3_25ms_Count", taskvalue, Greater);  
  
  snprintf( chActionText, elCount(chActionText), "Check 50ms Task Counter from Core3 "); 
  snprintf( chExpectedText, elCount(chExpectedText), "50ms Counter from Core3 is  incrementing"); 
  TestStepAddActionExpected( chActionText, chExpectedText );
  A_DBGR_VariableRead( "Task_Core3_50ms_Count", taskvalue);
  E_DBGR_VariableCheck("Task_Core3_50ms_Count", taskvalue, Greater);

  snprintf( chActionText, elCount(chActionText), "Check 100ms Task Counter from Core3 "); 
  snprintf( chExpectedText, elCount(chExpectedText), "100ms Counter from Core3 is  incrementing"); 
  TestStepAddActionExpected( chActionText, chExpectedText );
  A_DBGR_VariableRead( "Task_Core3_100ms_Count", taskvalue);
  E_DBGR_VariableCheck("Task_Core3_100ms_Count", taskvalue, Greater); 
  
  snprintf( chActionText, elCount(chActionText), "Check 250ms Task Counter from Core3 "); 
  snprintf( chExpectedText, elCount(chExpectedText), "250ms Counter from Core3 is  incrementing"); 
  TestStepAddActionExpected( chActionText, chExpectedText );
  A_DBGR_VariableRead( "Task_Core3_250ms_Count", taskvalue);
  E_DBGR_VariableCheck("Task_Core3_250ms_Count", taskvalue, Greater);
  
  snprintf( chActionText, elCount(chActionText), "Check 1000ms Task Counter from Core3 "); 
  snprintf( chExpectedText, elCount(chExpectedText), "1000ms Counter from Core3 is  incrementing"); 
  TestStepAddActionExpected( chActionText, chExpectedText );
  A_DBGR_VariableRead( "Task_Core3_1000ms_Count", taskvalue);
  E_DBGR_VariableCheck("Task_Core3_1000ms_Count", taskvalue, Greater);
  
    //Check task from Core4 is running
  snprintf( chActionText, elCount(chActionText), "Check 1000ms Task Counter from Core4 "); 
  snprintf( chExpectedText, elCount(chExpectedText), "1000ms Counter from Core4 is  incrementing"); 
  TestStepAddActionExpected( chActionText, chExpectedText );
  A_DBGR_VariableRead( "Task_Core4_1000ms_Count", taskvalue);
  E_DBGR_VariableCheck("Task_Core4_1000ms_Count", taskvalue, Greater);
    
  //Check task from Core5 is running
  snprintf( chActionText, elCount(chActionText), "Check 1000ms Task Counter from Core5 "); 
  snprintf( chExpectedText, elCount(chExpectedText), "1000ms Counter from Core5 is  incrementing"); 
  TestStepAddActionExpected( chActionText, chExpectedText );
  A_DBGR_VariableRead( "Task_Core5_1000ms_Count", taskvalue);
  E_DBGR_VariableCheck("Task_Core5_1000ms_Count", taskvalue, Greater);
   
}


/***************************************************************************************************
----------------------------------------------------------------------------------------------------
Test case name:  TC_L30SW_Q-36684436: Testcase_to_verify_the_functionality_of_interface_DsblHWIO_GM_TaskInits_to_prohibits_all_application_defined_RTOS_tasks_and_application_ISRs_from_pre_empting_the_current_task_or_ISR_on_the_CPU3.
----------------------------------------------------------------------------------------------------
Description:   Test case to verify the functionality of interface GetHWIO_e_CPU() to check the ActiveCPU_ID for currently executing CPU3.

***************************************************************************************************/
testcase Testcase_to_verify_DsblHWIO_GM_TaskInits_to_prohibits_all_RTOS_tasks_and_ISRs_from_preempting_current_task_or_ISR_on_the_CPU3()
{
  /***************************************************************************************************************/    
                                                // Variable Definition
  /***************************************************************************************************************/ 
  
  long taskvalue;
  
  /***************************************************************************************************************/    
                                               // Local Values
  /***************************************************************************************************************/ 
  

  
  /***************************************************************************************************************/    
                                              // Test Case Info
  /***************************************************************************************************************/
  setWriteDbgLevel(DebugOff);
  snprintf( chTestTitle, elCount(chTestTitle), "Testcase_to_verify_the_functionality_of_interface_DsblHWIO_GM_TaskInits_to_prohibits_all_application_defined_RTOS_tasks_and_application_ISRs_from_pre_empting_the_current_task_or_ISR_on_the_CPU3" );
  snprintf( chTestDescription, elCount(chTestDescription), "Purpose: test case to verify the functionality of interface DsblHWIO_GM_TaskInits to to prohibits all application defined RTOS tasks and application ISRs from pre-empting the current task or ISR on the CPU3.");
  TestCaseAddInfo( chTestTitle, "TC_L30SW_Q-36684436", chTestDescription );

  /***************************************************************************************************************/    
                                              // Start of Test Case
  /***************************************************************************************************************/
  
  /***************************************************************************************************************/    
                                              // Test Step 1 PRECONDITIONS
  /***************************************************************************************************************/
  
  snprintf( chActionText, elCount(chActionText), "Flash the Software and ECU is running"); 
  snprintf( chExpectedText, elCount(chExpectedText), "ECU should be in running state"); 
  TestStepAddActionExpected( chActionText, chExpectedText );

  A_DBGR_BreakpointDeleteAll();
  A_DBGR_RnGo();
  E_DBGR_CheckState(T32_State_Running);
  

   /***************************************************************************************************************/    
            // Test Step 2: Check all cores are in running state                                   
  /***************************************************************************************************************/
  
  //Check Core0 is running
  snprintf( chActionText, elCount(chActionText), "Check 1000ms Task Counter from Core0 "); 
  snprintf( chExpectedText, elCount(chExpectedText), "1000ms Counter from Core0 is incrementing"); 
  TestStepAddActionExpected( chActionText, chExpectedText );
  A_DBGR_VariableRead( "Task_Core0_1000ms_Count", taskvalue);
  E_DBGR_VariableCheck("Task_Core0_1000ms_Count", taskvalue, Greater);
  
  //Check Core1 is running
  snprintf( chActionText, elCount(chActionText), "Check 1000ms Task Counter from Core1 "); 
  snprintf( chExpectedText, elCount(chExpectedText), "1000ms Counter from Core1 is incrementing"); 
  TestStepAddActionExpected( chActionText, chExpectedText );
  A_DBGR_VariableRead( "Task_Core1_1000ms_Count", taskvalue);
  E_DBGR_VariableCheck("Task_Core1_1000ms_Count", taskvalue, Greater);
  
  //Check Core2 is running
  snprintf( chActionText, elCount(chActionText), "Check 1000ms Task Counter from Core2 "); 
  snprintf( chExpectedText, elCount(chExpectedText), "1000ms Counter from Core2 is incrementing"); 
  TestStepAddActionExpected( chActionText, chExpectedText );
  A_DBGR_VariableRead( "Task_Core2_1000ms_Count", taskvalue);
  E_DBGR_VariableCheck("Task_Core2_1000ms_Count", taskvalue, Greater);
    
  //Check Core3 is running
  snprintf( chActionText, elCount(chActionText), "Check 1000ms Task Counter from Core3 "); 
  snprintf( chExpectedText, elCount(chExpectedText), "1000ms Counter from Core3 is incrementing"); 
  TestStepAddActionExpected( chActionText, chExpectedText );
  A_DBGR_VariableRead( "Task_Core3_1000ms_Count", taskvalue);
  E_DBGR_VariableCheck("Task_Core3_1000ms_Count", taskvalue, Greater);
    
  //Check Core4 is running
  snprintf( chActionText, elCount(chActionText), "Check 1000ms Task Counter from Core4 "); 
  snprintf( chExpectedText, elCount(chExpectedText), "1000ms Counter from Core4 is incrementing"); 
  TestStepAddActionExpected( chActionText, chExpectedText );
  A_DBGR_VariableRead( "Task_Core4_1000ms_Count", taskvalue);
  E_DBGR_VariableCheck("Task_Core4_1000ms_Count", taskvalue, Greater);
    
  //Check Core5 is running
  snprintf( chActionText, elCount(chActionText), "Check 1000ms Task Counter from Core5 "); 
  snprintf( chExpectedText, elCount(chExpectedText), "1000ms Counter from Core5 is incrementing"); 
  TestStepAddActionExpected( chActionText, chExpectedText );
  A_DBGR_VariableRead( "Task_Core5_1000ms_Count", taskvalue);
  E_DBGR_VariableCheck("Task_Core5_1000ms_Count", taskvalue, Greater);
  

  /***************************************************************************************************************/    
    // Test Step 3: Disable Interface DsblHWIO_GM_TaskInits for Core3
  /***************************************************************************************************************/

  snprintf( chActionText, elCount(chActionText), "Disable Interface DsblHWIO_GM_TaskInits for 1000ms Task for core3 "); 
  snprintf( chExpectedText, elCount(chExpectedText), "Check Interface DsblHWIO_GM_TaskInits 1000ms Task for core3 shall set to 1 "); 
  TestStepAddActionExpected( chActionText, chExpectedText );
  A_DBGR_VariableSet("test_disable_task_initiator_core3", "1");
  E_DBGR_VariableCheck("test_disable_task_initiator_core3", 1, Equal);    


  /***************************************************************************************************************/    
    // Test Step 4: Check all Cores are running except core 3, shall be disabled
  /***************************************************************************************************************/
 
  //Check All tasks of Core0 are running
  snprintf( chActionText, elCount(chActionText), "Check 2pt5ms Task Counter from Core0 "); 
  snprintf( chExpectedText, elCount(chExpectedText), "2pt5ms Counter from Core0 is incrementing"); 
  TestStepAddActionExpected( chActionText, chExpectedText );
  A_DBGR_VariableRead( "Task_Core0_2pt5ms_Count", taskvalue);
  E_DBGR_VariableCheck("Task_Core0_2pt5ms_Count", taskvalue, Greater);
  
  snprintf( chActionText, elCount(chActionText), "Check 5ms Task Counter from Core0 "); 
  snprintf( chExpectedText, elCount(chExpectedText), "5ms Counter from Core0 is incrementing"); 
  TestStepAddActionExpected( chActionText, chExpectedText );
  A_DBGR_VariableRead( "Task_Core0_5ms_Count", taskvalue);
  E_DBGR_VariableCheck("Task_Core0_5ms_Count", taskvalue, Greater);
  
  snprintf( chActionText, elCount(chActionText), "Check 10ms Task Counter from Core0 "); 
  snprintf( chExpectedText, elCount(chExpectedText), "10ms Counter from Core0 is incrementing"); 
  TestStepAddActionExpected( chActionText, chExpectedText );
  A_DBGR_VariableRead( "Task_Core0_10ms_Count", taskvalue);
  E_DBGR_VariableCheck("Task_Core0_10ms_Count", taskvalue, Greater);  
  
  snprintf( chActionText, elCount(chActionText), "Check 25ms Task Counter from Core0 "); 
  snprintf( chExpectedText, elCount(chExpectedText), "25ms Counter from Core0 is incrementing"); 
  TestStepAddActionExpected( chActionText, chExpectedText );
  A_DBGR_VariableRead( "Task_Core0_25ms_Count", taskvalue);
  E_DBGR_VariableCheck("Task_Core0_25ms_Count", taskvalue, Greater);  

  snprintf( chActionText, elCount(chActionText), "Check 50ms Task Counter from Core0 "); 
  snprintf( chExpectedText, elCount(chExpectedText), "50ms Counter from Core0 is incrementing"); 
  TestStepAddActionExpected( chActionText, chExpectedText );
  A_DBGR_VariableRead( "Task_Core0_50ms_Count", taskvalue);
  E_DBGR_VariableCheck("Task_Core0_50ms_Count", taskvalue, Greater);
  
  snprintf( chActionText, elCount(chActionText), "Check 100ms Task Counter from Core0 "); 
  snprintf( chExpectedText, elCount(chExpectedText), "100ms Counter from Core0 is incrementing"); 
  TestStepAddActionExpected( chActionText, chExpectedText );
  A_DBGR_VariableRead( "Task_Core0_100ms_Count", taskvalue);
  E_DBGR_VariableCheck("Task_Core0_100ms_Count", taskvalue, Greater); 
  
  snprintf( chActionText, elCount(chActionText), "Check 250ms Task Counter from Core0 "); 
  snprintf( chExpectedText, elCount(chExpectedText), "250ms Counter from Core0 is incrementing"); 
  TestStepAddActionExpected( chActionText, chExpectedText );
  A_DBGR_VariableRead( "Task_Core0_250ms_Count", taskvalue);
  E_DBGR_VariableCheck("Task_Core0_250ms_Count", taskvalue, Greater);
  
  snprintf( chActionText, elCount(chActionText), "Check 500ms Task Counter from Core0 "); 
  snprintf( chExpectedText, elCount(chExpectedText), "500ms Counter from Core0 is incrementing"); 
  TestStepAddActionExpected( chActionText, chExpectedText );
  A_DBGR_VariableRead( "Task_Core0_500ms_Count", taskvalue);
  E_DBGR_VariableCheck("Task_Core0_500ms_Count", taskvalue, Greater);
  
  snprintf( chActionText, elCount(chActionText), "Check 1000ms Task Counter from Core0 "); 
  snprintf( chExpectedText, elCount(chExpectedText), "1000ms Counter from Core0 is incrementing"); 
  TestStepAddActionExpected( chActionText, chExpectedText );
  A_DBGR_VariableRead( "Task_Core0_1000ms_Count", taskvalue);
  E_DBGR_VariableCheck("Task_Core0_1000ms_Count", taskvalue, Greater);
  
  
  //Check All tasks of Core1 are Running  
  snprintf( chActionText, elCount(chActionText), "Check 2pt5ms Task Counter from Core1 "); 
  snprintf( chExpectedText, elCount(chExpectedText), "2pt5ms Counter from Core1 is  incrementing"); 
  TestStepAddActionExpected( chActionText, chExpectedText );
  A_DBGR_VariableRead( "Task_Core1_2pt5ms_Count", taskvalue);
  E_DBGR_VariableCheck("Task_Core1_2pt5ms_Count", taskvalue, Greater);
  
  snprintf( chActionText, elCount(chActionText), "Check 5ms Task Counter from Core1 "); 
  snprintf( chExpectedText, elCount(chExpectedText), "5ms Counter from Core1 is  incrementing"); 
  TestStepAddActionExpected( chActionText, chExpectedText );
  A_DBGR_VariableRead( "Task_Core1_5ms_Count", taskvalue);
  E_DBGR_VariableCheck("Task_Core1_5ms_Count", taskvalue, Greater);
  
  snprintf( chActionText, elCount(chActionText), "Check 10ms Task Counter from Core1 "); 
  snprintf( chExpectedText, elCount(chExpectedText), "10ms Counter from Core1 is  incrementing"); 
  TestStepAddActionExpected( chActionText, chExpectedText );
  A_DBGR_VariableRead( "Task_Core1_10ms_Count", taskvalue);
  E_DBGR_VariableCheck("Task_Core1_10ms_Count", taskvalue, Greater);  
  
  snprintf( chActionText, elCount(chActionText), "Check 25ms Task Counter from Core1 "); 
  snprintf( chExpectedText, elCount(chExpectedText), "25ms Counter from Core1 is  incrementing"); 
  TestStepAddActionExpected( chActionText, chExpectedText );
  A_DBGR_VariableRead( "Task_Core1_25ms_Count", taskvalue);
  E_DBGR_VariableCheck("Task_Core1_25ms_Count", taskvalue, Greater); 
  
  snprintf( chActionText, elCount(chActionText), "Check 50ms Task Counter from Core1 "); 
  snprintf( chExpectedText, elCount(chExpectedText), "50ms Counter from Core1 is  incrementing"); 
  TestStepAddActionExpected( chActionText, chExpectedText );
  A_DBGR_VariableRead( "Task_Core1_50ms_Count", taskvalue);
  E_DBGR_VariableCheck("Task_Core1_50ms_Count", taskvalue, Greater);
    
  snprintf( chActionText, elCount(chActionText), "Check 100ms Task Counter from Core1 "); 
  snprintf( chExpectedText, elCount(chExpectedText), "100ms Counter from Core1 is  incrementing"); 
  TestStepAddActionExpected( chActionText, chExpectedText );
  A_DBGR_VariableRead( "Task_Core1_100ms_Count", taskvalue);
  E_DBGR_VariableCheck("Task_Core1_100ms_Count", taskvalue, Greater);

  snprintf( chActionText, elCount(chActionText), "Check 250ms Task Counter from Core1 "); 
  snprintf( chExpectedText, elCount(chExpectedText), "250ms Counter from Core1 is  incrementing"); 
  TestStepAddActionExpected( chActionText, chExpectedText );
  A_DBGR_VariableRead( "Task_Core1_250ms_Count", taskvalue);
  E_DBGR_VariableCheck("Task_Core1_250ms_Count", taskvalue, Greater);
  
  snprintf( chActionText, elCount(chActionText), "Check 500ms Task Counter from Core1 "); 
  snprintf( chExpectedText, elCount(chExpectedText), "500ms Counter from Core1 is  incrementing"); 
  TestStepAddActionExpected( chActionText, chExpectedText );
  A_DBGR_VariableRead( "Task_Core1_500ms_Count", taskvalue);
  E_DBGR_VariableCheck("Task_Core1_500ms_Count", taskvalue, Greater);

  snprintf( chActionText, elCount(chActionText), "Check 1000ms Task Counter from Core1 "); 
  snprintf( chExpectedText, elCount(chExpectedText), "1000ms Counter from Core1 is incrementing"); 
  TestStepAddActionExpected( chActionText, chExpectedText );
  A_DBGR_VariableRead( "Task_Core1_1000ms_Count", taskvalue);
  E_DBGR_VariableCheck("Task_Core1_1000ms_Count", taskvalue, Greater);
  
  
  //Check All tasks of Core2 are Running
  snprintf( chActionText, elCount(chActionText), "Check 2pt5ms Task Counter from Core2 "); 
  snprintf( chExpectedText, elCount(chExpectedText), "2pt5ms Counter from Core2 is  incrementing"); 
  TestStepAddActionExpected( chActionText, chExpectedText );
  A_DBGR_VariableRead( "Task_Core2_2pt5ms_Count", taskvalue);
  E_DBGR_VariableCheck("Task_Core2_2pt5ms_Count", taskvalue, Greater);
  
  snprintf( chActionText, elCount(chActionText), "Check 5ms Task Counter from Core2 "); 
  snprintf( chExpectedText, elCount(chExpectedText), "5ms Counter from Core2 is  incrementing"); 
  TestStepAddActionExpected( chActionText, chExpectedText );
  A_DBGR_VariableRead( "Task_Core2_5ms_Count", taskvalue);
  E_DBGR_VariableCheck("Task_Core2_5ms_Count", taskvalue, Greater);
  
  snprintf( chActionText, elCount(chActionText), "Check 10ms Task Counter from Core2 "); 
  snprintf( chExpectedText, elCount(chExpectedText), "10ms Counter from Core2 is  incrementing"); 
  TestStepAddActionExpected( chActionText, chExpectedText );
  A_DBGR_VariableRead( "Task_Core2_10ms_Count", taskvalue);
  E_DBGR_VariableCheck("Task_Core2_10ms_Count", taskvalue, Greater);  
  
  snprintf( chActionText, elCount(chActionText), "Check 25ms Task Counter from Core2 "); 
  snprintf( chExpectedText, elCount(chExpectedText), "25ms Counter from Core2 is  incrementing"); 
  TestStepAddActionExpected( chActionText, chExpectedText );
  A_DBGR_VariableRead( "Task_Core2_25ms_Count", taskvalue);
  E_DBGR_VariableCheck("Task_Core2_25ms_Count", taskvalue, Greater); 

  snprintf( chActionText, elCount(chActionText), "Check 50ms Task Counter from Core2 "); 
  snprintf( chExpectedText, elCount(chExpectedText), "50ms Counter from Core2 is  incrementing"); 
  TestStepAddActionExpected( chActionText, chExpectedText );
  A_DBGR_VariableRead( "Task_Core2_50ms_Count", taskvalue);
  E_DBGR_VariableCheck("Task_Core2_50ms_Count", taskvalue, Greater);
  
  snprintf( chActionText, elCount(chActionText), "Check 100ms Task Counter from Core2 "); 
  snprintf( chExpectedText, elCount(chExpectedText), "100ms Counter from Core2 is  incrementing"); 
  TestStepAddActionExpected( chActionText, chExpectedText );
  A_DBGR_VariableRead( "Task_Core2_100ms_Count", taskvalue);
  E_DBGR_VariableCheck("Task_Core2_100ms_Count", taskvalue, Greater); 
  
  snprintf( chActionText, elCount(chActionText), "Check 250ms Task Counter from Core2 "); 
  snprintf( chExpectedText, elCount(chExpectedText), "250ms Counter from Core2 is  incrementing"); 
  TestStepAddActionExpected( chActionText, chExpectedText );
  A_DBGR_VariableRead( "Task_Core2_250ms_Count", taskvalue);
  E_DBGR_VariableCheck("Task_Core2_250ms_Count", taskvalue, Greater);

  snprintf( chActionText, elCount(chActionText), "Check 500ms Task Counter from Core2 "); 
  snprintf( chExpectedText, elCount(chExpectedText), "500ms Counter from Core2 is  incrementing"); 
  TestStepAddActionExpected( chActionText, chExpectedText );
  A_DBGR_VariableRead( "Task_Core2_500ms_Count", taskvalue);
  E_DBGR_VariableCheck("Task_Core2_500ms_Count", taskvalue, Greater);

  snprintf( chActionText, elCount(chActionText), "Check 1000ms Task Counter from Core2 "); 
  snprintf( chExpectedText, elCount(chExpectedText), "1000ms Counter from Core2 is  incrementing"); 
  TestStepAddActionExpected( chActionText, chExpectedText );
  A_DBGR_VariableRead( "Task_Core2_1000ms_Count", taskvalue);
  E_DBGR_VariableCheck("Task_Core2_1000ms_Count", taskvalue, Greater);
  
  
    //Check All tasks of Core3 are Stopped
  snprintf( chActionText, elCount(chActionText), "Check 2pt5ms Task Counter from Core3 "); 
  snprintf( chExpectedText, elCount(chExpectedText), "2pt5ms Counter from Core3 is stop incrementing"); 
  TestStepAddActionExpected( chActionText, chExpectedText );
  A_DBGR_VariableRead( "Task_Core3_2pt5ms_Count", taskvalue);
  E_DBGR_VariableCheck("Task_Core3_2pt5ms_Count", taskvalue, Equal);
  
   snprintf( chActionText, elCount(chActionText), "Check 5ms Task Counter from Core3 "); 
  snprintf( chExpectedText, elCount(chExpectedText), "5ms Counter from Core3 is stop incrementing"); 
  TestStepAddActionExpected( chActionText, chExpectedText );
  A_DBGR_VariableRead( "Task_Core3_5ms_Count", taskvalue);
  E_DBGR_VariableCheck("Task_Core3_5ms_Count", taskvalue, Equal);
  
  snprintf( chActionText, elCount(chActionText), "Check 10ms Task Counter from Core3 "); 
  snprintf( chExpectedText, elCount(chExpectedText), "10ms Counter from Core3 is stop incrementing"); 
  TestStepAddActionExpected( chActionText, chExpectedText );
  A_DBGR_VariableRead( "Task_Core3_10ms_Count", taskvalue);
  E_DBGR_VariableCheck("Task_Core3_10ms_Count", taskvalue, Equal);  
  
  snprintf( chActionText, elCount(chActionText), "Check 25ms Task Counter from Core3 "); 
  snprintf( chExpectedText, elCount(chExpectedText), "25ms Counter from Core3 is stop incrementing"); 
  TestStepAddActionExpected( chActionText, chExpectedText );
  A_DBGR_VariableRead( "Task_Core3_25ms_Count", taskvalue);
  E_DBGR_VariableCheck("Task_Core3_25ms_Count", taskvalue, Equal);  
  
  snprintf( chActionText, elCount(chActionText), "Check 50ms Task Counter from Core3 "); 
  snprintf( chExpectedText, elCount(chExpectedText), "50ms Counter from Core3 is stop incrementing"); 
  TestStepAddActionExpected( chActionText, chExpectedText );
  A_DBGR_VariableRead( "Task_Core3_50ms_Count", taskvalue);
  E_DBGR_VariableCheck("Task_Core3_50ms_Count", taskvalue, Equal);

  snprintf( chActionText, elCount(chActionText), "Check 100ms Task Counter from Core3 "); 
  snprintf( chExpectedText, elCount(chExpectedText), "100ms Counter from Core3 is stop incrementing"); 
  TestStepAddActionExpected( chActionText, chExpectedText );
  A_DBGR_VariableRead( "Task_Core3_100ms_Count", taskvalue);
  E_DBGR_VariableCheck("Task_Core3_100ms_Count", taskvalue, Equal); 
  
  snprintf( chActionText, elCount(chActionText), "Check 250ms Task Counter from Core3 "); 
  snprintf( chExpectedText, elCount(chExpectedText), "250ms Counter from Core3 is stop incrementing"); 
  TestStepAddActionExpected( chActionText, chExpectedText );
  A_DBGR_VariableRead( "Task_Core3_250ms_Count", taskvalue);
  E_DBGR_VariableCheck("Task_Core3_250ms_Count", taskvalue, Equal);
  
  snprintf( chActionText, elCount(chActionText), "Check 1000ms Task Counter from Core3 "); 
  snprintf( chExpectedText, elCount(chExpectedText), "1000ms Counter from Core3 is stop incrementing"); 
  TestStepAddActionExpected( chActionText, chExpectedText );
  A_DBGR_VariableRead( "Task_Core3_1000ms_Count", taskvalue);
  E_DBGR_VariableCheck("Task_Core3_1000ms_Count", taskvalue, Equal);
  
    //Check task from Core4 is running
  snprintf( chActionText, elCount(chActionText), "Check 1000ms Task Counter from Core4 "); 
  snprintf( chExpectedText, elCount(chExpectedText), "1000ms Counter from Core4 is  incrementing"); 
  TestStepAddActionExpected( chActionText, chExpectedText );
  A_DBGR_VariableRead( "Task_Core4_1000ms_Count", taskvalue);
  E_DBGR_VariableCheck("Task_Core4_1000ms_Count", taskvalue, Greater);
    
  //Check task from Core5 is running
  snprintf( chActionText, elCount(chActionText), "Check 1000ms Task Counter from Core5 "); 
  snprintf( chExpectedText, elCount(chExpectedText), "1000ms Counter from Core5 is  incrementing"); 
  TestStepAddActionExpected( chActionText, chExpectedText );
  A_DBGR_VariableRead( "Task_Core5_1000ms_Count", taskvalue);
  E_DBGR_VariableCheck("Task_Core5_1000ms_Count", taskvalue, Greater);
  
  
}


/***************************************************************************************************
----------------------------------------------------------------------------------------------------
Test case name:  TC_L30SW_Q-36684435: Testcase_to_verify_the_functionality_of_interface_DsblHWIO_GM_TaskInits_to_prohibits_all_application_defined_RTOS_tasks_and_application_ISRs_from_pre_empting_the_current_task_or_ISR_on_the_CPU4.
----------------------------------------------------------------------------------------------------
Description:   Test case to verify the functionality of interface GetHWIO_e_CPU() to check the ActiveCPU_ID for currently executing CPU4.

***************************************************************************************************/
testcase Testcase_to_verify_DsblHWIO_GM_TaskInits_to_prohibits_all_RTOS_tasks_and_ISRs_from_preempting_current_task_or_ISR_on_the_CPU4()
{
  /***************************************************************************************************************/    
                                                // Variable Definition
  /***************************************************************************************************************/ 
  
  long taskvalue;
  
  /***************************************************************************************************************/    
                                               // Local Values
  /***************************************************************************************************************/ 
  

  
  /***************************************************************************************************************/    
                                              // Test Case Info
  /***************************************************************************************************************/
  setWriteDbgLevel(DebugOff);
  snprintf( chTestTitle, elCount(chTestTitle), "Testcase_to_verify_the_functionality_of_interface_DsblHWIO_GM_TaskInits_to_prohibits_all_application_defined_RTOS_tasks_and_application_ISRs_from_pre_empting_the_current_task_or_ISR_on_the_CPU4" );
  snprintf( chTestDescription, elCount(chTestDescription), "Purpose: test case to verify the functionality of interface DsblHWIO_GM_TaskInits to to prohibits all application defined RTOS tasks and application ISRs from pre-empting the current task or ISR on the CPU4.");
  TestCaseAddInfo( chTestTitle, "TC_L30SW_Q-36684435", chTestDescription );

  /***************************************************************************************************************/    
                                              // Start of Test Case
  /***************************************************************************************************************/
  
  /***************************************************************************************************************/    
                                              // Test Step 1 PRECONDITIONS
  /***************************************************************************************************************/
  
  snprintf( chActionText, elCount(chActionText), "Flash the Software and ECU is running"); 
  snprintf( chExpectedText, elCount(chExpectedText), "ECU should be in running state"); 
  TestStepAddActionExpected( chActionText, chExpectedText );

  A_DBGR_BreakpointDeleteAll();
  A_DBGR_RnGo();
  E_DBGR_CheckState(T32_State_Running);
  

   /***************************************************************************************************************/    
            // Test Step 2: Check all cores are in running state                                   
  /***************************************************************************************************************/
  
  //Check Core0 is running
  snprintf( chActionText, elCount(chActionText), "Check 1000ms Task Counter from Core0 "); 
  snprintf( chExpectedText, elCount(chExpectedText), "1000ms Counter from Core0 is incrementing"); 
  TestStepAddActionExpected( chActionText, chExpectedText );
  A_DBGR_VariableRead( "Task_Core0_1000ms_Count", taskvalue);
  E_DBGR_VariableCheck("Task_Core0_1000ms_Count", taskvalue, Greater);
  
  //Check Core1 is running
  snprintf( chActionText, elCount(chActionText), "Check 1000ms Task Counter from Core1 "); 
  snprintf( chExpectedText, elCount(chExpectedText), "1000ms Counter from Core1 is incrementing"); 
  TestStepAddActionExpected( chActionText, chExpectedText );
  A_DBGR_VariableRead( "Task_Core1_1000ms_Count", taskvalue);
  E_DBGR_VariableCheck("Task_Core1_1000ms_Count", taskvalue, Greater);
  
  //Check Core2 is running
  snprintf( chActionText, elCount(chActionText), "Check 1000ms Task Counter from Core2 "); 
  snprintf( chExpectedText, elCount(chExpectedText), "1000ms Counter from Core2 is incrementing"); 
  TestStepAddActionExpected( chActionText, chExpectedText );
  A_DBGR_VariableRead( "Task_Core2_1000ms_Count", taskvalue);
  E_DBGR_VariableCheck("Task_Core2_1000ms_Count", taskvalue, Greater);
    
  //Check Core3 is running
  snprintf( chActionText, elCount(chActionText), "Check 1000ms Task Counter from Core3 "); 
  snprintf( chExpectedText, elCount(chExpectedText), "1000ms Counter from Core3 is incrementing"); 
  TestStepAddActionExpected( chActionText, chExpectedText );
  A_DBGR_VariableRead( "Task_Core3_1000ms_Count", taskvalue);
  E_DBGR_VariableCheck("Task_Core3_1000ms_Count", taskvalue, Greater);
    
  //Check Core4 is running
  snprintf( chActionText, elCount(chActionText), "Check 1000ms Task Counter from Core4 "); 
  snprintf( chExpectedText, elCount(chExpectedText), "1000ms Counter from Core4 is incrementing"); 
  TestStepAddActionExpected( chActionText, chExpectedText );
  A_DBGR_VariableRead( "Task_Core4_1000ms_Count", taskvalue);
  E_DBGR_VariableCheck("Task_Core4_1000ms_Count", taskvalue, Greater);
    
  //Check Core5 is running
  snprintf( chActionText, elCount(chActionText), "Check 1000ms Task Counter from Core5 "); 
  snprintf( chExpectedText, elCount(chExpectedText), "1000ms Counter from Core5 is incrementing"); 
  TestStepAddActionExpected( chActionText, chExpectedText );
  A_DBGR_VariableRead( "Task_Core5_1000ms_Count", taskvalue);
  E_DBGR_VariableCheck("Task_Core5_1000ms_Count", taskvalue, Greater);
  

  /***************************************************************************************************************/    
    // Test Step 3: Disable Interface DsblHWIO_GM_TaskInits for Core3
  /***************************************************************************************************************/

  snprintf( chActionText, elCount(chActionText), "Disable Interface DsblHWIO_GM_TaskInits for 1000ms Task for core4 "); 
  snprintf( chExpectedText, elCount(chExpectedText), "Check Interface DsblHWIO_GM_TaskInits 1000ms Task for core4 shall set to 1 "); 
  TestStepAddActionExpected( chActionText, chExpectedText );
  A_DBGR_VariableSet("test_disable_task_initiator_core4", "1");
  E_DBGR_VariableCheck("test_disable_task_initiator_core4", 1, Equal);    


  /***************************************************************************************************************/    
    // Test Step 4: Check all Cores are running except core 4, shall be disabled
  /***************************************************************************************************************/
 
  
  //Check All tasks of Core0 are Running
  snprintf( chActionText, elCount(chActionText), "Check 2pt5ms Task Counter from Core0 "); 
  snprintf( chExpectedText, elCount(chExpectedText), "2pt5ms Counter from Core0 is  incrementing"); 
  TestStepAddActionExpected( chActionText, chExpectedText );
  A_DBGR_VariableRead( "Task_Core0_2pt5ms_Count", taskvalue);
  E_DBGR_VariableCheck("Task_Core0_2pt5ms_Count", taskvalue, Greater);
  
  snprintf( chActionText, elCount(chActionText), "Check 5ms Task Counter from Core0 "); 
  snprintf( chExpectedText, elCount(chExpectedText), "5ms Counter from Core0 is  incrementing"); 
  TestStepAddActionExpected( chActionText, chExpectedText );
  A_DBGR_VariableRead( "Task_Core0_5ms_Count", taskvalue);
  E_DBGR_VariableCheck("Task_Core0_5ms_Count", taskvalue, Greater);
  
  snprintf( chActionText, elCount(chActionText), "Check 10ms Task Counter from Core0 "); 
  snprintf( chExpectedText, elCount(chExpectedText), "10ms Counter from Core0 is  incrementing"); 
  TestStepAddActionExpected( chActionText, chExpectedText );
  A_DBGR_VariableRead( "Task_Core0_10ms_Count", taskvalue);
  E_DBGR_VariableCheck("Task_Core0_10ms_Count", taskvalue, Greater);  
  
  snprintf( chActionText, elCount(chActionText), "Check 25ms Task Counter from Core0 "); 
  snprintf( chExpectedText, elCount(chExpectedText), "25ms Counter from Core0 is  incrementing"); 
  TestStepAddActionExpected( chActionText, chExpectedText );
  A_DBGR_VariableRead( "Task_Core0_25ms_Count", taskvalue);
  E_DBGR_VariableCheck("Task_Core0_25ms_Count", taskvalue, Greater);  

  snprintf( chActionText, elCount(chActionText), "Check 50ms Task Counter from Core0 "); 
  snprintf( chExpectedText, elCount(chExpectedText), "50ms Counter from Core0 is  incrementing"); 
  TestStepAddActionExpected( chActionText, chExpectedText );
  A_DBGR_VariableRead( "Task_Core0_50ms_Count", taskvalue);
  E_DBGR_VariableCheck("Task_Core0_50ms_Count", taskvalue, Greater);
  
  snprintf( chActionText, elCount(chActionText), "Check 250ms Task Counter from Core0 "); 
  snprintf( chExpectedText, elCount(chExpectedText), "250ms Counter from Core0 is  incrementing"); 
  TestStepAddActionExpected( chActionText, chExpectedText );
  A_DBGR_VariableRead( "Task_Core0_250ms_Count", taskvalue);
  E_DBGR_VariableCheck("Task_Core0_250ms_Count", taskvalue, Greater);
  
  snprintf( chActionText, elCount(chActionText), "Check 100ms Task Counter from Core0 "); 
  snprintf( chExpectedText, elCount(chExpectedText), "100ms Counter from Core0 is  incrementing"); 
  TestStepAddActionExpected( chActionText, chExpectedText );
  A_DBGR_VariableRead( "Task_Core0_100ms_Count", taskvalue);
  E_DBGR_VariableCheck("Task_Core0_100ms_Count", taskvalue, Greater); 

  snprintf( chActionText, elCount(chActionText), "Check 500ms Task Counter from Core0 "); 
  snprintf( chExpectedText, elCount(chExpectedText), "500ms Counter from Core0 is  incrementing"); 
  TestStepAddActionExpected( chActionText, chExpectedText );
  A_DBGR_VariableRead( "Task_Core0_500ms_Count", taskvalue);
  E_DBGR_VariableCheck("Task_Core0_500ms_Count", taskvalue, Greater);
  
  snprintf( chActionText, elCount(chActionText), "Check 1000ms Task Counter from Core0 "); 
  snprintf( chExpectedText, elCount(chExpectedText), "1000ms Counter from Core0 is  incrementing"); 
  TestStepAddActionExpected( chActionText, chExpectedText );
  A_DBGR_VariableRead( "Task_Core0_1000ms_Count", taskvalue);
  E_DBGR_VariableCheck("Task_Core0_1000ms_Count", taskvalue, Greater);
  
  
  //Check All tasks of Core1 are Running
  snprintf( chActionText, elCount(chActionText), "Check 2pt5ms Task Counter from Core1 "); 
  snprintf( chExpectedText, elCount(chExpectedText), "2pt5ms Counter from Core1 is  incrementing"); 
  TestStepAddActionExpected( chActionText, chExpectedText );
  A_DBGR_VariableRead( "Task_Core1_2pt5ms_Count", taskvalue);
  E_DBGR_VariableCheck("Task_Core1_2pt5ms_Count", taskvalue, Greater);
  
  snprintf( chActionText, elCount(chActionText), "Check 5ms Task Counter from Core1 "); 
  snprintf( chExpectedText, elCount(chExpectedText), "5ms Counter from Core1 is  incrementing"); 
  TestStepAddActionExpected( chActionText, chExpectedText );
  A_DBGR_VariableRead( "Task_Core1_5ms_Count", taskvalue);
  E_DBGR_VariableCheck("Task_Core1_5ms_Count", taskvalue, Greater);
  
  snprintf( chActionText, elCount(chActionText), "Check 10ms Task Counter from Core1 "); 
  snprintf( chExpectedText, elCount(chExpectedText), "10ms Counter from Core1 is  incrementing"); 
  TestStepAddActionExpected( chActionText, chExpectedText );
  A_DBGR_VariableRead( "Task_Core1_10ms_Count", taskvalue);
  E_DBGR_VariableCheck("Task_Core1_10ms_Count", taskvalue, Greater);  
  
  snprintf( chActionText, elCount(chActionText), "Check 25ms Task Counter from Core1 "); 
  snprintf( chExpectedText, elCount(chExpectedText), "25ms Counter from Core1 is  incrementing"); 
  TestStepAddActionExpected( chActionText, chExpectedText );
  A_DBGR_VariableRead( "Task_Core1_25ms_Count", taskvalue);
  E_DBGR_VariableCheck("Task_Core1_25ms_Count", taskvalue, Greater); 
  
  snprintf( chActionText, elCount(chActionText), "Check 50ms Task Counter from Core1 "); 
  snprintf( chExpectedText, elCount(chExpectedText), "50ms Counter from Core1 is  incrementing"); 
  TestStepAddActionExpected( chActionText, chExpectedText );
  A_DBGR_VariableRead( "Task_Core1_50ms_Count", taskvalue);
  E_DBGR_VariableCheck("Task_Core1_50ms_Count", taskvalue, Greater);
    
  snprintf( chActionText, elCount(chActionText), "Check 100ms Task Counter from Core1 "); 
  snprintf( chExpectedText, elCount(chExpectedText), "100ms Counter from Core1 is  incrementing"); 
  TestStepAddActionExpected( chActionText, chExpectedText );
  A_DBGR_VariableRead( "Task_Core1_100ms_Count", taskvalue);
  E_DBGR_VariableCheck("Task_Core1_100ms_Count", taskvalue, Greater);

  snprintf( chActionText, elCount(chActionText), "Check 250ms Task Counter from Core1 "); 
  snprintf( chExpectedText, elCount(chExpectedText), "250ms Counter from Core1 is  incrementing"); 
  TestStepAddActionExpected( chActionText, chExpectedText );
  A_DBGR_VariableRead( "Task_Core1_250ms_Count", taskvalue);
  E_DBGR_VariableCheck("Task_Core1_250ms_Count", taskvalue, Greater);
  
  snprintf( chActionText, elCount(chActionText), "Check 500ms Task Counter from Core1 "); 
  snprintf( chExpectedText, elCount(chExpectedText), "500ms Counter from Core1 is  incrementing"); 
  TestStepAddActionExpected( chActionText, chExpectedText );
  A_DBGR_VariableRead( "Task_Core1_500ms_Count", taskvalue);
  E_DBGR_VariableCheck("Task_Core1_500ms_Count", taskvalue, Greater);

  snprintf( chActionText, elCount(chActionText), "Check 1000ms Task Counter from Core1 "); 
  snprintf( chExpectedText, elCount(chExpectedText), "1000ms Counter from Core1 is stop incrementing"); 
  TestStepAddActionExpected( chActionText, chExpectedText );
  A_DBGR_VariableRead( "Task_Core1_1000ms_Count", taskvalue);
  E_DBGR_VariableCheck("Task_Core1_1000ms_Count", taskvalue, Greater);
  
  
  //Check All tasks of Core2 are Running
  snprintf( chActionText, elCount(chActionText), "Check 2pt5ms Task Counter from Core2 "); 
  snprintf( chExpectedText, elCount(chExpectedText), "2pt5ms Counter from Core2 is   incrementing"); 
  TestStepAddActionExpected( chActionText, chExpectedText );
  A_DBGR_VariableRead( "Task_Core2_2pt5ms_Count", taskvalue);
  E_DBGR_VariableCheck("Task_Core2_2pt5ms_Count", taskvalue, Greater);
  
  snprintf( chActionText, elCount(chActionText), "Check 5ms Task Counter from Core2 "); 
  snprintf( chExpectedText, elCount(chExpectedText), "5ms Counter from Core2 is   incrementing"); 
  TestStepAddActionExpected( chActionText, chExpectedText );
  A_DBGR_VariableRead( "Task_Core2_5ms_Count", taskvalue);
  E_DBGR_VariableCheck("Task_Core2_5ms_Count", taskvalue, Greater);
  
  snprintf( chActionText, elCount(chActionText), "Check 10ms Task Counter from Core2 "); 
  snprintf( chExpectedText, elCount(chExpectedText), "10ms Counter from Core2 is   incrementing"); 
  TestStepAddActionExpected( chActionText, chExpectedText );
  A_DBGR_VariableRead( "Task_Core2_10ms_Count", taskvalue);
  E_DBGR_VariableCheck("Task_Core2_10ms_Count", taskvalue, Greater);  
  
  snprintf( chActionText, elCount(chActionText), "Check 25ms Task Counter from Core2 "); 
  snprintf( chExpectedText, elCount(chExpectedText), "25ms Counter from Core2 is   incrementing"); 
  TestStepAddActionExpected( chActionText, chExpectedText );
  A_DBGR_VariableRead( "Task_Core2_25ms_Count", taskvalue);
  E_DBGR_VariableCheck("Task_Core2_25ms_Count", taskvalue, Greater); 

  snprintf( chActionText, elCount(chActionText), "Check 50ms Task Counter from Core2 "); 
  snprintf( chExpectedText, elCount(chExpectedText), "50ms Counter from Core2 is   incrementing"); 
  TestStepAddActionExpected( chActionText, chExpectedText );
  A_DBGR_VariableRead( "Task_Core2_50ms_Count", taskvalue);
  E_DBGR_VariableCheck("Task_Core2_50ms_Count", taskvalue, Greater);
  
  snprintf( chActionText, elCount(chActionText), "Check 100ms Task Counter from Core2 "); 
  snprintf( chExpectedText, elCount(chExpectedText), "100ms Counter from Core2 is   incrementing"); 
  TestStepAddActionExpected( chActionText, chExpectedText );
  A_DBGR_VariableRead( "Task_Core2_100ms_Count", taskvalue);
  E_DBGR_VariableCheck("Task_Core2_100ms_Count", taskvalue, Greater); 
  
  snprintf( chActionText, elCount(chActionText), "Check 250ms Task Counter from Core2 "); 
  snprintf( chExpectedText, elCount(chExpectedText), "250ms Counter from Core2 is   incrementing"); 
  TestStepAddActionExpected( chActionText, chExpectedText );
  A_DBGR_VariableRead( "Task_Core2_250ms_Count", taskvalue);
  E_DBGR_VariableCheck("Task_Core2_250ms_Count", taskvalue, Greater);

  snprintf( chActionText, elCount(chActionText), "Check 500ms Task Counter from Core2 "); 
  snprintf( chExpectedText, elCount(chExpectedText), "500ms Counter from Core2 is   incrementing"); 
  TestStepAddActionExpected( chActionText, chExpectedText );
  A_DBGR_VariableRead( "Task_Core2_500ms_Count", taskvalue);
  E_DBGR_VariableCheck("Task_Core2_500ms_Count", taskvalue, Greater);

  snprintf( chActionText, elCount(chActionText), "Check 1000ms Task Counter from Core2 "); 
  snprintf( chExpectedText, elCount(chExpectedText), "1000ms Counter from Core2 is   incrementing"); 
  TestStepAddActionExpected( chActionText, chExpectedText );
  A_DBGR_VariableRead( "Task_Core2_1000ms_Count", taskvalue);
  E_DBGR_VariableCheck("Task_Core2_1000ms_Count", taskvalue, Greater);
  
  
    //Check All tasks of Core3 incrementing
  snprintf( chActionText, elCount(chActionText), "Check 2pt5ms Task Counter from Core3 "); 
  snprintf( chExpectedText, elCount(chExpectedText), "2pt5ms Counter from Core3 is  incrementing"); 
  TestStepAddActionExpected( chActionText, chExpectedText );
  A_DBGR_VariableRead( "Task_Core3_2pt5ms_Count", taskvalue);
  E_DBGR_VariableCheck("Task_Core3_2pt5ms_Count", taskvalue, Greater);
  
   snprintf( chActionText, elCount(chActionText), "Check 5ms Task Counter from Core3 "); 
  snprintf( chExpectedText, elCount(chExpectedText), "5ms Counter from Core3 is  incrementing"); 
  TestStepAddActionExpected( chActionText, chExpectedText );
  A_DBGR_VariableRead( "Task_Core3_5ms_Count", taskvalue);
  E_DBGR_VariableCheck("Task_Core3_5ms_Count", taskvalue, Greater);
  
  snprintf( chActionText, elCount(chActionText), "Check 10ms Task Counter from Core3 "); 
  snprintf( chExpectedText, elCount(chExpectedText), "10ms Counter from Core3 is   incrementing"); 
  TestStepAddActionExpected( chActionText, chExpectedText );
  A_DBGR_VariableRead( "Task_Core3_10ms_Count", taskvalue);
  E_DBGR_VariableCheck("Task_Core3_10ms_Count", taskvalue, Greater);  
  
  snprintf( chActionText, elCount(chActionText), "Check 25ms Task Counter from Core3 "); 
  snprintf( chExpectedText, elCount(chExpectedText), "25ms Counter from Core3 is incrementing"); 
  TestStepAddActionExpected( chActionText, chExpectedText );
  A_DBGR_VariableRead( "Task_Core3_25ms_Count", taskvalue);
  E_DBGR_VariableCheck("Task_Core3_25ms_Count", taskvalue, Greater);  
  
  snprintf( chActionText, elCount(chActionText), "Check 50ms Task Counter from Core3 "); 
  snprintf( chExpectedText, elCount(chExpectedText), "50ms Counter from Core3 is incrementing"); 
  TestStepAddActionExpected( chActionText, chExpectedText );
  A_DBGR_VariableRead( "Task_Core3_50ms_Count", taskvalue);
  E_DBGR_VariableCheck("Task_Core3_50ms_Count", taskvalue, Greater);

  snprintf( chActionText, elCount(chActionText), "Check 100ms Task Counter from Core3 "); 
  snprintf( chExpectedText, elCount(chExpectedText), "100ms Counter from Core3 is incrementing"); 
  TestStepAddActionExpected( chActionText, chExpectedText );
  A_DBGR_VariableRead( "Task_Core3_100ms_Count", taskvalue);
  E_DBGR_VariableCheck("Task_Core3_100ms_Count", taskvalue, Greater); 
  
  snprintf( chActionText, elCount(chActionText), "Check 250ms Task Counter from Core3 "); 
  snprintf( chExpectedText, elCount(chExpectedText), "250ms Counter from Core3 is incrementing"); 
  TestStepAddActionExpected( chActionText, chExpectedText );
  A_DBGR_VariableRead( "Task_Core3_250ms_Count", taskvalue);
  E_DBGR_VariableCheck("Task_Core3_250ms_Count", taskvalue, Greater);
  
  snprintf( chActionText, elCount(chActionText), "Check 500ms Task Counter from Core3 "); 
  snprintf( chExpectedText, elCount(chExpectedText), "500ms Counter from Core3 is stop incrementing"); 
  TestStepAddActionExpected( chActionText, chExpectedText );
  A_DBGR_VariableRead( "Task_Core3_500ms_Count", taskvalue);
  E_DBGR_VariableCheck("Task_Core3_500ms_Count", taskvalue, Greater);
  
  snprintf( chActionText, elCount(chActionText), "Check 1000ms Task Counter from Core3 "); 
  snprintf( chExpectedText, elCount(chExpectedText), "1000ms Counter from Core3 is incrementing"); 
  TestStepAddActionExpected( chActionText, chExpectedText );
  A_DBGR_VariableRead( "Task_Core3_1000ms_Count", taskvalue);
  E_DBGR_VariableCheck("Task_Core3_1000ms_Count", taskvalue, Greater);
  
    //Check task from Core4 is stopped
  snprintf( chActionText, elCount(chActionText), "Check 1000ms Task Counter from Core4 "); 
  snprintf( chExpectedText, elCount(chExpectedText), "1000ms Counter from Core4 is stop incrementing"); 
  TestStepAddActionExpected( chActionText, chExpectedText );
  A_DBGR_VariableRead( "Task_Core4_1000ms_Count", taskvalue);
  E_DBGR_VariableCheck("Task_Core4_1000ms_Count", taskvalue, Equal);
    
  //Check task from Core5 is running
  snprintf( chActionText, elCount(chActionText), "Check 1000ms Task Counter from Core5 "); 
  snprintf( chExpectedText, elCount(chExpectedText), "1000ms Counter from Core5 is  incrementing"); 
  TestStepAddActionExpected( chActionText, chExpectedText );
  A_DBGR_VariableRead( "Task_Core5_1000ms_Count", taskvalue);
  E_DBGR_VariableCheck("Task_Core5_1000ms_Count", taskvalue, Greater);
  
 
}


/***************************************************************************************************
----------------------------------------------------------------------------------------------------
Test case name:  TC_L30SW_Q-36684434: Testcase_to_verify_the_functionality_of_interface_DsblHWIO_GM_TaskInits_to_prohibits_all_application_defined_RTOS_tasks_and_application_ISRs_from_pre_empting_the_current_task_or_ISR_on_the_CPU5.
----------------------------------------------------------------------------------------------------
Description:   Test case to verify the functionality of interface GetHWIO_e_CPU() to check the ActiveCPU_ID for currently executing CPU5.

***************************************************************************************************/
testcase Testcase_to_verify_DsblHWIO_GM_TaskInits_to_prohibits_all_RTOS_tasks_and_ISRs_from_preempting_current_task_or_ISR_on_the_CPU5()
{
  /***************************************************************************************************************/    
                                                // Variable Definition
  /***************************************************************************************************************/ 
  
  long taskvalue;
  
  /***************************************************************************************************************/    
                                               // Local Values
  /***************************************************************************************************************/ 
  

  
  /***************************************************************************************************************/    
                                              // Test Case Info
  /***************************************************************************************************************/
  setWriteDbgLevel(DebugOff);
  snprintf( chTestTitle, elCount(chTestTitle), "Testcase_to_verify_the_functionality_of_interface_DsblHWIO_GM_TaskInits_to_prohibits_all_application_defined_RTOS_tasks_and_application_ISRs_from_pre_empting_the_current_task_or_ISR_on_the_CPU5" );
  snprintf( chTestDescription, elCount(chTestDescription), "Purpose: test case to verify the functionality of interface DsblHWIO_GM_TaskInits to to prohibits all application defined RTOS tasks and application ISRs from pre-empting the current task or ISR on the CPU5.");
  TestCaseAddInfo( chTestTitle, "TC_L30SW_Q-36684434", chTestDescription );

  /***************************************************************************************************************/    
                                              // Start of Test Case
  /***************************************************************************************************************/
  
  /***************************************************************************************************************/    
                                              // Test Step 1 PRECONDITIONS
  /***************************************************************************************************************/
  
  snprintf( chActionText, elCount(chActionText), "Flash the Software and ECU is running"); 
  snprintf( chExpectedText, elCount(chExpectedText), "ECU should be in running state"); 
  TestStepAddActionExpected( chActionText, chExpectedText );

  A_DBGR_BreakpointDeleteAll();
  A_DBGR_RnGo();
  E_DBGR_CheckState(T32_State_Running);
  

   /***************************************************************************************************************/    
            // Test Step 2: Check all cores are in running state                                   
  /***************************************************************************************************************/
  
  //Check Core0 is running
  snprintf( chActionText, elCount(chActionText), "Check 1000ms Task Counter from Core0 "); 
  snprintf( chExpectedText, elCount(chExpectedText), "1000ms Counter from Core0 is incrementing"); 
  TestStepAddActionExpected( chActionText, chExpectedText );
  A_DBGR_VariableRead( "Task_Core0_1000ms_Count", taskvalue);
  E_DBGR_VariableCheck("Task_Core0_1000ms_Count", taskvalue, Greater);
  
  //Check Core1 is running
  snprintf( chActionText, elCount(chActionText), "Check 1000ms Task Counter from Core1 "); 
  snprintf( chExpectedText, elCount(chExpectedText), "1000ms Counter from Core1 is incrementing"); 
  TestStepAddActionExpected( chActionText, chExpectedText );
  A_DBGR_VariableRead( "Task_Core1_1000ms_Count", taskvalue);
  E_DBGR_VariableCheck("Task_Core1_1000ms_Count", taskvalue, Greater);
  
  //Check Core2 is running
  snprintf( chActionText, elCount(chActionText), "Check 1000ms Task Counter from Core2 "); 
  snprintf( chExpectedText, elCount(chExpectedText), "1000ms Counter from Core2 is incrementing"); 
  TestStepAddActionExpected( chActionText, chExpectedText );
  A_DBGR_VariableRead( "Task_Core2_1000ms_Count", taskvalue);
  E_DBGR_VariableCheck("Task_Core2_1000ms_Count", taskvalue, Greater);
    
  //Check Core3 is running
  snprintf( chActionText, elCount(chActionText), "Check 1000ms Task Counter from Core3 "); 
  snprintf( chExpectedText, elCount(chExpectedText), "1000ms Counter from Core3 is incrementing"); 
  TestStepAddActionExpected( chActionText, chExpectedText );
  A_DBGR_VariableRead( "Task_Core3_1000ms_Count", taskvalue);
  E_DBGR_VariableCheck("Task_Core3_1000ms_Count", taskvalue, Greater);
    
  //Check Core4 is running
  snprintf( chActionText, elCount(chActionText), "Check 1000ms Task Counter from Core4 "); 
  snprintf( chExpectedText, elCount(chExpectedText), "1000ms Counter from Core4 is incrementing"); 
  TestStepAddActionExpected( chActionText, chExpectedText );
  A_DBGR_VariableRead( "Task_Core4_1000ms_Count", taskvalue);
  E_DBGR_VariableCheck("Task_Core4_1000ms_Count", taskvalue, Greater);
    
  //Check Core5 is running
  snprintf( chActionText, elCount(chActionText), "Check 1000ms Task Counter from Core5 "); 
  snprintf( chExpectedText, elCount(chExpectedText), "1000ms Counter from Core5 is incrementing"); 
  TestStepAddActionExpected( chActionText, chExpectedText );
  A_DBGR_VariableRead( "Task_Core5_1000ms_Count", taskvalue);
  E_DBGR_VariableCheck("Task_Core5_1000ms_Count", taskvalue, Greater);
  

  /***************************************************************************************************************/    
    // Test Step 3: Disable Interface DsblHWIO_GM_TaskInits for Core5
  /***************************************************************************************************************/

  snprintf( chActionText, elCount(chActionText), "Disable Interface DsblHWIO_GM_TaskInits for 1000ms Task for core5 "); 
  snprintf( chExpectedText, elCount(chExpectedText), "Check Interface DsblHWIO_GM_TaskInits 1000ms Task for core5 shall set to 1 "); 
  TestStepAddActionExpected( chActionText, chExpectedText );
  A_DBGR_VariableSet("test_disable_task_initiator_core5", "1");
  E_DBGR_VariableCheck("test_disable_task_initiator_core5", 1, Equal);    


  /***************************************************************************************************************/    
    // Test Step 4: Check all Cores are running except core 5, shall be disabled
  /***************************************************************************************************************/

  
  //Check All tasks of Core0 are Running
  snprintf( chActionText, elCount(chActionText), "Check 2pt5ms Task Counter from Core0 "); 
  snprintf( chExpectedText, elCount(chExpectedText), "2pt5ms Counter from Core0 is  incrementing"); 
  TestStepAddActionExpected( chActionText, chExpectedText );
  A_DBGR_VariableRead( "Task_Core0_2pt5ms_Count", taskvalue);
  E_DBGR_VariableCheck("Task_Core0_2pt5ms_Count", taskvalue, Greater);
  
  snprintf( chActionText, elCount(chActionText), "Check 5ms Task Counter from Core0 "); 
  snprintf( chExpectedText, elCount(chExpectedText), "5ms Counter from Core0 is  incrementing"); 
  TestStepAddActionExpected( chActionText, chExpectedText );
  A_DBGR_VariableRead( "Task_Core0_5ms_Count", taskvalue);
  E_DBGR_VariableCheck("Task_Core0_5ms_Count", taskvalue, Greater);
  
  snprintf( chActionText, elCount(chActionText), "Check 10ms Task Counter from Core0 "); 
  snprintf( chExpectedText, elCount(chExpectedText), "10ms Counter from Core0 is  incrementing"); 
  TestStepAddActionExpected( chActionText, chExpectedText );
  A_DBGR_VariableRead( "Task_Core0_10ms_Count", taskvalue);
  E_DBGR_VariableCheck("Task_Core0_10ms_Count", taskvalue, Greater);  
  
  snprintf( chActionText, elCount(chActionText), "Check 25ms Task Counter from Core0 "); 
  snprintf( chExpectedText, elCount(chExpectedText), "25ms Counter from Core0 is  incrementing"); 
  TestStepAddActionExpected( chActionText, chExpectedText );
  A_DBGR_VariableRead( "Task_Core0_25ms_Count", taskvalue);
  E_DBGR_VariableCheck("Task_Core0_25ms_Count", taskvalue, Greater);  

  snprintf( chActionText, elCount(chActionText), "Check 50ms Task Counter from Core0 "); 
  snprintf( chExpectedText, elCount(chExpectedText), "50ms Counter from Core0 is  incrementing"); 
  TestStepAddActionExpected( chActionText, chExpectedText );
  A_DBGR_VariableRead( "Task_Core0_50ms_Count", taskvalue);
  E_DBGR_VariableCheck("Task_Core0_50ms_Count", taskvalue, Greater);
  
  snprintf( chActionText, elCount(chActionText), "Check 250ms Task Counter from Core0 "); 
  snprintf( chExpectedText, elCount(chExpectedText), "250ms Counter from Core0 is  incrementing"); 
  TestStepAddActionExpected( chActionText, chExpectedText );
  A_DBGR_VariableRead( "Task_Core0_250ms_Count", taskvalue);
  E_DBGR_VariableCheck("Task_Core0_250ms_Count", taskvalue, Greater);
  
  snprintf( chActionText, elCount(chActionText), "Check 100ms Task Counter from Core0 "); 
  snprintf( chExpectedText, elCount(chExpectedText), "100ms Counter from Core0 is  incrementing"); 
  TestStepAddActionExpected( chActionText, chExpectedText );
  A_DBGR_VariableRead( "Task_Core0_100ms_Count", taskvalue);
  E_DBGR_VariableCheck("Task_Core0_100ms_Count", taskvalue, Greater); 

  snprintf( chActionText, elCount(chActionText), "Check 500ms Task Counter from Core0 "); 
  snprintf( chExpectedText, elCount(chExpectedText), "500ms Counter from Core0 is  incrementing"); 
  TestStepAddActionExpected( chActionText, chExpectedText );
  A_DBGR_VariableRead( "Task_Core0_500ms_Count", taskvalue);
  E_DBGR_VariableCheck("Task_Core0_500ms_Count", taskvalue, Greater);
  
  snprintf( chActionText, elCount(chActionText), "Check 1000ms Task Counter from Core0 "); 
  snprintf( chExpectedText, elCount(chExpectedText), "1000ms Counter from Core0 is  incrementing"); 
  TestStepAddActionExpected( chActionText, chExpectedText );
  A_DBGR_VariableRead( "Task_Core0_1000ms_Count", taskvalue);
  E_DBGR_VariableCheck("Task_Core0_1000ms_Count", taskvalue, Greater);
  
  
  //Check All tasks of Core1 are Running
  snprintf( chActionText, elCount(chActionText), "Check 2pt5ms Task Counter from Core1 "); 
  snprintf( chExpectedText, elCount(chExpectedText), "2pt5ms Counter from Core1 is  incrementing"); 
  TestStepAddActionExpected( chActionText, chExpectedText );
  A_DBGR_VariableRead( "Task_Core1_2pt5ms_Count", taskvalue);
  E_DBGR_VariableCheck("Task_Core1_2pt5ms_Count", taskvalue, Greater);
  
  snprintf( chActionText, elCount(chActionText), "Check 5ms Task Counter from Core1 "); 
  snprintf( chExpectedText, elCount(chExpectedText), "5ms Counter from Core1 is  incrementing"); 
  TestStepAddActionExpected( chActionText, chExpectedText );
  A_DBGR_VariableRead( "Task_Core1_5ms_Count", taskvalue);
  E_DBGR_VariableCheck("Task_Core1_5ms_Count", taskvalue, Greater);
  
  snprintf( chActionText, elCount(chActionText), "Check 10ms Task Counter from Core1 "); 
  snprintf( chExpectedText, elCount(chExpectedText), "10ms Counter from Core1 is  incrementing"); 
  TestStepAddActionExpected( chActionText, chExpectedText );
  A_DBGR_VariableRead( "Task_Core1_10ms_Count", taskvalue);
  E_DBGR_VariableCheck("Task_Core1_10ms_Count", taskvalue, Greater);  
  
  snprintf( chActionText, elCount(chActionText), "Check 25ms Task Counter from Core1 "); 
  snprintf( chExpectedText, elCount(chExpectedText), "25ms Counter from Core1 is  incrementing"); 
  TestStepAddActionExpected( chActionText, chExpectedText );
  A_DBGR_VariableRead( "Task_Core1_25ms_Count", taskvalue);
  E_DBGR_VariableCheck("Task_Core1_25ms_Count", taskvalue, Greater); 
  
  snprintf( chActionText, elCount(chActionText), "Check 50ms Task Counter from Core1 "); 
  snprintf( chExpectedText, elCount(chExpectedText), "50ms Counter from Core1 is  incrementing"); 
  TestStepAddActionExpected( chActionText, chExpectedText );
  A_DBGR_VariableRead( "Task_Core1_50ms_Count", taskvalue);
  E_DBGR_VariableCheck("Task_Core1_50ms_Count", taskvalue, Greater);
    
  snprintf( chActionText, elCount(chActionText), "Check 100ms Task Counter from Core1 "); 
  snprintf( chExpectedText, elCount(chExpectedText), "100ms Counter from Core1 is  incrementing"); 
  TestStepAddActionExpected( chActionText, chExpectedText );
  A_DBGR_VariableRead( "Task_Core1_100ms_Count", taskvalue);
  E_DBGR_VariableCheck("Task_Core1_100ms_Count", taskvalue, Greater);

  snprintf( chActionText, elCount(chActionText), "Check 250ms Task Counter from Core1 "); 
  snprintf( chExpectedText, elCount(chExpectedText), "250ms Counter from Core1 is  incrementing"); 
  TestStepAddActionExpected( chActionText, chExpectedText );
  A_DBGR_VariableRead( "Task_Core1_250ms_Count", taskvalue);
  E_DBGR_VariableCheck("Task_Core1_250ms_Count", taskvalue, Greater);
  
  snprintf( chActionText, elCount(chActionText), "Check 500ms Task Counter from Core1 "); 
  snprintf( chExpectedText, elCount(chExpectedText), "500ms Counter from Core1 is  incrementing"); 
  TestStepAddActionExpected( chActionText, chExpectedText );
  A_DBGR_VariableRead( "Task_Core1_500ms_Count", taskvalue);
  E_DBGR_VariableCheck("Task_Core1_500ms_Count", taskvalue, Greater);

  snprintf( chActionText, elCount(chActionText), "Check 1000ms Task Counter from Core1 "); 
  snprintf( chExpectedText, elCount(chExpectedText), "1000ms Counter from Core1 is stop incrementing"); 
  TestStepAddActionExpected( chActionText, chExpectedText );
  A_DBGR_VariableRead( "Task_Core1_1000ms_Count", taskvalue);
  E_DBGR_VariableCheck("Task_Core1_1000ms_Count", taskvalue, Greater);
  
  
  //Check All tasks of Core2 are Running
  snprintf( chActionText, elCount(chActionText), "Check 2pt5ms Task Counter from Core2 "); 
  snprintf( chExpectedText, elCount(chExpectedText), "2pt5ms Counter from Core2 is   incrementing"); 
  TestStepAddActionExpected( chActionText, chExpectedText );
  A_DBGR_VariableRead( "Task_Core2_2pt5ms_Count", taskvalue);
  E_DBGR_VariableCheck("Task_Core2_2pt5ms_Count", taskvalue, Greater);
  
  snprintf( chActionText, elCount(chActionText), "Check 5ms Task Counter from Core2 "); 
  snprintf( chExpectedText, elCount(chExpectedText), "5ms Counter from Core2 is   incrementing"); 
  TestStepAddActionExpected( chActionText, chExpectedText );
  A_DBGR_VariableRead( "Task_Core2_5ms_Count", taskvalue);
  E_DBGR_VariableCheck("Task_Core2_5ms_Count", taskvalue, Greater);
  
  snprintf( chActionText, elCount(chActionText), "Check 10ms Task Counter from Core2 "); 
  snprintf( chExpectedText, elCount(chExpectedText), "10ms Counter from Core2 is   incrementing"); 
  TestStepAddActionExpected( chActionText, chExpectedText );
  A_DBGR_VariableRead( "Task_Core2_10ms_Count", taskvalue);
  E_DBGR_VariableCheck("Task_Core2_10ms_Count", taskvalue, Greater);  
  
  snprintf( chActionText, elCount(chActionText), "Check 25ms Task Counter from Core2 "); 
  snprintf( chExpectedText, elCount(chExpectedText), "25ms Counter from Core2 is   incrementing"); 
  TestStepAddActionExpected( chActionText, chExpectedText );
  A_DBGR_VariableRead( "Task_Core2_25ms_Count", taskvalue);
  E_DBGR_VariableCheck("Task_Core2_25ms_Count", taskvalue, Greater); 

  snprintf( chActionText, elCount(chActionText), "Check 50ms Task Counter from Core2 "); 
  snprintf( chExpectedText, elCount(chExpectedText), "50ms Counter from Core2 is   incrementing"); 
  TestStepAddActionExpected( chActionText, chExpectedText );
  A_DBGR_VariableRead( "Task_Core2_50ms_Count", taskvalue);
  E_DBGR_VariableCheck("Task_Core2_50ms_Count", taskvalue, Greater);
  
  snprintf( chActionText, elCount(chActionText), "Check 100ms Task Counter from Core2 "); 
  snprintf( chExpectedText, elCount(chExpectedText), "100ms Counter from Core2 is   incrementing"); 
  TestStepAddActionExpected( chActionText, chExpectedText );
  A_DBGR_VariableRead( "Task_Core2_100ms_Count", taskvalue);
  E_DBGR_VariableCheck("Task_Core2_100ms_Count", taskvalue, Greater); 
  
  snprintf( chActionText, elCount(chActionText), "Check 250ms Task Counter from Core2 "); 
  snprintf( chExpectedText, elCount(chExpectedText), "250ms Counter from Core2 is   incrementing"); 
  TestStepAddActionExpected( chActionText, chExpectedText );
  A_DBGR_VariableRead( "Task_Core2_250ms_Count", taskvalue);
  E_DBGR_VariableCheck("Task_Core2_250ms_Count", taskvalue, Greater);

  snprintf( chActionText, elCount(chActionText), "Check 500ms Task Counter from Core2 "); 
  snprintf( chExpectedText, elCount(chExpectedText), "500ms Counter from Core2 is   incrementing"); 
  TestStepAddActionExpected( chActionText, chExpectedText );
  A_DBGR_VariableRead( "Task_Core2_500ms_Count", taskvalue);
  E_DBGR_VariableCheck("Task_Core2_500ms_Count", taskvalue, Greater);

  snprintf( chActionText, elCount(chActionText), "Check 1000ms Task Counter from Core2 "); 
  snprintf( chExpectedText, elCount(chExpectedText), "1000ms Counter from Core2 is   incrementing"); 
  TestStepAddActionExpected( chActionText, chExpectedText );
  A_DBGR_VariableRead( "Task_Core2_1000ms_Count", taskvalue);
  E_DBGR_VariableCheck("Task_Core2_1000ms_Count", taskvalue, Greater);
  
  
    //Check All tasks of Core3 are stopped
  snprintf( chActionText, elCount(chActionText), "Check 2pt5ms Task Counter from Core3 "); 
  snprintf( chExpectedText, elCount(chExpectedText), "2pt5ms Counter from Core3 is  incrementing"); 
  TestStepAddActionExpected( chActionText, chExpectedText );
  A_DBGR_VariableRead( "Task_Core3_2pt5ms_Count", taskvalue);
  E_DBGR_VariableCheck("Task_Core3_2pt5ms_Count", taskvalue, Greater);
  
   snprintf( chActionText, elCount(chActionText), "Check 5ms Task Counter from Core3 "); 
  snprintf( chExpectedText, elCount(chExpectedText), "5ms Counter from Core3 is  incrementing"); 
  TestStepAddActionExpected( chActionText, chExpectedText );
  A_DBGR_VariableRead( "Task_Core3_5ms_Count", taskvalue);
  E_DBGR_VariableCheck("Task_Core3_5ms_Count", taskvalue, Greater);
  
  snprintf( chActionText, elCount(chActionText), "Check 10ms Task Counter from Core3 "); 
  snprintf( chExpectedText, elCount(chExpectedText), "10ms Counter from Core3 is   incrementing"); 
  TestStepAddActionExpected( chActionText, chExpectedText );
  A_DBGR_VariableRead( "Task_Core3_10ms_Count", taskvalue);
  E_DBGR_VariableCheck("Task_Core3_10ms_Count", taskvalue, Greater);  
  
  snprintf( chActionText, elCount(chActionText), "Check 25ms Task Counter from Core3 "); 
  snprintf( chExpectedText, elCount(chExpectedText), "25ms Counter from Core3 is incrementing"); 
  TestStepAddActionExpected( chActionText, chExpectedText );
  A_DBGR_VariableRead( "Task_Core3_25ms_Count", taskvalue);
  E_DBGR_VariableCheck("Task_Core3_25ms_Count", taskvalue, Greater);  
  
  snprintf( chActionText, elCount(chActionText), "Check 50ms Task Counter from Core3 "); 
  snprintf( chExpectedText, elCount(chExpectedText), "50ms Counter from Core3 is incrementing"); 
  TestStepAddActionExpected( chActionText, chExpectedText );
  A_DBGR_VariableRead( "Task_Core3_50ms_Count", taskvalue);
  E_DBGR_VariableCheck("Task_Core3_50ms_Count", taskvalue, Greater);

  snprintf( chActionText, elCount(chActionText), "Check 100ms Task Counter from Core3 "); 
  snprintf( chExpectedText, elCount(chExpectedText), "100ms Counter from Core3 is incrementing"); 
  TestStepAddActionExpected( chActionText, chExpectedText );
  A_DBGR_VariableRead( "Task_Core3_100ms_Count", taskvalue);
  E_DBGR_VariableCheck("Task_Core3_100ms_Count", taskvalue, Greater); 
  
  snprintf( chActionText, elCount(chActionText), "Check 250ms Task Counter from Core3 "); 
  snprintf( chExpectedText, elCount(chExpectedText), "250ms Counter from Core3 is incrementing"); 
  TestStepAddActionExpected( chActionText, chExpectedText );
  A_DBGR_VariableRead( "Task_Core3_250ms_Count", taskvalue);
  E_DBGR_VariableCheck("Task_Core3_250ms_Count", taskvalue, Greater);
  
  snprintf( chActionText, elCount(chActionText), "Check 500ms Task Counter from Core3 "); 
  snprintf( chExpectedText, elCount(chExpectedText), "500ms Counter from Core3 is stop incrementing"); 
  TestStepAddActionExpected( chActionText, chExpectedText );
  A_DBGR_VariableRead( "Task_Core3_500ms_Count", taskvalue);
  E_DBGR_VariableCheck("Task_Core3_500ms_Count", taskvalue, Greater);
  
  snprintf( chActionText, elCount(chActionText), "Check 1000ms Task Counter from Core3 "); 
  snprintf( chExpectedText, elCount(chExpectedText), "1000ms Counter from Core3 is incrementing"); 
  TestStepAddActionExpected( chActionText, chExpectedText );
  A_DBGR_VariableRead( "Task_Core3_1000ms_Count", taskvalue);
  E_DBGR_VariableCheck("Task_Core3_1000ms_Count", taskvalue, Greater);
  
    //Check task from Core4 is running
  snprintf( chActionText, elCount(chActionText), "Check 1000ms Task Counter from Core4 "); 
  snprintf( chExpectedText, elCount(chExpectedText), "1000ms Counter from Core4 is incrementing"); 
  TestStepAddActionExpected( chActionText, chExpectedText );
  A_DBGR_VariableRead( "Task_Core4_1000ms_Count", taskvalue);
  E_DBGR_VariableCheck("Task_Core4_1000ms_Count", taskvalue, Greater);
    
  //Check task from Core5 is stopped
  snprintf( chActionText, elCount(chActionText), "Check 1000ms Task Counter from Core5 "); 
  snprintf( chExpectedText, elCount(chExpectedText), "1000ms Counter from Core5 is stop incrementing"); 
  TestStepAddActionExpected( chActionText, chExpectedText );
  A_DBGR_VariableRead( "Task_Core5_1000ms_Count", taskvalue);
  E_DBGR_VariableCheck("Task_Core5_1000ms_Count", taskvalue, Equal);
  
 
  
}


/***************************************************************************************************
----------------------------------------------------------------------------------------------------
Test case name:  TC_L30SW_Q-36684465: Testcase_to_verify_interface_EnblHWIO_GM_TaskInits_to_Allows_application_defined_RTOS_tasks_and_ISRs_to_receive_event_triggers_on_CPU0
Description:   Test case to verify the functionality of interface EnblHWIO_GM_TaskInits to Allows application defined RTOS tasks and ISRs to receive their event triggers on the CPU0

***************************************************************************************************/
testcase Testcase_to_verify_interface_EnblHWIO_GM_TaskInits_to_Allow_application_RTOS_tasks_and_ISRs_to_receive_event_triggers_on_CPU0()
{
  /***************************************************************************************************************/    
                                                // Variable Definition
  /***************************************************************************************************************/ 
  
  long taskvalue;
  
  /***************************************************************************************************************/    
                                               // Local Values
  /***************************************************************************************************************/ 
  

  
  /***************************************************************************************************************/    
                                              // Test Case Info
  /***************************************************************************************************************/
  setWriteDbgLevel(DebugOff);
  snprintf( chTestTitle, elCount(chTestTitle), "Testcase_to_verify_interface_EnblHWIO_GM_TaskInits_to_Allow_application_RTOS_tasks_and_ISRs_to_receive_event_triggers_on_CPU5" );
  snprintf( chTestDescription, elCount(chTestDescription), "Purpose: Test case to verify the functionality of interface EnblHWIO_GM_TaskInits to Allows application defined RTOS tasks and ISRs to receive their event triggers on the CPU5.");
  TestCaseAddInfo( chTestTitle, "TC_L30SW_Q-36684465", chTestDescription );

  /***************************************************************************************************************/    
                                              // Start of Test Case
  /***************************************************************************************************************/
  
  /***************************************************************************************************************/    
                                              // Test Step 1 PRECONDITIONS
  /***************************************************************************************************************/
  
  snprintf( chActionText, elCount(chActionText), "Flash the Software and ECU is running"); 
  snprintf( chExpectedText, elCount(chExpectedText), "ECU should be in running state"); 
  TestStepAddActionExpected( chActionText, chExpectedText );

  A_DBGR_BreakpointDeleteAll();
  A_DBGR_RnGo();
  E_DBGR_CheckState(T32_State_Running);
  

   /***************************************************************************************************************/    
            // Test Step 2: Check all cores are in running state                                   
  /***************************************************************************************************************/
  
  //Check Core0 is running
  snprintf( chActionText, elCount(chActionText), "Check 1000ms Task Counter from Core0 "); 
  snprintf( chExpectedText, elCount(chExpectedText), "1000ms Counter from Core0 is incrementing"); 
  TestStepAddActionExpected( chActionText, chExpectedText );
  A_DBGR_VariableRead( "Task_Core0_1000ms_Count", taskvalue);
  E_DBGR_VariableCheck("Task_Core0_1000ms_Count", taskvalue, Greater);
  
  //Check Core1 is running
  snprintf( chActionText, elCount(chActionText), "Check 1000ms Task Counter from Core1 "); 
  snprintf( chExpectedText, elCount(chExpectedText), "1000ms Counter from Core1 is incrementing"); 
  TestStepAddActionExpected( chActionText, chExpectedText );
  A_DBGR_VariableRead( "Task_Core1_1000ms_Count", taskvalue);
  E_DBGR_VariableCheck("Task_Core1_1000ms_Count", taskvalue, Greater);
  
  //Check Core2 is running
  snprintf( chActionText, elCount(chActionText), "Check 1000ms Task Counter from Core2 "); 
  snprintf( chExpectedText, elCount(chExpectedText), "1000ms Counter from Core2 is incrementing"); 
  TestStepAddActionExpected( chActionText, chExpectedText );
  A_DBGR_VariableRead( "Task_Core2_1000ms_Count", taskvalue);
  E_DBGR_VariableCheck("Task_Core2_1000ms_Count", taskvalue, Greater);
    
  //Check Core3 is running
  snprintf( chActionText, elCount(chActionText), "Check 1000ms Task Counter from Core3 "); 
  snprintf( chExpectedText, elCount(chExpectedText), "1000ms Counter from Core3 is incrementing"); 
  TestStepAddActionExpected( chActionText, chExpectedText );
  A_DBGR_VariableRead( "Task_Core3_1000ms_Count", taskvalue);
  E_DBGR_VariableCheck("Task_Core3_1000ms_Count", taskvalue, Greater);
    
  //Check Core4 is running
  snprintf( chActionText, elCount(chActionText), "Check 1000ms Task Counter from Core4 "); 
  snprintf( chExpectedText, elCount(chExpectedText), "1000ms Counter from Core4 is incrementing"); 
  TestStepAddActionExpected( chActionText, chExpectedText );
  A_DBGR_VariableRead( "Task_Core4_1000ms_Count", taskvalue);
  E_DBGR_VariableCheck("Task_Core4_1000ms_Count", taskvalue, Greater);
    
  //Check Core5 is running
  snprintf( chActionText, elCount(chActionText), "Check 1000ms Task Counter from Core5 "); 
  snprintf( chExpectedText, elCount(chExpectedText), "1000ms Counter from Core5 is incrementing"); 
  TestStepAddActionExpected( chActionText, chExpectedText );
  A_DBGR_VariableRead( "Task_Core5_1000ms_Count", taskvalue);
  E_DBGR_VariableCheck("Task_Core5_1000ms_Count", taskvalue, Greater);
  

  /***************************************************************************************************************/    
    // Test Step 3: Disable Interface DsblHWIO_GM_TaskInits for Core0
  /***************************************************************************************************************/

  snprintf( chActionText, elCount(chActionText), "Disable Interface DsblHWIO_GM_TaskInits for 1000ms Task for core0 "); 
  snprintf( chExpectedText, elCount(chExpectedText), "Check Interface DsblHWIO_GM_TaskInits 1000ms Task for core1 shall set to 0 "); 
  TestStepAddActionExpected( chActionText, chExpectedText );
  A_DBGR_VariableSet("test_disable_task_initiator_core0", "1");
  E_DBGR_VariableCheck("test_disable_task_initiator_core0", 1, Equal);    


  /***************************************************************************************************************/    
    // Test Step 4: Check all Cores are running except core 0, shall be disabled
  /***************************************************************************************************************/

  
//Check All tasks of Core0 are stopped
  snprintf( chActionText, elCount(chActionText), "Check 2pt5ms Task Counter from Core0 "); 
  snprintf( chExpectedText, elCount(chExpectedText), "2pt5ms Counter from Core0 is stop  incrementing"); 
  TestStepAddActionExpected( chActionText, chExpectedText );
  A_DBGR_VariableRead( "Task_Core0_2pt5ms_Count", taskvalue);
  E_DBGR_VariableCheck("Task_Core0_2pt5ms_Count", taskvalue, Equal);
  
  snprintf( chActionText, elCount(chActionText), "Check 5ms Task Counter from Core0 "); 
  snprintf( chExpectedText, elCount(chExpectedText), "5ms Counter from Core0 is stop  incrementing"); 
  TestStepAddActionExpected( chActionText, chExpectedText );
  A_DBGR_VariableRead( "Task_Core0_5ms_Count", taskvalue);
  E_DBGR_VariableCheck("Task_Core0_5ms_Count", taskvalue, Equal);
  
  snprintf( chActionText, elCount(chActionText), "Check 10ms Task Counter from Core0 "); 
  snprintf( chExpectedText, elCount(chExpectedText), "10ms Counter from Core0 is stop  incrementing"); 
  TestStepAddActionExpected( chActionText, chExpectedText );
  A_DBGR_VariableRead( "Task_Core0_10ms_Count", taskvalue);
  E_DBGR_VariableCheck("Task_Core0_10ms_Count", taskvalue, Equal);  
  
  snprintf( chActionText, elCount(chActionText), "Check 25ms Task Counter from Core0 "); 
  snprintf( chExpectedText, elCount(chExpectedText), "25ms Counter from Core0 is stop  incrementing"); 
  TestStepAddActionExpected( chActionText, chExpectedText );
  A_DBGR_VariableRead( "Task_Core0_25ms_Count", taskvalue);
  E_DBGR_VariableCheck("Task_Core0_25ms_Count", taskvalue, Equal);  

  snprintf( chActionText, elCount(chActionText), "Check 50ms Task Counter from Core0 "); 
  snprintf( chExpectedText, elCount(chExpectedText), "50ms Counter from Core0 is stop  incrementing"); 
  TestStepAddActionExpected( chActionText, chExpectedText );
  A_DBGR_VariableRead( "Task_Core0_50ms_Count", taskvalue);
  E_DBGR_VariableCheck("Task_Core0_50ms_Count", taskvalue, Equal);
  
  snprintf( chActionText, elCount(chActionText), "Check 250ms Task Counter from Core0 "); 
  snprintf( chExpectedText, elCount(chExpectedText), "250ms Counter from Core0 is stop  incrementing"); 
  TestStepAddActionExpected( chActionText, chExpectedText );
  A_DBGR_VariableRead( "Task_Core0_250ms_Count", taskvalue);
  E_DBGR_VariableCheck("Task_Core0_250ms_Count", taskvalue, Equal);
  
  snprintf( chActionText, elCount(chActionText), "Check 100ms Task Counter from Core0 "); 
  snprintf( chExpectedText, elCount(chExpectedText), "100ms Counter from Core0 is stop  incrementing"); 
  TestStepAddActionExpected( chActionText, chExpectedText );
  A_DBGR_VariableRead( "Task_Core0_100ms_Count", taskvalue);
  E_DBGR_VariableCheck("Task_Core0_100ms_Count", taskvalue, Equal); 

  snprintf( chActionText, elCount(chActionText), "Check 500ms Task Counter from Core0 "); 
  snprintf( chExpectedText, elCount(chExpectedText), "500ms Counter from Core0 is stop  incrementing"); 
  TestStepAddActionExpected( chActionText, chExpectedText );
  A_DBGR_VariableRead( "Task_Core0_500ms_Count", taskvalue);
  E_DBGR_VariableCheck("Task_Core0_500ms_Count", taskvalue, Equal);
  
  snprintf( chActionText, elCount(chActionText), "Check 1000ms Task Counter from Core0 "); 
  snprintf( chExpectedText, elCount(chExpectedText), "1000ms Counter from Core0 is stop  incrementing"); 
  TestStepAddActionExpected( chActionText, chExpectedText );
  A_DBGR_VariableRead( "Task_Core0_1000ms_Count", taskvalue);
  E_DBGR_VariableCheck("Task_Core0_1000ms_Count", taskvalue, Equal);
  

  //Check All tasks of Core1 are running
  snprintf( chActionText, elCount(chActionText), "Check 2pt5ms Task Counter from Core1 "); 
  snprintf( chExpectedText, elCount(chExpectedText), "2pt5ms Counter from Core1 is  incrementing"); 
  TestStepAddActionExpected( chActionText, chExpectedText );
  A_DBGR_VariableRead( "Task_Core1_2pt5ms_Count", taskvalue);
  E_DBGR_VariableCheck("Task_Core1_2pt5ms_Count", taskvalue, Greater);
  
  snprintf( chActionText, elCount(chActionText), "Check 5ms Task Counter from Core1 "); 
  snprintf( chExpectedText, elCount(chExpectedText), "5ms Counter from Core1 is  incrementing"); 
  TestStepAddActionExpected( chActionText, chExpectedText );
  A_DBGR_VariableRead( "Task_Core1_5ms_Count", taskvalue);
  E_DBGR_VariableCheck("Task_Core1_5ms_Count", taskvalue, Greater);
  
  snprintf( chActionText, elCount(chActionText), "Check 10ms Task Counter from Core1 "); 
  snprintf( chExpectedText, elCount(chExpectedText), "10ms Counter from Core1 is  incrementing"); 
  TestStepAddActionExpected( chActionText, chExpectedText );
  A_DBGR_VariableRead( "Task_Core1_10ms_Count", taskvalue);
  E_DBGR_VariableCheck("Task_Core1_10ms_Count", taskvalue, Greater);  
  
  snprintf( chActionText, elCount(chActionText), "Check 25ms Task Counter from Core1 "); 
  snprintf( chExpectedText, elCount(chExpectedText), "25ms Counter from Core1 is  incrementing"); 
  TestStepAddActionExpected( chActionText, chExpectedText );
  A_DBGR_VariableRead( "Task_Core1_25ms_Count", taskvalue);
  E_DBGR_VariableCheck("Task_Core1_25ms_Count", taskvalue, Greater); 
  
  snprintf( chActionText, elCount(chActionText), "Check 50ms Task Counter from Core1 "); 
  snprintf( chExpectedText, elCount(chExpectedText), "50ms Counter from Core1 is  incrementing"); 
  TestStepAddActionExpected( chActionText, chExpectedText );
  A_DBGR_VariableRead( "Task_Core1_50ms_Count", taskvalue);
  E_DBGR_VariableCheck("Task_Core1_50ms_Count", taskvalue, Greater);
    
  snprintf( chActionText, elCount(chActionText), "Check 100ms Task Counter from Core1 "); 
  snprintf( chExpectedText, elCount(chExpectedText), "100ms Counter from Core1 is  incrementing"); 
  TestStepAddActionExpected( chActionText, chExpectedText );
  A_DBGR_VariableRead( "Task_Core1_100ms_Count", taskvalue);
  E_DBGR_VariableCheck("Task_Core1_100ms_Count", taskvalue, Greater);

  snprintf( chActionText, elCount(chActionText), "Check 250ms Task Counter from Core1 "); 
  snprintf( chExpectedText, elCount(chExpectedText), "250ms Counter from Core1 is  incrementing"); 
  TestStepAddActionExpected( chActionText, chExpectedText );
  A_DBGR_VariableRead( "Task_Core1_250ms_Count", taskvalue);
  E_DBGR_VariableCheck("Task_Core1_250ms_Count", taskvalue, Greater);
  
  snprintf( chActionText, elCount(chActionText), "Check 500ms Task Counter from Core1 "); 
  snprintf( chExpectedText, elCount(chExpectedText), "500ms Counter from Core1 is  incrementing"); 
  TestStepAddActionExpected( chActionText, chExpectedText );
  A_DBGR_VariableRead( "Task_Core1_500ms_Count", taskvalue);
  E_DBGR_VariableCheck("Task_Core1_500ms_Count", taskvalue, Greater);

  snprintf( chActionText, elCount(chActionText), "Check 1000ms Task Counter from Core1 "); 
  snprintf( chExpectedText, elCount(chExpectedText), "1000ms Counter from Core1 is incrementing"); 
  TestStepAddActionExpected( chActionText, chExpectedText );
  A_DBGR_VariableRead( "Task_Core1_1000ms_Count", taskvalue);
  E_DBGR_VariableCheck("Task_Core1_1000ms_Count", taskvalue, Greater);
  
  
  //Check All tasks of Core2 are Running
  snprintf( chActionText, elCount(chActionText), "Check 2pt5ms Task Counter from Core2 "); 
  snprintf( chExpectedText, elCount(chExpectedText), "2pt5ms Counter from Core2 is   incrementing"); 
  TestStepAddActionExpected( chActionText, chExpectedText );
  A_DBGR_VariableRead( "Task_Core2_2pt5ms_Count", taskvalue);
  E_DBGR_VariableCheck("Task_Core2_2pt5ms_Count", taskvalue, Greater);
  
  snprintf( chActionText, elCount(chActionText), "Check 5ms Task Counter from Core2 "); 
  snprintf( chExpectedText, elCount(chExpectedText), "5ms Counter from Core2 is   incrementing"); 
  TestStepAddActionExpected( chActionText, chExpectedText );
  A_DBGR_VariableRead( "Task_Core2_5ms_Count", taskvalue);
  E_DBGR_VariableCheck("Task_Core2_5ms_Count", taskvalue, Greater);
  
  snprintf( chActionText, elCount(chActionText), "Check 10ms Task Counter from Core2 "); 
  snprintf( chExpectedText, elCount(chExpectedText), "10ms Counter from Core2 is   incrementing"); 
  TestStepAddActionExpected( chActionText, chExpectedText );
  A_DBGR_VariableRead( "Task_Core2_10ms_Count", taskvalue);
  E_DBGR_VariableCheck("Task_Core2_10ms_Count", taskvalue, Greater);  
  
  snprintf( chActionText, elCount(chActionText), "Check 25ms Task Counter from Core2 "); 
  snprintf( chExpectedText, elCount(chExpectedText), "25ms Counter from Core2 is   incrementing"); 
  TestStepAddActionExpected( chActionText, chExpectedText );
  A_DBGR_VariableRead( "Task_Core2_25ms_Count", taskvalue);
  E_DBGR_VariableCheck("Task_Core2_25ms_Count", taskvalue, Greater); 

  snprintf( chActionText, elCount(chActionText), "Check 50ms Task Counter from Core2 "); 
  snprintf( chExpectedText, elCount(chExpectedText), "50ms Counter from Core2 is   incrementing"); 
  TestStepAddActionExpected( chActionText, chExpectedText );
  A_DBGR_VariableRead( "Task_Core2_50ms_Count", taskvalue);
  E_DBGR_VariableCheck("Task_Core2_50ms_Count", taskvalue, Greater);
  
  snprintf( chActionText, elCount(chActionText), "Check 100ms Task Counter from Core2 "); 
  snprintf( chExpectedText, elCount(chExpectedText), "100ms Counter from Core2 is   incrementing"); 
  TestStepAddActionExpected( chActionText, chExpectedText );
  A_DBGR_VariableRead( "Task_Core2_100ms_Count", taskvalue);
  E_DBGR_VariableCheck("Task_Core2_100ms_Count", taskvalue, Greater); 
  
  snprintf( chActionText, elCount(chActionText), "Check 250ms Task Counter from Core2 "); 
  snprintf( chExpectedText, elCount(chExpectedText), "250ms Counter from Core2 is   incrementing"); 
  TestStepAddActionExpected( chActionText, chExpectedText );
  A_DBGR_VariableRead( "Task_Core2_250ms_Count", taskvalue);
  E_DBGR_VariableCheck("Task_Core2_250ms_Count", taskvalue, Greater);

  snprintf( chActionText, elCount(chActionText), "Check 500ms Task Counter from Core2 "); 
  snprintf( chExpectedText, elCount(chExpectedText), "500ms Counter from Core2 is   incrementing"); 
  TestStepAddActionExpected( chActionText, chExpectedText );
  A_DBGR_VariableRead( "Task_Core2_500ms_Count", taskvalue);
  E_DBGR_VariableCheck("Task_Core2_500ms_Count", taskvalue, Greater);

  snprintf( chActionText, elCount(chActionText), "Check 1000ms Task Counter from Core2 "); 
  snprintf( chExpectedText, elCount(chExpectedText), "1000ms Counter from Core2 is   incrementing"); 
  TestStepAddActionExpected( chActionText, chExpectedText );
  A_DBGR_VariableRead( "Task_Core2_1000ms_Count", taskvalue);
  E_DBGR_VariableCheck("Task_Core2_1000ms_Count", taskvalue, Greater);
  
  
    //Check All tasks of Core3 are running
  snprintf( chActionText, elCount(chActionText), "Check 2pt5ms Task Counter from Core3 "); 
  snprintf( chExpectedText, elCount(chExpectedText), "2pt5ms Counter from Core3 is  incrementing"); 
  TestStepAddActionExpected( chActionText, chExpectedText );
  A_DBGR_VariableRead( "Task_Core3_2pt5ms_Count", taskvalue);
  E_DBGR_VariableCheck("Task_Core3_2pt5ms_Count", taskvalue, Greater);
  
   snprintf( chActionText, elCount(chActionText), "Check 5ms Task Counter from Core3 "); 
  snprintf( chExpectedText, elCount(chExpectedText), "5ms Counter from Core3 is  incrementing"); 
  TestStepAddActionExpected( chActionText, chExpectedText );
  A_DBGR_VariableRead( "Task_Core3_5ms_Count", taskvalue);
  E_DBGR_VariableCheck("Task_Core3_5ms_Count", taskvalue, Greater);
  
  snprintf( chActionText, elCount(chActionText), "Check 10ms Task Counter from Core3 "); 
  snprintf( chExpectedText, elCount(chExpectedText), "10ms Counter from Core3 is   incrementing"); 
  TestStepAddActionExpected( chActionText, chExpectedText );
  A_DBGR_VariableRead( "Task_Core3_10ms_Count", taskvalue);
  E_DBGR_VariableCheck("Task_Core3_10ms_Count", taskvalue, Greater);  
  
  snprintf( chActionText, elCount(chActionText), "Check 25ms Task Counter from Core3 "); 
  snprintf( chExpectedText, elCount(chExpectedText), "25ms Counter from Core3 is incrementing"); 
  TestStepAddActionExpected( chActionText, chExpectedText );
  A_DBGR_VariableRead( "Task_Core3_25ms_Count", taskvalue);
  E_DBGR_VariableCheck("Task_Core3_25ms_Count", taskvalue, Greater);  
  
  snprintf( chActionText, elCount(chActionText), "Check 50ms Task Counter from Core3 "); 
  snprintf( chExpectedText, elCount(chExpectedText), "50ms Counter from Core3 is incrementing"); 
  TestStepAddActionExpected( chActionText, chExpectedText );
  A_DBGR_VariableRead( "Task_Core3_50ms_Count", taskvalue);
  E_DBGR_VariableCheck("Task_Core3_50ms_Count", taskvalue, Greater);

  snprintf( chActionText, elCount(chActionText), "Check 100ms Task Counter from Core3 "); 
  snprintf( chExpectedText, elCount(chExpectedText), "100ms Counter from Core3 is incrementing"); 
  TestStepAddActionExpected( chActionText, chExpectedText );
  A_DBGR_VariableRead( "Task_Core3_100ms_Count", taskvalue);
  E_DBGR_VariableCheck("Task_Core3_100ms_Count", taskvalue, Greater); 
  
  snprintf( chActionText, elCount(chActionText), "Check 250ms Task Counter from Core3 "); 
  snprintf( chExpectedText, elCount(chExpectedText), "250ms Counter from Core3 is incrementing"); 
  TestStepAddActionExpected( chActionText, chExpectedText );
  A_DBGR_VariableRead( "Task_Core3_250ms_Count", taskvalue);
  E_DBGR_VariableCheck("Task_Core3_250ms_Count", taskvalue, Greater);
  
  snprintf( chActionText, elCount(chActionText), "Check 500ms Task Counter from Core3 "); 
  snprintf( chExpectedText, elCount(chExpectedText), "500ms Counter from Core3 is stop incrementing"); 
  TestStepAddActionExpected( chActionText, chExpectedText );
  A_DBGR_VariableRead( "Task_Core3_500ms_Count", taskvalue);
  E_DBGR_VariableCheck("Task_Core3_500ms_Count", taskvalue, Greater);
  
  snprintf( chActionText, elCount(chActionText), "Check 1000ms Task Counter from Core3 "); 
  snprintf( chExpectedText, elCount(chExpectedText), "1000ms Counter from Core3 is incrementing"); 
  TestStepAddActionExpected( chActionText, chExpectedText );
  A_DBGR_VariableRead( "Task_Core3_1000ms_Count", taskvalue);
  E_DBGR_VariableCheck("Task_Core3_1000ms_Count", taskvalue, Greater);
  
    //Check task from Core4 is running
  snprintf( chActionText, elCount(chActionText), "Check 1000ms Task Counter from Core4 "); 
  snprintf( chExpectedText, elCount(chExpectedText), "1000ms Counter from Core4 is incrementing"); 
  TestStepAddActionExpected( chActionText, chExpectedText );
  A_DBGR_VariableRead( "Task_Core4_1000ms_Count", taskvalue);
  E_DBGR_VariableCheck("Task_Core4_1000ms_Count", taskvalue, Greater);
    
  //Check task from Core5 is running
  snprintf( chActionText, elCount(chActionText), "Check 1000ms Task Counter from Core5 "); 
  snprintf( chExpectedText, elCount(chExpectedText), "1000ms Counter from Core5 is stop incrementing"); 
  TestStepAddActionExpected( chActionText, chExpectedText );
  A_DBGR_VariableRead( "Task_Core5_1000ms_Count", taskvalue);
  E_DBGR_VariableCheck("Task_Core5_1000ms_Count", taskvalue, Greater);
  
  /***************************************************************************************************************/    
    // Test Step 5: Enable Task Initiators
  /***************************************************************************************************************/
  
  // Enable Task Initiator 
  snprintf( chActionText, elCount(chActionText), "Enable interrupt GMTaskinterruptWait to enable Interface EnblHWIO_GM_TaskInits for core0 "); 
  snprintf( chExpectedText, elCount(chExpectedText), "Check interrut GMTaskinterruptWait shall set to 1 "); 
  TestStepAddActionExpected( chActionText, chExpectedText );
  A_DBGR_VariableSet("GMTaskinterruptWait", "1");
  E_DBGR_VariableCheck("GMTaskinterruptWait", 1, Equal);   
  
  /***************************************************************************************************************/    
    // Test Step 6: Check Task 0 counters are running
  /***************************************************************************************************************/
 
  //Check All tasks of Core0 are Running
  snprintf( chActionText, elCount(chActionText), "Check 2pt5ms Task Counter from Core0 "); 
  snprintf( chExpectedText, elCount(chExpectedText), "2pt5ms Counter from Core0 is  incrementing"); 
  TestStepAddActionExpected( chActionText, chExpectedText );
  A_DBGR_VariableRead( "Task_Core0_2pt5ms_Count", taskvalue);
  E_DBGR_VariableCheck("Task_Core0_2pt5ms_Count", taskvalue, Greater);
  
  snprintf( chActionText, elCount(chActionText), "Check 5ms Task Counter from Core0 "); 
  snprintf( chExpectedText, elCount(chExpectedText), "5ms Counter from Core0 is  incrementing"); 
  TestStepAddActionExpected( chActionText, chExpectedText );
  A_DBGR_VariableRead( "Task_Core0_5ms_Count", taskvalue);
  E_DBGR_VariableCheck("Task_Core0_5ms_Count", taskvalue, Greater);
  
  snprintf( chActionText, elCount(chActionText), "Check 10ms Task Counter from Core0 "); 
  snprintf( chExpectedText, elCount(chExpectedText), "10ms Counter from Core0 is  incrementing"); 
  TestStepAddActionExpected( chActionText, chExpectedText );
  A_DBGR_VariableRead( "Task_Core0_10ms_Count", taskvalue);
  E_DBGR_VariableCheck("Task_Core0_10ms_Count", taskvalue, Greater);  
  
  snprintf( chActionText, elCount(chActionText), "Check 25ms Task Counter from Core0 "); 
  snprintf( chExpectedText, elCount(chExpectedText), "25ms Counter from Core0 is  incrementing"); 
  TestStepAddActionExpected( chActionText, chExpectedText );
  A_DBGR_VariableRead( "Task_Core0_25ms_Count", taskvalue);
  E_DBGR_VariableCheck("Task_Core0_25ms_Count", taskvalue, Greater);  

  snprintf( chActionText, elCount(chActionText), "Check 50ms Task Counter from Core0 "); 
  snprintf( chExpectedText, elCount(chExpectedText), "50ms Counter from Core0 is  incrementing"); 
  TestStepAddActionExpected( chActionText, chExpectedText );
  A_DBGR_VariableRead( "Task_Core0_50ms_Count", taskvalue);
  E_DBGR_VariableCheck("Task_Core0_50ms_Count", taskvalue, Greater);
  
  snprintf( chActionText, elCount(chActionText), "Check 250ms Task Counter from Core0 "); 
  snprintf( chExpectedText, elCount(chExpectedText), "250ms Counter from Core0 is  incrementing"); 
  TestStepAddActionExpected( chActionText, chExpectedText );
  A_DBGR_VariableRead( "Task_Core0_250ms_Count", taskvalue);
  E_DBGR_VariableCheck("Task_Core0_250ms_Count", taskvalue, Greater);
  
  snprintf( chActionText, elCount(chActionText), "Check 100ms Task Counter from Core0 "); 
  snprintf( chExpectedText, elCount(chExpectedText), "100ms Counter from Core0 is  incrementing"); 
  TestStepAddActionExpected( chActionText, chExpectedText );
  A_DBGR_VariableRead( "Task_Core0_100ms_Count", taskvalue);
  E_DBGR_VariableCheck("Task_Core0_100ms_Count", taskvalue, Greater); 

  snprintf( chActionText, elCount(chActionText), "Check 500ms Task Counter from Core0 "); 
  snprintf( chExpectedText, elCount(chExpectedText), "500ms Counter from Core0 is  incrementing"); 
  TestStepAddActionExpected( chActionText, chExpectedText );
  A_DBGR_VariableRead( "Task_Core0_500ms_Count", taskvalue);
  E_DBGR_VariableCheck("Task_Core0_500ms_Count", taskvalue, Greater);
  
  snprintf( chActionText, elCount(chActionText), "Check 1000ms Task Counter from Core0 "); 
  snprintf( chExpectedText, elCount(chExpectedText), "1000ms Counter from Core0 is  incrementing"); 
  TestStepAddActionExpected( chActionText, chExpectedText );
  A_DBGR_VariableRead( "Task_Core0_1000ms_Count", taskvalue);
  E_DBGR_VariableCheck("Task_Core0_1000ms_Count", taskvalue, Greater);
  
  
}




/***************************************************************************************************
----------------------------------------------------------------------------------------------------
Test case name:  TC_L30SW_Q-36684464: Testcase_to_verify_interface_EnblHWIO_GM_TaskInits_to_Allows_application_defined_RTOS_tasks_and_ISRs_to_receive_event_triggers_on_CPU1
Description:   Test case to verify the functionality of interface EnblHWIO_GM_TaskInits to Allows application defined RTOS tasks and ISRs to receive their event triggers on the CPU1

***************************************************************************************************/
testcase Testcase_to_verify_interface_EnblHWIO_GM_TaskInits_to_Allow_application_RTOS_tasks_and_ISRs_to_receive_event_triggers_on_CPU1()
{
  /***************************************************************************************************************/    
                                                // Variable Definition
  /***************************************************************************************************************/ 
  
  long taskvalue;
  
  /***************************************************************************************************************/    
                                               // Local Values
  /***************************************************************************************************************/ 
  

  
  /***************************************************************************************************************/    
                                              // Test Case Info
  /***************************************************************************************************************/
  setWriteDbgLevel(DebugOff);
  snprintf( chTestTitle, elCount(chTestTitle), "Testcase_to_verify_interface_EnblHWIO_GM_TaskInits_to_Allow_application_RTOS_tasks_and_ISRs_to_receive_event_triggers_on_CPU5" );
  snprintf( chTestDescription, elCount(chTestDescription), "Purpose: Test case to verify the functionality of interface EnblHWIO_GM_TaskInits to Allows application defined RTOS tasks and ISRs to receive their event triggers on the CPU5.");
  TestCaseAddInfo( chTestTitle, "TC_L30SW_Q-36684464", chTestDescription );

  /***************************************************************************************************************/    
                                              // Start of Test Case
  /***************************************************************************************************************/
  
  /***************************************************************************************************************/    
                                              // Test Step 1 PRECONDITIONS
  /***************************************************************************************************************/
  
  snprintf( chActionText, elCount(chActionText), "Flash the Software and ECU is running"); 
  snprintf( chExpectedText, elCount(chExpectedText), "ECU should be in running state"); 
  TestStepAddActionExpected( chActionText, chExpectedText );

  A_DBGR_BreakpointDeleteAll();
  A_DBGR_RnGo();
  E_DBGR_CheckState(T32_State_Running);
  

   /***************************************************************************************************************/    
            // Test Step 2: Check all cores are in running state                                   
  /***************************************************************************************************************/
  
  //Check Core0 is running
  snprintf( chActionText, elCount(chActionText), "Check 1000ms Task Counter from Core0 "); 
  snprintf( chExpectedText, elCount(chExpectedText), "1000ms Counter from Core0 is incrementing"); 
  TestStepAddActionExpected( chActionText, chExpectedText );
  A_DBGR_VariableRead( "Task_Core0_1000ms_Count", taskvalue);
  E_DBGR_VariableCheck("Task_Core0_1000ms_Count", taskvalue, Greater);
  
  //Check Core1 is running
  snprintf( chActionText, elCount(chActionText), "Check 1000ms Task Counter from Core1 "); 
  snprintf( chExpectedText, elCount(chExpectedText), "1000ms Counter from Core1 is incrementing"); 
  TestStepAddActionExpected( chActionText, chExpectedText );
  A_DBGR_VariableRead( "Task_Core1_1000ms_Count", taskvalue);
  E_DBGR_VariableCheck("Task_Core1_1000ms_Count", taskvalue, Greater);
  
  //Check Core2 is running
  snprintf( chActionText, elCount(chActionText), "Check 1000ms Task Counter from Core2 "); 
  snprintf( chExpectedText, elCount(chExpectedText), "1000ms Counter from Core2 is incrementing"); 
  TestStepAddActionExpected( chActionText, chExpectedText );
  A_DBGR_VariableRead( "Task_Core2_1000ms_Count", taskvalue);
  E_DBGR_VariableCheck("Task_Core2_1000ms_Count", taskvalue, Greater);
    
  //Check Core3 is running
  snprintf( chActionText, elCount(chActionText), "Check 1000ms Task Counter from Core3 "); 
  snprintf( chExpectedText, elCount(chExpectedText), "1000ms Counter from Core3 is incrementing"); 
  TestStepAddActionExpected( chActionText, chExpectedText );
  A_DBGR_VariableRead( "Task_Core3_1000ms_Count", taskvalue);
  E_DBGR_VariableCheck("Task_Core3_1000ms_Count", taskvalue, Greater);
    
  //Check Core4 is running
  snprintf( chActionText, elCount(chActionText), "Check 1000ms Task Counter from Core4 "); 
  snprintf( chExpectedText, elCount(chExpectedText), "1000ms Counter from Core4 is incrementing"); 
  TestStepAddActionExpected( chActionText, chExpectedText );
  A_DBGR_VariableRead( "Task_Core4_1000ms_Count", taskvalue);
  E_DBGR_VariableCheck("Task_Core4_1000ms_Count", taskvalue, Greater);
    
  //Check Core5 is running
  snprintf( chActionText, elCount(chActionText), "Check 1000ms Task Counter from Core5 "); 
  snprintf( chExpectedText, elCount(chExpectedText), "1000ms Counter from Core5 is incrementing"); 
  TestStepAddActionExpected( chActionText, chExpectedText );
  A_DBGR_VariableRead( "Task_Core5_1000ms_Count", taskvalue);
  E_DBGR_VariableCheck("Task_Core5_1000ms_Count", taskvalue, Greater);
  

  /***************************************************************************************************************/    
    // Test Step 3: Disable Interface DsblHWIO_GM_TaskInits for Core1
  /***************************************************************************************************************/

  snprintf( chActionText, elCount(chActionText), "Disable Interface DsblHWIO_GM_TaskInits for 1000ms Task for core1 "); 
  snprintf( chExpectedText, elCount(chExpectedText), "Check Interface DsblHWIO_GM_TaskInits 1000ms Task for core1 shall set to 1 "); 
  TestStepAddActionExpected( chActionText, chExpectedText );
  A_DBGR_VariableSet("test_disable_task_initiator_core1", "1");
  E_DBGR_VariableCheck("test_disable_task_initiator_core1", 1, Equal);    


  /***************************************************************************************************************/    
    // Test Step 4: Check all Cores are running except core 1, shall be disabled
  /***************************************************************************************************************/

  
  //Check All tasks of Core0 are Running
  snprintf( chActionText, elCount(chActionText), "Check 2pt5ms Task Counter from Core0 "); 
  snprintf( chExpectedText, elCount(chExpectedText), "2pt5ms Counter from Core0 is  incrementing"); 
  TestStepAddActionExpected( chActionText, chExpectedText );
  A_DBGR_VariableRead( "Task_Core0_2pt5ms_Count", taskvalue);
  E_DBGR_VariableCheck("Task_Core0_2pt5ms_Count", taskvalue, Greater);
  
  snprintf( chActionText, elCount(chActionText), "Check 5ms Task Counter from Core0 "); 
  snprintf( chExpectedText, elCount(chExpectedText), "5ms Counter from Core0 is  incrementing"); 
  TestStepAddActionExpected( chActionText, chExpectedText );
  A_DBGR_VariableRead( "Task_Core0_5ms_Count", taskvalue);
  E_DBGR_VariableCheck("Task_Core0_5ms_Count", taskvalue, Greater);
  
  snprintf( chActionText, elCount(chActionText), "Check 10ms Task Counter from Core0 "); 
  snprintf( chExpectedText, elCount(chExpectedText), "10ms Counter from Core0 is  incrementing"); 
  TestStepAddActionExpected( chActionText, chExpectedText );
  A_DBGR_VariableRead( "Task_Core0_10ms_Count", taskvalue);
  E_DBGR_VariableCheck("Task_Core0_10ms_Count", taskvalue, Greater);  
  
  snprintf( chActionText, elCount(chActionText), "Check 25ms Task Counter from Core0 "); 
  snprintf( chExpectedText, elCount(chExpectedText), "25ms Counter from Core0 is  incrementing"); 
  TestStepAddActionExpected( chActionText, chExpectedText );
  A_DBGR_VariableRead( "Task_Core0_25ms_Count", taskvalue);
  E_DBGR_VariableCheck("Task_Core0_25ms_Count", taskvalue, Greater);  

  snprintf( chActionText, elCount(chActionText), "Check 50ms Task Counter from Core0 "); 
  snprintf( chExpectedText, elCount(chExpectedText), "50ms Counter from Core0 is  incrementing"); 
  TestStepAddActionExpected( chActionText, chExpectedText );
  A_DBGR_VariableRead( "Task_Core0_50ms_Count", taskvalue);
  E_DBGR_VariableCheck("Task_Core0_50ms_Count", taskvalue, Greater);
  
  snprintf( chActionText, elCount(chActionText), "Check 250ms Task Counter from Core0 "); 
  snprintf( chExpectedText, elCount(chExpectedText), "250ms Counter from Core0 is  incrementing"); 
  TestStepAddActionExpected( chActionText, chExpectedText );
  A_DBGR_VariableRead( "Task_Core0_250ms_Count", taskvalue);
  E_DBGR_VariableCheck("Task_Core0_250ms_Count", taskvalue, Greater);
  
  snprintf( chActionText, elCount(chActionText), "Check 100ms Task Counter from Core0 "); 
  snprintf( chExpectedText, elCount(chExpectedText), "100ms Counter from Core0 is  incrementing"); 
  TestStepAddActionExpected( chActionText, chExpectedText );
  A_DBGR_VariableRead( "Task_Core0_100ms_Count", taskvalue);
  E_DBGR_VariableCheck("Task_Core0_100ms_Count", taskvalue, Greater); 

  snprintf( chActionText, elCount(chActionText), "Check 500ms Task Counter from Core0 "); 
  snprintf( chExpectedText, elCount(chExpectedText), "500ms Counter from Core0 is  incrementing"); 
  TestStepAddActionExpected( chActionText, chExpectedText );
  A_DBGR_VariableRead( "Task_Core0_500ms_Count", taskvalue);
  E_DBGR_VariableCheck("Task_Core0_500ms_Count", taskvalue, Greater);
  
  snprintf( chActionText, elCount(chActionText), "Check 1000ms Task Counter from Core0 "); 
  snprintf( chExpectedText, elCount(chExpectedText), "1000ms Counter from Core0 is  incrementing"); 
  TestStepAddActionExpected( chActionText, chExpectedText );
  A_DBGR_VariableRead( "Task_Core0_1000ms_Count", taskvalue);
  E_DBGR_VariableCheck("Task_Core0_1000ms_Count", taskvalue, Greater);
  
 
  //Check All tasks of Core1 are Stopped
  snprintf( chActionText, elCount(chActionText), "Check 2pt5ms Task Counter from Core1 "); 
  snprintf( chExpectedText, elCount(chExpectedText), "2pt5ms Counter from Core1 is stop  incrementing"); 
  TestStepAddActionExpected( chActionText, chExpectedText );
  A_DBGR_VariableRead( "Task_Core1_2pt5ms_Count", taskvalue);
  E_DBGR_VariableCheck("Task_Core1_2pt5ms_Count", taskvalue, Equal);
  
  snprintf( chActionText, elCount(chActionText), "Check 5ms Task Counter from Core1 "); 
  snprintf( chExpectedText, elCount(chExpectedText), "5ms Counter from Core1 is stop  incrementing"); 
  TestStepAddActionExpected( chActionText, chExpectedText );
  A_DBGR_VariableRead( "Task_Core1_5ms_Count", taskvalue);
  E_DBGR_VariableCheck("Task_Core1_5ms_Count", taskvalue, Equal);
  
  snprintf( chActionText, elCount(chActionText), "Check 10ms Task Counter from Core1 "); 
  snprintf( chExpectedText, elCount(chExpectedText), "10ms Counter from Core1 is stop  incrementing"); 
  TestStepAddActionExpected( chActionText, chExpectedText );
  A_DBGR_VariableRead( "Task_Core1_10ms_Count", taskvalue);
  E_DBGR_VariableCheck("Task_Core1_10ms_Count", taskvalue, Equal);  
  
  snprintf( chActionText, elCount(chActionText), "Check 25ms Task Counter from Core1 "); 
  snprintf( chExpectedText, elCount(chExpectedText), "25ms Counter from Core1 is stop  incrementing"); 
  TestStepAddActionExpected( chActionText, chExpectedText );
  A_DBGR_VariableRead( "Task_Core1_25ms_Count", taskvalue);
  E_DBGR_VariableCheck("Task_Core1_25ms_Count", taskvalue, Equal); 
  
  snprintf( chActionText, elCount(chActionText), "Check 50ms Task Counter from Core1 "); 
  snprintf( chExpectedText, elCount(chExpectedText), "50ms Counter from Core1 is stop  incrementing"); 
  TestStepAddActionExpected( chActionText, chExpectedText );
  A_DBGR_VariableRead( "Task_Core1_50ms_Count", taskvalue);
  E_DBGR_VariableCheck("Task_Core1_50ms_Count", taskvalue, Equal);
    
  snprintf( chActionText, elCount(chActionText), "Check 100ms Task Counter from Core1 "); 
  snprintf( chExpectedText, elCount(chExpectedText), "100ms Counter from Core1 is stop  incrementing"); 
  TestStepAddActionExpected( chActionText, chExpectedText );
  A_DBGR_VariableRead( "Task_Core1_100ms_Count", taskvalue);
  E_DBGR_VariableCheck("Task_Core1_100ms_Count", taskvalue, Equal);

  snprintf( chActionText, elCount(chActionText), "Check 250ms Task Counter from Core1 "); 
  snprintf( chExpectedText, elCount(chExpectedText), "250ms Counter from Core1 is stop  incrementing"); 
  TestStepAddActionExpected( chActionText, chExpectedText );
  A_DBGR_VariableRead( "Task_Core1_250ms_Count", taskvalue);
  E_DBGR_VariableCheck("Task_Core1_250ms_Count", taskvalue, Equal);
  
  snprintf( chActionText, elCount(chActionText), "Check 500ms Task Counter from Core1 "); 
  snprintf( chExpectedText, elCount(chExpectedText), "500ms Counter from Core1 is stop  incrementing"); 
  TestStepAddActionExpected( chActionText, chExpectedText );
  A_DBGR_VariableRead( "Task_Core1_500ms_Count", taskvalue);
  E_DBGR_VariableCheck("Task_Core1_500ms_Count", taskvalue, Equal);

  snprintf( chActionText, elCount(chActionText), "Check 1000ms Task Counter from Core1 "); 
  snprintf( chExpectedText, elCount(chExpectedText), "1000ms Counter from Core1 is stop incrementing"); 
  TestStepAddActionExpected( chActionText, chExpectedText );
  A_DBGR_VariableRead( "Task_Core1_1000ms_Count", taskvalue);
  E_DBGR_VariableCheck("Task_Core1_1000ms_Count", taskvalue, Equal);
   
  
  //Check All tasks of Core2 are Running
  snprintf( chActionText, elCount(chActionText), "Check 2pt5ms Task Counter from Core2 "); 
  snprintf( chExpectedText, elCount(chExpectedText), "2pt5ms Counter from Core2 is   incrementing"); 
  TestStepAddActionExpected( chActionText, chExpectedText );
  A_DBGR_VariableRead( "Task_Core2_2pt5ms_Count", taskvalue);
  E_DBGR_VariableCheck("Task_Core2_2pt5ms_Count", taskvalue, Greater);
  
  snprintf( chActionText, elCount(chActionText), "Check 5ms Task Counter from Core2 "); 
  snprintf( chExpectedText, elCount(chExpectedText), "5ms Counter from Core2 is   incrementing"); 
  TestStepAddActionExpected( chActionText, chExpectedText );
  A_DBGR_VariableRead( "Task_Core2_5ms_Count", taskvalue);
  E_DBGR_VariableCheck("Task_Core2_5ms_Count", taskvalue, Greater);
  
  snprintf( chActionText, elCount(chActionText), "Check 10ms Task Counter from Core2 "); 
  snprintf( chExpectedText, elCount(chExpectedText), "10ms Counter from Core2 is   incrementing"); 
  TestStepAddActionExpected( chActionText, chExpectedText );
  A_DBGR_VariableRead( "Task_Core2_10ms_Count", taskvalue);
  E_DBGR_VariableCheck("Task_Core2_10ms_Count", taskvalue, Greater);  
  
  snprintf( chActionText, elCount(chActionText), "Check 25ms Task Counter from Core2 "); 
  snprintf( chExpectedText, elCount(chExpectedText), "25ms Counter from Core2 is   incrementing"); 
  TestStepAddActionExpected( chActionText, chExpectedText );
  A_DBGR_VariableRead( "Task_Core2_25ms_Count", taskvalue);
  E_DBGR_VariableCheck("Task_Core2_25ms_Count", taskvalue, Greater); 

  snprintf( chActionText, elCount(chActionText), "Check 50ms Task Counter from Core2 "); 
  snprintf( chExpectedText, elCount(chExpectedText), "50ms Counter from Core2 is   incrementing"); 
  TestStepAddActionExpected( chActionText, chExpectedText );
  A_DBGR_VariableRead( "Task_Core2_50ms_Count", taskvalue);
  E_DBGR_VariableCheck("Task_Core2_50ms_Count", taskvalue, Greater);
  
  snprintf( chActionText, elCount(chActionText), "Check 100ms Task Counter from Core2 "); 
  snprintf( chExpectedText, elCount(chExpectedText), "100ms Counter from Core2 is   incrementing"); 
  TestStepAddActionExpected( chActionText, chExpectedText );
  A_DBGR_VariableRead( "Task_Core2_100ms_Count", taskvalue);
  E_DBGR_VariableCheck("Task_Core2_100ms_Count", taskvalue, Greater); 
  
  snprintf( chActionText, elCount(chActionText), "Check 250ms Task Counter from Core2 "); 
  snprintf( chExpectedText, elCount(chExpectedText), "250ms Counter from Core2 is   incrementing"); 
  TestStepAddActionExpected( chActionText, chExpectedText );
  A_DBGR_VariableRead( "Task_Core2_250ms_Count", taskvalue);
  E_DBGR_VariableCheck("Task_Core2_250ms_Count", taskvalue, Greater);

  snprintf( chActionText, elCount(chActionText), "Check 500ms Task Counter from Core2 "); 
  snprintf( chExpectedText, elCount(chExpectedText), "500ms Counter from Core2 is   incrementing"); 
  TestStepAddActionExpected( chActionText, chExpectedText );
  A_DBGR_VariableRead( "Task_Core2_500ms_Count", taskvalue);
  E_DBGR_VariableCheck("Task_Core2_500ms_Count", taskvalue, Greater);

  snprintf( chActionText, elCount(chActionText), "Check 1000ms Task Counter from Core2 "); 
  snprintf( chExpectedText, elCount(chExpectedText), "1000ms Counter from Core2 is   incrementing"); 
  TestStepAddActionExpected( chActionText, chExpectedText );
  A_DBGR_VariableRead( "Task_Core2_1000ms_Count", taskvalue);
  E_DBGR_VariableCheck("Task_Core2_1000ms_Count", taskvalue, Greater);
  
  
    //Check All tasks of Core3 are running
  snprintf( chActionText, elCount(chActionText), "Check 2pt5ms Task Counter from Core3 "); 
  snprintf( chExpectedText, elCount(chExpectedText), "2pt5ms Counter from Core3 is  incrementing"); 
  TestStepAddActionExpected( chActionText, chExpectedText );
  A_DBGR_VariableRead( "Task_Core3_2pt5ms_Count", taskvalue);
  E_DBGR_VariableCheck("Task_Core3_2pt5ms_Count", taskvalue, Greater);
  
   snprintf( chActionText, elCount(chActionText), "Check 5ms Task Counter from Core3 "); 
  snprintf( chExpectedText, elCount(chExpectedText), "5ms Counter from Core3 is  incrementing"); 
  TestStepAddActionExpected( chActionText, chExpectedText );
  A_DBGR_VariableRead( "Task_Core3_5ms_Count", taskvalue);
  E_DBGR_VariableCheck("Task_Core3_5ms_Count", taskvalue, Greater);
  
  snprintf( chActionText, elCount(chActionText), "Check 10ms Task Counter from Core3 "); 
  snprintf( chExpectedText, elCount(chExpectedText), "10ms Counter from Core3 is   incrementing"); 
  TestStepAddActionExpected( chActionText, chExpectedText );
  A_DBGR_VariableRead( "Task_Core3_10ms_Count", taskvalue);
  E_DBGR_VariableCheck("Task_Core3_10ms_Count", taskvalue, Greater);  
  
  snprintf( chActionText, elCount(chActionText), "Check 25ms Task Counter from Core3 "); 
  snprintf( chExpectedText, elCount(chExpectedText), "25ms Counter from Core3 is incrementing"); 
  TestStepAddActionExpected( chActionText, chExpectedText );
  A_DBGR_VariableRead( "Task_Core3_25ms_Count", taskvalue);
  E_DBGR_VariableCheck("Task_Core3_25ms_Count", taskvalue, Greater);  
  
  snprintf( chActionText, elCount(chActionText), "Check 50ms Task Counter from Core3 "); 
  snprintf( chExpectedText, elCount(chExpectedText), "50ms Counter from Core3 is incrementing"); 
  TestStepAddActionExpected( chActionText, chExpectedText );
  A_DBGR_VariableRead( "Task_Core3_50ms_Count", taskvalue);
  E_DBGR_VariableCheck("Task_Core3_50ms_Count", taskvalue, Greater);

  snprintf( chActionText, elCount(chActionText), "Check 100ms Task Counter from Core3 "); 
  snprintf( chExpectedText, elCount(chExpectedText), "100ms Counter from Core3 is incrementing"); 
  TestStepAddActionExpected( chActionText, chExpectedText );
  A_DBGR_VariableRead( "Task_Core3_100ms_Count", taskvalue);
  E_DBGR_VariableCheck("Task_Core3_100ms_Count", taskvalue, Greater); 
  
  snprintf( chActionText, elCount(chActionText), "Check 250ms Task Counter from Core3 "); 
  snprintf( chExpectedText, elCount(chExpectedText), "250ms Counter from Core3 is incrementing"); 
  TestStepAddActionExpected( chActionText, chExpectedText );
  A_DBGR_VariableRead( "Task_Core3_250ms_Count", taskvalue);
  E_DBGR_VariableCheck("Task_Core3_250ms_Count", taskvalue, Greater);
  
  snprintf( chActionText, elCount(chActionText), "Check 500ms Task Counter from Core3 "); 
  snprintf( chExpectedText, elCount(chExpectedText), "500ms Counter from Core3 is stop incrementing"); 
  TestStepAddActionExpected( chActionText, chExpectedText );
  A_DBGR_VariableRead( "Task_Core3_500ms_Count", taskvalue);
  E_DBGR_VariableCheck("Task_Core3_500ms_Count", taskvalue, Greater);
  
  snprintf( chActionText, elCount(chActionText), "Check 1000ms Task Counter from Core3 "); 
  snprintf( chExpectedText, elCount(chExpectedText), "1000ms Counter from Core3 is incrementing"); 
  TestStepAddActionExpected( chActionText, chExpectedText );
  A_DBGR_VariableRead( "Task_Core3_1000ms_Count", taskvalue);
  E_DBGR_VariableCheck("Task_Core3_1000ms_Count", taskvalue, Greater);
  
    //Check task from Core4 is running
  snprintf( chActionText, elCount(chActionText), "Check 1000ms Task Counter from Core4 "); 
  snprintf( chExpectedText, elCount(chExpectedText), "1000ms Counter from Core4 is incrementing"); 
  TestStepAddActionExpected( chActionText, chExpectedText );
  A_DBGR_VariableRead( "Task_Core4_1000ms_Count", taskvalue);
  E_DBGR_VariableCheck("Task_Core4_1000ms_Count", taskvalue, Greater);
    
  //Check task from Core5 is running
  snprintf( chActionText, elCount(chActionText), "Check 1000ms Task Counter from Core5 "); 
  snprintf( chExpectedText, elCount(chExpectedText), "1000ms Counter from Core5 is stop incrementing"); 
  TestStepAddActionExpected( chActionText, chExpectedText );
  A_DBGR_VariableRead( "Task_Core5_1000ms_Count", taskvalue);
  E_DBGR_VariableCheck("Task_Core5_1000ms_Count", taskvalue, Greater);
  
  /***************************************************************************************************************/    
    // Test Step 5: Enable Task Initiators
  /***************************************************************************************************************/
  
  // Enable Task Initiator 
  snprintf( chActionText, elCount(chActionText), "Enable interrupt GMTaskinterruptWait to enable Interface EnblHWIO_GM_TaskInits for core1 "); 
  snprintf( chExpectedText, elCount(chExpectedText), "Check interrut GMTaskinterruptWait shall set to 1 "); 
  TestStepAddActionExpected( chActionText, chExpectedText );
  A_DBGR_VariableSet("GMTaskinterruptWait", "1");
  E_DBGR_VariableCheck("GMTaskinterruptWait", 1, Equal);   
  
  /***************************************************************************************************************/    
    // Test Step 6: Check Task 1 counters are running
  /***************************************************************************************************************/
 
 //Check All tasks of Core1 are running
  snprintf( chActionText, elCount(chActionText), "Check 2pt5ms Task Counter from Core1 "); 
  snprintf( chExpectedText, elCount(chExpectedText), "2pt5ms Counter from Core1 is  incrementing"); 
  TestStepAddActionExpected( chActionText, chExpectedText );
  A_DBGR_VariableRead( "Task_Core1_2pt5ms_Count", taskvalue);
  E_DBGR_VariableCheck("Task_Core1_2pt5ms_Count", taskvalue, Greater);
  
  snprintf( chActionText, elCount(chActionText), "Check 5ms Task Counter from Core1 "); 
  snprintf( chExpectedText, elCount(chExpectedText), "5ms Counter from Core1 is  incrementing"); 
  TestStepAddActionExpected( chActionText, chExpectedText );
  A_DBGR_VariableRead( "Task_Core1_5ms_Count", taskvalue);
  E_DBGR_VariableCheck("Task_Core1_5ms_Count", taskvalue, Greater);
  
  snprintf( chActionText, elCount(chActionText), "Check 10ms Task Counter from Core1 "); 
  snprintf( chExpectedText, elCount(chExpectedText), "10ms Counter from Core1 is  incrementing"); 
  TestStepAddActionExpected( chActionText, chExpectedText );
  A_DBGR_VariableRead( "Task_Core1_10ms_Count", taskvalue);
  E_DBGR_VariableCheck("Task_Core1_10ms_Count", taskvalue, Greater);  
  
  snprintf( chActionText, elCount(chActionText), "Check 25ms Task Counter from Core1 "); 
  snprintf( chExpectedText, elCount(chExpectedText), "25ms Counter from Core1 is  incrementing"); 
  TestStepAddActionExpected( chActionText, chExpectedText );
  A_DBGR_VariableRead( "Task_Core1_25ms_Count", taskvalue);
  E_DBGR_VariableCheck("Task_Core1_25ms_Count", taskvalue, Greater); 
  
  snprintf( chActionText, elCount(chActionText), "Check 50ms Task Counter from Core1 "); 
  snprintf( chExpectedText, elCount(chExpectedText), "50ms Counter from Core1 is  incrementing"); 
  TestStepAddActionExpected( chActionText, chExpectedText );
  A_DBGR_VariableRead( "Task_Core1_50ms_Count", taskvalue);
  E_DBGR_VariableCheck("Task_Core1_50ms_Count", taskvalue, Greater);
    
  snprintf( chActionText, elCount(chActionText), "Check 100ms Task Counter from Core1 "); 
  snprintf( chExpectedText, elCount(chExpectedText), "100ms Counter from Core1 is  incrementing"); 
  TestStepAddActionExpected( chActionText, chExpectedText );
  A_DBGR_VariableRead( "Task_Core1_100ms_Count", taskvalue);
  E_DBGR_VariableCheck("Task_Core1_100ms_Count", taskvalue, Greater);

  snprintf( chActionText, elCount(chActionText), "Check 250ms Task Counter from Core1 "); 
  snprintf( chExpectedText, elCount(chExpectedText), "250ms Counter from Core1 is  incrementing"); 
  TestStepAddActionExpected( chActionText, chExpectedText );
  A_DBGR_VariableRead( "Task_Core1_250ms_Count", taskvalue);
  E_DBGR_VariableCheck("Task_Core1_250ms_Count", taskvalue, Greater);
  
  snprintf( chActionText, elCount(chActionText), "Check 500ms Task Counter from Core1 "); 
  snprintf( chExpectedText, elCount(chExpectedText), "500ms Counter from Core1 is  incrementing"); 
  TestStepAddActionExpected( chActionText, chExpectedText );
  A_DBGR_VariableRead( "Task_Core1_500ms_Count", taskvalue);
  E_DBGR_VariableCheck("Task_Core1_500ms_Count", taskvalue, Greater);

  snprintf( chActionText, elCount(chActionText), "Check 1000ms Task Counter from Core1 "); 
  snprintf( chExpectedText, elCount(chExpectedText), "1000ms Counter from Core1 is incrementing"); 
  TestStepAddActionExpected( chActionText, chExpectedText );
  A_DBGR_VariableRead( "Task_Core1_1000ms_Count", taskvalue);
  E_DBGR_VariableCheck("Task_Core1_1000ms_Count", taskvalue, Greater);
  
  
  
}



/***************************************************************************************************
----------------------------------------------------------------------------------------------------
Test case name:  TC_L30SW_Q-36684463: Testcase_to_verify_interface_EnblHWIO_GM_TaskInits_to_Allow_application_RTOS_tasks_and_ISRs_to_receive_event_triggers_on_CPU2.
----------------------------------------------------------------------------------------------------
Description:   Test case to verify the functionality of interface EnblHWIO_GM_TaskInits to Allows application defined RTOS tasks and ISRs to receive their event triggers on the CPU2.

***************************************************************************************************/

testcase Testcase_to_verify_interface_EnblHWIO_GM_TaskInits_to_Allow_application_RTOS_tasks_and_ISRs_to_receive_event_triggers_on_CPU2()
{
  /***************************************************************************************************************/    
                                                // Variable Definition
  /***************************************************************************************************************/ 
  
  long taskvalue;
  
  /***************************************************************************************************************/    
                                               // Local Values
  /***************************************************************************************************************/ 
  

  
  /***************************************************************************************************************/    
                                              // Test Case Info
  /***************************************************************************************************************/
  setWriteDbgLevel(DebugOff);
  snprintf( chTestTitle, elCount(chTestTitle), "Testcase_to_verify_interface_EnblHWIO_GM_TaskInits_to_Allow_application_RTOS_tasks_and_ISRs_to_receive_event_triggers_on_CPU2" );
  snprintf( chTestDescription, elCount(chTestDescription), "Purpose: Test case to verify the functionality of interface EnblHWIO_GM_TaskInits to Allows application defined RTOS tasks and ISRs to receive their event triggers on the CPU2.");
  TestCaseAddInfo( chTestTitle, "TC_L30SW_Q-36684463", chTestDescription );

  /***************************************************************************************************************/    
                                              // Start of Test Case
  /***************************************************************************************************************/
  
  /***************************************************************************************************************/    
                                              // Test Step 1 PRECONDITIONS
  /***************************************************************************************************************/
  
  snprintf( chActionText, elCount(chActionText), "Flash the Software and ECU is running"); 
  snprintf( chExpectedText, elCount(chExpectedText), "ECU should be in running state"); 
  TestStepAddActionExpected( chActionText, chExpectedText );

  A_DBGR_BreakpointDeleteAll();
  A_DBGR_RnGo();
  E_DBGR_CheckState(T32_State_Running);
  

   /***************************************************************************************************************/    
            // Test Step 2: Check all cores are in running state                                   
  /***************************************************************************************************************/
  
  //Check Core0 is running
  snprintf( chActionText, elCount(chActionText), "Check 1000ms Task Counter from Core0 "); 
  snprintf( chExpectedText, elCount(chExpectedText), "1000ms Counter from Core0 is incrementing"); 
  TestStepAddActionExpected( chActionText, chExpectedText );
  A_DBGR_VariableRead( "Task_Core0_1000ms_Count", taskvalue);
  E_DBGR_VariableCheck("Task_Core0_1000ms_Count", taskvalue, Greater);
  
  //Check Core1 is running
  snprintf( chActionText, elCount(chActionText), "Check 1000ms Task Counter from Core1 "); 
  snprintf( chExpectedText, elCount(chExpectedText), "1000ms Counter from Core1 is incrementing"); 
  TestStepAddActionExpected( chActionText, chExpectedText );
  A_DBGR_VariableRead( "Task_Core1_1000ms_Count", taskvalue);
  E_DBGR_VariableCheck("Task_Core1_1000ms_Count", taskvalue, Greater);
  
  //Check Core2 is running
  snprintf( chActionText, elCount(chActionText), "Check 1000ms Task Counter from Core2 "); 
  snprintf( chExpectedText, elCount(chExpectedText), "1000ms Counter from Core2 is incrementing"); 
  TestStepAddActionExpected( chActionText, chExpectedText );
  A_DBGR_VariableRead( "Task_Core2_1000ms_Count", taskvalue);
  E_DBGR_VariableCheck("Task_Core2_1000ms_Count", taskvalue, Greater);
    
  //Check Core3 is running
  snprintf( chActionText, elCount(chActionText), "Check 1000ms Task Counter from Core3 "); 
  snprintf( chExpectedText, elCount(chExpectedText), "1000ms Counter from Core3 is incrementing"); 
  TestStepAddActionExpected( chActionText, chExpectedText );
  A_DBGR_VariableRead( "Task_Core3_1000ms_Count", taskvalue);
  E_DBGR_VariableCheck("Task_Core3_1000ms_Count", taskvalue, Greater);
    
  //Check Core4 is running
  snprintf( chActionText, elCount(chActionText), "Check 1000ms Task Counter from Core4 "); 
  snprintf( chExpectedText, elCount(chExpectedText), "1000ms Counter from Core4 is incrementing"); 
  TestStepAddActionExpected( chActionText, chExpectedText );
  A_DBGR_VariableRead( "Task_Core4_1000ms_Count", taskvalue);
  E_DBGR_VariableCheck("Task_Core4_1000ms_Count", taskvalue, Greater);
    
  //Check Core5 is running
  snprintf( chActionText, elCount(chActionText), "Check 1000ms Task Counter from Core5 "); 
  snprintf( chExpectedText, elCount(chExpectedText), "1000ms Counter from Core5 is incrementing"); 
  TestStepAddActionExpected( chActionText, chExpectedText );
  A_DBGR_VariableRead( "Task_Core5_1000ms_Count", taskvalue);
  E_DBGR_VariableCheck("Task_Core5_1000ms_Count", taskvalue, Greater);
   


  /***************************************************************************************************************/    
    // Test Step 3: Disable Interface DsblHWIO_GM_TaskInits for Core2
  /***************************************************************************************************************/

  snprintf( chActionText, elCount(chActionText), "Disable Interface DsblHWIO_GM_TaskInits for 1000ms Task for core2 "); 
  snprintf( chExpectedText, elCount(chExpectedText), "Check Interface DsblHWIO_GM_TaskInits 1000ms Task for core2 shall set to 1 "); 
  TestStepAddActionExpected( chActionText, chExpectedText );
  A_DBGR_VariableSet("test_disable_task_initiator_core2", "1");
  E_DBGR_VariableCheck("test_disable_task_initiator_core2", 1, Equal);    


  /***************************************************************************************************************/    
    // Test Step 4: Check all Cores are running except core 2, shall be disabled
  /***************************************************************************************************************/
 
   
  //Check All tasks of Core0 are Running
  snprintf( chActionText, elCount(chActionText), "Check 2pt5ms Task Counter from Core0 "); 
  snprintf( chExpectedText, elCount(chExpectedText), "2pt5ms Counter from Core0 is  incrementing"); 
  TestStepAddActionExpected( chActionText, chExpectedText );
  A_DBGR_VariableRead( "Task_Core0_2pt5ms_Count", taskvalue);
  E_DBGR_VariableCheck("Task_Core0_2pt5ms_Count", taskvalue, Greater);
  
  snprintf( chActionText, elCount(chActionText), "Check 5ms Task Counter from Core0 "); 
  snprintf( chExpectedText, elCount(chExpectedText), "5ms Counter from Core0 is  incrementing"); 
  TestStepAddActionExpected( chActionText, chExpectedText );
  A_DBGR_VariableRead( "Task_Core0_5ms_Count", taskvalue);
  E_DBGR_VariableCheck("Task_Core0_5ms_Count", taskvalue, Greater);
  
  snprintf( chActionText, elCount(chActionText), "Check 10ms Task Counter from Core0 "); 
  snprintf( chExpectedText, elCount(chExpectedText), "10ms Counter from Core0 is  incrementing"); 
  TestStepAddActionExpected( chActionText, chExpectedText );
  A_DBGR_VariableRead( "Task_Core0_10ms_Count", taskvalue);
  E_DBGR_VariableCheck("Task_Core0_10ms_Count", taskvalue, Greater);  
  
  snprintf( chActionText, elCount(chActionText), "Check 25ms Task Counter from Core0 "); 
  snprintf( chExpectedText, elCount(chExpectedText), "25ms Counter from Core0 is  incrementing"); 
  TestStepAddActionExpected( chActionText, chExpectedText );
  A_DBGR_VariableRead( "Task_Core0_25ms_Count", taskvalue);
  E_DBGR_VariableCheck("Task_Core0_25ms_Count", taskvalue, Greater);  

  snprintf( chActionText, elCount(chActionText), "Check 50ms Task Counter from Core0 "); 
  snprintf( chExpectedText, elCount(chExpectedText), "50ms Counter from Core0 is  incrementing"); 
  TestStepAddActionExpected( chActionText, chExpectedText );
  A_DBGR_VariableRead( "Task_Core0_50ms_Count", taskvalue);
  E_DBGR_VariableCheck("Task_Core0_50ms_Count", taskvalue, Greater);
  
  snprintf( chActionText, elCount(chActionText), "Check 250ms Task Counter from Core0 "); 
  snprintf( chExpectedText, elCount(chExpectedText), "250ms Counter from Core0 is  incrementing"); 
  TestStepAddActionExpected( chActionText, chExpectedText );
  A_DBGR_VariableRead( "Task_Core0_250ms_Count", taskvalue);
  E_DBGR_VariableCheck("Task_Core0_250ms_Count", taskvalue, Greater);
  
  snprintf( chActionText, elCount(chActionText), "Check 100ms Task Counter from Core0 "); 
  snprintf( chExpectedText, elCount(chExpectedText), "100ms Counter from Core0 is  incrementing"); 
  TestStepAddActionExpected( chActionText, chExpectedText );
  A_DBGR_VariableRead( "Task_Core0_100ms_Count", taskvalue);
  E_DBGR_VariableCheck("Task_Core0_100ms_Count", taskvalue, Greater); 

  snprintf( chActionText, elCount(chActionText), "Check 500ms Task Counter from Core0 "); 
  snprintf( chExpectedText, elCount(chExpectedText), "500ms Counter from Core0 is  incrementing"); 
  TestStepAddActionExpected( chActionText, chExpectedText );
  A_DBGR_VariableRead( "Task_Core0_500ms_Count", taskvalue);
  E_DBGR_VariableCheck("Task_Core0_500ms_Count", taskvalue, Greater);
  
  snprintf( chActionText, elCount(chActionText), "Check 1000ms Task Counter from Core0 "); 
  snprintf( chExpectedText, elCount(chExpectedText), "1000ms Counter from Core0 is  incrementing"); 
  TestStepAddActionExpected( chActionText, chExpectedText );
  A_DBGR_VariableRead( "Task_Core0_1000ms_Count", taskvalue);
  E_DBGR_VariableCheck("Task_Core0_1000ms_Count", taskvalue, Greater);
  
  
  //Check All tasks of Core1 are Running
  snprintf( chActionText, elCount(chActionText), "Check 2pt5ms Task Counter from Core1 "); 
  snprintf( chExpectedText, elCount(chExpectedText), "2pt5ms Counter from Core1 is  incrementing"); 
  TestStepAddActionExpected( chActionText, chExpectedText );
  A_DBGR_VariableRead( "Task_Core1_2pt5ms_Count", taskvalue);
  E_DBGR_VariableCheck("Task_Core1_2pt5ms_Count", taskvalue, Greater);
  
  snprintf( chActionText, elCount(chActionText), "Check 5ms Task Counter from Core1 "); 
  snprintf( chExpectedText, elCount(chExpectedText), "5ms Counter from Core1 is  incrementing"); 
  TestStepAddActionExpected( chActionText, chExpectedText );
  A_DBGR_VariableRead( "Task_Core1_5ms_Count", taskvalue);
  E_DBGR_VariableCheck("Task_Core1_5ms_Count", taskvalue, Greater);
  
  snprintf( chActionText, elCount(chActionText), "Check 10ms Task Counter from Core1 "); 
  snprintf( chExpectedText, elCount(chExpectedText), "10ms Counter from Core1 is  incrementing"); 
  TestStepAddActionExpected( chActionText, chExpectedText );
  A_DBGR_VariableRead( "Task_Core1_10ms_Count", taskvalue);
  E_DBGR_VariableCheck("Task_Core1_10ms_Count", taskvalue, Greater);  
  
  snprintf( chActionText, elCount(chActionText), "Check 25ms Task Counter from Core1 "); 
  snprintf( chExpectedText, elCount(chExpectedText), "25ms Counter from Core1 is  incrementing"); 
  TestStepAddActionExpected( chActionText, chExpectedText );
  A_DBGR_VariableRead( "Task_Core1_25ms_Count", taskvalue);
  E_DBGR_VariableCheck("Task_Core1_25ms_Count", taskvalue, Greater); 
  
  snprintf( chActionText, elCount(chActionText), "Check 50ms Task Counter from Core1 "); 
  snprintf( chExpectedText, elCount(chExpectedText), "50ms Counter from Core1 is  incrementing"); 
  TestStepAddActionExpected( chActionText, chExpectedText );
  A_DBGR_VariableRead( "Task_Core1_50ms_Count", taskvalue);
  E_DBGR_VariableCheck("Task_Core1_50ms_Count", taskvalue, Greater);
    
  snprintf( chActionText, elCount(chActionText), "Check 100ms Task Counter from Core1 "); 
  snprintf( chExpectedText, elCount(chExpectedText), "100ms Counter from Core1 is  incrementing"); 
  TestStepAddActionExpected( chActionText, chExpectedText );
  A_DBGR_VariableRead( "Task_Core1_100ms_Count", taskvalue);
  E_DBGR_VariableCheck("Task_Core1_100ms_Count", taskvalue, Greater);

  snprintf( chActionText, elCount(chActionText), "Check 250ms Task Counter from Core1 "); 
  snprintf( chExpectedText, elCount(chExpectedText), "250ms Counter from Core1 is  incrementing"); 
  TestStepAddActionExpected( chActionText, chExpectedText );
  A_DBGR_VariableRead( "Task_Core1_250ms_Count", taskvalue);
  E_DBGR_VariableCheck("Task_Core1_250ms_Count", taskvalue, Greater);
  
  snprintf( chActionText, elCount(chActionText), "Check 500ms Task Counter from Core1 "); 
  snprintf( chExpectedText, elCount(chExpectedText), "500ms Counter from Core1 is  incrementing"); 
  TestStepAddActionExpected( chActionText, chExpectedText );
  A_DBGR_VariableRead( "Task_Core1_500ms_Count", taskvalue);
  E_DBGR_VariableCheck("Task_Core1_500ms_Count", taskvalue, Greater);

  snprintf( chActionText, elCount(chActionText), "Check 1000ms Task Counter from Core1 "); 
  snprintf( chExpectedText, elCount(chExpectedText), "1000ms Counter from Core1 is stop incrementing"); 
  TestStepAddActionExpected( chActionText, chExpectedText );
  A_DBGR_VariableRead( "Task_Core1_1000ms_Count", taskvalue);
  E_DBGR_VariableCheck("Task_Core1_1000ms_Count", taskvalue, Greater);
  
  
  //Check All tasks of Core2 are Stopped
  snprintf( chActionText, elCount(chActionText), "Check 2pt5ms Task Counter from Core2 "); 
  snprintf( chExpectedText, elCount(chExpectedText), "2pt5ms Counter from Core2 is  stop  incrementing"); 
  TestStepAddActionExpected( chActionText, chExpectedText );
  A_DBGR_VariableRead( "Task_Core2_2pt5ms_Count", taskvalue);
  E_DBGR_VariableCheck("Task_Core2_2pt5ms_Count", taskvalue, Equal);
  
  snprintf( chActionText, elCount(chActionText), "Check 5ms Task Counter from Core2 "); 
  snprintf( chExpectedText, elCount(chExpectedText), "5ms Counter from Core2 is  stop  incrementing"); 
  TestStepAddActionExpected( chActionText, chExpectedText );
  A_DBGR_VariableRead( "Task_Core2_5ms_Count", taskvalue);
  E_DBGR_VariableCheck("Task_Core2_5ms_Count", taskvalue, Equal);
  
  snprintf( chActionText, elCount(chActionText), "Check 10ms Task Counter from Core2 "); 
  snprintf( chExpectedText, elCount(chExpectedText), "10ms Counter from Core2 is  stop  incrementing"); 
  TestStepAddActionExpected( chActionText, chExpectedText );
  A_DBGR_VariableRead( "Task_Core2_10ms_Count", taskvalue);
  E_DBGR_VariableCheck("Task_Core2_10ms_Count", taskvalue, Equal);  
  
  snprintf( chActionText, elCount(chActionText), "Check 25ms Task Counter from Core2 "); 
  snprintf( chExpectedText, elCount(chExpectedText), "25ms Counter from Core2 is  stop  incrementing"); 
  TestStepAddActionExpected( chActionText, chExpectedText );
  A_DBGR_VariableRead( "Task_Core2_25ms_Count", taskvalue);
  E_DBGR_VariableCheck("Task_Core2_25ms_Count", taskvalue, Equal); 

  snprintf( chActionText, elCount(chActionText), "Check 50ms Task Counter from Core2 "); 
  snprintf( chExpectedText, elCount(chExpectedText), "50ms Counter from Core2 is  stop  incrementing"); 
  TestStepAddActionExpected( chActionText, chExpectedText );
  A_DBGR_VariableRead( "Task_Core2_50ms_Count", taskvalue);
  E_DBGR_VariableCheck("Task_Core2_50ms_Count", taskvalue, Equal);
  
  snprintf( chActionText, elCount(chActionText), "Check 100ms Task Counter from Core2 "); 
  snprintf( chExpectedText, elCount(chExpectedText), "100ms Counter from Core2 is  stop  incrementing"); 
  TestStepAddActionExpected( chActionText, chExpectedText );
  A_DBGR_VariableRead( "Task_Core2_100ms_Count", taskvalue);
  E_DBGR_VariableCheck("Task_Core2_100ms_Count", taskvalue, Equal); 
  
  snprintf( chActionText, elCount(chActionText), "Check 250ms Task Counter from Core2 "); 
  snprintf( chExpectedText, elCount(chExpectedText), "250ms Counter from Core2 is  stop  incrementing"); 
  TestStepAddActionExpected( chActionText, chExpectedText );
  A_DBGR_VariableRead( "Task_Core2_250ms_Count", taskvalue);
  E_DBGR_VariableCheck("Task_Core2_250ms_Count", taskvalue, Equal);

  snprintf( chActionText, elCount(chActionText), "Check 500ms Task Counter from Core2 "); 
  snprintf( chExpectedText, elCount(chExpectedText), "500ms Counter from Core2 is  stop  incrementing"); 
  TestStepAddActionExpected( chActionText, chExpectedText );
  A_DBGR_VariableRead( "Task_Core2_500ms_Count", taskvalue);
  E_DBGR_VariableCheck("Task_Core2_500ms_Count", taskvalue, Equal);

  snprintf( chActionText, elCount(chActionText), "Check 1000ms Task Counter from Core2 "); 
  snprintf( chExpectedText, elCount(chExpectedText), "1000ms Counter from Core2 is  stop  incrementing"); 
  TestStepAddActionExpected( chActionText, chExpectedText );
  A_DBGR_VariableRead( "Task_Core2_1000ms_Count", taskvalue);
  E_DBGR_VariableCheck("Task_Core2_1000ms_Count", taskvalue, Equal);
  
  
    //Check All tasks of Core3 are running
  snprintf( chActionText, elCount(chActionText), "Check 2pt5ms Task Counter from Core3 "); 
  snprintf( chExpectedText, elCount(chExpectedText), "2pt5ms Counter from Core3 is  incrementing"); 
  TestStepAddActionExpected( chActionText, chExpectedText );
  A_DBGR_VariableRead( "Task_Core3_2pt5ms_Count", taskvalue);
  E_DBGR_VariableCheck("Task_Core3_2pt5ms_Count", taskvalue, Greater);
  
   snprintf( chActionText, elCount(chActionText), "Check 5ms Task Counter from Core3 "); 
  snprintf( chExpectedText, elCount(chExpectedText), "5ms Counter from Core3 is  incrementing"); 
  TestStepAddActionExpected( chActionText, chExpectedText );
  A_DBGR_VariableRead( "Task_Core3_5ms_Count", taskvalue);
  E_DBGR_VariableCheck("Task_Core3_5ms_Count", taskvalue, Greater);
  
  snprintf( chActionText, elCount(chActionText), "Check 10ms Task Counter from Core3 "); 
  snprintf( chExpectedText, elCount(chExpectedText), "10ms Counter from Core3 is  incrementing"); 
  TestStepAddActionExpected( chActionText, chExpectedText );
  A_DBGR_VariableRead( "Task_Core3_10ms_Count", taskvalue);
  E_DBGR_VariableCheck("Task_Core3_10ms_Count", taskvalue, Greater);  
  
  snprintf( chActionText, elCount(chActionText), "Check 25ms Task Counter from Core3 "); 
  snprintf( chExpectedText, elCount(chExpectedText), "25ms Counter from Core3 is  incrementing"); 
  TestStepAddActionExpected( chActionText, chExpectedText );
  A_DBGR_VariableRead( "Task_Core3_25ms_Count", taskvalue);
  E_DBGR_VariableCheck("Task_Core3_25ms_Count", taskvalue, Greater);  
  
  snprintf( chActionText, elCount(chActionText), "Check 50ms Task Counter from Core3 "); 
  snprintf( chExpectedText, elCount(chExpectedText), "50ms Counter from Core3 is  incrementing"); 
  TestStepAddActionExpected( chActionText, chExpectedText );
  A_DBGR_VariableRead( "Task_Core3_50ms_Count", taskvalue);
  E_DBGR_VariableCheck("Task_Core3_50ms_Count", taskvalue, Greater);

  snprintf( chActionText, elCount(chActionText), "Check 100ms Task Counter from Core3 "); 
  snprintf( chExpectedText, elCount(chExpectedText), "100ms Counter from Core3 is  incrementing"); 
  TestStepAddActionExpected( chActionText, chExpectedText );
  A_DBGR_VariableRead( "Task_Core3_100ms_Count", taskvalue);
  E_DBGR_VariableCheck("Task_Core3_100ms_Count", taskvalue, Greater); 
  
  snprintf( chActionText, elCount(chActionText), "Check 250ms Task Counter from Core3 "); 
  snprintf( chExpectedText, elCount(chExpectedText), "250ms Counter from Core3 is  incrementing"); 
  TestStepAddActionExpected( chActionText, chExpectedText );
  A_DBGR_VariableRead( "Task_Core3_250ms_Count", taskvalue);
  E_DBGR_VariableCheck("Task_Core3_250ms_Count", taskvalue, Greater);
  
  snprintf( chActionText, elCount(chActionText), "Check 1000ms Task Counter from Core3 "); 
  snprintf( chExpectedText, elCount(chExpectedText), "1000ms Counter from Core3 is  incrementing"); 
  TestStepAddActionExpected( chActionText, chExpectedText );
  A_DBGR_VariableRead( "Task_Core3_1000ms_Count", taskvalue);
  E_DBGR_VariableCheck("Task_Core3_1000ms_Count", taskvalue, Greater);
  
    //Check task from Core4 is running
  snprintf( chActionText, elCount(chActionText), "Check 1000ms Task Counter from Core4 "); 
  snprintf( chExpectedText, elCount(chExpectedText), "1000ms Counter from Core4 is  incrementing"); 
  TestStepAddActionExpected( chActionText, chExpectedText );
  A_DBGR_VariableRead( "Task_Core4_1000ms_Count", taskvalue);
  E_DBGR_VariableCheck("Task_Core4_1000ms_Count", taskvalue, Greater);
    
  //Check task from Core5 is running
  snprintf( chActionText, elCount(chActionText), "Check 1000ms Task Counter from Core5 "); 
  snprintf( chExpectedText, elCount(chExpectedText), "1000ms Counter from Core5 is  incrementing"); 
  TestStepAddActionExpected( chActionText, chExpectedText );
  A_DBGR_VariableRead( "Task_Core5_1000ms_Count", taskvalue);
  E_DBGR_VariableCheck("Task_Core5_1000ms_Count", taskvalue, Greater);
  
  
 /***************************************************************************************************************/    
    // Test Step 5: Enable Task Initiators
  /***************************************************************************************************************/
  
  // Enable Task Initiator by enabling GMTaskinterruptWait = TRUE
  snprintf( chActionText, elCount(chActionText), "Enable interrupt GMTaskinterruptWait to enable Interface EnblHWIO_GM_TaskInits for core2 "); 
  snprintf( chExpectedText, elCount(chExpectedText), "Check interrut GMTaskinterruptWait shall set to 1 "); 
  TestStepAddActionExpected( chActionText, chExpectedText );
  A_DBGR_VariableSet("GMTaskinterruptWait", "1");
  E_DBGR_VariableCheck("GMTaskinterruptWait", 1, Equal);   
  
  /***************************************************************************************************************/    
    // Test Step 6: Check all Task counters of core 2 are running
  /***************************************************************************************************************/
 
  
  //Check All tasks of Core2 are Running
  snprintf( chActionText, elCount(chActionText), "Check 2pt5ms Task Counter from Core2 "); 
  snprintf( chExpectedText, elCount(chExpectedText), "2pt5ms Counter from Core2 is   incrementing"); 
  TestStepAddActionExpected( chActionText, chExpectedText );
  A_DBGR_VariableRead( "Task_Core2_2pt5ms_Count", taskvalue);
  E_DBGR_VariableCheck("Task_Core2_2pt5ms_Count", taskvalue, Greater);
  
  snprintf( chActionText, elCount(chActionText), "Check 5ms Task Counter from Core2 "); 
  snprintf( chExpectedText, elCount(chExpectedText), "5ms Counter from Core2 is   incrementing"); 
  TestStepAddActionExpected( chActionText, chExpectedText );
  A_DBGR_VariableRead( "Task_Core2_5ms_Count", taskvalue);
  E_DBGR_VariableCheck("Task_Core2_5ms_Count", taskvalue, Greater);
  
  snprintf( chActionText, elCount(chActionText), "Check 10ms Task Counter from Core2 "); 
  snprintf( chExpectedText, elCount(chExpectedText), "10ms Counter from Core2 is   incrementing"); 
  TestStepAddActionExpected( chActionText, chExpectedText );
  A_DBGR_VariableRead( "Task_Core2_10ms_Count", taskvalue);
  E_DBGR_VariableCheck("Task_Core2_10ms_Count", taskvalue, Greater);  
  
  snprintf( chActionText, elCount(chActionText), "Check 25ms Task Counter from Core2 "); 
  snprintf( chExpectedText, elCount(chExpectedText), "25ms Counter from Core2 is   incrementing"); 
  TestStepAddActionExpected( chActionText, chExpectedText );
  A_DBGR_VariableRead( "Task_Core2_25ms_Count", taskvalue);
  E_DBGR_VariableCheck("Task_Core2_25ms_Count", taskvalue, Greater); 

  snprintf( chActionText, elCount(chActionText), "Check 50ms Task Counter from Core2 "); 
  snprintf( chExpectedText, elCount(chExpectedText), "50ms Counter from Core2 is   incrementing"); 
  TestStepAddActionExpected( chActionText, chExpectedText );
  A_DBGR_VariableRead( "Task_Core2_50ms_Count", taskvalue);
  E_DBGR_VariableCheck("Task_Core2_50ms_Count", taskvalue, Greater);
  
  snprintf( chActionText, elCount(chActionText), "Check 100ms Task Counter from Core2 "); 
  snprintf( chExpectedText, elCount(chExpectedText), "100ms Counter from Core2 is   incrementing"); 
  TestStepAddActionExpected( chActionText, chExpectedText );
  A_DBGR_VariableRead( "Task_Core2_100ms_Count", taskvalue);
  E_DBGR_VariableCheck("Task_Core2_100ms_Count", taskvalue, Greater); 
  
  snprintf( chActionText, elCount(chActionText), "Check 250ms Task Counter from Core2 "); 
  snprintf( chExpectedText, elCount(chExpectedText), "250ms Counter from Core2 is   incrementing"); 
  TestStepAddActionExpected( chActionText, chExpectedText );
  A_DBGR_VariableRead( "Task_Core2_250ms_Count", taskvalue);
  E_DBGR_VariableCheck("Task_Core2_250ms_Count", taskvalue, Greater);

  snprintf( chActionText, elCount(chActionText), "Check 500ms Task Counter from Core2 "); 
  snprintf( chExpectedText, elCount(chExpectedText), "500ms Counter from Core2 is   incrementing"); 
  TestStepAddActionExpected( chActionText, chExpectedText );
  A_DBGR_VariableRead( "Task_Core2_500ms_Count", taskvalue);
  E_DBGR_VariableCheck("Task_Core2_500ms_Count", taskvalue, Greater);

  snprintf( chActionText, elCount(chActionText), "Check 1000ms Task Counter from Core2 "); 
  snprintf( chExpectedText, elCount(chExpectedText), "1000ms Counter from Core2 is   incrementing"); 
  TestStepAddActionExpected( chActionText, chExpectedText );
  A_DBGR_VariableRead( "Task_Core2_1000ms_Count", taskvalue);
  E_DBGR_VariableCheck("Task_Core2_1000ms_Count", taskvalue, Greater);
  
  
  
}



/***************************************************************************************************
----------------------------------------------------------------------------------------------------
Test case name:  TC_L30SW_Q-36684462: Testcase_to_verify_interface_EnblHWIO_GM_TaskInits_to_Allow_application_RTOS_tasks_and_ISRs_to_receive_event_triggers_on_CPU3.
----------------------------------------------------------------------------------------------------
Description:   Test case to verify the functionality of interface EnblHWIO_GM_TaskInits to Allows application defined RTOS tasks and ISRs to receive their event triggers on the CPU3.

***************************************************************************************************/
testcase Testcase_to_verify_interface_EnblHWIO_GM_TaskInits_to_Allow_application_RTOS_tasks_and_ISRs_to_receive_event_triggers_on_CPU3()
{
  /***************************************************************************************************************/    
                                                // Variable Definition
  /***************************************************************************************************************/ 
  
  long taskvalue;
  
  /***************************************************************************************************************/    
                                               // Local Values
  /***************************************************************************************************************/ 
  

  
  /***************************************************************************************************************/    
                                              // Test Case Info
  /***************************************************************************************************************/
  setWriteDbgLevel(DebugOff);
  snprintf( chTestTitle, elCount(chTestTitle), "Testcase_to_verify_interface_EnblHWIO_GM_TaskInits_to_Allow_application_RTOS_tasks_and_ISRs_to_receive_event_triggers_on_CPU3" );
  snprintf( chTestDescription, elCount(chTestDescription), "Purpose: Test case to verify the functionality of interface EnblHWIO_GM_TaskInits to Allows application defined RTOS tasks and ISRs to receive their event triggers on the CPU3.");
  TestCaseAddInfo( chTestTitle, "TC_L30SW_Q-36684462", chTestDescription );

  /***************************************************************************************************************/    
                                              // Start of Test Case
  /***************************************************************************************************************/
  
  /***************************************************************************************************************/    
                                              // Test Step 1 PRECONDITIONS
  /***************************************************************************************************************/
  
  snprintf( chActionText, elCount(chActionText), "Flash the Software and ECU is running"); 
  snprintf( chExpectedText, elCount(chExpectedText), "ECU should be in running state"); 
  TestStepAddActionExpected( chActionText, chExpectedText );

  A_DBGR_BreakpointDeleteAll();
  A_DBGR_RnGo();
  E_DBGR_CheckState(T32_State_Running);
  

   /***************************************************************************************************************/    
            // Test Step 2: Check all cores are in running state                                   
  /***************************************************************************************************************/
  
  //Check Core0 is running
  snprintf( chActionText, elCount(chActionText), "Check 1000ms Task Counter from Core0 "); 
  snprintf( chExpectedText, elCount(chExpectedText), "1000ms Counter from Core0 is incrementing"); 
  TestStepAddActionExpected( chActionText, chExpectedText );
  A_DBGR_VariableRead( "Task_Core0_1000ms_Count", taskvalue);
  E_DBGR_VariableCheck("Task_Core0_1000ms_Count", taskvalue, Greater);
  
  //Check Core1 is running
  snprintf( chActionText, elCount(chActionText), "Check 1000ms Task Counter from Core1 "); 
  snprintf( chExpectedText, elCount(chExpectedText), "1000ms Counter from Core1 is incrementing"); 
  TestStepAddActionExpected( chActionText, chExpectedText );
  A_DBGR_VariableRead( "Task_Core1_1000ms_Count", taskvalue);
  E_DBGR_VariableCheck("Task_Core1_1000ms_Count", taskvalue, Greater);
  
  //Check Core2 is running
  snprintf( chActionText, elCount(chActionText), "Check 1000ms Task Counter from Core2 "); 
  snprintf( chExpectedText, elCount(chExpectedText), "1000ms Counter from Core2 is incrementing"); 
  TestStepAddActionExpected( chActionText, chExpectedText );
  A_DBGR_VariableRead( "Task_Core2_1000ms_Count", taskvalue);
  E_DBGR_VariableCheck("Task_Core2_1000ms_Count", taskvalue, Greater);
    
  //Check Core3 is running
  snprintf( chActionText, elCount(chActionText), "Check 1000ms Task Counter from Core3 "); 
  snprintf( chExpectedText, elCount(chExpectedText), "1000ms Counter from Core3 is incrementing"); 
  TestStepAddActionExpected( chActionText, chExpectedText );
  A_DBGR_VariableRead( "Task_Core3_1000ms_Count", taskvalue);
  E_DBGR_VariableCheck("Task_Core3_1000ms_Count", taskvalue, Greater);
    
  //Check Core4 is running
  snprintf( chActionText, elCount(chActionText), "Check 1000ms Task Counter from Core4 "); 
  snprintf( chExpectedText, elCount(chExpectedText), "1000ms Counter from Core4 is incrementing"); 
  TestStepAddActionExpected( chActionText, chExpectedText );
  A_DBGR_VariableRead( "Task_Core4_1000ms_Count", taskvalue);
  E_DBGR_VariableCheck("Task_Core4_1000ms_Count", taskvalue, Greater);
    
  //Check Core5 is running
  snprintf( chActionText, elCount(chActionText), "Check 1000ms Task Counter from Core5 "); 
  snprintf( chExpectedText, elCount(chExpectedText), "1000ms Counter from Core5 is incrementing"); 
  TestStepAddActionExpected( chActionText, chExpectedText );
  A_DBGR_VariableRead( "Task_Core5_1000ms_Count", taskvalue);
  E_DBGR_VariableCheck("Task_Core5_1000ms_Count", taskvalue, Greater);
  

  /***************************************************************************************************************/    
    // Test Step 3: Disable Interface DsblHWIO_GM_TaskInits for Core3
  /***************************************************************************************************************/

  snprintf( chActionText, elCount(chActionText), "Disable Interface DsblHWIO_GM_TaskInits for 1000ms Task for core3 "); 
  snprintf( chExpectedText, elCount(chExpectedText), "Check Interface DsblHWIO_GM_TaskInits 1000ms Task for core3 shall set to 1 "); 
  TestStepAddActionExpected( chActionText, chExpectedText );
  A_DBGR_VariableSet("test_disable_task_initiator_core3", "1");
  E_DBGR_VariableCheck("test_disable_task_initiator_core3", 1, Equal);    


  /***************************************************************************************************************/    
    // Test Step 4: Check all Cores are running except core 3, shall be disabled
  /***************************************************************************************************************/
 
  //Check All tasks of Core0 are running
  snprintf( chActionText, elCount(chActionText), "Check 2pt5ms Task Counter from Core0 "); 
  snprintf( chExpectedText, elCount(chExpectedText), "2pt5ms Counter from Core0 is incrementing"); 
  TestStepAddActionExpected( chActionText, chExpectedText );
  A_DBGR_VariableRead( "Task_Core0_2pt5ms_Count", taskvalue);
  E_DBGR_VariableCheck("Task_Core0_2pt5ms_Count", taskvalue, Greater);
  
  snprintf( chActionText, elCount(chActionText), "Check 5ms Task Counter from Core0 "); 
  snprintf( chExpectedText, elCount(chExpectedText), "5ms Counter from Core0 is incrementing"); 
  TestStepAddActionExpected( chActionText, chExpectedText );
  A_DBGR_VariableRead( "Task_Core0_5ms_Count", taskvalue);
  E_DBGR_VariableCheck("Task_Core0_5ms_Count", taskvalue, Greater);
  
  snprintf( chActionText, elCount(chActionText), "Check 10ms Task Counter from Core0 "); 
  snprintf( chExpectedText, elCount(chExpectedText), "10ms Counter from Core0 is incrementing"); 
  TestStepAddActionExpected( chActionText, chExpectedText );
  A_DBGR_VariableRead( "Task_Core0_10ms_Count", taskvalue);
  E_DBGR_VariableCheck("Task_Core0_10ms_Count", taskvalue, Greater);  
  
  snprintf( chActionText, elCount(chActionText), "Check 25ms Task Counter from Core0 "); 
  snprintf( chExpectedText, elCount(chExpectedText), "25ms Counter from Core0 is incrementing"); 
  TestStepAddActionExpected( chActionText, chExpectedText );
  A_DBGR_VariableRead( "Task_Core0_25ms_Count", taskvalue);
  E_DBGR_VariableCheck("Task_Core0_25ms_Count", taskvalue, Greater);  

  snprintf( chActionText, elCount(chActionText), "Check 50ms Task Counter from Core0 "); 
  snprintf( chExpectedText, elCount(chExpectedText), "50ms Counter from Core0 is incrementing"); 
  TestStepAddActionExpected( chActionText, chExpectedText );
  A_DBGR_VariableRead( "Task_Core0_50ms_Count", taskvalue);
  E_DBGR_VariableCheck("Task_Core0_50ms_Count", taskvalue, Greater);
  
  snprintf( chActionText, elCount(chActionText), "Check 100ms Task Counter from Core0 "); 
  snprintf( chExpectedText, elCount(chExpectedText), "100ms Counter from Core0 is incrementing"); 
  TestStepAddActionExpected( chActionText, chExpectedText );
  A_DBGR_VariableRead( "Task_Core0_100ms_Count", taskvalue);
  E_DBGR_VariableCheck("Task_Core0_100ms_Count", taskvalue, Greater); 
  
  snprintf( chActionText, elCount(chActionText), "Check 250ms Task Counter from Core0 "); 
  snprintf( chExpectedText, elCount(chExpectedText), "250ms Counter from Core0 is incrementing"); 
  TestStepAddActionExpected( chActionText, chExpectedText );
  A_DBGR_VariableRead( "Task_Core0_250ms_Count", taskvalue);
  E_DBGR_VariableCheck("Task_Core0_250ms_Count", taskvalue, Greater);
  
  snprintf( chActionText, elCount(chActionText), "Check 500ms Task Counter from Core0 "); 
  snprintf( chExpectedText, elCount(chExpectedText), "500ms Counter from Core0 is incrementing"); 
  TestStepAddActionExpected( chActionText, chExpectedText );
  A_DBGR_VariableRead( "Task_Core0_500ms_Count", taskvalue);
  E_DBGR_VariableCheck("Task_Core0_500ms_Count", taskvalue, Greater);
  
  snprintf( chActionText, elCount(chActionText), "Check 1000ms Task Counter from Core0 "); 
  snprintf( chExpectedText, elCount(chExpectedText), "1000ms Counter from Core0 is incrementing"); 
  TestStepAddActionExpected( chActionText, chExpectedText );
  A_DBGR_VariableRead( "Task_Core0_1000ms_Count", taskvalue);
  E_DBGR_VariableCheck("Task_Core0_1000ms_Count", taskvalue, Greater);
  
  
  //Check All tasks of Core1 are Running  
  snprintf( chActionText, elCount(chActionText), "Check 2pt5ms Task Counter from Core1 "); 
  snprintf( chExpectedText, elCount(chExpectedText), "2pt5ms Counter from Core1 is  incrementing"); 
  TestStepAddActionExpected( chActionText, chExpectedText );
  A_DBGR_VariableRead( "Task_Core1_2pt5ms_Count", taskvalue);
  E_DBGR_VariableCheck("Task_Core1_2pt5ms_Count", taskvalue, Greater);
  
  snprintf( chActionText, elCount(chActionText), "Check 5ms Task Counter from Core1 "); 
  snprintf( chExpectedText, elCount(chExpectedText), "5ms Counter from Core1 is  incrementing"); 
  TestStepAddActionExpected( chActionText, chExpectedText );
  A_DBGR_VariableRead( "Task_Core1_5ms_Count", taskvalue);
  E_DBGR_VariableCheck("Task_Core1_5ms_Count", taskvalue, Greater);
  
  snprintf( chActionText, elCount(chActionText), "Check 10ms Task Counter from Core1 "); 
  snprintf( chExpectedText, elCount(chExpectedText), "10ms Counter from Core1 is  incrementing"); 
  TestStepAddActionExpected( chActionText, chExpectedText );
  A_DBGR_VariableRead( "Task_Core1_10ms_Count", taskvalue);
  E_DBGR_VariableCheck("Task_Core1_10ms_Count", taskvalue, Greater);  
  
  snprintf( chActionText, elCount(chActionText), "Check 25ms Task Counter from Core1 "); 
  snprintf( chExpectedText, elCount(chExpectedText), "25ms Counter from Core1 is  incrementing"); 
  TestStepAddActionExpected( chActionText, chExpectedText );
  A_DBGR_VariableRead( "Task_Core1_25ms_Count", taskvalue);
  E_DBGR_VariableCheck("Task_Core1_25ms_Count", taskvalue, Greater); 
  
  snprintf( chActionText, elCount(chActionText), "Check 50ms Task Counter from Core1 "); 
  snprintf( chExpectedText, elCount(chExpectedText), "50ms Counter from Core1 is  incrementing"); 
  TestStepAddActionExpected( chActionText, chExpectedText );
  A_DBGR_VariableRead( "Task_Core1_50ms_Count", taskvalue);
  E_DBGR_VariableCheck("Task_Core1_50ms_Count", taskvalue, Greater);
    
  snprintf( chActionText, elCount(chActionText), "Check 100ms Task Counter from Core1 "); 
  snprintf( chExpectedText, elCount(chExpectedText), "100ms Counter from Core1 is  incrementing"); 
  TestStepAddActionExpected( chActionText, chExpectedText );
  A_DBGR_VariableRead( "Task_Core1_100ms_Count", taskvalue);
  E_DBGR_VariableCheck("Task_Core1_100ms_Count", taskvalue, Greater);

  snprintf( chActionText, elCount(chActionText), "Check 250ms Task Counter from Core1 "); 
  snprintf( chExpectedText, elCount(chExpectedText), "250ms Counter from Core1 is  incrementing"); 
  TestStepAddActionExpected( chActionText, chExpectedText );
  A_DBGR_VariableRead( "Task_Core1_250ms_Count", taskvalue);
  E_DBGR_VariableCheck("Task_Core1_250ms_Count", taskvalue, Greater);
  
  snprintf( chActionText, elCount(chActionText), "Check 500ms Task Counter from Core1 "); 
  snprintf( chExpectedText, elCount(chExpectedText), "500ms Counter from Core1 is  incrementing"); 
  TestStepAddActionExpected( chActionText, chExpectedText );
  A_DBGR_VariableRead( "Task_Core1_500ms_Count", taskvalue);
  E_DBGR_VariableCheck("Task_Core1_500ms_Count", taskvalue, Greater);

  snprintf( chActionText, elCount(chActionText), "Check 1000ms Task Counter from Core1 "); 
  snprintf( chExpectedText, elCount(chExpectedText), "1000ms Counter from Core1 is incrementing"); 
  TestStepAddActionExpected( chActionText, chExpectedText );
  A_DBGR_VariableRead( "Task_Core1_1000ms_Count", taskvalue);
  E_DBGR_VariableCheck("Task_Core1_1000ms_Count", taskvalue, Greater);
  
  
  //Check All tasks of Core2 are Running
  snprintf( chActionText, elCount(chActionText), "Check 2pt5ms Task Counter from Core2 "); 
  snprintf( chExpectedText, elCount(chExpectedText), "2pt5ms Counter from Core2 is  incrementing"); 
  TestStepAddActionExpected( chActionText, chExpectedText );
  A_DBGR_VariableRead( "Task_Core2_2pt5ms_Count", taskvalue);
  E_DBGR_VariableCheck("Task_Core2_2pt5ms_Count", taskvalue, Greater);
  
  snprintf( chActionText, elCount(chActionText), "Check 5ms Task Counter from Core2 "); 
  snprintf( chExpectedText, elCount(chExpectedText), "5ms Counter from Core2 is  incrementing"); 
  TestStepAddActionExpected( chActionText, chExpectedText );
  A_DBGR_VariableRead( "Task_Core2_5ms_Count", taskvalue);
  E_DBGR_VariableCheck("Task_Core2_5ms_Count", taskvalue, Greater);
  
  snprintf( chActionText, elCount(chActionText), "Check 10ms Task Counter from Core2 "); 
  snprintf( chExpectedText, elCount(chExpectedText), "10ms Counter from Core2 is  incrementing"); 
  TestStepAddActionExpected( chActionText, chExpectedText );
  A_DBGR_VariableRead( "Task_Core2_10ms_Count", taskvalue);
  E_DBGR_VariableCheck("Task_Core2_10ms_Count", taskvalue, Greater);  
  
  snprintf( chActionText, elCount(chActionText), "Check 25ms Task Counter from Core2 "); 
  snprintf( chExpectedText, elCount(chExpectedText), "25ms Counter from Core2 is  incrementing"); 
  TestStepAddActionExpected( chActionText, chExpectedText );
  A_DBGR_VariableRead( "Task_Core2_25ms_Count", taskvalue);
  E_DBGR_VariableCheck("Task_Core2_25ms_Count", taskvalue, Greater); 

  snprintf( chActionText, elCount(chActionText), "Check 50ms Task Counter from Core2 "); 
  snprintf( chExpectedText, elCount(chExpectedText), "50ms Counter from Core2 is  incrementing"); 
  TestStepAddActionExpected( chActionText, chExpectedText );
  A_DBGR_VariableRead( "Task_Core2_50ms_Count", taskvalue);
  E_DBGR_VariableCheck("Task_Core2_50ms_Count", taskvalue, Greater);
  
  snprintf( chActionText, elCount(chActionText), "Check 100ms Task Counter from Core2 "); 
  snprintf( chExpectedText, elCount(chExpectedText), "100ms Counter from Core2 is  incrementing"); 
  TestStepAddActionExpected( chActionText, chExpectedText );
  A_DBGR_VariableRead( "Task_Core2_100ms_Count", taskvalue);
  E_DBGR_VariableCheck("Task_Core2_100ms_Count", taskvalue, Greater); 
  
  snprintf( chActionText, elCount(chActionText), "Check 250ms Task Counter from Core2 "); 
  snprintf( chExpectedText, elCount(chExpectedText), "250ms Counter from Core2 is  incrementing"); 
  TestStepAddActionExpected( chActionText, chExpectedText );
  A_DBGR_VariableRead( "Task_Core2_250ms_Count", taskvalue);
  E_DBGR_VariableCheck("Task_Core2_250ms_Count", taskvalue, Greater);

  snprintf( chActionText, elCount(chActionText), "Check 500ms Task Counter from Core2 "); 
  snprintf( chExpectedText, elCount(chExpectedText), "500ms Counter from Core2 is  incrementing"); 
  TestStepAddActionExpected( chActionText, chExpectedText );
  A_DBGR_VariableRead( "Task_Core2_500ms_Count", taskvalue);
  E_DBGR_VariableCheck("Task_Core2_500ms_Count", taskvalue, Greater);

  snprintf( chActionText, elCount(chActionText), "Check 1000ms Task Counter from Core2 "); 
  snprintf( chExpectedText, elCount(chExpectedText), "1000ms Counter from Core2 is  incrementing"); 
  TestStepAddActionExpected( chActionText, chExpectedText );
  A_DBGR_VariableRead( "Task_Core2_1000ms_Count", taskvalue);
  E_DBGR_VariableCheck("Task_Core2_1000ms_Count", taskvalue, Greater);
  
  
    //Check All tasks of Core3 are Stopped
  snprintf( chActionText, elCount(chActionText), "Check 2pt5ms Task Counter from Core3 "); 
  snprintf( chExpectedText, elCount(chExpectedText), "2pt5ms Counter from Core3 is stop incrementing"); 
  TestStepAddActionExpected( chActionText, chExpectedText );
  A_DBGR_VariableRead( "Task_Core3_2pt5ms_Count", taskvalue);
  E_DBGR_VariableCheck("Task_Core3_2pt5ms_Count", taskvalue, Equal);
  
   snprintf( chActionText, elCount(chActionText), "Check 5ms Task Counter from Core3 "); 
  snprintf( chExpectedText, elCount(chExpectedText), "5ms Counter from Core3 is stop incrementing"); 
  TestStepAddActionExpected( chActionText, chExpectedText );
  A_DBGR_VariableRead( "Task_Core3_5ms_Count", taskvalue);
  E_DBGR_VariableCheck("Task_Core3_5ms_Count", taskvalue, Equal);
  
  snprintf( chActionText, elCount(chActionText), "Check 10ms Task Counter from Core3 "); 
  snprintf( chExpectedText, elCount(chExpectedText), "10ms Counter from Core3 is stop incrementing"); 
  TestStepAddActionExpected( chActionText, chExpectedText );
  A_DBGR_VariableRead( "Task_Core3_10ms_Count", taskvalue);
  E_DBGR_VariableCheck("Task_Core3_10ms_Count", taskvalue, Equal);  
  
  snprintf( chActionText, elCount(chActionText), "Check 25ms Task Counter from Core3 "); 
  snprintf( chExpectedText, elCount(chExpectedText), "25ms Counter from Core3 is stop incrementing"); 
  TestStepAddActionExpected( chActionText, chExpectedText );
  A_DBGR_VariableRead( "Task_Core3_25ms_Count", taskvalue);
  E_DBGR_VariableCheck("Task_Core3_25ms_Count", taskvalue, Equal);  
  
  snprintf( chActionText, elCount(chActionText), "Check 50ms Task Counter from Core3 "); 
  snprintf( chExpectedText, elCount(chExpectedText), "50ms Counter from Core3 is stop incrementing"); 
  TestStepAddActionExpected( chActionText, chExpectedText );
  A_DBGR_VariableRead( "Task_Core3_50ms_Count", taskvalue);
  E_DBGR_VariableCheck("Task_Core3_50ms_Count", taskvalue, Equal);

  snprintf( chActionText, elCount(chActionText), "Check 100ms Task Counter from Core3 "); 
  snprintf( chExpectedText, elCount(chExpectedText), "100ms Counter from Core3 is stop incrementing"); 
  TestStepAddActionExpected( chActionText, chExpectedText );
  A_DBGR_VariableRead( "Task_Core3_100ms_Count", taskvalue);
  E_DBGR_VariableCheck("Task_Core3_100ms_Count", taskvalue, Equal); 
  
  snprintf( chActionText, elCount(chActionText), "Check 250ms Task Counter from Core3 "); 
  snprintf( chExpectedText, elCount(chExpectedText), "250ms Counter from Core3 is stop incrementing"); 
  TestStepAddActionExpected( chActionText, chExpectedText );
  A_DBGR_VariableRead( "Task_Core3_250ms_Count", taskvalue);
  E_DBGR_VariableCheck("Task_Core3_250ms_Count", taskvalue, Equal);
  
  snprintf( chActionText, elCount(chActionText), "Check 1000ms Task Counter from Core3 "); 
  snprintf( chExpectedText, elCount(chExpectedText), "1000ms Counter from Core3 is stop incrementing"); 
  TestStepAddActionExpected( chActionText, chExpectedText );
  A_DBGR_VariableRead( "Task_Core3_1000ms_Count", taskvalue);
  E_DBGR_VariableCheck("Task_Core3_1000ms_Count", taskvalue, Equal);
  
    //Check task from Core4 is running
  snprintf( chActionText, elCount(chActionText), "Check 1000ms Task Counter from Core4 "); 
  snprintf( chExpectedText, elCount(chExpectedText), "1000ms Counter from Core4 is  incrementing"); 
  TestStepAddActionExpected( chActionText, chExpectedText );
  A_DBGR_VariableRead( "Task_Core4_1000ms_Count", taskvalue);
  E_DBGR_VariableCheck("Task_Core4_1000ms_Count", taskvalue, Greater);
    
  //Check task from Core5 is running
  snprintf( chActionText, elCount(chActionText), "Check 1000ms Task Counter from Core5 "); 
  snprintf( chExpectedText, elCount(chExpectedText), "1000ms Counter from Core5 is  incrementing"); 
  TestStepAddActionExpected( chActionText, chExpectedText );
  A_DBGR_VariableRead( "Task_Core5_1000ms_Count", taskvalue);
  E_DBGR_VariableCheck("Task_Core5_1000ms_Count", taskvalue, Greater);
  
  
 /***************************************************************************************************************/    
    // Test Step 5: Enable Task Initiators
  /***************************************************************************************************************/
  
  // Enable Task Initiator by enabling GMTaskinterruptWait = TRUE
  snprintf( chActionText, elCount(chActionText), "Enable interrupt GMTaskinterruptWait to enable Interface EnblHWIO_GM_TaskInits for core3 "); 
  snprintf( chExpectedText, elCount(chExpectedText), "Check interrut GMTaskinterruptWait shall set to 1 "); 
  TestStepAddActionExpected( chActionText, chExpectedText );
  A_DBGR_VariableSet("GMTaskinterruptWait", "1");
  E_DBGR_VariableCheck("GMTaskinterruptWait", 1, Equal);   
  
  /***************************************************************************************************************/    
    // Test Step 6: Check all Task counters of core 3 are running
  /***************************************************************************************************************/
 
     //Check All tasks of Core3 are running
  snprintf( chActionText, elCount(chActionText), "Check 2pt5ms Task Counter from Core3 "); 
  snprintf( chExpectedText, elCount(chExpectedText), "2pt5ms Counter from Core3 is  incrementing"); 
  TestStepAddActionExpected( chActionText, chExpectedText );
  A_DBGR_VariableRead( "Task_Core3_2pt5ms_Count", taskvalue);
  E_DBGR_VariableCheck("Task_Core3_2pt5ms_Count", taskvalue, Greater);
  
   snprintf( chActionText, elCount(chActionText), "Check 5ms Task Counter from Core3 "); 
  snprintf( chExpectedText, elCount(chExpectedText), "5ms Counter from Core3 is  incrementing"); 
  TestStepAddActionExpected( chActionText, chExpectedText );
  A_DBGR_VariableRead( "Task_Core3_5ms_Count", taskvalue);
  E_DBGR_VariableCheck("Task_Core3_5ms_Count", taskvalue, Greater);
  
  snprintf( chActionText, elCount(chActionText), "Check 10ms Task Counter from Core3 "); 
  snprintf( chExpectedText, elCount(chExpectedText), "10ms Counter from Core3 is   incrementing"); 
  TestStepAddActionExpected( chActionText, chExpectedText );
  A_DBGR_VariableRead( "Task_Core3_10ms_Count", taskvalue);
  E_DBGR_VariableCheck("Task_Core3_10ms_Count", taskvalue, Greater);  
  
  snprintf( chActionText, elCount(chActionText), "Check 25ms Task Counter from Core3 "); 
  snprintf( chExpectedText, elCount(chExpectedText), "25ms Counter from Core3 is incrementing"); 
  TestStepAddActionExpected( chActionText, chExpectedText );
  A_DBGR_VariableRead( "Task_Core3_25ms_Count", taskvalue);
  E_DBGR_VariableCheck("Task_Core3_25ms_Count", taskvalue, Greater);  
  
  snprintf( chActionText, elCount(chActionText), "Check 50ms Task Counter from Core3 "); 
  snprintf( chExpectedText, elCount(chExpectedText), "50ms Counter from Core3 is incrementing"); 
  TestStepAddActionExpected( chActionText, chExpectedText );
  A_DBGR_VariableRead( "Task_Core3_50ms_Count", taskvalue);
  E_DBGR_VariableCheck("Task_Core3_50ms_Count", taskvalue, Greater);

  snprintf( chActionText, elCount(chActionText), "Check 100ms Task Counter from Core3 "); 
  snprintf( chExpectedText, elCount(chExpectedText), "100ms Counter from Core3 is incrementing"); 
  TestStepAddActionExpected( chActionText, chExpectedText );
  A_DBGR_VariableRead( "Task_Core3_100ms_Count", taskvalue);
  E_DBGR_VariableCheck("Task_Core3_100ms_Count", taskvalue, Greater); 
  
  snprintf( chActionText, elCount(chActionText), "Check 250ms Task Counter from Core3 "); 
  snprintf( chExpectedText, elCount(chExpectedText), "250ms Counter from Core3 is incrementing"); 
  TestStepAddActionExpected( chActionText, chExpectedText );
  A_DBGR_VariableRead( "Task_Core3_250ms_Count", taskvalue);
  E_DBGR_VariableCheck("Task_Core3_250ms_Count", taskvalue, Greater);
  
  snprintf( chActionText, elCount(chActionText), "Check 500ms Task Counter from Core3 "); 
  snprintf( chExpectedText, elCount(chExpectedText), "500ms Counter from Core3 is stop incrementing"); 
  TestStepAddActionExpected( chActionText, chExpectedText );
  A_DBGR_VariableRead( "Task_Core3_500ms_Count", taskvalue);
  E_DBGR_VariableCheck("Task_Core3_500ms_Count", taskvalue, Greater);
  
  snprintf( chActionText, elCount(chActionText), "Check 1000ms Task Counter from Core3 "); 
  snprintf( chExpectedText, elCount(chExpectedText), "1000ms Counter from Core3 is incrementing"); 
  TestStepAddActionExpected( chActionText, chExpectedText );
  A_DBGR_VariableRead( "Task_Core3_1000ms_Count", taskvalue);
  E_DBGR_VariableCheck("Task_Core3_1000ms_Count", taskvalue, Greater);
 
  
  
}




/***************************************************************************************************
----------------------------------------------------------------------------------------------------
Test case name:  TC_L30SW_Q-36684461: Testcase_to_verify_interface_EnblHWIO_GM_TaskInits_to_Allows_application_defined_RTOS_tasks_and_ISRs_to_receive_event_triggers_on_CPU4 
Description:   Test case to verify the functionality of interface EnblHWIO_GM_TaskInits to Allows application defined RTOS tasks and ISRs to receive their event triggers on the CPU4

***************************************************************************************************/
testcase Testcase_to_verify_interface_EnblHWIO_GM_TaskInits_to_Allow_application_RTOS_tasks_and_ISRs_to_receive_event_triggers_on_CPU4()
{
  /***************************************************************************************************************/    
                                                // Variable Definition
  /***************************************************************************************************************/ 
  
  long taskvalue;
  
  /***************************************************************************************************************/    
                                               // Local Values
  /***************************************************************************************************************/ 
  

  
  /***************************************************************************************************************/    
                                              // Test Case Info
  /***************************************************************************************************************/
  setWriteDbgLevel(DebugOff);
  snprintf( chTestTitle, elCount(chTestTitle), "Testcase_to_verify_interface_EnblHWIO_GM_TaskInits_to_Allow_application_RTOS_tasks_and_ISRs_to_receive_event_triggers_on_CPU4" );
  snprintf( chTestDescription, elCount(chTestDescription), "Purpose: Test case to verify the functionality of interface EnblHWIO_GM_TaskInits to Allows application defined RTOS tasks and ISRs to receive their event triggers on the CPU4.");
  TestCaseAddInfo( chTestTitle, "TC_L30SW_Q-36684461", chTestDescription );

  /***************************************************************************************************************/    
                                              // Start of Test Case
  /***************************************************************************************************************/
  
  /***************************************************************************************************************/    
                                              // Test Step 1 PRECONDITIONS
  /***************************************************************************************************************/
  
  snprintf( chActionText, elCount(chActionText), "Flash the Software and ECU is running"); 
  snprintf( chExpectedText, elCount(chExpectedText), "ECU should be in running state"); 
  TestStepAddActionExpected( chActionText, chExpectedText );

  A_DBGR_BreakpointDeleteAll();
  A_DBGR_RnGo();
  E_DBGR_CheckState(T32_State_Running);
  

   /***************************************************************************************************************/    
            // Test Step 2: Check all cores are in running state                                   
  /***************************************************************************************************************/
  
  //Check Core0 is running
  snprintf( chActionText, elCount(chActionText), "Check 1000ms Task Counter from Core0 "); 
  snprintf( chExpectedText, elCount(chExpectedText), "1000ms Counter from Core0 is incrementing"); 
  TestStepAddActionExpected( chActionText, chExpectedText );
  A_DBGR_VariableRead( "Task_Core0_1000ms_Count", taskvalue);
  E_DBGR_VariableCheck("Task_Core0_1000ms_Count", taskvalue, Greater);
  
  //Check Core1 is running
  snprintf( chActionText, elCount(chActionText), "Check 1000ms Task Counter from Core1 "); 
  snprintf( chExpectedText, elCount(chExpectedText), "1000ms Counter from Core1 is incrementing"); 
  TestStepAddActionExpected( chActionText, chExpectedText );
  A_DBGR_VariableRead( "Task_Core1_1000ms_Count", taskvalue);
  E_DBGR_VariableCheck("Task_Core1_1000ms_Count", taskvalue, Greater);
  
  //Check Core2 is running
  snprintf( chActionText, elCount(chActionText), "Check 1000ms Task Counter from Core2 "); 
  snprintf( chExpectedText, elCount(chExpectedText), "1000ms Counter from Core2 is incrementing"); 
  TestStepAddActionExpected( chActionText, chExpectedText );
  A_DBGR_VariableRead( "Task_Core2_1000ms_Count", taskvalue);
  E_DBGR_VariableCheck("Task_Core2_1000ms_Count", taskvalue, Greater);
    
  //Check Core3 is running
  snprintf( chActionText, elCount(chActionText), "Check 1000ms Task Counter from Core3 "); 
  snprintf( chExpectedText, elCount(chExpectedText), "1000ms Counter from Core3 is incrementing"); 
  TestStepAddActionExpected( chActionText, chExpectedText );
  A_DBGR_VariableRead( "Task_Core3_1000ms_Count", taskvalue);
  E_DBGR_VariableCheck("Task_Core3_1000ms_Count", taskvalue, Greater);
    
  //Check Core4 is running
  snprintf( chActionText, elCount(chActionText), "Check 1000ms Task Counter from Core4 "); 
  snprintf( chExpectedText, elCount(chExpectedText), "1000ms Counter from Core4 is incrementing"); 
  TestStepAddActionExpected( chActionText, chExpectedText );
  A_DBGR_VariableRead( "Task_Core4_1000ms_Count", taskvalue);
  E_DBGR_VariableCheck("Task_Core4_1000ms_Count", taskvalue, Greater);
    
  //Check Core5 is running
  snprintf( chActionText, elCount(chActionText), "Check 1000ms Task Counter from Core5 "); 
  snprintf( chExpectedText, elCount(chExpectedText), "1000ms Counter from Core5 is incrementing"); 
  TestStepAddActionExpected( chActionText, chExpectedText );
  A_DBGR_VariableRead( "Task_Core5_1000ms_Count", taskvalue);
  E_DBGR_VariableCheck("Task_Core5_1000ms_Count", taskvalue, Greater);
  

  /***************************************************************************************************************/    
    // Test Step 3: Disable Interface DsblHWIO_GM_TaskInits for Core4
  /***************************************************************************************************************/

  snprintf( chActionText, elCount(chActionText), "Disable Interface DsblHWIO_GM_TaskInits for 1000ms Task for core4 "); 
  snprintf( chExpectedText, elCount(chExpectedText), "Check Interface DsblHWIO_GM_TaskInits 1000ms Task for core4 shall set to 1 "); 
  TestStepAddActionExpected( chActionText, chExpectedText );
  A_DBGR_VariableSet("test_disable_task_initiator_core4", "1");
  E_DBGR_VariableCheck("test_disable_task_initiator_core4", 1, Equal);    


  /***************************************************************************************************************/    
    // Test Step 4: Check all Cores are running except core 4, shall be disabled
  /***************************************************************************************************************/

  
  //Check All tasks of Core0 are Running
  snprintf( chActionText, elCount(chActionText), "Check 2pt5ms Task Counter from Core0 "); 
  snprintf( chExpectedText, elCount(chExpectedText), "2pt5ms Counter from Core0 is  incrementing"); 
  TestStepAddActionExpected( chActionText, chExpectedText );
  A_DBGR_VariableRead( "Task_Core0_2pt5ms_Count", taskvalue);
  E_DBGR_VariableCheck("Task_Core0_2pt5ms_Count", taskvalue, Greater);
  
  snprintf( chActionText, elCount(chActionText), "Check 5ms Task Counter from Core0 "); 
  snprintf( chExpectedText, elCount(chExpectedText), "5ms Counter from Core0 is  incrementing"); 
  TestStepAddActionExpected( chActionText, chExpectedText );
  A_DBGR_VariableRead( "Task_Core0_5ms_Count", taskvalue);
  E_DBGR_VariableCheck("Task_Core0_5ms_Count", taskvalue, Greater);
  
  snprintf( chActionText, elCount(chActionText), "Check 10ms Task Counter from Core0 "); 
  snprintf( chExpectedText, elCount(chExpectedText), "10ms Counter from Core0 is  incrementing"); 
  TestStepAddActionExpected( chActionText, chExpectedText );
  A_DBGR_VariableRead( "Task_Core0_10ms_Count", taskvalue);
  E_DBGR_VariableCheck("Task_Core0_10ms_Count", taskvalue, Greater);  
  
  snprintf( chActionText, elCount(chActionText), "Check 25ms Task Counter from Core0 "); 
  snprintf( chExpectedText, elCount(chExpectedText), "25ms Counter from Core0 is  incrementing"); 
  TestStepAddActionExpected( chActionText, chExpectedText );
  A_DBGR_VariableRead( "Task_Core0_25ms_Count", taskvalue);
  E_DBGR_VariableCheck("Task_Core0_25ms_Count", taskvalue, Greater);  

  snprintf( chActionText, elCount(chActionText), "Check 50ms Task Counter from Core0 "); 
  snprintf( chExpectedText, elCount(chExpectedText), "50ms Counter from Core0 is  incrementing"); 
  TestStepAddActionExpected( chActionText, chExpectedText );
  A_DBGR_VariableRead( "Task_Core0_50ms_Count", taskvalue);
  E_DBGR_VariableCheck("Task_Core0_50ms_Count", taskvalue, Greater);
  
  snprintf( chActionText, elCount(chActionText), "Check 250ms Task Counter from Core0 "); 
  snprintf( chExpectedText, elCount(chExpectedText), "250ms Counter from Core0 is  incrementing"); 
  TestStepAddActionExpected( chActionText, chExpectedText );
  A_DBGR_VariableRead( "Task_Core0_250ms_Count", taskvalue);
  E_DBGR_VariableCheck("Task_Core0_250ms_Count", taskvalue, Greater);
  
  snprintf( chActionText, elCount(chActionText), "Check 100ms Task Counter from Core0 "); 
  snprintf( chExpectedText, elCount(chExpectedText), "100ms Counter from Core0 is  incrementing"); 
  TestStepAddActionExpected( chActionText, chExpectedText );
  A_DBGR_VariableRead( "Task_Core0_100ms_Count", taskvalue);
  E_DBGR_VariableCheck("Task_Core0_100ms_Count", taskvalue, Greater); 

  snprintf( chActionText, elCount(chActionText), "Check 500ms Task Counter from Core0 "); 
  snprintf( chExpectedText, elCount(chExpectedText), "500ms Counter from Core0 is  incrementing"); 
  TestStepAddActionExpected( chActionText, chExpectedText );
  A_DBGR_VariableRead( "Task_Core0_500ms_Count", taskvalue);
  E_DBGR_VariableCheck("Task_Core0_500ms_Count", taskvalue, Greater);
  
  snprintf( chActionText, elCount(chActionText), "Check 1000ms Task Counter from Core0 "); 
  snprintf( chExpectedText, elCount(chExpectedText), "1000ms Counter from Core0 is  incrementing"); 
  TestStepAddActionExpected( chActionText, chExpectedText );
  A_DBGR_VariableRead( "Task_Core0_1000ms_Count", taskvalue);
  E_DBGR_VariableCheck("Task_Core0_1000ms_Count", taskvalue, Greater);
  
  
  //Check All tasks of Core1 are Running
  snprintf( chActionText, elCount(chActionText), "Check 2pt5ms Task Counter from Core1 "); 
  snprintf( chExpectedText, elCount(chExpectedText), "2pt5ms Counter from Core1 is  incrementing"); 
  TestStepAddActionExpected( chActionText, chExpectedText );
  A_DBGR_VariableRead( "Task_Core1_2pt5ms_Count", taskvalue);
  E_DBGR_VariableCheck("Task_Core1_2pt5ms_Count", taskvalue, Greater);
  
  snprintf( chActionText, elCount(chActionText), "Check 5ms Task Counter from Core1 "); 
  snprintf( chExpectedText, elCount(chExpectedText), "5ms Counter from Core1 is  incrementing"); 
  TestStepAddActionExpected( chActionText, chExpectedText );
  A_DBGR_VariableRead( "Task_Core1_5ms_Count", taskvalue);
  E_DBGR_VariableCheck("Task_Core1_5ms_Count", taskvalue, Greater);
  
  snprintf( chActionText, elCount(chActionText), "Check 10ms Task Counter from Core1 "); 
  snprintf( chExpectedText, elCount(chExpectedText), "10ms Counter from Core1 is  incrementing"); 
  TestStepAddActionExpected( chActionText, chExpectedText );
  A_DBGR_VariableRead( "Task_Core1_10ms_Count", taskvalue);
  E_DBGR_VariableCheck("Task_Core1_10ms_Count", taskvalue, Greater);  
  
  snprintf( chActionText, elCount(chActionText), "Check 25ms Task Counter from Core1 "); 
  snprintf( chExpectedText, elCount(chExpectedText), "25ms Counter from Core1 is  incrementing"); 
  TestStepAddActionExpected( chActionText, chExpectedText );
  A_DBGR_VariableRead( "Task_Core1_25ms_Count", taskvalue);
  E_DBGR_VariableCheck("Task_Core1_25ms_Count", taskvalue, Greater); 
  
  snprintf( chActionText, elCount(chActionText), "Check 50ms Task Counter from Core1 "); 
  snprintf( chExpectedText, elCount(chExpectedText), "50ms Counter from Core1 is  incrementing"); 
  TestStepAddActionExpected( chActionText, chExpectedText );
  A_DBGR_VariableRead( "Task_Core1_50ms_Count", taskvalue);
  E_DBGR_VariableCheck("Task_Core1_50ms_Count", taskvalue, Greater);
    
  snprintf( chActionText, elCount(chActionText), "Check 100ms Task Counter from Core1 "); 
  snprintf( chExpectedText, elCount(chExpectedText), "100ms Counter from Core1 is  incrementing"); 
  TestStepAddActionExpected( chActionText, chExpectedText );
  A_DBGR_VariableRead( "Task_Core1_100ms_Count", taskvalue);
  E_DBGR_VariableCheck("Task_Core1_100ms_Count", taskvalue, Greater);

  snprintf( chActionText, elCount(chActionText), "Check 250ms Task Counter from Core1 "); 
  snprintf( chExpectedText, elCount(chExpectedText), "250ms Counter from Core1 is  incrementing"); 
  TestStepAddActionExpected( chActionText, chExpectedText );
  A_DBGR_VariableRead( "Task_Core1_250ms_Count", taskvalue);
  E_DBGR_VariableCheck("Task_Core1_250ms_Count", taskvalue, Greater);
  
  snprintf( chActionText, elCount(chActionText), "Check 500ms Task Counter from Core1 "); 
  snprintf( chExpectedText, elCount(chExpectedText), "500ms Counter from Core1 is  incrementing"); 
  TestStepAddActionExpected( chActionText, chExpectedText );
  A_DBGR_VariableRead( "Task_Core1_500ms_Count", taskvalue);
  E_DBGR_VariableCheck("Task_Core1_500ms_Count", taskvalue, Greater);

  snprintf( chActionText, elCount(chActionText), "Check 1000ms Task Counter from Core1 "); 
  snprintf( chExpectedText, elCount(chExpectedText), "1000ms Counter from Core1 is stop incrementing"); 
  TestStepAddActionExpected( chActionText, chExpectedText );
  A_DBGR_VariableRead( "Task_Core1_1000ms_Count", taskvalue);
  E_DBGR_VariableCheck("Task_Core1_1000ms_Count", taskvalue, Greater);
  
  
  //Check All tasks of Core2 are Running
  snprintf( chActionText, elCount(chActionText), "Check 2pt5ms Task Counter from Core2 "); 
  snprintf( chExpectedText, elCount(chExpectedText), "2pt5ms Counter from Core2 is   incrementing"); 
  TestStepAddActionExpected( chActionText, chExpectedText );
  A_DBGR_VariableRead( "Task_Core2_2pt5ms_Count", taskvalue);
  E_DBGR_VariableCheck("Task_Core2_2pt5ms_Count", taskvalue, Greater);
  
  snprintf( chActionText, elCount(chActionText), "Check 5ms Task Counter from Core2 "); 
  snprintf( chExpectedText, elCount(chExpectedText), "5ms Counter from Core2 is   incrementing"); 
  TestStepAddActionExpected( chActionText, chExpectedText );
  A_DBGR_VariableRead( "Task_Core2_5ms_Count", taskvalue);
  E_DBGR_VariableCheck("Task_Core2_5ms_Count", taskvalue, Greater);
  
  snprintf( chActionText, elCount(chActionText), "Check 10ms Task Counter from Core2 "); 
  snprintf( chExpectedText, elCount(chExpectedText), "10ms Counter from Core2 is   incrementing"); 
  TestStepAddActionExpected( chActionText, chExpectedText );
  A_DBGR_VariableRead( "Task_Core2_10ms_Count", taskvalue);
  E_DBGR_VariableCheck("Task_Core2_10ms_Count", taskvalue, Greater);  
  
  snprintf( chActionText, elCount(chActionText), "Check 25ms Task Counter from Core2 "); 
  snprintf( chExpectedText, elCount(chExpectedText), "25ms Counter from Core2 is   incrementing"); 
  TestStepAddActionExpected( chActionText, chExpectedText );
  A_DBGR_VariableRead( "Task_Core2_25ms_Count", taskvalue);
  E_DBGR_VariableCheck("Task_Core2_25ms_Count", taskvalue, Greater); 

  snprintf( chActionText, elCount(chActionText), "Check 50ms Task Counter from Core2 "); 
  snprintf( chExpectedText, elCount(chExpectedText), "50ms Counter from Core2 is   incrementing"); 
  TestStepAddActionExpected( chActionText, chExpectedText );
  A_DBGR_VariableRead( "Task_Core2_50ms_Count", taskvalue);
  E_DBGR_VariableCheck("Task_Core2_50ms_Count", taskvalue, Greater);
  
  snprintf( chActionText, elCount(chActionText), "Check 100ms Task Counter from Core2 "); 
  snprintf( chExpectedText, elCount(chExpectedText), "100ms Counter from Core2 is   incrementing"); 
  TestStepAddActionExpected( chActionText, chExpectedText );
  A_DBGR_VariableRead( "Task_Core2_100ms_Count", taskvalue);
  E_DBGR_VariableCheck("Task_Core2_100ms_Count", taskvalue, Greater); 
  
  snprintf( chActionText, elCount(chActionText), "Check 250ms Task Counter from Core2 "); 
  snprintf( chExpectedText, elCount(chExpectedText), "250ms Counter from Core2 is   incrementing"); 
  TestStepAddActionExpected( chActionText, chExpectedText );
  A_DBGR_VariableRead( "Task_Core2_250ms_Count", taskvalue);
  E_DBGR_VariableCheck("Task_Core2_250ms_Count", taskvalue, Greater);

  snprintf( chActionText, elCount(chActionText), "Check 500ms Task Counter from Core2 "); 
  snprintf( chExpectedText, elCount(chExpectedText), "500ms Counter from Core2 is   incrementing"); 
  TestStepAddActionExpected( chActionText, chExpectedText );
  A_DBGR_VariableRead( "Task_Core2_500ms_Count", taskvalue);
  E_DBGR_VariableCheck("Task_Core2_500ms_Count", taskvalue, Greater);

  snprintf( chActionText, elCount(chActionText), "Check 1000ms Task Counter from Core2 "); 
  snprintf( chExpectedText, elCount(chExpectedText), "1000ms Counter from Core2 is   incrementing"); 
  TestStepAddActionExpected( chActionText, chExpectedText );
  A_DBGR_VariableRead( "Task_Core2_1000ms_Count", taskvalue);
  E_DBGR_VariableCheck("Task_Core2_1000ms_Count", taskvalue, Greater);
  
  
    //Check All tasks of Core3 are running
  snprintf( chActionText, elCount(chActionText), "Check 2pt5ms Task Counter from Core3 "); 
  snprintf( chExpectedText, elCount(chExpectedText), "2pt5ms Counter from Core3 is  incrementing"); 
  TestStepAddActionExpected( chActionText, chExpectedText );
  A_DBGR_VariableRead( "Task_Core3_2pt5ms_Count", taskvalue);
  E_DBGR_VariableCheck("Task_Core3_2pt5ms_Count", taskvalue, Greater);
  
   snprintf( chActionText, elCount(chActionText), "Check 5ms Task Counter from Core3 "); 
  snprintf( chExpectedText, elCount(chExpectedText), "5ms Counter from Core3 is  incrementing"); 
  TestStepAddActionExpected( chActionText, chExpectedText );
  A_DBGR_VariableRead( "Task_Core3_5ms_Count", taskvalue);
  E_DBGR_VariableCheck("Task_Core3_5ms_Count", taskvalue, Greater);
  
  snprintf( chActionText, elCount(chActionText), "Check 10ms Task Counter from Core3 "); 
  snprintf( chExpectedText, elCount(chExpectedText), "10ms Counter from Core3 is   incrementing"); 
  TestStepAddActionExpected( chActionText, chExpectedText );
  A_DBGR_VariableRead( "Task_Core3_10ms_Count", taskvalue);
  E_DBGR_VariableCheck("Task_Core3_10ms_Count", taskvalue, Greater);  
  
  snprintf( chActionText, elCount(chActionText), "Check 25ms Task Counter from Core3 "); 
  snprintf( chExpectedText, elCount(chExpectedText), "25ms Counter from Core3 is incrementing"); 
  TestStepAddActionExpected( chActionText, chExpectedText );
  A_DBGR_VariableRead( "Task_Core3_25ms_Count", taskvalue);
  E_DBGR_VariableCheck("Task_Core3_25ms_Count", taskvalue, Greater);  
  
  snprintf( chActionText, elCount(chActionText), "Check 50ms Task Counter from Core3 "); 
  snprintf( chExpectedText, elCount(chExpectedText), "50ms Counter from Core3 is incrementing"); 
  TestStepAddActionExpected( chActionText, chExpectedText );
  A_DBGR_VariableRead( "Task_Core3_50ms_Count", taskvalue);
  E_DBGR_VariableCheck("Task_Core3_50ms_Count", taskvalue, Greater);

  snprintf( chActionText, elCount(chActionText), "Check 100ms Task Counter from Core3 "); 
  snprintf( chExpectedText, elCount(chExpectedText), "100ms Counter from Core3 is incrementing"); 
  TestStepAddActionExpected( chActionText, chExpectedText );
  A_DBGR_VariableRead( "Task_Core3_100ms_Count", taskvalue);
  E_DBGR_VariableCheck("Task_Core3_100ms_Count", taskvalue, Greater); 
  
  snprintf( chActionText, elCount(chActionText), "Check 250ms Task Counter from Core3 "); 
  snprintf( chExpectedText, elCount(chExpectedText), "250ms Counter from Core3 is incrementing"); 
  TestStepAddActionExpected( chActionText, chExpectedText );
  A_DBGR_VariableRead( "Task_Core3_250ms_Count", taskvalue);
  E_DBGR_VariableCheck("Task_Core3_250ms_Count", taskvalue, Greater);
  
  snprintf( chActionText, elCount(chActionText), "Check 500ms Task Counter from Core3 "); 
  snprintf( chExpectedText, elCount(chExpectedText), "500ms Counter from Core3 is stop incrementing"); 
  TestStepAddActionExpected( chActionText, chExpectedText );
  A_DBGR_VariableRead( "Task_Core3_500ms_Count", taskvalue);
  E_DBGR_VariableCheck("Task_Core3_500ms_Count", taskvalue, Greater);
  
  snprintf( chActionText, elCount(chActionText), "Check 1000ms Task Counter from Core3 "); 
  snprintf( chExpectedText, elCount(chExpectedText), "1000ms Counter from Core3 is incrementing"); 
  TestStepAddActionExpected( chActionText, chExpectedText );
  A_DBGR_VariableRead( "Task_Core3_1000ms_Count", taskvalue);
  E_DBGR_VariableCheck("Task_Core3_1000ms_Count", taskvalue, Greater);
  
    //Check task from Core4 is stopped
  snprintf( chActionText, elCount(chActionText), "Check 1000ms Task Counter from Core4 "); 
  snprintf( chExpectedText, elCount(chExpectedText), "1000ms Counter from Core4 is stop incrementing"); 
  TestStepAddActionExpected( chActionText, chExpectedText );
  A_DBGR_VariableRead( "Task_Core4_1000ms_Count", taskvalue);
  E_DBGR_VariableCheck("Task_Core4_1000ms_Count", taskvalue, Equal);
    
  //Check task from Core5 is running
  snprintf( chActionText, elCount(chActionText), "Check 1000ms Task Counter from Core5 "); 
  snprintf( chExpectedText, elCount(chExpectedText), "1000ms Counter from Core5 is incrementing"); 
  TestStepAddActionExpected( chActionText, chExpectedText );
  A_DBGR_VariableRead( "Task_Core5_1000ms_Count", taskvalue);
  E_DBGR_VariableCheck("Task_Core5_1000ms_Count", taskvalue, Greater);
  
  /***************************************************************************************************************/    
    // Test Step 5: Enable Task Initiators
  /***************************************************************************************************************/
  
  // Enable Task Initiator by enabling GMTaskinterruptWait = TRUE
  snprintf( chActionText, elCount(chActionText), "Enable interrupt GMTaskinterruptWait to enable Interface EnblHWIO_GM_TaskInits for core5 "); 
  snprintf( chExpectedText, elCount(chExpectedText), "Check interrut GMTaskinterruptWait shall set to 1 "); 
  TestStepAddActionExpected( chActionText, chExpectedText );
  A_DBGR_VariableSet("GMTaskinterruptWait", "1");
  E_DBGR_VariableCheck("GMTaskinterruptWait", 1, Equal);   
  
  /***************************************************************************************************************/    
    // Test Step 6: Check Task 4 counter in running
  /***************************************************************************************************************/
 
  snprintf( chActionText, elCount(chActionText), "Check 1000ms Task Counter from Core4 "); 
  snprintf( chExpectedText, elCount(chExpectedText), "1000ms Counter from Core4 is incrementing"); 
  TestStepAddActionExpected( chActionText, chExpectedText );
  A_DBGR_VariableRead( "Task_Core4_1000ms_Count", taskvalue);
  E_DBGR_VariableCheck("Task_Core4_1000ms_Count", taskvalue, Greater);
  
}


/***************************************************************************************************
----------------------------------------------------------------------------------------------------
Test case name:  TC_L30SW_Q-36684460: Testcase_to_verify_interface_EnblHWIO_GM_TaskInits_to_Allows_application_defined_RTOS_tasks_and_ISRs_to_receive_event_triggers_on_CPU5 ----------------------------------------------------------------------------------------------------
Description:   Test case to verify the functionality of interface EnblHWIO_GM_TaskInits to Allows application defined RTOS tasks and ISRs to receive their event triggers on the CPU5

***************************************************************************************************/
testcase Testcase_to_verify_interface_EnblHWIO_GM_TaskInits_to_Allow_application_RTOS_tasks_and_ISRs_to_receive_event_triggers_on_CPU5()
{
  /***************************************************************************************************************/    
                                                // Variable Definition
  /***************************************************************************************************************/ 
  
  long taskvalue;
  
  /***************************************************************************************************************/    
                                               // Local Values
  /***************************************************************************************************************/ 
  

  
  /***************************************************************************************************************/    
                                              // Test Case Info
  /***************************************************************************************************************/
  setWriteDbgLevel(DebugOff);
  snprintf( chTestTitle, elCount(chTestTitle), "Testcase_to_verify_interface_EnblHWIO_GM_TaskInits_to_Allow_application_RTOS_tasks_and_ISRs_to_receive_event_triggers_on_CPU5" );
  snprintf( chTestDescription, elCount(chTestDescription), "Purpose: Test case to verify the functionality of interface EnblHWIO_GM_TaskInits to Allows application defined RTOS tasks and ISRs to receive their event triggers on the CPU5.");
  TestCaseAddInfo( chTestTitle, "TC_L30SW_Q-36684460", chTestDescription );

  /***************************************************************************************************************/    
                                              // Start of Test Case
  /***************************************************************************************************************/
  
  /***************************************************************************************************************/    
                                              // Test Step 1 PRECONDITIONS
  /***************************************************************************************************************/
  
  snprintf( chActionText, elCount(chActionText), "Flash the Software and ECU is running"); 
  snprintf( chExpectedText, elCount(chExpectedText), "ECU should be in running state"); 
  TestStepAddActionExpected( chActionText, chExpectedText );

  A_DBGR_BreakpointDeleteAll();
  A_DBGR_RnGo();
  E_DBGR_CheckState(T32_State_Running);
  

   /***************************************************************************************************************/    
            // Test Step 2: Check all cores are in running state                                   
  /***************************************************************************************************************/
  
  //Check Core0 is running
  snprintf( chActionText, elCount(chActionText), "Check 1000ms Task Counter from Core0 "); 
  snprintf( chExpectedText, elCount(chExpectedText), "1000ms Counter from Core0 is incrementing"); 
  TestStepAddActionExpected( chActionText, chExpectedText );
  A_DBGR_VariableRead( "Task_Core0_1000ms_Count", taskvalue);
  E_DBGR_VariableCheck("Task_Core0_1000ms_Count", taskvalue, Greater);
  
  //Check Core1 is running
  snprintf( chActionText, elCount(chActionText), "Check 1000ms Task Counter from Core1 "); 
  snprintf( chExpectedText, elCount(chExpectedText), "1000ms Counter from Core1 is incrementing"); 
  TestStepAddActionExpected( chActionText, chExpectedText );
  A_DBGR_VariableRead( "Task_Core1_1000ms_Count", taskvalue);
  E_DBGR_VariableCheck("Task_Core1_1000ms_Count", taskvalue, Greater);
  
  //Check Core2 is running
  snprintf( chActionText, elCount(chActionText), "Check 1000ms Task Counter from Core2 "); 
  snprintf( chExpectedText, elCount(chExpectedText), "1000ms Counter from Core2 is incrementing"); 
  TestStepAddActionExpected( chActionText, chExpectedText );
  A_DBGR_VariableRead( "Task_Core2_1000ms_Count", taskvalue);
  E_DBGR_VariableCheck("Task_Core2_1000ms_Count", taskvalue, Greater);
    
  //Check Core3 is running
  snprintf( chActionText, elCount(chActionText), "Check 1000ms Task Counter from Core3 "); 
  snprintf( chExpectedText, elCount(chExpectedText), "1000ms Counter from Core3 is incrementing"); 
  TestStepAddActionExpected( chActionText, chExpectedText );
  A_DBGR_VariableRead( "Task_Core3_1000ms_Count", taskvalue);
  E_DBGR_VariableCheck("Task_Core3_1000ms_Count", taskvalue, Greater);
    
  //Check Core4 is running
  snprintf( chActionText, elCount(chActionText), "Check 1000ms Task Counter from Core4 "); 
  snprintf( chExpectedText, elCount(chExpectedText), "1000ms Counter from Core4 is incrementing"); 
  TestStepAddActionExpected( chActionText, chExpectedText );
  A_DBGR_VariableRead( "Task_Core4_1000ms_Count", taskvalue);
  E_DBGR_VariableCheck("Task_Core4_1000ms_Count", taskvalue, Greater);
    
  //Check Core5 is running
  snprintf( chActionText, elCount(chActionText), "Check 1000ms Task Counter from Core5 "); 
  snprintf( chExpectedText, elCount(chExpectedText), "1000ms Counter from Core5 is incrementing"); 
  TestStepAddActionExpected( chActionText, chExpectedText );
  A_DBGR_VariableRead( "Task_Core5_1000ms_Count", taskvalue);
  E_DBGR_VariableCheck("Task_Core5_1000ms_Count", taskvalue, Greater);
  

  /***************************************************************************************************************/    
    // Test Step 3: Disable Interface DsblHWIO_GM_TaskInits for Core5
  /***************************************************************************************************************/

  snprintf( chActionText, elCount(chActionText), "Disable Interface DsblHWIO_GM_TaskInits for 1000ms Task for core5 "); 
  snprintf( chExpectedText, elCount(chExpectedText), "Check Interface DsblHWIO_GM_TaskInits 1000ms Task for core5 shall set to 1 "); 
  TestStepAddActionExpected( chActionText, chExpectedText );
  A_DBGR_VariableSet("test_disable_task_initiator_core5", "1");
  E_DBGR_VariableCheck("test_disable_task_initiator_core5", 1, Equal);    


  /***************************************************************************************************************/    
    // Test Step 4: Check all Cores are running except core 5, shall be disabled
  /***************************************************************************************************************/

  
  //Check All tasks of Core0 are Running
  snprintf( chActionText, elCount(chActionText), "Check 2pt5ms Task Counter from Core0 "); 
  snprintf( chExpectedText, elCount(chExpectedText), "2pt5ms Counter from Core0 is  incrementing"); 
  TestStepAddActionExpected( chActionText, chExpectedText );
  A_DBGR_VariableRead( "Task_Core0_2pt5ms_Count", taskvalue);
  E_DBGR_VariableCheck("Task_Core0_2pt5ms_Count", taskvalue, Greater);
  
  snprintf( chActionText, elCount(chActionText), "Check 5ms Task Counter from Core0 "); 
  snprintf( chExpectedText, elCount(chExpectedText), "5ms Counter from Core0 is  incrementing"); 
  TestStepAddActionExpected( chActionText, chExpectedText );
  A_DBGR_VariableRead( "Task_Core0_5ms_Count", taskvalue);
  E_DBGR_VariableCheck("Task_Core0_5ms_Count", taskvalue, Greater);
  
  snprintf( chActionText, elCount(chActionText), "Check 10ms Task Counter from Core0 "); 
  snprintf( chExpectedText, elCount(chExpectedText), "10ms Counter from Core0 is  incrementing"); 
  TestStepAddActionExpected( chActionText, chExpectedText );
  A_DBGR_VariableRead( "Task_Core0_10ms_Count", taskvalue);
  E_DBGR_VariableCheck("Task_Core0_10ms_Count", taskvalue, Greater);  
  
  snprintf( chActionText, elCount(chActionText), "Check 25ms Task Counter from Core0 "); 
  snprintf( chExpectedText, elCount(chExpectedText), "25ms Counter from Core0 is  incrementing"); 
  TestStepAddActionExpected( chActionText, chExpectedText );
  A_DBGR_VariableRead( "Task_Core0_25ms_Count", taskvalue);
  E_DBGR_VariableCheck("Task_Core0_25ms_Count", taskvalue, Greater);  

  snprintf( chActionText, elCount(chActionText), "Check 50ms Task Counter from Core0 "); 
  snprintf( chExpectedText, elCount(chExpectedText), "50ms Counter from Core0 is  incrementing"); 
  TestStepAddActionExpected( chActionText, chExpectedText );
  A_DBGR_VariableRead( "Task_Core0_50ms_Count", taskvalue);
  E_DBGR_VariableCheck("Task_Core0_50ms_Count", taskvalue, Greater);
  
  snprintf( chActionText, elCount(chActionText), "Check 250ms Task Counter from Core0 "); 
  snprintf( chExpectedText, elCount(chExpectedText), "250ms Counter from Core0 is  incrementing"); 
  TestStepAddActionExpected( chActionText, chExpectedText );
  A_DBGR_VariableRead( "Task_Core0_250ms_Count", taskvalue);
  E_DBGR_VariableCheck("Task_Core0_250ms_Count", taskvalue, Greater);
  
  snprintf( chActionText, elCount(chActionText), "Check 100ms Task Counter from Core0 "); 
  snprintf( chExpectedText, elCount(chExpectedText), "100ms Counter from Core0 is  incrementing"); 
  TestStepAddActionExpected( chActionText, chExpectedText );
  A_DBGR_VariableRead( "Task_Core0_100ms_Count", taskvalue);
  E_DBGR_VariableCheck("Task_Core0_100ms_Count", taskvalue, Greater); 

  snprintf( chActionText, elCount(chActionText), "Check 500ms Task Counter from Core0 "); 
  snprintf( chExpectedText, elCount(chExpectedText), "500ms Counter from Core0 is  incrementing"); 
  TestStepAddActionExpected( chActionText, chExpectedText );
  A_DBGR_VariableRead( "Task_Core0_500ms_Count", taskvalue);
  E_DBGR_VariableCheck("Task_Core0_500ms_Count", taskvalue, Greater);
  
  snprintf( chActionText, elCount(chActionText), "Check 1000ms Task Counter from Core0 "); 
  snprintf( chExpectedText, elCount(chExpectedText), "1000ms Counter from Core0 is  incrementing"); 
  TestStepAddActionExpected( chActionText, chExpectedText );
  A_DBGR_VariableRead( "Task_Core0_1000ms_Count", taskvalue);
  E_DBGR_VariableCheck("Task_Core0_1000ms_Count", taskvalue, Greater);
  
  
  //Check All tasks of Core1 are Running
  snprintf( chActionText, elCount(chActionText), "Check 2pt5ms Task Counter from Core1 "); 
  snprintf( chExpectedText, elCount(chExpectedText), "2pt5ms Counter from Core1 is  incrementing"); 
  TestStepAddActionExpected( chActionText, chExpectedText );
  A_DBGR_VariableRead( "Task_Core1_2pt5ms_Count", taskvalue);
  E_DBGR_VariableCheck("Task_Core1_2pt5ms_Count", taskvalue, Greater);
  
  snprintf( chActionText, elCount(chActionText), "Check 5ms Task Counter from Core1 "); 
  snprintf( chExpectedText, elCount(chExpectedText), "5ms Counter from Core1 is  incrementing"); 
  TestStepAddActionExpected( chActionText, chExpectedText );
  A_DBGR_VariableRead( "Task_Core1_5ms_Count", taskvalue);
  E_DBGR_VariableCheck("Task_Core1_5ms_Count", taskvalue, Greater);
  
  snprintf( chActionText, elCount(chActionText), "Check 10ms Task Counter from Core1 "); 
  snprintf( chExpectedText, elCount(chExpectedText), "10ms Counter from Core1 is  incrementing"); 
  TestStepAddActionExpected( chActionText, chExpectedText );
  A_DBGR_VariableRead( "Task_Core1_10ms_Count", taskvalue);
  E_DBGR_VariableCheck("Task_Core1_10ms_Count", taskvalue, Greater);  
  
  snprintf( chActionText, elCount(chActionText), "Check 25ms Task Counter from Core1 "); 
  snprintf( chExpectedText, elCount(chExpectedText), "25ms Counter from Core1 is  incrementing"); 
  TestStepAddActionExpected( chActionText, chExpectedText );
  A_DBGR_VariableRead( "Task_Core1_25ms_Count", taskvalue);
  E_DBGR_VariableCheck("Task_Core1_25ms_Count", taskvalue, Greater); 
  
  snprintf( chActionText, elCount(chActionText), "Check 50ms Task Counter from Core1 "); 
  snprintf( chExpectedText, elCount(chExpectedText), "50ms Counter from Core1 is  incrementing"); 
  TestStepAddActionExpected( chActionText, chExpectedText );
  A_DBGR_VariableRead( "Task_Core1_50ms_Count", taskvalue);
  E_DBGR_VariableCheck("Task_Core1_50ms_Count", taskvalue, Greater);
    
  snprintf( chActionText, elCount(chActionText), "Check 100ms Task Counter from Core1 "); 
  snprintf( chExpectedText, elCount(chExpectedText), "100ms Counter from Core1 is  incrementing"); 
  TestStepAddActionExpected( chActionText, chExpectedText );
  A_DBGR_VariableRead( "Task_Core1_100ms_Count", taskvalue);
  E_DBGR_VariableCheck("Task_Core1_100ms_Count", taskvalue, Greater);

  snprintf( chActionText, elCount(chActionText), "Check 250ms Task Counter from Core1 "); 
  snprintf( chExpectedText, elCount(chExpectedText), "250ms Counter from Core1 is  incrementing"); 
  TestStepAddActionExpected( chActionText, chExpectedText );
  A_DBGR_VariableRead( "Task_Core1_250ms_Count", taskvalue);
  E_DBGR_VariableCheck("Task_Core1_250ms_Count", taskvalue, Greater);
  
  snprintf( chActionText, elCount(chActionText), "Check 500ms Task Counter from Core1 "); 
  snprintf( chExpectedText, elCount(chExpectedText), "500ms Counter from Core1 is  incrementing"); 
  TestStepAddActionExpected( chActionText, chExpectedText );
  A_DBGR_VariableRead( "Task_Core1_500ms_Count", taskvalue);
  E_DBGR_VariableCheck("Task_Core1_500ms_Count", taskvalue, Greater);

  snprintf( chActionText, elCount(chActionText), "Check 1000ms Task Counter from Core1 "); 
  snprintf( chExpectedText, elCount(chExpectedText), "1000ms Counter from Core1 is stop incrementing"); 
  TestStepAddActionExpected( chActionText, chExpectedText );
  A_DBGR_VariableRead( "Task_Core1_1000ms_Count", taskvalue);
  E_DBGR_VariableCheck("Task_Core1_1000ms_Count", taskvalue, Greater);
  
  
  //Check All tasks of Core2 are Running
  snprintf( chActionText, elCount(chActionText), "Check 2pt5ms Task Counter from Core2 "); 
  snprintf( chExpectedText, elCount(chExpectedText), "2pt5ms Counter from Core2 is   incrementing"); 
  TestStepAddActionExpected( chActionText, chExpectedText );
  A_DBGR_VariableRead( "Task_Core2_2pt5ms_Count", taskvalue);
  E_DBGR_VariableCheck("Task_Core2_2pt5ms_Count", taskvalue, Greater);
  
  snprintf( chActionText, elCount(chActionText), "Check 5ms Task Counter from Core2 "); 
  snprintf( chExpectedText, elCount(chExpectedText), "5ms Counter from Core2 is   incrementing"); 
  TestStepAddActionExpected( chActionText, chExpectedText );
  A_DBGR_VariableRead( "Task_Core2_5ms_Count", taskvalue);
  E_DBGR_VariableCheck("Task_Core2_5ms_Count", taskvalue, Greater);
  
  snprintf( chActionText, elCount(chActionText), "Check 10ms Task Counter from Core2 "); 
  snprintf( chExpectedText, elCount(chExpectedText), "10ms Counter from Core2 is   incrementing"); 
  TestStepAddActionExpected( chActionText, chExpectedText );
  A_DBGR_VariableRead( "Task_Core2_10ms_Count", taskvalue);
  E_DBGR_VariableCheck("Task_Core2_10ms_Count", taskvalue, Greater);  
  
  snprintf( chActionText, elCount(chActionText), "Check 25ms Task Counter from Core2 "); 
  snprintf( chExpectedText, elCount(chExpectedText), "25ms Counter from Core2 is   incrementing"); 
  TestStepAddActionExpected( chActionText, chExpectedText );
  A_DBGR_VariableRead( "Task_Core2_25ms_Count", taskvalue);
  E_DBGR_VariableCheck("Task_Core2_25ms_Count", taskvalue, Greater); 

  snprintf( chActionText, elCount(chActionText), "Check 50ms Task Counter from Core2 "); 
  snprintf( chExpectedText, elCount(chExpectedText), "50ms Counter from Core2 is   incrementing"); 
  TestStepAddActionExpected( chActionText, chExpectedText );
  A_DBGR_VariableRead( "Task_Core2_50ms_Count", taskvalue);
  E_DBGR_VariableCheck("Task_Core2_50ms_Count", taskvalue, Greater);
  
  snprintf( chActionText, elCount(chActionText), "Check 100ms Task Counter from Core2 "); 
  snprintf( chExpectedText, elCount(chExpectedText), "100ms Counter from Core2 is   incrementing"); 
  TestStepAddActionExpected( chActionText, chExpectedText );
  A_DBGR_VariableRead( "Task_Core2_100ms_Count", taskvalue);
  E_DBGR_VariableCheck("Task_Core2_100ms_Count", taskvalue, Greater); 
  
  snprintf( chActionText, elCount(chActionText), "Check 250ms Task Counter from Core2 "); 
  snprintf( chExpectedText, elCount(chExpectedText), "250ms Counter from Core2 is   incrementing"); 
  TestStepAddActionExpected( chActionText, chExpectedText );
  A_DBGR_VariableRead( "Task_Core2_250ms_Count", taskvalue);
  E_DBGR_VariableCheck("Task_Core2_250ms_Count", taskvalue, Greater);

  snprintf( chActionText, elCount(chActionText), "Check 500ms Task Counter from Core2 "); 
  snprintf( chExpectedText, elCount(chExpectedText), "500ms Counter from Core2 is   incrementing"); 
  TestStepAddActionExpected( chActionText, chExpectedText );
  A_DBGR_VariableRead( "Task_Core2_500ms_Count", taskvalue);
  E_DBGR_VariableCheck("Task_Core2_500ms_Count", taskvalue, Greater);

  snprintf( chActionText, elCount(chActionText), "Check 1000ms Task Counter from Core2 "); 
  snprintf( chExpectedText, elCount(chExpectedText), "1000ms Counter from Core2 is   incrementing"); 
  TestStepAddActionExpected( chActionText, chExpectedText );
  A_DBGR_VariableRead( "Task_Core2_1000ms_Count", taskvalue);
  E_DBGR_VariableCheck("Task_Core2_1000ms_Count", taskvalue, Greater);
  
  
    //Check All tasks of Core3 are stopped
  snprintf( chActionText, elCount(chActionText), "Check 2pt5ms Task Counter from Core3 "); 
  snprintf( chExpectedText, elCount(chExpectedText), "2pt5ms Counter from Core3 is  incrementing"); 
  TestStepAddActionExpected( chActionText, chExpectedText );
  A_DBGR_VariableRead( "Task_Core3_2pt5ms_Count", taskvalue);
  E_DBGR_VariableCheck("Task_Core3_2pt5ms_Count", taskvalue, Greater);
  
   snprintf( chActionText, elCount(chActionText), "Check 5ms Task Counter from Core3 "); 
  snprintf( chExpectedText, elCount(chExpectedText), "5ms Counter from Core3 is  incrementing"); 
  TestStepAddActionExpected( chActionText, chExpectedText );
  A_DBGR_VariableRead( "Task_Core3_5ms_Count", taskvalue);
  E_DBGR_VariableCheck("Task_Core3_5ms_Count", taskvalue, Greater);
  
  snprintf( chActionText, elCount(chActionText), "Check 10ms Task Counter from Core3 "); 
  snprintf( chExpectedText, elCount(chExpectedText), "10ms Counter from Core3 is   incrementing"); 
  TestStepAddActionExpected( chActionText, chExpectedText );
  A_DBGR_VariableRead( "Task_Core3_10ms_Count", taskvalue);
  E_DBGR_VariableCheck("Task_Core3_10ms_Count", taskvalue, Greater);  
  
  snprintf( chActionText, elCount(chActionText), "Check 25ms Task Counter from Core3 "); 
  snprintf( chExpectedText, elCount(chExpectedText), "25ms Counter from Core3 is incrementing"); 
  TestStepAddActionExpected( chActionText, chExpectedText );
  A_DBGR_VariableRead( "Task_Core3_25ms_Count", taskvalue);
  E_DBGR_VariableCheck("Task_Core3_25ms_Count", taskvalue, Greater);  
  
  snprintf( chActionText, elCount(chActionText), "Check 50ms Task Counter from Core3 "); 
  snprintf( chExpectedText, elCount(chExpectedText), "50ms Counter from Core3 is incrementing"); 
  TestStepAddActionExpected( chActionText, chExpectedText );
  A_DBGR_VariableRead( "Task_Core3_50ms_Count", taskvalue);
  E_DBGR_VariableCheck("Task_Core3_50ms_Count", taskvalue, Greater);

  snprintf( chActionText, elCount(chActionText), "Check 100ms Task Counter from Core3 "); 
  snprintf( chExpectedText, elCount(chExpectedText), "100ms Counter from Core3 is incrementing"); 
  TestStepAddActionExpected( chActionText, chExpectedText );
  A_DBGR_VariableRead( "Task_Core3_100ms_Count", taskvalue);
  E_DBGR_VariableCheck("Task_Core3_100ms_Count", taskvalue, Greater); 
  
  snprintf( chActionText, elCount(chActionText), "Check 250ms Task Counter from Core3 "); 
  snprintf( chExpectedText, elCount(chExpectedText), "250ms Counter from Core3 is incrementing"); 
  TestStepAddActionExpected( chActionText, chExpectedText );
  A_DBGR_VariableRead( "Task_Core3_250ms_Count", taskvalue);
  E_DBGR_VariableCheck("Task_Core3_250ms_Count", taskvalue, Greater);
  
  snprintf( chActionText, elCount(chActionText), "Check 500ms Task Counter from Core3 "); 
  snprintf( chExpectedText, elCount(chExpectedText), "500ms Counter from Core3 is stop incrementing"); 
  TestStepAddActionExpected( chActionText, chExpectedText );
  A_DBGR_VariableRead( "Task_Core3_500ms_Count", taskvalue);
  E_DBGR_VariableCheck("Task_Core3_500ms_Count", taskvalue, Greater);
  
  snprintf( chActionText, elCount(chActionText), "Check 1000ms Task Counter from Core3 "); 
  snprintf( chExpectedText, elCount(chExpectedText), "1000ms Counter from Core3 is incrementing"); 
  TestStepAddActionExpected( chActionText, chExpectedText );
  A_DBGR_VariableRead( "Task_Core3_1000ms_Count", taskvalue);
  E_DBGR_VariableCheck("Task_Core3_1000ms_Count", taskvalue, Greater);
  
    //Check task from Core4 is running
  snprintf( chActionText, elCount(chActionText), "Check 1000ms Task Counter from Core4 "); 
  snprintf( chExpectedText, elCount(chExpectedText), "1000ms Counter from Core4 is incrementing"); 
  TestStepAddActionExpected( chActionText, chExpectedText );
  A_DBGR_VariableRead( "Task_Core4_1000ms_Count", taskvalue);
  E_DBGR_VariableCheck("Task_Core4_1000ms_Count", taskvalue, Greater);
    
  //Check task from Core5 is stopped
  snprintf( chActionText, elCount(chActionText), "Check 1000ms Task Counter from Core5 "); 
  snprintf( chExpectedText, elCount(chExpectedText), "1000ms Counter from Core5 is stop incrementing"); 
  TestStepAddActionExpected( chActionText, chExpectedText );
  A_DBGR_VariableRead( "Task_Core5_1000ms_Count", taskvalue);
  E_DBGR_VariableCheck("Task_Core5_1000ms_Count", taskvalue, Equal);
  
  /***************************************************************************************************************/    
    // Test Step 5: Enable Task Initiators
  /***************************************************************************************************************/
  
  // Enable Task Initiator 
  snprintf( chActionText, elCount(chActionText), "Enable interrupt GMTaskinterruptWait to enable Interface EnblHWIO_GM_TaskInits for core5 "); 
  snprintf( chExpectedText, elCount(chExpectedText), "Check interrut GMTaskinterruptWait shall set to 1 "); 
  TestStepAddActionExpected( chActionText, chExpectedText );
  A_DBGR_VariableSet("GMTaskinterruptWait", "1");
  E_DBGR_VariableCheck("GMTaskinterruptWait", 1, Equal);   
  
  /***************************************************************************************************************/    
    // Test Step 6: Check Task 5 counter in running
  /***************************************************************************************************************/
 
  snprintf( chActionText, elCount(chActionText), "Check 1000ms Task Counter from Core5 "); 
  snprintf( chExpectedText, elCount(chExpectedText), "1000ms Counter from Core5 is incrementing"); 
  TestStepAddActionExpected( chActionText, chExpectedText );
  A_DBGR_VariableRead( "Task_Core5_1000ms_Count", taskvalue);
  E_DBGR_VariableCheck("Task_Core5_1000ms_Count", taskvalue, Greater);
  
}



/***************************************************************************************************
----------------------------------------------------------------------------------------------------
Test case name:  TC_L30SW_Q-36542212: Testcase_to_verify_the_functionality_of_interface_MngTSKR_e_PreTask_shall_be_triggred_before_the_task_is_invoked_for_CPU0
----------------------------------------------------------------------------------------------------
Description:  Test case to verify the functionality of interface MngTSKR_e_PreTask() shall be triggred before the task is invoked.

***************************************************************************************************/
testcase Testcase_to_verify_the_functionality_of_interface_MngTSKR_e_PreTask_shall_be_triggred_before_the_task_is_invoked_for_CPU0()
{
  /***************************************************************************************************************/    
                                                // Variable Definition
  /***************************************************************************************************************/ 
  
  long taskvalue;
  
  /***************************************************************************************************************/    
                                               // Local Values
  /***************************************************************************************************************/ 
  

  
  /***************************************************************************************************************/    
                                              // Test Case Info
  /***************************************************************************************************************/
  setWriteDbgLevel(DebugOff);
  snprintf( chTestTitle, elCount(chTestTitle), "Testcase_to_verify_the_functionality_of_interface_MngTSKR_e_PreTask_shall_be_triggred_before_the_task_is_invoked_for_CPU0" );
  snprintf( chTestDescription, elCount(chTestDescription), "Purose: Test case to verify the functionality of interface MngTSKR_e_PreTask() shall be triggred before the task is invoked.");
  TestCaseAddInfo( chTestTitle, "TC_L30SW_Q-36542212", chTestDescription );

  /***************************************************************************************************************/    
                                              // Start of Test Case
  /***************************************************************************************************************/
  
  /***************************************************************************************************************/    
                                              // Test Step 1 PRECONDITIONS
  /***************************************************************************************************************/
  
  snprintf( chActionText, elCount(chActionText), "Flash the Software and ECU is running"); 
  snprintf( chExpectedText, elCount(chExpectedText), "ECU should be in running state"); 
  TestStepAddActionExpected( chActionText, chExpectedText );

  A_DBGR_BreakpointDeleteAll();
  A_DBGR_RnGo();
  E_DBGR_CheckState(T32_State_Running);
  

   /***************************************************************************************************************/    
            // Test Step 2: Check all cores are in running state                                   
  /***************************************************************************************************************/
  
  //Check Core0 is running
  snprintf( chActionText, elCount(chActionText), "Check 1000ms Task Counter from Core0 "); 
  snprintf( chExpectedText, elCount(chExpectedText), "1000ms Counter from Core0 is incrementing"); 
  TestStepAddActionExpected( chActionText, chExpectedText );
  A_DBGR_VariableRead( "Task_Core0_1000ms_Count", taskvalue);
  E_DBGR_VariableCheck("Task_Core0_1000ms_Count", taskvalue, Greater);
  
  //Check Core1 is running
  snprintf( chActionText, elCount(chActionText), "Check 1000ms Task Counter from Core1 "); 
  snprintf( chExpectedText, elCount(chExpectedText), "1000ms Counter from Core1 is incrementing"); 
  TestStepAddActionExpected( chActionText, chExpectedText );
  A_DBGR_VariableRead( "Task_Core1_1000ms_Count", taskvalue);
  E_DBGR_VariableCheck("Task_Core1_1000ms_Count", taskvalue, Greater);
  
  //Check Core2 is running
  snprintf( chActionText, elCount(chActionText), "Check 1000ms Task Counter from Core2 "); 
  snprintf( chExpectedText, elCount(chExpectedText), "1000ms Counter from Core2 is incrementing"); 
  TestStepAddActionExpected( chActionText, chExpectedText );
  A_DBGR_VariableRead( "Task_Core2_1000ms_Count", taskvalue);
  E_DBGR_VariableCheck("Task_Core2_1000ms_Count", taskvalue, Greater);
    
  //Check Core3 is running
  snprintf( chActionText, elCount(chActionText), "Check 1000ms Task Counter from Core3 "); 
  snprintf( chExpectedText, elCount(chExpectedText), "1000ms Counter from Core3 is incrementing"); 
  TestStepAddActionExpected( chActionText, chExpectedText );
  A_DBGR_VariableRead( "Task_Core3_1000ms_Count", taskvalue);
  E_DBGR_VariableCheck("Task_Core3_1000ms_Count", taskvalue, Greater);
    
  //Check Core4 is running
  snprintf( chActionText, elCount(chActionText), "Check 1000ms Task Counter from Core4 "); 
  snprintf( chExpectedText, elCount(chExpectedText), "1000ms Counter from Core4 is incrementing"); 
  TestStepAddActionExpected( chActionText, chExpectedText );
  A_DBGR_VariableRead( "Task_Core4_1000ms_Count", taskvalue);
  E_DBGR_VariableCheck("Task_Core4_1000ms_Count", taskvalue, Greater);
    
  //Check Core5 is running
  snprintf( chActionText, elCount(chActionText), "Check 1000ms Task Counter from Core5 "); 
  snprintf( chExpectedText, elCount(chExpectedText), "1000ms Counter from Core5 is incrementing"); 
  TestStepAddActionExpected( chActionText, chExpectedText );
  A_DBGR_VariableRead( "Task_Core5_1000ms_Count", taskvalue);
  E_DBGR_VariableCheck("Task_Core5_1000ms_Count", taskvalue, Greater);
  
  /***************************************************************************************************************/    
    // Test Step 3: Set breakpoint at function FUNC(void, OS_CALLOUT_CODE) PreTaskHook(void) and  MngTSKR_e_PreTask( ) and check function called
  /***************************************************************************************************************/

  snprintf( chActionText, elCount(chActionText), "Set Breakpoint at FUNC(void, OS_CALLOUT_CODE) PreTaskHook(void), Run SW & check Break point got hit "); 
  snprintf( chExpectedText, elCount(chExpectedText), "Verify Breakpoint got hit at FUNC(void, OS_CALLOUT_CODE) PreTaskHook(void)"); 
  TestStepAddActionExpected( chActionText, chExpectedText );
  A_DBGR_BreakpointSet("PreTaskHook"); 
  A_DBGR_Go(); 
  E_DBGR_BreakpointCheckForHalt("PreTaskHook");
  
  
  snprintf( chActionText, elCount(chActionText), "Run Software and check breakpoint got hit at function MngTSKR_e_PreTask();   "); 
  snprintf( chExpectedText, elCount(chExpectedText), "Verify Software is Running and breakpoint got hit at function MngTSKR_e_PreTask();"); 
  TestStepAddActionExpected( chActionText, chExpectedText );
  A_DBGR_BreakpointDeleteAll();
  A_DBGR_BreakpointSet("MngTSKR_e_PreTask"); 
  A_DBGR_Go(); 
  E_DBGR_BreakpointCheckForHalt("MngTSKR_e_PreTask");
 
}



/***************************************************************************************************
----------------------------------------------------------------------------------------------------
Test case name:  TC_L30SW_Q-36542213: Testcase_to_verify_the_functionality_of_interface_MngTSKR_e_PreTask_shall_be_triggred_before_the_task_is_invoked_for_CPU1
----------------------------------------------------------------------------------------------------
Description:  Test case to verify the functionality of interface MngTSKR_e_PreTask() shall be triggred before the task is invoked.

***************************************************************************************************/
testcase Testcase_to_verify_the_functionality_of_interface_MngTSKR_e_PreTask_shall_be_triggred_before_the_task_is_invoked_for_CPU1()
{
  /***************************************************************************************************************/    
                                                // Variable Definition
  /***************************************************************************************************************/ 
  
  long taskvalue;
  
  /***************************************************************************************************************/    
                                               // Local Values
  /***************************************************************************************************************/ 
  

  
  /***************************************************************************************************************/    
                                              // Test Case Info
  /***************************************************************************************************************/
  setWriteDbgLevel(DebugOff);
  snprintf( chTestTitle, elCount(chTestTitle), "Testcase_to_verify_the_functionality_of_interface_MngTSKR_e_PreTask_shall_be_triggred_before_the_task_is_invoked_for_CPU1" );
  snprintf( chTestDescription, elCount(chTestDescription), "Purose: Test case to verify the functionality of interface MngTSKR_e_PreTask() shall be triggred before the task is invoked.");
  TestCaseAddInfo( chTestTitle, "TC_L30SW_Q-36542213", chTestDescription );

  /***************************************************************************************************************/    
                                              // Start of Test Case
  /***************************************************************************************************************/
  
  /***************************************************************************************************************/    
                                              // Test Step 1 PRECONDITIONS
  /***************************************************************************************************************/
  
  snprintf( chActionText, elCount(chActionText), "Flash the Software and ECU is running"); 
  snprintf( chExpectedText, elCount(chExpectedText), "ECU should be in running state"); 
  TestStepAddActionExpected( chActionText, chExpectedText );

  A_DBGR_BreakpointDeleteAll();
  A_DBGR_RnGo();
  E_DBGR_CheckState(T32_State_Running);
  

   /***************************************************************************************************************/    
            // Test Step 2: Check all cores are in running state                                   
  /***************************************************************************************************************/
  
  //Check Core0 is running
  snprintf( chActionText, elCount(chActionText), "Check 1000ms Task Counter from Core0 "); 
  snprintf( chExpectedText, elCount(chExpectedText), "1000ms Counter from Core0 is incrementing"); 
  TestStepAddActionExpected( chActionText, chExpectedText );
  A_DBGR_VariableRead( "Task_Core0_1000ms_Count", taskvalue);
  E_DBGR_VariableCheck("Task_Core0_1000ms_Count", taskvalue, Greater);
  
  //Check Core1 is running
  snprintf( chActionText, elCount(chActionText), "Check 1000ms Task Counter from Core1 "); 
  snprintf( chExpectedText, elCount(chExpectedText), "1000ms Counter from Core1 is incrementing"); 
  TestStepAddActionExpected( chActionText, chExpectedText );
  A_DBGR_VariableRead( "Task_Core1_1000ms_Count", taskvalue);
  E_DBGR_VariableCheck("Task_Core1_1000ms_Count", taskvalue, Greater);
  
  //Check Core2 is running
  snprintf( chActionText, elCount(chActionText), "Check 1000ms Task Counter from Core2 "); 
  snprintf( chExpectedText, elCount(chExpectedText), "1000ms Counter from Core2 is incrementing"); 
  TestStepAddActionExpected( chActionText, chExpectedText );
  A_DBGR_VariableRead( "Task_Core2_1000ms_Count", taskvalue);
  E_DBGR_VariableCheck("Task_Core2_1000ms_Count", taskvalue, Greater);
    
  //Check Core3 is running
  snprintf( chActionText, elCount(chActionText), "Check 1000ms Task Counter from Core3 "); 
  snprintf( chExpectedText, elCount(chExpectedText), "1000ms Counter from Core3 is incrementing"); 
  TestStepAddActionExpected( chActionText, chExpectedText );
  A_DBGR_VariableRead( "Task_Core3_1000ms_Count", taskvalue);
  E_DBGR_VariableCheck("Task_Core3_1000ms_Count", taskvalue, Greater);
    
  //Check Core4 is running
  snprintf( chActionText, elCount(chActionText), "Check 1000ms Task Counter from Core4 "); 
  snprintf( chExpectedText, elCount(chExpectedText), "1000ms Counter from Core4 is incrementing"); 
  TestStepAddActionExpected( chActionText, chExpectedText );
  A_DBGR_VariableRead( "Task_Core4_1000ms_Count", taskvalue);
  E_DBGR_VariableCheck("Task_Core4_1000ms_Count", taskvalue, Greater);
    
  //Check Core5 is running
  snprintf( chActionText, elCount(chActionText), "Check 1000ms Task Counter from Core5 "); 
  snprintf( chExpectedText, elCount(chExpectedText), "1000ms Counter from Core5 is incrementing"); 
  TestStepAddActionExpected( chActionText, chExpectedText );
  A_DBGR_VariableRead( "Task_Core5_1000ms_Count", taskvalue);
  E_DBGR_VariableCheck("Task_Core5_1000ms_Count", taskvalue, Greater);
  
  /***************************************************************************************************************/    
    // Test Step 3: Set breakpoint at function FUNC(void, OS_CALLOUT_CODE) PreTaskHook(void) and  MngTSKR_e_PreTask( ) and check function called
  /***************************************************************************************************************/

  snprintf( chActionText, elCount(chActionText), "Set Breakpoint at FUNC(void, OS_CALLOUT_CODE) PreTaskHook(void), Run SW & check Break point got hit "); 
  snprintf( chExpectedText, elCount(chExpectedText), "Verify Breakpoint got hit at FUNC(void, OS_CALLOUT_CODE) PreTaskHook(void)"); 
  TestStepAddActionExpected( chActionText, chExpectedText );
  A_DBGR_BreakpointSet("PreTaskHook");  
  A_DBGR_Go(); 
  E_DBGR_BreakpointCheckForHalt("PreTaskHook");
  
  
  snprintf( chActionText, elCount(chActionText), "Run Software and check breakpoint got hit at function MngTSKR_e_PreTaskCPU1();   "); 
  snprintf( chExpectedText, elCount(chExpectedText), "Verify Software is Running and breakpoint got hit at function MngTSKR_e_PreTaskCPU1();"); 
  TestStepAddActionExpected( chActionText, chExpectedText );
  A_DBGR_BreakpointDeleteAll();
  A_DBGR_BreakpointSet("MngTSKR_e_PreTaskCPU1");
  A_DBGR_Go(); 
  E_DBGR_BreakpointCheckForHalt("MngTSKR_e_PreTaskCPU1");
 
}



/***************************************************************************************************
----------------------------------------------------------------------------------------------------
Test case name:  TC_L30SW_Q-36542214: Testcase_to_verify_the_functionality_of_interface_MngTSKR_e_PreTask_shall_be_triggred_before_the_task_is_invoked_for_CPU2
----------------------------------------------------------------------------------------------------
Description:  Test case to verify the functionality of interface MngTSKR_e_PreTask() shall be triggred before the task is invoked.

***************************************************************************************************/
testcase Testcase_to_verify_the_functionality_of_interface_MngTSKR_e_PreTask_shall_be_triggred_before_the_task_is_invoked_for_CPU2()
{
  /***************************************************************************************************************/    
                                                // Variable Definition
  /***************************************************************************************************************/ 
  
  long taskvalue;
  
  /***************************************************************************************************************/    
                                               // Local Values
  /***************************************************************************************************************/ 
  

  
  /***************************************************************************************************************/    
                                              // Test Case Info
  /***************************************************************************************************************/
  setWriteDbgLevel(DebugOff);
  snprintf( chTestTitle, elCount(chTestTitle), "Testcase_to_verify_the_functionality_of_interface_MngTSKR_e_PreTask_shall_be_triggred_before_the_task_is_invoked_for_CPU2" );
  snprintf( chTestDescription, elCount(chTestDescription), "Purose: Test case to verify the functionality of interface MngTSKR_e_PreTask() shall be triggred before the task is invoked.");
  TestCaseAddInfo( chTestTitle, "TC_L30SW_Q-36542214", chTestDescription );

  /***************************************************************************************************************/    
                                              // Start of Test Case
  /***************************************************************************************************************/
  
  /***************************************************************************************************************/    
                                              // Test Step 1 PRECONDITIONS
  /***************************************************************************************************************/
  
  snprintf( chActionText, elCount(chActionText), "Flash the Software and ECU is running"); 
  snprintf( chExpectedText, elCount(chExpectedText), "ECU should be in running state"); 
  TestStepAddActionExpected( chActionText, chExpectedText );

  A_DBGR_BreakpointDeleteAll();
  A_DBGR_RnGo();
  E_DBGR_CheckState(T32_State_Running);
  

   /***************************************************************************************************************/    
            // Test Step 2: Check all cores are in running state                                   
  /***************************************************************************************************************/
  
  //Check Core0 is running
  snprintf( chActionText, elCount(chActionText), "Check 1000ms Task Counter from Core0 "); 
  snprintf( chExpectedText, elCount(chExpectedText), "1000ms Counter from Core0 is incrementing"); 
  TestStepAddActionExpected( chActionText, chExpectedText );
  A_DBGR_VariableRead( "Task_Core0_1000ms_Count", taskvalue);
  E_DBGR_VariableCheck("Task_Core0_1000ms_Count", taskvalue, Greater);
  
  //Check Core1 is running
  snprintf( chActionText, elCount(chActionText), "Check 1000ms Task Counter from Core1 "); 
  snprintf( chExpectedText, elCount(chExpectedText), "1000ms Counter from Core1 is incrementing"); 
  TestStepAddActionExpected( chActionText, chExpectedText );
  A_DBGR_VariableRead( "Task_Core1_1000ms_Count", taskvalue);
  E_DBGR_VariableCheck("Task_Core1_1000ms_Count", taskvalue, Greater);
  
  //Check Core2 is running
  snprintf( chActionText, elCount(chActionText), "Check 1000ms Task Counter from Core2 "); 
  snprintf( chExpectedText, elCount(chExpectedText), "1000ms Counter from Core2 is incrementing"); 
  TestStepAddActionExpected( chActionText, chExpectedText );
  A_DBGR_VariableRead( "Task_Core2_1000ms_Count", taskvalue);
  E_DBGR_VariableCheck("Task_Core2_1000ms_Count", taskvalue, Greater);
    
  //Check Core3 is running
  snprintf( chActionText, elCount(chActionText), "Check 1000ms Task Counter from Core3 "); 
  snprintf( chExpectedText, elCount(chExpectedText), "1000ms Counter from Core3 is incrementing"); 
  TestStepAddActionExpected( chActionText, chExpectedText );
  A_DBGR_VariableRead( "Task_Core3_1000ms_Count", taskvalue);
  E_DBGR_VariableCheck("Task_Core3_1000ms_Count", taskvalue, Greater);
    
  //Check Core4 is running
  snprintf( chActionText, elCount(chActionText), "Check 1000ms Task Counter from Core4 "); 
  snprintf( chExpectedText, elCount(chExpectedText), "1000ms Counter from Core4 is incrementing"); 
  TestStepAddActionExpected( chActionText, chExpectedText );
  A_DBGR_VariableRead( "Task_Core4_1000ms_Count", taskvalue);
  E_DBGR_VariableCheck("Task_Core4_1000ms_Count", taskvalue, Greater);
    
  //Check Core5 is running
  snprintf( chActionText, elCount(chActionText), "Check 1000ms Task Counter from Core5 "); 
  snprintf( chExpectedText, elCount(chExpectedText), "1000ms Counter from Core5 is incrementing"); 
  TestStepAddActionExpected( chActionText, chExpectedText );
  A_DBGR_VariableRead( "Task_Core5_1000ms_Count", taskvalue);
  E_DBGR_VariableCheck("Task_Core5_1000ms_Count", taskvalue, Greater);
  
  /***************************************************************************************************************/    
    // Test Step 3: Set breakpoint at function FUNC(void, OS_CALLOUT_CODE) PreTaskHook(void) and  MngTSKR_e_PreTask( ) and check function called
  /***************************************************************************************************************/

  snprintf( chActionText, elCount(chActionText), "Set Breakpoint at FUNC(void, OS_CALLOUT_CODE) PreTaskHook(void), Run SW & check Break point got hit "); 
  snprintf( chExpectedText, elCount(chExpectedText), "Verify Breakpoint got hit at FUNC(void, OS_CALLOUT_CODE) PreTaskHook(void)"); 
  TestStepAddActionExpected( chActionText, chExpectedText );
  A_DBGR_BreakpointSet("PreTaskHook");  
  A_DBGR_Go(); 
  E_DBGR_BreakpointCheckForHalt("PreTaskHook");
  
  
  snprintf( chActionText, elCount(chActionText), "Run Software and check breakpoint got hit at function MngTSKR_e_PreTaskCPU2();   "); 
  snprintf( chExpectedText, elCount(chExpectedText), "Verify Software is Running and breakpoint got hit at function MngTSKR_e_PreTaskCPU2();"); 
  TestStepAddActionExpected( chActionText, chExpectedText );
  A_DBGR_BreakpointDeleteAll();
  A_DBGR_BreakpointSet("MngTSKR_e_PreTaskCPU2");
  A_DBGR_Go(); 
  E_DBGR_BreakpointCheckForHalt("MngTSKR_e_PreTaskCPU2");
 
}




/***************************************************************************************************
----------------------------------------------------------------------------------------------------
Test case name:  TC_L30SW_Q-36542215: Testcase_to_verify_the_functionality_of_interface_MngTSKR_e_PreTask_shall_be_triggred_before_the_task_is_invoked_for_CPU3
----------------------------------------------------------------------------------------------------
Description:  Test case to verify the functionality of interface MngTSKR_e_PreTask() shall be triggred before the task is invoked.

***************************************************************************************************/
testcase Testcase_to_verify_the_functionality_of_interface_MngTSKR_e_PreTask_shall_be_triggred_before_the_task_is_invoked_for_CPU3()
{
  /***************************************************************************************************************/    
                                                // Variable Definition
  /***************************************************************************************************************/ 
  
  long taskvalue;
  
  /***************************************************************************************************************/    
                                               // Local Values
  /***************************************************************************************************************/ 
  

  
  /***************************************************************************************************************/    
                                              // Test Case Info
  /***************************************************************************************************************/
  setWriteDbgLevel(DebugOff);
  snprintf( chTestTitle, elCount(chTestTitle), "Testcase_to_verify_the_functionality_of_interface_MngTSKR_e_PreTask_shall_be_triggred_before_the_task_is_invoked_for_CPU3" );
  snprintf( chTestDescription, elCount(chTestDescription), "Purose: Test case to verify the functionality of interface MngTSKR_e_PreTask() shall be triggred before the task is invoked.");
  TestCaseAddInfo( chTestTitle, "TC_L30SW_Q-36542215", chTestDescription );

  /***************************************************************************************************************/    
                                              // Start of Test Case
  /***************************************************************************************************************/
  
  /***************************************************************************************************************/    
                                              // Test Step 1 PRECONDITIONS
  /***************************************************************************************************************/
  
  snprintf( chActionText, elCount(chActionText), "Flash the Software and ECU is running"); 
  snprintf( chExpectedText, elCount(chExpectedText), "ECU should be in running state"); 
  TestStepAddActionExpected( chActionText, chExpectedText );

  A_DBGR_BreakpointDeleteAll();
  A_DBGR_RnGo();
  E_DBGR_CheckState(T32_State_Running);
  

   /***************************************************************************************************************/    
            // Test Step 2: Check all cores are in running state                                   
  /***************************************************************************************************************/
  
  //Check Core0 is running
  snprintf( chActionText, elCount(chActionText), "Check 1000ms Task Counter from Core0 "); 
  snprintf( chExpectedText, elCount(chExpectedText), "1000ms Counter from Core0 is incrementing"); 
  TestStepAddActionExpected( chActionText, chExpectedText );
  A_DBGR_VariableRead( "Task_Core0_1000ms_Count", taskvalue);
  E_DBGR_VariableCheck("Task_Core0_1000ms_Count", taskvalue, Greater);
  
  //Check Core1 is running
  snprintf( chActionText, elCount(chActionText), "Check 1000ms Task Counter from Core1 "); 
  snprintf( chExpectedText, elCount(chExpectedText), "1000ms Counter from Core1 is incrementing"); 
  TestStepAddActionExpected( chActionText, chExpectedText );
  A_DBGR_VariableRead( "Task_Core1_1000ms_Count", taskvalue);
  E_DBGR_VariableCheck("Task_Core1_1000ms_Count", taskvalue, Greater);
  
  //Check Core2 is running
  snprintf( chActionText, elCount(chActionText), "Check 1000ms Task Counter from Core2 "); 
  snprintf( chExpectedText, elCount(chExpectedText), "1000ms Counter from Core2 is incrementing"); 
  TestStepAddActionExpected( chActionText, chExpectedText );
  A_DBGR_VariableRead( "Task_Core2_1000ms_Count", taskvalue);
  E_DBGR_VariableCheck("Task_Core2_1000ms_Count", taskvalue, Greater);
    
  //Check Core3 is running
  snprintf( chActionText, elCount(chActionText), "Check 1000ms Task Counter from Core3 "); 
  snprintf( chExpectedText, elCount(chExpectedText), "1000ms Counter from Core3 is incrementing"); 
  TestStepAddActionExpected( chActionText, chExpectedText );
  A_DBGR_VariableRead( "Task_Core3_1000ms_Count", taskvalue);
  E_DBGR_VariableCheck("Task_Core3_1000ms_Count", taskvalue, Greater);
    
  //Check Core4 is running
  snprintf( chActionText, elCount(chActionText), "Check 1000ms Task Counter from Core4 "); 
  snprintf( chExpectedText, elCount(chExpectedText), "1000ms Counter from Core4 is incrementing"); 
  TestStepAddActionExpected( chActionText, chExpectedText );
  A_DBGR_VariableRead( "Task_Core4_1000ms_Count", taskvalue);
  E_DBGR_VariableCheck("Task_Core4_1000ms_Count", taskvalue, Greater);
    
  //Check Core5 is running
  snprintf( chActionText, elCount(chActionText), "Check 1000ms Task Counter from Core5 "); 
  snprintf( chExpectedText, elCount(chExpectedText), "1000ms Counter from Core5 is incrementing"); 
  TestStepAddActionExpected( chActionText, chExpectedText );
  A_DBGR_VariableRead( "Task_Core5_1000ms_Count", taskvalue);
  E_DBGR_VariableCheck("Task_Core5_1000ms_Count", taskvalue, Greater);
  
  /***************************************************************************************************************/    
    // Test Step 3: Set breakpoint at function FUNC(void, OS_CALLOUT_CODE) PreTaskHook(void) and  MngTSKR_e_PreTaskCPU3( ) and check function called
  /***************************************************************************************************************/

  snprintf( chActionText, elCount(chActionText), "Set Breakpoint at FUNC(void, OS_CALLOUT_CODE) PreTaskHook(void), Run SW & check Break point got hit "); 
  snprintf( chExpectedText, elCount(chExpectedText), "Verify Breakpoint got hit at FUNC(void, OS_CALLOUT_CODE) PreTaskHook(void)"); 
  TestStepAddActionExpected( chActionText, chExpectedText );
  A_DBGR_BreakpointSet("PreTaskHook");  
  A_DBGR_Go(); 
  E_DBGR_BreakpointCheckForHalt("PreTaskHook");
  
  
  snprintf( chActionText, elCount(chActionText), "Run Software and check breakpoint got hit at function MngTSKR_e_PreTaskCPU3();   "); 
  snprintf( chExpectedText, elCount(chExpectedText), "Verify Software is Running and breakpoint got hit at function MngTSKR_e_PreTaskCPU3();"); 
  TestStepAddActionExpected( chActionText, chExpectedText );
  A_DBGR_BreakpointDeleteAll();
  A_DBGR_BreakpointSet("MngTSKR_e_PreTaskCPU3");
  A_DBGR_Go(); 
  E_DBGR_BreakpointCheckForHalt("MngTSKR_e_PreTaskCPU3");
 
}





/***************************************************************************************************
----------------------------------------------------------------------------------------------------
Test case name:  TC_L30SW_Q-36542216: Testcase_to_verify_the_functionality_of_interface_MngTSKR_e_PreTask_shall_be_triggred_before_the_task_is_invoked_for_CPU4
----------------------------------------------------------------------------------------------------
Description:  Test case to verify the functionality of interface MngTSKR_e_PreTaskCPU4() shall be triggred before the task is invoked.

***************************************************************************************************/
testcase Testcase_to_verify_the_functionality_of_interface_MngTSKR_e_PreTask_shall_be_triggred_before_the_task_is_invoked_for_CPU4()
{
  /***************************************************************************************************************/    
                                                // Variable Definition
  /***************************************************************************************************************/ 
  
  long taskvalue;
  
  /***************************************************************************************************************/    
                                               // Local Values
  /***************************************************************************************************************/ 
  

  
  /***************************************************************************************************************/    
                                              // Test Case Info
  /***************************************************************************************************************/
  setWriteDbgLevel(DebugOff);
  snprintf( chTestTitle, elCount(chTestTitle), "Testcase_to_verify_the_functionality_of_interface_MngTSKR_e_PreTask_shall_be_triggred_before_the_task_is_invoked_for_CPU4" );
  snprintf( chTestDescription, elCount(chTestDescription), "Purose: Test case to verify the functionality of interface MngTSKR_e_PreTask() shall be triggred before the task is invoked.");
  TestCaseAddInfo( chTestTitle, "TC_L30SW_Q-36542216", chTestDescription );

  /***************************************************************************************************************/    
                                              // Start of Test Case
  /***************************************************************************************************************/
  
  /***************************************************************************************************************/    
                                              // Test Step 1 PRECONDITIONS
  /***************************************************************************************************************/
  
  snprintf( chActionText, elCount(chActionText), "Flash the Software and ECU is running"); 
  snprintf( chExpectedText, elCount(chExpectedText), "ECU should be in running state"); 
  TestStepAddActionExpected( chActionText, chExpectedText );

  A_DBGR_BreakpointDeleteAll();
  A_DBGR_RnGo();
  E_DBGR_CheckState(T32_State_Running);
  

   /***************************************************************************************************************/    
            // Test Step 2: Check all cores are in running state                                   
  /***************************************************************************************************************/
  
  //Check Core0 is running
  snprintf( chActionText, elCount(chActionText), "Check 1000ms Task Counter from Core0 "); 
  snprintf( chExpectedText, elCount(chExpectedText), "1000ms Counter from Core0 is incrementing"); 
  TestStepAddActionExpected( chActionText, chExpectedText );
  A_DBGR_VariableRead( "Task_Core0_1000ms_Count", taskvalue);
  E_DBGR_VariableCheck("Task_Core0_1000ms_Count", taskvalue, Greater);
  
  //Check Core1 is running
  snprintf( chActionText, elCount(chActionText), "Check 1000ms Task Counter from Core1 "); 
  snprintf( chExpectedText, elCount(chExpectedText), "1000ms Counter from Core1 is incrementing"); 
  TestStepAddActionExpected( chActionText, chExpectedText );
  A_DBGR_VariableRead( "Task_Core1_1000ms_Count", taskvalue);
  E_DBGR_VariableCheck("Task_Core1_1000ms_Count", taskvalue, Greater);
  
  //Check Core2 is running
  snprintf( chActionText, elCount(chActionText), "Check 1000ms Task Counter from Core2 "); 
  snprintf( chExpectedText, elCount(chExpectedText), "1000ms Counter from Core2 is incrementing"); 
  TestStepAddActionExpected( chActionText, chExpectedText );
  A_DBGR_VariableRead( "Task_Core2_1000ms_Count", taskvalue);
  E_DBGR_VariableCheck("Task_Core2_1000ms_Count", taskvalue, Greater);
    
  //Check Core3 is running
  snprintf( chActionText, elCount(chActionText), "Check 1000ms Task Counter from Core3 "); 
  snprintf( chExpectedText, elCount(chExpectedText), "1000ms Counter from Core3 is incrementing"); 
  TestStepAddActionExpected( chActionText, chExpectedText );
  A_DBGR_VariableRead( "Task_Core3_1000ms_Count", taskvalue);
  E_DBGR_VariableCheck("Task_Core3_1000ms_Count", taskvalue, Greater);
    
  //Check Core4 is running
  snprintf( chActionText, elCount(chActionText), "Check 1000ms Task Counter from Core4 "); 
  snprintf( chExpectedText, elCount(chExpectedText), "1000ms Counter from Core4 is incrementing"); 
  TestStepAddActionExpected( chActionText, chExpectedText );
  A_DBGR_VariableRead( "Task_Core4_1000ms_Count", taskvalue);
  E_DBGR_VariableCheck("Task_Core4_1000ms_Count", taskvalue, Greater);
    
  //Check Core5 is running
  snprintf( chActionText, elCount(chActionText), "Check 1000ms Task Counter from Core5 "); 
  snprintf( chExpectedText, elCount(chExpectedText), "1000ms Counter from Core5 is incrementing"); 
  TestStepAddActionExpected( chActionText, chExpectedText );
  A_DBGR_VariableRead( "Task_Core5_1000ms_Count", taskvalue);
  E_DBGR_VariableCheck("Task_Core5_1000ms_Count", taskvalue, Greater);
  
  /***************************************************************************************************************/    
    // Test Step 3: Set breakpoint at function FUNC(void, OS_CALLOUT_CODE) PreTaskHook(void) and  MngTSKR_e_PreTaskCPU4( ) and check function called
  /***************************************************************************************************************/

  snprintf( chActionText, elCount(chActionText), "Set Breakpoint at FUNC(void, OS_CALLOUT_CODE) PreTaskHook(void), Run SW & check Break point got hit "); 
  snprintf( chExpectedText, elCount(chExpectedText), "Verify Breakpoint got hit at FUNC(void, OS_CALLOUT_CODE) PreTaskHook(void)"); 
  TestStepAddActionExpected( chActionText, chExpectedText );
  A_DBGR_BreakpointSet("PreTaskHook");  
  A_DBGR_Go(); 
  E_DBGR_BreakpointCheckForHalt("PreTaskHook");
  
  
  snprintf( chActionText, elCount(chActionText), "Run Software and check breakpoint got hit at function MngTSKR_e_PreTaskCPU4();   "); 
  snprintf( chExpectedText, elCount(chExpectedText), "Verify Software is Running and breakpoint got hit at function MngTSKR_e_PreTaskCPU4();"); 
  TestStepAddActionExpected( chActionText, chExpectedText );
  A_DBGR_BreakpointDeleteAll();
  A_DBGR_BreakpointSet("MngTSKR_e_PreTaskCPU4");
  A_DBGR_Go(); 
  E_DBGR_BreakpointCheckForHalt("MngTSKR_e_PreTaskCPU4");
 
}





/***************************************************************************************************
----------------------------------------------------------------------------------------------------
Test case name:  TC_L30SW_Q-36542217: Testcase_to_verify_the_functionality_of_interface_MngTSKR_e_PreTask_shall_be_triggred_before_the_task_is_invoked_for_CPU5
----------------------------------------------------------------------------------------------------
Description:  Test case to verify the functionality of interface MngTSKR_e_PreTaskCPU5() shall be triggred before the task is invoked.

***************************************************************************************************/
testcase Testcase_to_verify_the_functionality_of_interface_MngTSKR_e_PreTask_shall_be_triggred_before_the_task_is_invoked_for_CPU5()
{
  /***************************************************************************************************************/    
                                                // Variable Definition
  /***************************************************************************************************************/ 
  
  long taskvalue;
  
  /***************************************************************************************************************/    
                                               // Local Values
  /***************************************************************************************************************/ 
  

  
  /***************************************************************************************************************/    
                                              // Test Case Info
  /***************************************************************************************************************/
  setWriteDbgLevel(DebugOff);
  snprintf( chTestTitle, elCount(chTestTitle), "Testcase_to_verify_the_functionality_of_interface_MngTSKR_e_PreTask_shall_be_triggred_before_the_task_is_invoked_for_CPU5" );
  snprintf( chTestDescription, elCount(chTestDescription), "Purose: Test case to verify the functionality of interface MngTSKR_e_PreTask() shall be triggred before the task is invoked.");
  TestCaseAddInfo( chTestTitle, "TC_L30SW_Q-36542217", chTestDescription );

  /***************************************************************************************************************/    
                                              // Start of Test Case
  /***************************************************************************************************************/
  
  /***************************************************************************************************************/    
                                              // Test Step 1 PRECONDITIONS
  /***************************************************************************************************************/
  
  snprintf( chActionText, elCount(chActionText), "Flash the Software and ECU is running"); 
  snprintf( chExpectedText, elCount(chExpectedText), "ECU should be in running state"); 
  TestStepAddActionExpected( chActionText, chExpectedText );

  A_DBGR_BreakpointDeleteAll();
  A_DBGR_RnGo();
  E_DBGR_CheckState(T32_State_Running);
  

   /***************************************************************************************************************/    
            // Test Step 2: Check all cores are in running state                                   
  /***************************************************************************************************************/
  
  //Check Core0 is running
  snprintf( chActionText, elCount(chActionText), "Check 1000ms Task Counter from Core0 "); 
  snprintf( chExpectedText, elCount(chExpectedText), "1000ms Counter from Core0 is incrementing"); 
  TestStepAddActionExpected( chActionText, chExpectedText );
  A_DBGR_VariableRead( "Task_Core0_1000ms_Count", taskvalue);
  E_DBGR_VariableCheck("Task_Core0_1000ms_Count", taskvalue, Greater);
  
  //Check Core1 is running
  snprintf( chActionText, elCount(chActionText), "Check 1000ms Task Counter from Core1 "); 
  snprintf( chExpectedText, elCount(chExpectedText), "1000ms Counter from Core1 is incrementing"); 
  TestStepAddActionExpected( chActionText, chExpectedText );
  A_DBGR_VariableRead( "Task_Core1_1000ms_Count", taskvalue);
  E_DBGR_VariableCheck("Task_Core1_1000ms_Count", taskvalue, Greater);
  
  //Check Core2 is running
  snprintf( chActionText, elCount(chActionText), "Check 1000ms Task Counter from Core2 "); 
  snprintf( chExpectedText, elCount(chExpectedText), "1000ms Counter from Core2 is incrementing"); 
  TestStepAddActionExpected( chActionText, chExpectedText );
  A_DBGR_VariableRead( "Task_Core2_1000ms_Count", taskvalue);
  E_DBGR_VariableCheck("Task_Core2_1000ms_Count", taskvalue, Greater);
    
  //Check Core3 is running
  snprintf( chActionText, elCount(chActionText), "Check 1000ms Task Counter from Core3 "); 
  snprintf( chExpectedText, elCount(chExpectedText), "1000ms Counter from Core3 is incrementing"); 
  TestStepAddActionExpected( chActionText, chExpectedText );
  A_DBGR_VariableRead( "Task_Core3_1000ms_Count", taskvalue);
  E_DBGR_VariableCheck("Task_Core3_1000ms_Count", taskvalue, Greater);
    
  //Check Core4 is running
  snprintf( chActionText, elCount(chActionText), "Check 1000ms Task Counter from Core4 "); 
  snprintf( chExpectedText, elCount(chExpectedText), "1000ms Counter from Core4 is incrementing"); 
  TestStepAddActionExpected( chActionText, chExpectedText );
  A_DBGR_VariableRead( "Task_Core4_1000ms_Count", taskvalue);
  E_DBGR_VariableCheck("Task_Core4_1000ms_Count", taskvalue, Greater);
    
  //Check Core5 is running
  snprintf( chActionText, elCount(chActionText), "Check 1000ms Task Counter from Core5 "); 
  snprintf( chExpectedText, elCount(chExpectedText), "1000ms Counter from Core5 is incrementing"); 
  TestStepAddActionExpected( chActionText, chExpectedText );
  A_DBGR_VariableRead( "Task_Core5_1000ms_Count", taskvalue);
  E_DBGR_VariableCheck("Task_Core5_1000ms_Count", taskvalue, Greater);
  
  /***************************************************************************************************************/    
    // Test Step 3: Set breakpoint at function FUNC(void, OS_CALLOUT_CODE) PreTaskHook(void) and  MngTSKR_e_PreTaskCPU5( ) and check function called
  /***************************************************************************************************************/

  snprintf( chActionText, elCount(chActionText), "Set Breakpoint at FUNC(void, OS_CALLOUT_CODE) PreTaskHook(void), Run SW & check Break point got hit "); 
  snprintf( chExpectedText, elCount(chExpectedText), "Verify Breakpoint got hit at FUNC(void, OS_CALLOUT_CODE) PreTaskHook(void)"); 
  TestStepAddActionExpected( chActionText, chExpectedText );
  A_DBGR_BreakpointSet("PreTaskHook");  
  A_DBGR_Go(); 
  E_DBGR_BreakpointCheckForHalt("PreTaskHook");
  
  
  snprintf( chActionText, elCount(chActionText), "Run Software and check breakpoint got hit at function MngTSKR_e_PreTaskCPU5();   "); 
  snprintf( chExpectedText, elCount(chExpectedText), "Verify Software is Running and breakpoint got hit at function MngTSKR_e_PreTaskCPU5();"); 
  TestStepAddActionExpected( chActionText, chExpectedText );
  A_DBGR_BreakpointDeleteAll();
  A_DBGR_BreakpointSet("MngTSKR_e_PreTaskCPU5");
  A_DBGR_Go(); 
  E_DBGR_BreakpointCheckForHalt("MngTSKR_e_PreTaskCPU5");
 
}





/***************************************************************************************************
----------------------------------------------------------------------------------------------------
Test case name:  TC_L30SW_Q-36542218: Testcase_to_verify_the_functionality_of_interface_MngTSKR_e_PostTask_shall_be_triggred_before_the_task_is_invoked_for_CPU0
----------------------------------------------------------------------------------------------------
Description:  Test case to verify the functionality of interface MngTSKR_e_PostTaskCP05() shall be triggred before the task is invoked.

***************************************************************************************************/
testcase Testcase_to_verify_the_functionality_of_interface_MngTSKR_e_PostTask_shall_be_triggred_before_the_task_is_invoked_for_CPU0()
{
  /***************************************************************************************************************/    
                                                // Variable Definition
  /***************************************************************************************************************/ 
  
  long taskvalue;
  
  /***************************************************************************************************************/    
                                               // Local Values
  /***************************************************************************************************************/ 
  

  
  /***************************************************************************************************************/    
                                              // Test Case Info
  /***************************************************************************************************************/
  setWriteDbgLevel(DebugOff);
  snprintf( chTestTitle, elCount(chTestTitle), "Testcase_to_verify_the_functionality_of_interface_MngTSKR_e_PostTask_shall_be_triggred_before_the_task_is_invoked_for_CPU0" );
  snprintf( chTestDescription, elCount(chTestDescription), "Purose: Test case to verify the functionality of interface MngTSKR_e_PostTask() shall be triggred before the task is invoked.");
  TestCaseAddInfo( chTestTitle, "TC_L30SW_Q-36542218", chTestDescription );

  /***************************************************************************************************************/    
                                              // Start of Test Case
  /***************************************************************************************************************/
  
  /***************************************************************************************************************/    
                                              // Test Step 1 PRECONDITIONS
  /***************************************************************************************************************/
  
  snprintf( chActionText, elCount(chActionText), "Flash the Software and ECU is running"); 
  snprintf( chExpectedText, elCount(chExpectedText), "ECU should be in running state"); 
  TestStepAddActionExpected( chActionText, chExpectedText );

  A_DBGR_BreakpointDeleteAll();
  A_DBGR_RnGo();
  E_DBGR_CheckState(T32_State_Running);
  

   /***************************************************************************************************************/    
            // Test Step 2: Check all cores are in running state                                   
  /***************************************************************************************************************/
  
  //Check Core0 is running
  snprintf( chActionText, elCount(chActionText), "Check 1000ms Task Counter from Core0 "); 
  snprintf( chExpectedText, elCount(chExpectedText), "1000ms Counter from Core0 is incrementing"); 
  TestStepAddActionExpected( chActionText, chExpectedText );
  A_DBGR_VariableRead( "Task_Core0_1000ms_Count", taskvalue);
  E_DBGR_VariableCheck("Task_Core0_1000ms_Count", taskvalue, Greater);
  
  //Check Core1 is running
  snprintf( chActionText, elCount(chActionText), "Check 1000ms Task Counter from Core1 "); 
  snprintf( chExpectedText, elCount(chExpectedText), "1000ms Counter from Core1 is incrementing"); 
  TestStepAddActionExpected( chActionText, chExpectedText );
  A_DBGR_VariableRead( "Task_Core1_1000ms_Count", taskvalue);
  E_DBGR_VariableCheck("Task_Core1_1000ms_Count", taskvalue, Greater);
  
  //Check Core2 is running
  snprintf( chActionText, elCount(chActionText), "Check 1000ms Task Counter from Core2 "); 
  snprintf( chExpectedText, elCount(chExpectedText), "1000ms Counter from Core2 is incrementing"); 
  TestStepAddActionExpected( chActionText, chExpectedText );
  A_DBGR_VariableRead( "Task_Core2_1000ms_Count", taskvalue);
  E_DBGR_VariableCheck("Task_Core2_1000ms_Count", taskvalue, Greater);
    
  //Check Core3 is running
  snprintf( chActionText, elCount(chActionText), "Check 1000ms Task Counter from Core3 "); 
  snprintf( chExpectedText, elCount(chExpectedText), "1000ms Counter from Core3 is incrementing"); 
  TestStepAddActionExpected( chActionText, chExpectedText );
  A_DBGR_VariableRead( "Task_Core3_1000ms_Count", taskvalue);
  E_DBGR_VariableCheck("Task_Core3_1000ms_Count", taskvalue, Greater);
    
  //Check Core4 is running
  snprintf( chActionText, elCount(chActionText), "Check 1000ms Task Counter from Core4 "); 
  snprintf( chExpectedText, elCount(chExpectedText), "1000ms Counter from Core4 is incrementing"); 
  TestStepAddActionExpected( chActionText, chExpectedText );
  A_DBGR_VariableRead( "Task_Core4_1000ms_Count", taskvalue);
  E_DBGR_VariableCheck("Task_Core4_1000ms_Count", taskvalue, Greater);
    
  //Check Core5 is running
  snprintf( chActionText, elCount(chActionText), "Check 1000ms Task Counter from Core5 "); 
  snprintf( chExpectedText, elCount(chExpectedText), "1000ms Counter from Core5 is incrementing"); 
  TestStepAddActionExpected( chActionText, chExpectedText );
  A_DBGR_VariableRead( "Task_Core5_1000ms_Count", taskvalue);
  E_DBGR_VariableCheck("Task_Core5_1000ms_Count", taskvalue, Greater);
  
  /***************************************************************************************************************/    
    // Test Step 3: Set breakpoint at function FUNC(void, OS_CALLOUT_CODE) PostTaskHook(void) and  MngTSKR_e_PostTaskCPU0( ) and check function called
  /***************************************************************************************************************/

  snprintf( chActionText, elCount(chActionText), "Set Breakpoint at FUNC(void, OS_CALLOUT_CODE) PostTaskHook(void), Run SW & check Break point got hit "); 
  snprintf( chExpectedText, elCount(chExpectedText), "Verify Breakpoint got hit at FUNC(void, OS_CALLOUT_CODE) PostTaskHook(void)"); 
  TestStepAddActionExpected( chActionText, chExpectedText );
  A_DBGR_BreakpointSet("PostTaskHook");  
  A_DBGR_Go(); 
  E_DBGR_BreakpointCheckForHalt("PostTaskHook");
  
  
  snprintf( chActionText, elCount(chActionText), "Run Software and check breakpoint got hit at function MngTSKR_e_PostTaskCPU0();   "); 
  snprintf( chExpectedText, elCount(chExpectedText), "Verify Software is Running and breakpoint got hit at function MngTSKR_e_PostTaskCPU0();"); 
  TestStepAddActionExpected( chActionText, chExpectedText );
  A_DBGR_BreakpointDeleteAll();
  A_DBGR_BreakpointSet("MngTSKR_e_PostTask");
  A_DBGR_Go(); 
  E_DBGR_BreakpointCheckForHalt("MngTSKR_e_PostTask");
 
}




/***************************************************************************************************
----------------------------------------------------------------------------------------------------
Test case name:  TC_L30SW_Q-36542219: Testcase_to_verify_the_functionality_of_interface_MngTSKR_e_PostTask_shall_be_triggred_before_the_task_is_invoked_for_CPU1
----------------------------------------------------------------------------------------------------
Description:  Test case to verify the functionality of interface MngTSKR_e_PostTask() shall be triggred before the task is invoked.

***************************************************************************************************/
testcase Testcase_to_verify_the_functionality_of_interface_MngTSKR_e_PostTask_shall_be_triggred_before_the_task_is_invoked_for_CPU1()
{
  /***************************************************************************************************************/    
                                                // Variable Definition
  /***************************************************************************************************************/ 
  
  long taskvalue;
  
  /***************************************************************************************************************/    
                                               // Local Values
  /***************************************************************************************************************/ 
  

  
  /***************************************************************************************************************/    
                                              // Test Case Info
  /***************************************************************************************************************/
  setWriteDbgLevel(DebugOff);
  snprintf( chTestTitle, elCount(chTestTitle), "Testcase_to_verify_the_functionality_of_interface_MngTSKR_e_PostTask_shall_be_triggred_before_the_task_is_invoked_for_CPU1" );
  snprintf( chTestDescription, elCount(chTestDescription), "Purose: Test case to verify the functionality of interface MngTSKR_e_PostTask() shall be triggred before the task is invoked.");
  TestCaseAddInfo( chTestTitle, "TC_L30SW_Q-36542219", chTestDescription );

  /***************************************************************************************************************/    
                                              // Start of Test Case
  /***************************************************************************************************************/
  
  /***************************************************************************************************************/    
                                              // Test Step 1 PRECONDITIONS
  /***************************************************************************************************************/
  
  snprintf( chActionText, elCount(chActionText), "Flash the Software and ECU is running"); 
  snprintf( chExpectedText, elCount(chExpectedText), "ECU should be in running state"); 
  TestStepAddActionExpected( chActionText, chExpectedText );

  A_DBGR_BreakpointDeleteAll();
  A_DBGR_RnGo();
  E_DBGR_CheckState(T32_State_Running);
  

   /***************************************************************************************************************/    
            // Test Step 2: Check all cores are in running state                                   
  /***************************************************************************************************************/
  
  //Check Core0 is running
  snprintf( chActionText, elCount(chActionText), "Check 1000ms Task Counter from Core0 "); 
  snprintf( chExpectedText, elCount(chExpectedText), "1000ms Counter from Core0 is incrementing"); 
  TestStepAddActionExpected( chActionText, chExpectedText );
  A_DBGR_VariableRead( "Task_Core0_1000ms_Count", taskvalue);
  E_DBGR_VariableCheck("Task_Core0_1000ms_Count", taskvalue, Greater);
  
  //Check Core1 is running
  snprintf( chActionText, elCount(chActionText), "Check 1000ms Task Counter from Core1 "); 
  snprintf( chExpectedText, elCount(chExpectedText), "1000ms Counter from Core1 is incrementing"); 
  TestStepAddActionExpected( chActionText, chExpectedText );
  A_DBGR_VariableRead( "Task_Core1_1000ms_Count", taskvalue);
  E_DBGR_VariableCheck("Task_Core1_1000ms_Count", taskvalue, Greater);
  
  //Check Core2 is running
  snprintf( chActionText, elCount(chActionText), "Check 1000ms Task Counter from Core2 "); 
  snprintf( chExpectedText, elCount(chExpectedText), "1000ms Counter from Core2 is incrementing"); 
  TestStepAddActionExpected( chActionText, chExpectedText );
  A_DBGR_VariableRead( "Task_Core2_1000ms_Count", taskvalue);
  E_DBGR_VariableCheck("Task_Core2_1000ms_Count", taskvalue, Greater);
    
  //Check Core3 is running
  snprintf( chActionText, elCount(chActionText), "Check 1000ms Task Counter from Core3 "); 
  snprintf( chExpectedText, elCount(chExpectedText), "1000ms Counter from Core3 is incrementing"); 
  TestStepAddActionExpected( chActionText, chExpectedText );
  A_DBGR_VariableRead( "Task_Core3_1000ms_Count", taskvalue);
  E_DBGR_VariableCheck("Task_Core3_1000ms_Count", taskvalue, Greater);
    
  //Check Core4 is running
  snprintf( chActionText, elCount(chActionText), "Check 1000ms Task Counter from Core4 "); 
  snprintf( chExpectedText, elCount(chExpectedText), "1000ms Counter from Core4 is incrementing"); 
  TestStepAddActionExpected( chActionText, chExpectedText );
  A_DBGR_VariableRead( "Task_Core4_1000ms_Count", taskvalue);
  E_DBGR_VariableCheck("Task_Core4_1000ms_Count", taskvalue, Greater);
    
  //Check Core5 is running
  snprintf( chActionText, elCount(chActionText), "Check 1000ms Task Counter from Core5 "); 
  snprintf( chExpectedText, elCount(chExpectedText), "1000ms Counter from Core5 is incrementing"); 
  TestStepAddActionExpected( chActionText, chExpectedText );
  A_DBGR_VariableRead( "Task_Core5_1000ms_Count", taskvalue);
  E_DBGR_VariableCheck("Task_Core5_1000ms_Count", taskvalue, Greater);
  
  /***************************************************************************************************************/    
    // Test Step 3: Set breakpoint at function FUNC(void, OS_CALLOUT_CODE) PostTaskHook(void) and  MngTSKR_e_PostTask( ) and check function called
  /***************************************************************************************************************/

  snprintf( chActionText, elCount(chActionText), "Set Breakpoint at FUNC(void, OS_CALLOUT_CODE) PostTaskHook(void), Run SW & check Break point got hit "); 
  snprintf( chExpectedText, elCount(chExpectedText), "Verify Breakpoint got hit at FUNC(void, OS_CALLOUT_CODE) PostTaskHook(void)"); 
  TestStepAddActionExpected( chActionText, chExpectedText );
  A_DBGR_BreakpointSet("PostTaskHook");  
  A_DBGR_Go(); 
  E_DBGR_BreakpointCheckForHalt("PostTaskHook");
  
  
  snprintf( chActionText, elCount(chActionText), "Run Software and check breakpoint got hit at function MngTSKR_e_PostTaskCPU1();   "); 
  snprintf( chExpectedText, elCount(chExpectedText), "Verify Software is Running and breakpoint got hit at function MngTSKR_e_PostTaskCPU1();"); 
  TestStepAddActionExpected( chActionText, chExpectedText );
  A_DBGR_BreakpointDeleteAll();
  A_DBGR_BreakpointSet("MngTSKR_e_PostTaskCPU1");
  A_DBGR_Go(); 
  E_DBGR_BreakpointCheckForHalt("MngTSKR_e_PostTaskCPU1");
 
}



/***************************************************************************************************
----------------------------------------------------------------------------------------------------
Test case name:  TC_L30SW_Q-36542220: Testcase_to_verify_the_functionality_of_interface_MngTSKR_e_PostTask_shall_be_triggred_before_the_task_is_invoked_for_CPU2
----------------------------------------------------------------------------------------------------
Description:  Test case to verify the functionality of interface MngTSKR_e_PostTask() shall be triggred before the task is invoked.

***************************************************************************************************/
testcase Testcase_to_verify_the_functionality_of_interface_MngTSKR_e_PostTask_shall_be_triggred_before_the_task_is_invoked_for_CPU2()
{
  /***************************************************************************************************************/    
                                                // Variable Definition
  /***************************************************************************************************************/ 
  
  long taskvalue;
  
  /***************************************************************************************************************/    
                                               // Local Values
  /***************************************************************************************************************/ 
  

  
  /***************************************************************************************************************/    
                                              // Test Case Info
  /***************************************************************************************************************/
  setWriteDbgLevel(DebugOff);
  snprintf( chTestTitle, elCount(chTestTitle), "Testcase_to_verify_the_functionality_of_interface_MngTSKR_e_PostTask_shall_be_triggred_before_the_task_is_invoked_for_CPU2" );
  snprintf( chTestDescription, elCount(chTestDescription), "Purose: Test case to verify the functionality of interface MngTSKR_e_PostTask() shall be triggred before the task is invoked.");
  TestCaseAddInfo( chTestTitle, "TC_L30SW_Q-36542220", chTestDescription );

  /***************************************************************************************************************/    
                                              // Start of Test Case
  /***************************************************************************************************************/
  
  /***************************************************************************************************************/    
                                              // Test Step 1 PRECONDITIONS
  /***************************************************************************************************************/
  
  snprintf( chActionText, elCount(chActionText), "Flash the Software and ECU is running"); 
  snprintf( chExpectedText, elCount(chExpectedText), "ECU should be in running state"); 
  TestStepAddActionExpected( chActionText, chExpectedText );

  A_DBGR_BreakpointDeleteAll();
  A_DBGR_RnGo();
  E_DBGR_CheckState(T32_State_Running);
  

   /***************************************************************************************************************/    
            // Test Step 2: Check all cores are in running state                                   
  /***************************************************************************************************************/
  
  //Check Core0 is running
  snprintf( chActionText, elCount(chActionText), "Check 1000ms Task Counter from Core0 "); 
  snprintf( chExpectedText, elCount(chExpectedText), "1000ms Counter from Core0 is incrementing"); 
  TestStepAddActionExpected( chActionText, chExpectedText );
  A_DBGR_VariableRead( "Task_Core0_1000ms_Count", taskvalue);
  E_DBGR_VariableCheck("Task_Core0_1000ms_Count", taskvalue, Greater);
  
  //Check Core1 is running
  snprintf( chActionText, elCount(chActionText), "Check 1000ms Task Counter from Core1 "); 
  snprintf( chExpectedText, elCount(chExpectedText), "1000ms Counter from Core1 is incrementing"); 
  TestStepAddActionExpected( chActionText, chExpectedText );
  A_DBGR_VariableRead( "Task_Core1_1000ms_Count", taskvalue);
  E_DBGR_VariableCheck("Task_Core1_1000ms_Count", taskvalue, Greater);
  
  //Check Core2 is running
  snprintf( chActionText, elCount(chActionText), "Check 1000ms Task Counter from Core2 "); 
  snprintf( chExpectedText, elCount(chExpectedText), "1000ms Counter from Core2 is incrementing"); 
  TestStepAddActionExpected( chActionText, chExpectedText );
  A_DBGR_VariableRead( "Task_Core2_1000ms_Count", taskvalue);
  E_DBGR_VariableCheck("Task_Core2_1000ms_Count", taskvalue, Greater);
    
  //Check Core3 is running
  snprintf( chActionText, elCount(chActionText), "Check 1000ms Task Counter from Core3 "); 
  snprintf( chExpectedText, elCount(chExpectedText), "1000ms Counter from Core3 is incrementing"); 
  TestStepAddActionExpected( chActionText, chExpectedText );
  A_DBGR_VariableRead( "Task_Core3_1000ms_Count", taskvalue);
  E_DBGR_VariableCheck("Task_Core3_1000ms_Count", taskvalue, Greater);
    
  //Check Core4 is running
  snprintf( chActionText, elCount(chActionText), "Check 1000ms Task Counter from Core4 "); 
  snprintf( chExpectedText, elCount(chExpectedText), "1000ms Counter from Core4 is incrementing"); 
  TestStepAddActionExpected( chActionText, chExpectedText );
  A_DBGR_VariableRead( "Task_Core4_1000ms_Count", taskvalue);
  E_DBGR_VariableCheck("Task_Core4_1000ms_Count", taskvalue, Greater);
    
  //Check Core5 is running
  snprintf( chActionText, elCount(chActionText), "Check 1000ms Task Counter from Core5 "); 
  snprintf( chExpectedText, elCount(chExpectedText), "1000ms Counter from Core5 is incrementing"); 
  TestStepAddActionExpected( chActionText, chExpectedText );
  A_DBGR_VariableRead( "Task_Core5_1000ms_Count", taskvalue);
  E_DBGR_VariableCheck("Task_Core5_1000ms_Count", taskvalue, Greater);
  
  /***************************************************************************************************************/    
    // Test Step 3: Set breakpoint at function FUNC(void, OS_CALLOUT_CODE) PostTaskHook(void) and  MngTSKR_e_PostTask( ) and check function called
  /***************************************************************************************************************/

  snprintf( chActionText, elCount(chActionText), "Set Breakpoint at FUNC(void, OS_CALLOUT_CODE) PostTaskHook(void), Run SW & check Break point got hit "); 
  snprintf( chExpectedText, elCount(chExpectedText), "Verify Breakpoint got hit at FUNC(void, OS_CALLOUT_CODE) PostTaskHook(void)"); 
  TestStepAddActionExpected( chActionText, chExpectedText );
  A_DBGR_BreakpointSet("PostTaskHook");  
  A_DBGR_Go(); 
  E_DBGR_BreakpointCheckForHalt("PostTaskHook");
  
  
  snprintf( chActionText, elCount(chActionText), "Run Software and check breakpoint got hit at function MngTSKR_e_PostTaskCPU2();   "); 
  snprintf( chExpectedText, elCount(chExpectedText), "Verify Software is Running and breakpoint got hit at function MngTSKR_e_PostTaskCPU2();"); 
  TestStepAddActionExpected( chActionText, chExpectedText );
  A_DBGR_BreakpointDeleteAll();
  A_DBGR_BreakpointSet("MngTSKR_e_PostTaskCPU2");
  A_DBGR_Go(); 
  E_DBGR_BreakpointCheckForHalt("MngTSKR_e_PostTaskCPU2");
 
}




/***************************************************************************************************
----------------------------------------------------------------------------------------------------
Test case name:  TC_L30SW_Q-36542221: Testcase_to_verify_the_functionality_of_interface_MngTSKR_e_PostTask_shall_be_triggred_before_the_task_is_invoked_for_CPU3
----------------------------------------------------------------------------------------------------
Description:  Test case to verify the functionality of interface MngTSKR_e_PostTask() shall be triggred before the task is invoked.

***************************************************************************************************/
testcase Testcase_to_verify_the_functionality_of_interface_MngTSKR_e_PostTask_shall_be_triggred_before_the_task_is_invoked_for_CPU3()
{
  /***************************************************************************************************************/    
                                                // Variable Definition
  /***************************************************************************************************************/ 
  
  long taskvalue;
  
  /***************************************************************************************************************/    
                                               // Local Values
  /***************************************************************************************************************/ 
  

  
  /***************************************************************************************************************/    
                                              // Test Case Info
  /***************************************************************************************************************/
  setWriteDbgLevel(DebugOff);
  snprintf( chTestTitle, elCount(chTestTitle), "Testcase_to_verify_the_functionality_of_interface_MngTSKR_e_PostTask_shall_be_triggred_before_the_task_is_invoked_for_CPU3" );
  snprintf( chTestDescription, elCount(chTestDescription), "Purose: Test case to verify the functionality of interface MngTSKR_e_PostTask() shall be triggred before the task is invoked.");
  TestCaseAddInfo( chTestTitle, "TC_L30SW_Q-36542221", chTestDescription );

  /***************************************************************************************************************/    
                                              // Start of Test Case
  /***************************************************************************************************************/
  
  /***************************************************************************************************************/    
                                              // Test Step 1 PRECONDITIONS
  /***************************************************************************************************************/
  
  snprintf( chActionText, elCount(chActionText), "Flash the Software and ECU is running"); 
  snprintf( chExpectedText, elCount(chExpectedText), "ECU should be in running state"); 
  TestStepAddActionExpected( chActionText, chExpectedText );

  A_DBGR_BreakpointDeleteAll();
  A_DBGR_RnGo();
  E_DBGR_CheckState(T32_State_Running);
  

   /***************************************************************************************************************/    
            // Test Step 2: Check all cores are in running state                                   
  /***************************************************************************************************************/
  
  //Check Core0 is running
  snprintf( chActionText, elCount(chActionText), "Check 1000ms Task Counter from Core0 "); 
  snprintf( chExpectedText, elCount(chExpectedText), "1000ms Counter from Core0 is incrementing"); 
  TestStepAddActionExpected( chActionText, chExpectedText );
  A_DBGR_VariableRead( "Task_Core0_1000ms_Count", taskvalue);
  E_DBGR_VariableCheck("Task_Core0_1000ms_Count", taskvalue, Greater);
  
  //Check Core1 is running
  snprintf( chActionText, elCount(chActionText), "Check 1000ms Task Counter from Core1 "); 
  snprintf( chExpectedText, elCount(chExpectedText), "1000ms Counter from Core1 is incrementing"); 
  TestStepAddActionExpected( chActionText, chExpectedText );
  A_DBGR_VariableRead( "Task_Core1_1000ms_Count", taskvalue);
  E_DBGR_VariableCheck("Task_Core1_1000ms_Count", taskvalue, Greater);
  
  //Check Core2 is running
  snprintf( chActionText, elCount(chActionText), "Check 1000ms Task Counter from Core2 "); 
  snprintf( chExpectedText, elCount(chExpectedText), "1000ms Counter from Core2 is incrementing"); 
  TestStepAddActionExpected( chActionText, chExpectedText );
  A_DBGR_VariableRead( "Task_Core2_1000ms_Count", taskvalue);
  E_DBGR_VariableCheck("Task_Core2_1000ms_Count", taskvalue, Greater);
    
  //Check Core3 is running
  snprintf( chActionText, elCount(chActionText), "Check 1000ms Task Counter from Core3 "); 
  snprintf( chExpectedText, elCount(chExpectedText), "1000ms Counter from Core3 is incrementing"); 
  TestStepAddActionExpected( chActionText, chExpectedText );
  A_DBGR_VariableRead( "Task_Core3_1000ms_Count", taskvalue);
  E_DBGR_VariableCheck("Task_Core3_1000ms_Count", taskvalue, Greater);
    
  //Check Core4 is running
  snprintf( chActionText, elCount(chActionText), "Check 1000ms Task Counter from Core4 "); 
  snprintf( chExpectedText, elCount(chExpectedText), "1000ms Counter from Core4 is incrementing"); 
  TestStepAddActionExpected( chActionText, chExpectedText );
  A_DBGR_VariableRead( "Task_Core4_1000ms_Count", taskvalue);
  E_DBGR_VariableCheck("Task_Core4_1000ms_Count", taskvalue, Greater);
    
  //Check Core5 is running
  snprintf( chActionText, elCount(chActionText), "Check 1000ms Task Counter from Core5 "); 
  snprintf( chExpectedText, elCount(chExpectedText), "1000ms Counter from Core5 is incrementing"); 
  TestStepAddActionExpected( chActionText, chExpectedText );
  A_DBGR_VariableRead( "Task_Core5_1000ms_Count", taskvalue);
  E_DBGR_VariableCheck("Task_Core5_1000ms_Count", taskvalue, Greater);
  
  /***************************************************************************************************************/    
    // Test Step 3: Set breakpoint at function FUNC(void, OS_CALLOUT_CODE) PostTaskHook(void) and  MngTSKR_e_PostTaskCPU3( ) and check function called
  /***************************************************************************************************************/

  snprintf( chActionText, elCount(chActionText), "Set Breakpoint at FUNC(void, OS_CALLOUT_CODE) PostTaskHook(void), Run SW & check Break point got hit "); 
  snprintf( chExpectedText, elCount(chExpectedText), "Verify Breakpoint got hit at FUNC(void, OS_CALLOUT_CODE) PostTaskHook(void)"); 
  TestStepAddActionExpected( chActionText, chExpectedText );
  A_DBGR_BreakpointSet("PostTaskHook");  
  A_DBGR_Go(); 
  E_DBGR_BreakpointCheckForHalt("PostTaskHook");
  
  
  snprintf( chActionText, elCount(chActionText), "Run Software and check breakpoint got hit at function MngTSKR_e_PostTaskCPU3();   "); 
  snprintf( chExpectedText, elCount(chExpectedText), "Verify Software is Running and breakpoint got hit at function MngTSKR_e_PostTaskCPU3();"); 
  TestStepAddActionExpected( chActionText, chExpectedText );
  A_DBGR_BreakpointDeleteAll();
  A_DBGR_BreakpointSet("MngTSKR_e_PostTaskCPU3");
  A_DBGR_Go(); 
  E_DBGR_BreakpointCheckForHalt("MngTSKR_e_PostTaskCPU3");
 
}





/***************************************************************************************************
----------------------------------------------------------------------------------------------------
Test case name:  TC_L30SW_Q-36542222: Testcase_to_verify_the_functionality_of_interface_MngTSKR_e_PostTask_shall_be_triggred_before_the_task_is_invoked_for_CPU4
----------------------------------------------------------------------------------------------------
Description:  Test case to verify the functionality of interface MngTSKR_e_PostTaskCPU4() shall be triggred before the task is invoked.

***************************************************************************************************/
testcase Testcase_to_verify_the_functionality_of_interface_MngTSKR_e_PostTask_shall_be_triggred_before_the_task_is_invoked_for_CPU4()
{
  /***************************************************************************************************************/    
                                                // Variable Definition
  /***************************************************************************************************************/ 
  
  long taskvalue;
  
  /***************************************************************************************************************/    
                                               // Local Values
  /***************************************************************************************************************/ 
  

  
  /***************************************************************************************************************/    
                                              // Test Case Info
  /***************************************************************************************************************/
  setWriteDbgLevel(DebugOff);
  snprintf( chTestTitle, elCount(chTestTitle), "Testcase_to_verify_the_functionality_of_interface_MngTSKR_e_PostTask_shall_be_triggred_before_the_task_is_invoked_for_CPU4" );
  snprintf( chTestDescription, elCount(chTestDescription), "Purose: Test case to verify the functionality of interface MngTSKR_e_PostTask() shall be triggred before the task is invoked.");
  TestCaseAddInfo( chTestTitle, "TC_L30SW_Q-36542222", chTestDescription );

  /***************************************************************************************************************/    
                                              // Start of Test Case
  /***************************************************************************************************************/
  
  /***************************************************************************************************************/    
                                              // Test Step 1 PRECONDITIONS
  /***************************************************************************************************************/
  
  snprintf( chActionText, elCount(chActionText), "Flash the Software and ECU is running"); 
  snprintf( chExpectedText, elCount(chExpectedText), "ECU should be in running state"); 
  TestStepAddActionExpected( chActionText, chExpectedText );

  A_DBGR_BreakpointDeleteAll();
  A_DBGR_RnGo();
  E_DBGR_CheckState(T32_State_Running);
  

   /***************************************************************************************************************/    
            // Test Step 2: Check all cores are in running state                                   
  /***************************************************************************************************************/
  
  //Check Core0 is running
  snprintf( chActionText, elCount(chActionText), "Check 1000ms Task Counter from Core0 "); 
  snprintf( chExpectedText, elCount(chExpectedText), "1000ms Counter from Core0 is incrementing"); 
  TestStepAddActionExpected( chActionText, chExpectedText );
  A_DBGR_VariableRead( "Task_Core0_1000ms_Count", taskvalue);
  E_DBGR_VariableCheck("Task_Core0_1000ms_Count", taskvalue, Greater);
  
  //Check Core1 is running
  snprintf( chActionText, elCount(chActionText), "Check 1000ms Task Counter from Core1 "); 
  snprintf( chExpectedText, elCount(chExpectedText), "1000ms Counter from Core1 is incrementing"); 
  TestStepAddActionExpected( chActionText, chExpectedText );
  A_DBGR_VariableRead( "Task_Core1_1000ms_Count", taskvalue);
  E_DBGR_VariableCheck("Task_Core1_1000ms_Count", taskvalue, Greater);
  
  //Check Core2 is running
  snprintf( chActionText, elCount(chActionText), "Check 1000ms Task Counter from Core2 "); 
  snprintf( chExpectedText, elCount(chExpectedText), "1000ms Counter from Core2 is incrementing"); 
  TestStepAddActionExpected( chActionText, chExpectedText );
  A_DBGR_VariableRead( "Task_Core2_1000ms_Count", taskvalue);
  E_DBGR_VariableCheck("Task_Core2_1000ms_Count", taskvalue, Greater);
    
  //Check Core3 is running
  snprintf( chActionText, elCount(chActionText), "Check 1000ms Task Counter from Core3 "); 
  snprintf( chExpectedText, elCount(chExpectedText), "1000ms Counter from Core3 is incrementing"); 
  TestStepAddActionExpected( chActionText, chExpectedText );
  A_DBGR_VariableRead( "Task_Core3_1000ms_Count", taskvalue);
  E_DBGR_VariableCheck("Task_Core3_1000ms_Count", taskvalue, Greater);
    
  //Check Core4 is running
  snprintf( chActionText, elCount(chActionText), "Check 1000ms Task Counter from Core4 "); 
  snprintf( chExpectedText, elCount(chExpectedText), "1000ms Counter from Core4 is incrementing"); 
  TestStepAddActionExpected( chActionText, chExpectedText );
  A_DBGR_VariableRead( "Task_Core4_1000ms_Count", taskvalue);
  E_DBGR_VariableCheck("Task_Core4_1000ms_Count", taskvalue, Greater);
    
  //Check Core5 is running
  snprintf( chActionText, elCount(chActionText), "Check 1000ms Task Counter from Core5 "); 
  snprintf( chExpectedText, elCount(chExpectedText), "1000ms Counter from Core5 is incrementing"); 
  TestStepAddActionExpected( chActionText, chExpectedText );
  A_DBGR_VariableRead( "Task_Core5_1000ms_Count", taskvalue);
  E_DBGR_VariableCheck("Task_Core5_1000ms_Count", taskvalue, Greater);
  
  /***************************************************************************************************************/    
    // Test Step 3: Set breakpoint at function FUNC(void, OS_CALLOUT_CODE) PostTaskHook(void) and  MngTSKR_e_PostTaskCPU4( ) and check function called
  /***************************************************************************************************************/

  snprintf( chActionText, elCount(chActionText), "Set Breakpoint at FUNC(void, OS_CALLOUT_CODE) PostTaskHook(void), Run SW & check Break point got hit "); 
  snprintf( chExpectedText, elCount(chExpectedText), "Verify Breakpoint got hit at FUNC(void, OS_CALLOUT_CODE) PostTaskHook(void)"); 
  TestStepAddActionExpected( chActionText, chExpectedText );
  A_DBGR_BreakpointSet("PostTaskHook");  
  A_DBGR_Go(); 
  E_DBGR_BreakpointCheckForHalt("PostTaskHook");
  
  
  snprintf( chActionText, elCount(chActionText), "Run Software and check breakpoint got hit at function MngTSKR_e_PostTaskCPU4();   "); 
  snprintf( chExpectedText, elCount(chExpectedText), "Verify Software is Running and breakpoint got hit at function MngTSKR_e_PostTaskCPU4();"); 
  TestStepAddActionExpected( chActionText, chExpectedText );
  A_DBGR_BreakpointDeleteAll();
  A_DBGR_BreakpointSet("MngTSKR_e_PostTaskCPU4");
  A_DBGR_Go(); 
  E_DBGR_BreakpointCheckForHalt("MngTSKR_e_PostTaskCPU4");
 
}





/***************************************************************************************************
----------------------------------------------------------------------------------------------------
Test case name:  TC_L30SW_Q-36542223: Testcase_to_verify_the_functionality_of_interface_MngTSKR_e_PostTask_shall_be_triggred_before_the_task_is_invoked_for_CPU5
----------------------------------------------------------------------------------------------------
Description:  Test case to verify the functionality of interface MngTSKR_e_PostTaskCPU5() shall be triggred before the task is invoked.

***************************************************************************************************/
testcase Testcase_to_verify_the_functionality_of_interface_MngTSKR_e_PostTask_shall_be_triggred_before_the_task_is_invoked_for_CPU5()
{
  /***************************************************************************************************************/    
                                                // Variable Definition
  /***************************************************************************************************************/ 
  
  long taskvalue;
  
  /***************************************************************************************************************/    
                                               // Local Values
  /***************************************************************************************************************/ 
  

  
  /***************************************************************************************************************/    
                                              // Test Case Info
  /***************************************************************************************************************/
  setWriteDbgLevel(DebugOff);
  snprintf( chTestTitle, elCount(chTestTitle), "Testcase_to_verify_the_functionality_of_interface_MngTSKR_e_PostTask_shall_be_triggred_before_the_task_is_invoked_for_CPU5" );
  snprintf( chTestDescription, elCount(chTestDescription), "Purose: Test case to verify the functionality of interface MngTSKR_e_PostTask() shall be triggred before the task is invoked.");
  TestCaseAddInfo( chTestTitle, "TC_L30SW_Q-36542223", chTestDescription );

  /***************************************************************************************************************/    
                                              // Start of Test Case
  /***************************************************************************************************************/
  
  /***************************************************************************************************************/    
                                              // Test Step 1 PRECONDITIONS
  /***************************************************************************************************************/
  
  snprintf( chActionText, elCount(chActionText), "Flash the Software and ECU is running"); 
  snprintf( chExpectedText, elCount(chExpectedText), "ECU should be in running state"); 
  TestStepAddActionExpected( chActionText, chExpectedText );

  A_DBGR_BreakpointDeleteAll();
  A_DBGR_RnGo();
  E_DBGR_CheckState(T32_State_Running);
  

   /***************************************************************************************************************/    
            // Test Step 2: Check all cores are in running state                                   
  /***************************************************************************************************************/
  
  //Check Core0 is running
  snprintf( chActionText, elCount(chActionText), "Check 1000ms Task Counter from Core0 "); 
  snprintf( chExpectedText, elCount(chExpectedText), "1000ms Counter from Core0 is incrementing"); 
  TestStepAddActionExpected( chActionText, chExpectedText );
  A_DBGR_VariableRead( "Task_Core0_1000ms_Count", taskvalue);
  E_DBGR_VariableCheck("Task_Core0_1000ms_Count", taskvalue, Greater);
  
  //Check Core1 is running
  snprintf( chActionText, elCount(chActionText), "Check 1000ms Task Counter from Core1 "); 
  snprintf( chExpectedText, elCount(chExpectedText), "1000ms Counter from Core1 is incrementing"); 
  TestStepAddActionExpected( chActionText, chExpectedText );
  A_DBGR_VariableRead( "Task_Core1_1000ms_Count", taskvalue);
  E_DBGR_VariableCheck("Task_Core1_1000ms_Count", taskvalue, Greater);
  
  //Check Core2 is running
  snprintf( chActionText, elCount(chActionText), "Check 1000ms Task Counter from Core2 "); 
  snprintf( chExpectedText, elCount(chExpectedText), "1000ms Counter from Core2 is incrementing"); 
  TestStepAddActionExpected( chActionText, chExpectedText );
  A_DBGR_VariableRead( "Task_Core2_1000ms_Count", taskvalue);
  E_DBGR_VariableCheck("Task_Core2_1000ms_Count", taskvalue, Greater);
    
  //Check Core3 is running
  snprintf( chActionText, elCount(chActionText), "Check 1000ms Task Counter from Core3 "); 
  snprintf( chExpectedText, elCount(chExpectedText), "1000ms Counter from Core3 is incrementing"); 
  TestStepAddActionExpected( chActionText, chExpectedText );
  A_DBGR_VariableRead( "Task_Core3_1000ms_Count", taskvalue);
  E_DBGR_VariableCheck("Task_Core3_1000ms_Count", taskvalue, Greater);
    
  //Check Core4 is running
  snprintf( chActionText, elCount(chActionText), "Check 1000ms Task Counter from Core4 "); 
  snprintf( chExpectedText, elCount(chExpectedText), "1000ms Counter from Core4 is incrementing"); 
  TestStepAddActionExpected( chActionText, chExpectedText );
  A_DBGR_VariableRead( "Task_Core4_1000ms_Count", taskvalue);
  E_DBGR_VariableCheck("Task_Core4_1000ms_Count", taskvalue, Greater);
    
  //Check Core5 is running
  snprintf( chActionText, elCount(chActionText), "Check 1000ms Task Counter from Core5 "); 
  snprintf( chExpectedText, elCount(chExpectedText), "1000ms Counter from Core5 is incrementing"); 
  TestStepAddActionExpected( chActionText, chExpectedText );
  A_DBGR_VariableRead( "Task_Core5_1000ms_Count", taskvalue);
  E_DBGR_VariableCheck("Task_Core5_1000ms_Count", taskvalue, Greater);
  
  /***************************************************************************************************************/    
    // Test Step 3: Set breakpoint at function FUNC(void, OS_CALLOUT_CODE) PostTaskHook(void) and  MngTSKR_e_PostTaskCPU5( ) and check function called
  /***************************************************************************************************************/

  snprintf( chActionText, elCount(chActionText), "Set Breakpoint at FUNC(void, OS_CALLOUT_CODE) PostTaskHook(void), Run SW & check Break point got hit "); 
  snprintf( chExpectedText, elCount(chExpectedText), "Verify Breakpoint got hit at FUNC(void, OS_CALLOUT_CODE) PostTaskHook(void)"); 
  TestStepAddActionExpected( chActionText, chExpectedText );
  A_DBGR_BreakpointSet("PostTaskHook");  
  A_DBGR_Go(); 
  E_DBGR_BreakpointCheckForHalt("PostTaskHook");
  
  
  snprintf( chActionText, elCount(chActionText), "Run Software and check breakpoint got hit at function MngTSKR_e_PostTaskCPU5();   "); 
  snprintf( chExpectedText, elCount(chExpectedText), "Verify Software is Running and breakpoint got hit at function MngTSKR_e_PostTaskCPU5();"); 
  TestStepAddActionExpected( chActionText, chExpectedText );
  A_DBGR_BreakpointDeleteAll();
  A_DBGR_BreakpointSet("MngTSKR_e_PostTaskCPU5");
  A_DBGR_Go(); 
  E_DBGR_BreakpointCheckForHalt("MngTSKR_e_PostTaskCPU5");
 
}


/***************************************************************************************************
----------------------------------------------------------------------------------------------------
Test case name:  TC_L30SW_Q-36655355: test case to verify the functionality of interface MngTSKR_TASKOS_TaskCPUx to trigger during normal task execution for CPU0 which is called from core0 1000ms task. (MngTSKR_1000msOS_Task)
----------------------------------------------------------------------------------------------------
Description:  test case to verify the functionality of interface MngTSKR_TASKOS_TaskCPUx to trigger during normal task execution for CPU0 which is called from core0 1000ms task. (MngTSKR_1000msOS_Task()

***************************************************************************************************/
testcase Testcase_to_verify_the_interface_MngTSKR_TASKOS_TaskCPUx_to_trigger_normal_task_execution_when_called_from_1000ms_task_for_CPU0()
{
  /***************************************************************************************************************/    
                                                // Variable Definition
  /***************************************************************************************************************/ 
  
  long taskvalue;
  
  /***************************************************************************************************************/    
                                               // Local Values
  /***************************************************************************************************************/ 
  

  
  /***************************************************************************************************************/    
                                              // Test Case Info
  /***************************************************************************************************************/
  setWriteDbgLevel(DebugOff);
  snprintf( chTestTitle, elCount(chTestTitle), "Testcase_to_verify_the_functionality_of_interface_MngTSKR_TASKOS_TaskCPUx_to_trigger_during_normal_task_execution_when_called_from_1000ms_task_for_CPU0" );
  snprintf( chTestDescription, elCount(chTestDescription), "Purose: test case to verify the functionality of interface MngTSKR_TASKOS_TaskCPUx to trigger during normal task execution for CPU0 which is called from core0 1000ms task. (MngTSKR_1000msOS_Task()");
  TestCaseAddInfo( chTestTitle, "TC_L30SW_Q-36655355", chTestDescription );

  /***************************************************************************************************************/    
                                              // Start of Test Case
  /***************************************************************************************************************/
  
  /***************************************************************************************************************/    
                                              // Test Step 1 PRECONDITIONS
  /***************************************************************************************************************/
  
  snprintf( chActionText, elCount(chActionText), "Flash the Software and ECU is running"); 
  snprintf( chExpectedText, elCount(chExpectedText), "ECU should be in running state"); 
  TestStepAddActionExpected( chActionText, chExpectedText );

  A_DBGR_BreakpointDeleteAll();
  A_DBGR_RnGo();
  E_DBGR_CheckState(T32_State_Running);
  

   /***************************************************************************************************************/    
            // Test Step 2: Check all cores are in running state                                   
  /***************************************************************************************************************/
  
  //Check Core0 is running
  snprintf( chActionText, elCount(chActionText), "Check 1000ms Task Counter from Core0 "); 
  snprintf( chExpectedText, elCount(chExpectedText), "1000ms Counter from Core0 is incrementing"); 
  TestStepAddActionExpected( chActionText, chExpectedText );
  A_DBGR_VariableRead( "Task_Core0_1000ms_Count", taskvalue);
  E_DBGR_VariableCheck("Task_Core0_1000ms_Count", taskvalue, Greater);
  
  //Check Core1 is running
  snprintf( chActionText, elCount(chActionText), "Check 1000ms Task Counter from Core1 "); 
  snprintf( chExpectedText, elCount(chExpectedText), "1000ms Counter from Core1 is incrementing"); 
  TestStepAddActionExpected( chActionText, chExpectedText );
  A_DBGR_VariableRead( "Task_Core1_1000ms_Count", taskvalue);
  E_DBGR_VariableCheck("Task_Core1_1000ms_Count", taskvalue, Greater);
  
  //Check Core2 is running
  snprintf( chActionText, elCount(chActionText), "Check 1000ms Task Counter from Core2 "); 
  snprintf( chExpectedText, elCount(chExpectedText), "1000ms Counter from Core2 is incrementing"); 
  TestStepAddActionExpected( chActionText, chExpectedText );
  A_DBGR_VariableRead( "Task_Core2_1000ms_Count", taskvalue);
  E_DBGR_VariableCheck("Task_Core2_1000ms_Count", taskvalue, Greater);
    
  //Check Core3 is running
  snprintf( chActionText, elCount(chActionText), "Check 1000ms Task Counter from Core3 "); 
  snprintf( chExpectedText, elCount(chExpectedText), "1000ms Counter from Core3 is incrementing"); 
  TestStepAddActionExpected( chActionText, chExpectedText );
  A_DBGR_VariableRead( "Task_Core3_1000ms_Count", taskvalue);
  E_DBGR_VariableCheck("Task_Core3_1000ms_Count", taskvalue, Greater);
    
  //Check Core4 is running
  snprintf( chActionText, elCount(chActionText), "Check 1000ms Task Counter from Core4 "); 
  snprintf( chExpectedText, elCount(chExpectedText), "1000ms Counter from Core4 is incrementing"); 
  TestStepAddActionExpected( chActionText, chExpectedText );
  A_DBGR_VariableRead( "Task_Core4_1000ms_Count", taskvalue);
  E_DBGR_VariableCheck("Task_Core4_1000ms_Count", taskvalue, Greater);
    
  //Check Core5 is running
  snprintf( chActionText, elCount(chActionText), "Check 1000ms Task Counter from Core5 "); 
  snprintf( chExpectedText, elCount(chExpectedText), "1000ms Counter from Core5 is incrementing"); 
  TestStepAddActionExpected( chActionText, chExpectedText );
  A_DBGR_VariableRead( "Task_Core5_1000ms_Count", taskvalue);
  E_DBGR_VariableCheck("Task_Core5_1000ms_Count", taskvalue, Greater);
  
  /*******************************************************************************************************************************************************/    
    // Test Step 3: Set Breakpoint in file OS_task.c at the entry of Core0 1000ms task TASK( Task_Core0_1000ms ) & at the Function MngTSKR_1000msOS_Task()
  /*******************************************************************************************************************************************************/

  snprintf( chActionText, elCount(chActionText), "Set Breakpoint in file OS_task.c at the entry of Core0 1000ms task TASK( Task_Core0_1000ms ), Run SW & check Break point got hit "); 
  snprintf( chExpectedText, elCount(chExpectedText), "Verify Breakpoint got hit at Core0 1000ms task TASK( Task_Core0_1000ms )"); 
  TestStepAddActionExpected( chActionText, chExpectedText );
  A_DBGR_BreakpointSet("Os_Entry_Task_Core0_1000ms");  
  A_DBGR_Go(); 
  E_DBGR_BreakpointCheckForHalt("Os_Entry_Task_Core0_1000ms");
  
  
  snprintf( chActionText, elCount(chActionText), "Run Software and check breakpoint got hit at function MngTSKR_1000msOS_Task();   "); 
  snprintf( chExpectedText, elCount(chExpectedText), "Verify Software is Running and breakpoint got hit at function MngTSKR_1000msOS_Task()"); 
  TestStepAddActionExpected( chActionText, chExpectedText );
  A_DBGR_BreakpointDeleteAll();
  A_DBGR_BreakpointSet("MngTSKR_1000msOS_Task");
  A_DBGR_Go(); 
  E_DBGR_BreakpointCheckForHalt("MngTSKR_1000msOS_Task");
 
}




/***************************************************************************************************
----------------------------------------------------------------------------------------------------
Test case name:  TC_L30SW_Q-36655356: test case to verify the functionality of interface MngTSKR_TASKOS_TaskCPUx to trigger during normal task execution for CPU0 which is called from core1 1000ms task. (MngTSKR_1000msOS_TaskCPU1)
----------------------------------------------------------------------------------------------------
Description: test case to verify the functionality of interface MngTSKR_TASKOS_TaskCPUx to trigger during normal task execution for CPU1 which is called from core1 1000ms task. (MngTSKR_1000msOS_TaskCPU1()

***************************************************************************************************/
testcase Testcase_to_verify_the_interface_MngTSKR_TASKOS_TaskCPUx_to_trigger_normal_task_execution_when_called_from_1000ms_task_for_CPU1()
{
  /***************************************************************************************************************/    
                                                // Variable Definition
  /***************************************************************************************************************/ 
  
  long taskvalue;
  
  /***************************************************************************************************************/    
                                               // Local Values
  /***************************************************************************************************************/ 
  

  
  /***************************************************************************************************************/    
                                              // Test Case Info
  /***************************************************************************************************************/
  setWriteDbgLevel(DebugOff);
  snprintf( chTestTitle, elCount(chTestTitle), "Testcase_to_verify_the_functionality_of_interface_MngTSKR_TASKOS_TaskCPUx_to_trigger_during_normal_task_execution_when_called_from_1000ms_task_for_CPU1" );
  snprintf( chTestDescription, elCount(chTestDescription), "Purose: test case to verify the functionality of interface MngTSKR_TASKOS_TaskCPUx to trigger during normal task execution for CPU1 which is called from core1 1000ms task. (MngTSKR_1000msOS_TaskCPU1()");
  TestCaseAddInfo( chTestTitle, "TC_L30SW_Q-36655356", chTestDescription );

  /***************************************************************************************************************/    
                                              // Start of Test Case
  /***************************************************************************************************************/
  
  /***************************************************************************************************************/    
                                              // Test Step 1 PRECONDITIONS
  /***************************************************************************************************************/
  
  snprintf( chActionText, elCount(chActionText), "Flash the Software and ECU is running"); 
  snprintf( chExpectedText, elCount(chExpectedText), "ECU should be in running state"); 
  TestStepAddActionExpected( chActionText, chExpectedText );

  A_DBGR_BreakpointDeleteAll();
  A_DBGR_RnGo();
  E_DBGR_CheckState(T32_State_Running);
  

   /***************************************************************************************************************/    
            // Test Step 2: Check all cores are in running state                                   
  /***************************************************************************************************************/
  
  //Check Core0 is running
  snprintf( chActionText, elCount(chActionText), "Check 1000ms Task Counter from Core0 "); 
  snprintf( chExpectedText, elCount(chExpectedText), "1000ms Counter from Core0 is incrementing"); 
  TestStepAddActionExpected( chActionText, chExpectedText );
  A_DBGR_VariableRead( "Task_Core0_1000ms_Count", taskvalue);
  E_DBGR_VariableCheck("Task_Core0_1000ms_Count", taskvalue, Greater);
  
  //Check Core1 is running
  snprintf( chActionText, elCount(chActionText), "Check 1000ms Task Counter from Core1 "); 
  snprintf( chExpectedText, elCount(chExpectedText), "1000ms Counter from Core1 is incrementing"); 
  TestStepAddActionExpected( chActionText, chExpectedText );
  A_DBGR_VariableRead( "Task_Core1_1000ms_Count", taskvalue);
  E_DBGR_VariableCheck("Task_Core1_1000ms_Count", taskvalue, Greater);
  
  //Check Core2 is running
  snprintf( chActionText, elCount(chActionText), "Check 1000ms Task Counter from Core2 "); 
  snprintf( chExpectedText, elCount(chExpectedText), "1000ms Counter from Core2 is incrementing"); 
  TestStepAddActionExpected( chActionText, chExpectedText );
  A_DBGR_VariableRead( "Task_Core2_1000ms_Count", taskvalue);
  E_DBGR_VariableCheck("Task_Core2_1000ms_Count", taskvalue, Greater);
    
  //Check Core3 is running
  snprintf( chActionText, elCount(chActionText), "Check 1000ms Task Counter from Core3 "); 
  snprintf( chExpectedText, elCount(chExpectedText), "1000ms Counter from Core3 is incrementing"); 
  TestStepAddActionExpected( chActionText, chExpectedText );
  A_DBGR_VariableRead( "Task_Core3_1000ms_Count", taskvalue);
  E_DBGR_VariableCheck("Task_Core3_1000ms_Count", taskvalue, Greater);
    
  //Check Core4 is running
  snprintf( chActionText, elCount(chActionText), "Check 1000ms Task Counter from Core4 "); 
  snprintf( chExpectedText, elCount(chExpectedText), "1000ms Counter from Core4 is incrementing"); 
  TestStepAddActionExpected( chActionText, chExpectedText );
  A_DBGR_VariableRead( "Task_Core4_1000ms_Count", taskvalue);
  E_DBGR_VariableCheck("Task_Core4_1000ms_Count", taskvalue, Greater);
    
  //Check Core5 is running
  snprintf( chActionText, elCount(chActionText), "Check 1000ms Task Counter from Core5 "); 
  snprintf( chExpectedText, elCount(chExpectedText), "1000ms Counter from Core5 is incrementing"); 
  TestStepAddActionExpected( chActionText, chExpectedText );
  A_DBGR_VariableRead( "Task_Core5_1000ms_Count", taskvalue);
  E_DBGR_VariableCheck("Task_Core5_1000ms_Count", taskvalue, Greater);
  
  /*******************************************************************************************************************************************************/    
    // Test Step 3: Set Breakpoint in file OS_task.c at the entry of Core1 1000ms task TASK( Task_Core1_1000ms ) & at the Function MngTSKR_1000msOS_Task()
  /*******************************************************************************************************************************************************/

  snprintf( chActionText, elCount(chActionText), "Set Breakpoint in file OS_task.c at the entry of Core0 1000ms task TASK( Task_Core1_1000ms ), Run SW & check Break point got hit "); 
  snprintf( chExpectedText, elCount(chExpectedText), "Verify Breakpoint got hit at Core1 1000ms task TASK( Task_Core1_1000ms )"); 
  TestStepAddActionExpected( chActionText, chExpectedText );
  A_DBGR_BreakpointSet("Os_Entry_Task_Core1_1000ms");  
  A_DBGR_Go(); 
  E_DBGR_BreakpointCheckForHalt("Os_Entry_Task_Core1_1000ms");
  
  
  snprintf( chActionText, elCount(chActionText), "Run Software and check breakpoint got hit at function MngTSKR_1000msOS_TaskCPU1();   "); 
  snprintf( chExpectedText, elCount(chExpectedText), "Verify Software is Running and breakpoint got hit at function MngTSKR_1000msOS_TaskCPU1()"); 
  TestStepAddActionExpected( chActionText, chExpectedText );
  A_DBGR_BreakpointDeleteAll();
  A_DBGR_BreakpointSet("MngTSKR_1000msOS_TaskCPU1");
  A_DBGR_Go(); 
  E_DBGR_BreakpointCheckForHalt("MngTSKR_1000msOS_TaskCPU1");
 
}



/***************************************************************************************************
----------------------------------------------------------------------------------------------------
Test case name:  TC_L30SW_Q-36655357: test case to verify the functionality of interface MngTSKR_TASKOS_TaskCPUx to trigger during normal task execution for CPU2 which is called from core2 1000ms task. (MngTSKR_1000msOS_TaskCPU2)
----------------------------------------------------------------------------------------------------
Description:  test case to verify the functionality of interface MngTSKR_TASKOS_TaskCPUx to trigger during normal task execution for CPU2 which is called from core2 1000ms task. (MngTSKR_1000msOS_TaskCPU2()

***************************************************************************************************/
testcase Testcase_to_verify_the_interface_MngTSKR_TASKOS_TaskCPUx_to_trigger_normal_task_execution_when_called_from_1000ms_task_for_CPU2()
{
  /***************************************************************************************************************/    
                                                // Variable Definition
  /***************************************************************************************************************/ 
  
  long taskvalue;
  
  /***************************************************************************************************************/    
                                               // Local Values
  /***************************************************************************************************************/ 
  

  
  /***************************************************************************************************************/    
                                              // Test Case Info
  /***************************************************************************************************************/
  setWriteDbgLevel(DebugOff);
  snprintf( chTestTitle, elCount(chTestTitle), "Testcase_to_verify_the_functionality_of_interface_MngTSKR_TASKOS_TaskCPUx_to_trigger_during_normal_task_execution_when_called_from_1000ms_task_for_CPU2" );
  snprintf( chTestDescription, elCount(chTestDescription), "Purose: test case to verify the functionality of interface MngTSKR_TASKOS_TaskCPUx to trigger during normal task execution for CPU2 which is called from core2 1000ms task. (MngTSKR_1000msOS_TaskCPU2()");
  TestCaseAddInfo( chTestTitle, "TC_L30SW_Q-36655357", chTestDescription );

  /***************************************************************************************************************/    
                                              // Start of Test Case
  /***************************************************************************************************************/
  
  /***************************************************************************************************************/    
                                              // Test Step 1 PRECONDITIONS
  /***************************************************************************************************************/
  
  snprintf( chActionText, elCount(chActionText), "Flash the Software and ECU is running"); 
  snprintf( chExpectedText, elCount(chExpectedText), "ECU should be in running state"); 
  TestStepAddActionExpected( chActionText, chExpectedText );

  A_DBGR_BreakpointDeleteAll();
  A_DBGR_RnGo();
  E_DBGR_CheckState(T32_State_Running);
  

   /***************************************************************************************************************/    
            // Test Step 2: Check all cores are in running state                                   
  /***************************************************************************************************************/
  
  //Check Core0 is running
  snprintf( chActionText, elCount(chActionText), "Check 1000ms Task Counter from Core0 "); 
  snprintf( chExpectedText, elCount(chExpectedText), "1000ms Counter from Core0 is incrementing"); 
  TestStepAddActionExpected( chActionText, chExpectedText );
  A_DBGR_VariableRead( "Task_Core0_1000ms_Count", taskvalue);
  E_DBGR_VariableCheck("Task_Core0_1000ms_Count", taskvalue, Greater);
  
  //Check Core1 is running
  snprintf( chActionText, elCount(chActionText), "Check 1000ms Task Counter from Core1 "); 
  snprintf( chExpectedText, elCount(chExpectedText), "1000ms Counter from Core1 is incrementing"); 
  TestStepAddActionExpected( chActionText, chExpectedText );
  A_DBGR_VariableRead( "Task_Core1_1000ms_Count", taskvalue);
  E_DBGR_VariableCheck("Task_Core1_1000ms_Count", taskvalue, Greater);
  
  //Check Core2 is running
  snprintf( chActionText, elCount(chActionText), "Check 1000ms Task Counter from Core2 "); 
  snprintf( chExpectedText, elCount(chExpectedText), "1000ms Counter from Core2 is incrementing"); 
  TestStepAddActionExpected( chActionText, chExpectedText );
  A_DBGR_VariableRead( "Task_Core2_1000ms_Count", taskvalue);
  E_DBGR_VariableCheck("Task_Core2_1000ms_Count", taskvalue, Greater);
    
  //Check Core3 is running
  snprintf( chActionText, elCount(chActionText), "Check 1000ms Task Counter from Core3 "); 
  snprintf( chExpectedText, elCount(chExpectedText), "1000ms Counter from Core3 is incrementing"); 
  TestStepAddActionExpected( chActionText, chExpectedText );
  A_DBGR_VariableRead( "Task_Core3_1000ms_Count", taskvalue);
  E_DBGR_VariableCheck("Task_Core3_1000ms_Count", taskvalue, Greater);
    
  //Check Core4 is running
  snprintf( chActionText, elCount(chActionText), "Check 1000ms Task Counter from Core4 "); 
  snprintf( chExpectedText, elCount(chExpectedText), "1000ms Counter from Core4 is incrementing"); 
  TestStepAddActionExpected( chActionText, chExpectedText );
  A_DBGR_VariableRead( "Task_Core4_1000ms_Count", taskvalue);
  E_DBGR_VariableCheck("Task_Core4_1000ms_Count", taskvalue, Greater);
    
  //Check Core5 is running
  snprintf( chActionText, elCount(chActionText), "Check 1000ms Task Counter from Core5 "); 
  snprintf( chExpectedText, elCount(chExpectedText), "1000ms Counter from Core5 is incrementing"); 
  TestStepAddActionExpected( chActionText, chExpectedText );
  A_DBGR_VariableRead( "Task_Core5_1000ms_Count", taskvalue);
  E_DBGR_VariableCheck("Task_Core5_1000ms_Count", taskvalue, Greater);
  
   /*******************************************************************************************************************************************************/    
    // Test Step 3: Set Breakpoint in file OS_task.c at the entry of Core2 1000ms task TASK( Task_Core2_1000ms ) & at the Function MngTSKR_1000msOS_Task()
  /*******************************************************************************************************************************************************/

  snprintf( chActionText, elCount(chActionText), "Set Breakpoint in file OS_task.c at the entry of Core0 1000ms task TASK( Task_Core2_1000ms ), Run SW & check Break point got hit "); 
  snprintf( chExpectedText, elCount(chExpectedText), "Verify Breakpoint got hit at Core2 1000ms task TASK( Task_Core2_1000ms )"); 
  TestStepAddActionExpected( chActionText, chExpectedText );
  A_DBGR_BreakpointSet("Os_Entry_Task_Core2_1000ms");  
  A_DBGR_Go(); 
  E_DBGR_BreakpointCheckForHalt("Os_Entry_Task_Core2_1000ms");
  
  
  snprintf( chActionText, elCount(chActionText), "Run Software and check breakpoint got hit at function MngTSKR_1000msOS_TaskCPU2();   "); 
  snprintf( chExpectedText, elCount(chExpectedText), "Verify Software is Running and breakpoint got hit at function MngTSKR_1000msOS_TaskCPU2()"); 
  TestStepAddActionExpected( chActionText, chExpectedText );
  A_DBGR_BreakpointDeleteAll();
  A_DBGR_BreakpointSet("MngTSKR_1000msOS_TaskCPU2");
  A_DBGR_Go(); 
  E_DBGR_BreakpointCheckForHalt("MngTSKR_1000msOS_TaskCPU2");
 
}




/***************************************************************************************************
----------------------------------------------------------------------------------------------------
Test case name:  TC_L30SW_Q-36655358: test case to verify the functionality of interface MngTSKR_TASKOS_TaskCPUx to trigger during normal task execution for CPU3 which is called from core3 1000ms task. (MngTSKR_1000msOS_TaskCPU3)
----------------------------------------------------------------------------------------------------
Description:  test case to verify the functionality of interface MngTSKR_TASKOS_TaskCPUx to trigger during normal task execution for CPU3 which is called from core3 1000ms task. (MngTSKR_1000msOS_TaskCPU3()

***************************************************************************************************/
testcase Testcase_to_verify_the_interface_MngTSKR_TASKOS_TaskCPUx_to_trigger_normal_task_execution_when_called_from_1000ms_task_for_CPU3()
{
  /***************************************************************************************************************/    
                                                // Variable Definition
  /***************************************************************************************************************/ 
  
  long taskvalue;
  
  /***************************************************************************************************************/    
                                               // Local Values
  /***************************************************************************************************************/ 
  

  
  /***************************************************************************************************************/    
                                              // Test Case Info
  /***************************************************************************************************************/
  setWriteDbgLevel(DebugOff);
  snprintf( chTestTitle, elCount(chTestTitle), "Testcase_to_verify_the_functionality_of_interface_MngTSKR_TASKOS_TaskCPUx_to_trigger_during_normal_task_execution_when_called_from_1000ms_task_for_CPU3" );
  snprintf( chTestDescription, elCount(chTestDescription), "Purose: test case to verify the functionality of interface MngTSKR_TASKOS_TaskCPUx to trigger during normal task execution for CPU3 which is called from core3 1000ms task. (MngTSKR_1000msOS_TaskCPU3()");
  TestCaseAddInfo( chTestTitle, "TC_L30SW_Q-36655358", chTestDescription );

  /***************************************************************************************************************/    
                                              // Start of Test Case
  /***************************************************************************************************************/
  
  /***************************************************************************************************************/    
                                              // Test Step 1 PRECONDITIONS
  /***************************************************************************************************************/
  
  snprintf( chActionText, elCount(chActionText), "Flash the Software and ECU is running"); 
  snprintf( chExpectedText, elCount(chExpectedText), "ECU should be in running state"); 
  TestStepAddActionExpected( chActionText, chExpectedText );

  A_DBGR_BreakpointDeleteAll();
  A_DBGR_RnGo();
  E_DBGR_CheckState(T32_State_Running);
  

   /***************************************************************************************************************/    
            // Test Step 2: Check all cores are in running state                                   
  /***************************************************************************************************************/
  
  //Check Core0 is running
  snprintf( chActionText, elCount(chActionText), "Check 1000ms Task Counter from Core0 "); 
  snprintf( chExpectedText, elCount(chExpectedText), "1000ms Counter from Core0 is incrementing"); 
  TestStepAddActionExpected( chActionText, chExpectedText );
  A_DBGR_VariableRead( "Task_Core0_1000ms_Count", taskvalue);
  E_DBGR_VariableCheck("Task_Core0_1000ms_Count", taskvalue, Greater);
  
  //Check Core1 is running
  snprintf( chActionText, elCount(chActionText), "Check 1000ms Task Counter from Core1 "); 
  snprintf( chExpectedText, elCount(chExpectedText), "1000ms Counter from Core1 is incrementing"); 
  TestStepAddActionExpected( chActionText, chExpectedText );
  A_DBGR_VariableRead( "Task_Core1_1000ms_Count", taskvalue);
  E_DBGR_VariableCheck("Task_Core1_1000ms_Count", taskvalue, Greater);
  
  //Check Core2 is running
  snprintf( chActionText, elCount(chActionText), "Check 1000ms Task Counter from Core2 "); 
  snprintf( chExpectedText, elCount(chExpectedText), "1000ms Counter from Core2 is incrementing"); 
  TestStepAddActionExpected( chActionText, chExpectedText );
  A_DBGR_VariableRead( "Task_Core2_1000ms_Count", taskvalue);
  E_DBGR_VariableCheck("Task_Core2_1000ms_Count", taskvalue, Greater);
    
  //Check Core3 is running
  snprintf( chActionText, elCount(chActionText), "Check 1000ms Task Counter from Core3 "); 
  snprintf( chExpectedText, elCount(chExpectedText), "1000ms Counter from Core3 is incrementing"); 
  TestStepAddActionExpected( chActionText, chExpectedText );
  A_DBGR_VariableRead( "Task_Core3_1000ms_Count", taskvalue);
  E_DBGR_VariableCheck("Task_Core3_1000ms_Count", taskvalue, Greater);
    
  //Check Core4 is running
  snprintf( chActionText, elCount(chActionText), "Check 1000ms Task Counter from Core4 "); 
  snprintf( chExpectedText, elCount(chExpectedText), "1000ms Counter from Core4 is incrementing"); 
  TestStepAddActionExpected( chActionText, chExpectedText );
  A_DBGR_VariableRead( "Task_Core4_1000ms_Count", taskvalue);
  E_DBGR_VariableCheck("Task_Core4_1000ms_Count", taskvalue, Greater);
    
  //Check Core5 is running
  snprintf( chActionText, elCount(chActionText), "Check 1000ms Task Counter from Core5 "); 
  snprintf( chExpectedText, elCount(chExpectedText), "1000ms Counter from Core5 is incrementing"); 
  TestStepAddActionExpected( chActionText, chExpectedText );
  A_DBGR_VariableRead( "Task_Core5_1000ms_Count", taskvalue);
  E_DBGR_VariableCheck("Task_Core5_1000ms_Count", taskvalue, Greater);
  
  /*******************************************************************************************************************************************************/    
    // Test Step 3: Set Breakpoint in file OS_task.c at the entry of Core3 1000ms task TASK( Task_Core3_1000ms ) & at the Function MngTSKR_1000msOS_Task()
  /*******************************************************************************************************************************************************/

  snprintf( chActionText, elCount(chActionText), "Set Breakpoint in file OS_task.c at the entry of Core0 1000ms task TASK( Task_Core3_1000ms ), Run SW & check Break point got hit "); 
  snprintf( chExpectedText, elCount(chExpectedText), "Verify Breakpoint got hit at Core3 1000ms task TASK( Task_Core3_1000ms )"); 
  TestStepAddActionExpected( chActionText, chExpectedText );
  A_DBGR_BreakpointSet("Os_Entry_Task_Core3_1000ms");  
  A_DBGR_Go(); 
  E_DBGR_BreakpointCheckForHalt("Os_Entry_Task_Core3_1000ms");
  
  
  snprintf( chActionText, elCount(chActionText), "Run Software and check breakpoint got hit at function MngTSKR_1000msOS_TaskCPU3();   "); 
  snprintf( chExpectedText, elCount(chExpectedText), "Verify Software is Running and breakpoint got hit at function MngTSKR_1000msOS_TaskCPU3()"); 
  TestStepAddActionExpected( chActionText, chExpectedText );
  A_DBGR_BreakpointDeleteAll();
  A_DBGR_BreakpointSet("MngTSKR_1000msOS_TaskCPU3");
  A_DBGR_Go(); 
  E_DBGR_BreakpointCheckForHalt("MngTSKR_1000msOS_TaskCPU3");
 
}





/***************************************************************************************************
----------------------------------------------------------------------------------------------------
Test case name:  TC_L30SW_Q-36655359: test case to verify the functionality of interface MngTSKR_TASKOS_TaskCPUx to trigger during normal task execution for CPU4 which is called from core4 1000ms task. (MngTSKR_1000msOS_TaskCPU4)
----------------------------------------------------------------------------------------------------
Description:  test case to verify the functionality of interface MngTSKR_TASKOS_TaskCPUx to trigger during normal task execution for CPU4 which is called from core4 1000ms task. (MngTSKR_1000msOS_TaskCPU4()

***************************************************************************************************/
testcase Testcase_to_verify_the_interface_MngTSKR_TASKOS_TaskCPUx_to_trigger_normal_task_execution_when_called_from_1000ms_task_for_CPU4()
{
  /***************************************************************************************************************/    
                                                // Variable Definition
  /***************************************************************************************************************/ 
  
  long taskvalue;
  
  /***************************************************************************************************************/    
                                               // Local Values
  /***************************************************************************************************************/ 
  

  
  /***************************************************************************************************************/    
                                              // Test Case Info
  /***************************************************************************************************************/
  setWriteDbgLevel(DebugOff);
  snprintf( chTestTitle, elCount(chTestTitle), "Testcase_to_verify_the_functionality_of_interface_MngTSKR_TASKOS_TaskCPUx_to_trigger_during_normal_task_execution_when_called_from_1000ms_task_for_CPU4" );
  snprintf( chTestDescription, elCount(chTestDescription), "Purose: test case to verify the functionality of interface MngTSKR_TASKOS_TaskCPUx to trigger during normal task execution for CPU4 which is called from core4 1000ms task. (MngTSKR_1000msOS_TaskCPU4().");
  TestCaseAddInfo( chTestTitle, "TC_L30SW_Q-36655359", chTestDescription );

  /***************************************************************************************************************/    
                                              // Start of Test Case
  /***************************************************************************************************************/
  
  /***************************************************************************************************************/    
                                              // Test Step 1 PRECONDITIONS
  /***************************************************************************************************************/
  
  snprintf( chActionText, elCount(chActionText), "Flash the Software and ECU is running"); 
  snprintf( chExpectedText, elCount(chExpectedText), "ECU should be in running state"); 
  TestStepAddActionExpected( chActionText, chExpectedText );

  A_DBGR_BreakpointDeleteAll();
  A_DBGR_RnGo();
  E_DBGR_CheckState(T32_State_Running);
  

   /***************************************************************************************************************/    
            // Test Step 2: Check all cores are in running state                                   
  /***************************************************************************************************************/
  
  //Check Core0 is running
  snprintf( chActionText, elCount(chActionText), "Check 1000ms Task Counter from Core0 "); 
  snprintf( chExpectedText, elCount(chExpectedText), "1000ms Counter from Core0 is incrementing"); 
  TestStepAddActionExpected( chActionText, chExpectedText );
  A_DBGR_VariableRead( "Task_Core0_1000ms_Count", taskvalue);
  E_DBGR_VariableCheck("Task_Core0_1000ms_Count", taskvalue, Greater);
  
  //Check Core1 is running
  snprintf( chActionText, elCount(chActionText), "Check 1000ms Task Counter from Core1 "); 
  snprintf( chExpectedText, elCount(chExpectedText), "1000ms Counter from Core1 is incrementing"); 
  TestStepAddActionExpected( chActionText, chExpectedText );
  A_DBGR_VariableRead( "Task_Core1_1000ms_Count", taskvalue);
  E_DBGR_VariableCheck("Task_Core1_1000ms_Count", taskvalue, Greater);
  
  //Check Core2 is running
  snprintf( chActionText, elCount(chActionText), "Check 1000ms Task Counter from Core2 "); 
  snprintf( chExpectedText, elCount(chExpectedText), "1000ms Counter from Core2 is incrementing"); 
  TestStepAddActionExpected( chActionText, chExpectedText );
  A_DBGR_VariableRead( "Task_Core2_1000ms_Count", taskvalue);
  E_DBGR_VariableCheck("Task_Core2_1000ms_Count", taskvalue, Greater);
    
  //Check Core3 is running
  snprintf( chActionText, elCount(chActionText), "Check 1000ms Task Counter from Core3 "); 
  snprintf( chExpectedText, elCount(chExpectedText), "1000ms Counter from Core3 is incrementing"); 
  TestStepAddActionExpected( chActionText, chExpectedText );
  A_DBGR_VariableRead( "Task_Core3_1000ms_Count", taskvalue);
  E_DBGR_VariableCheck("Task_Core3_1000ms_Count", taskvalue, Greater);
    
  //Check Core4 is running
  snprintf( chActionText, elCount(chActionText), "Check 1000ms Task Counter from Core4 "); 
  snprintf( chExpectedText, elCount(chExpectedText), "1000ms Counter from Core4 is incrementing"); 
  TestStepAddActionExpected( chActionText, chExpectedText );
  A_DBGR_VariableRead( "Task_Core4_1000ms_Count", taskvalue);
  E_DBGR_VariableCheck("Task_Core4_1000ms_Count", taskvalue, Greater);
    
  //Check Core5 is running
  snprintf( chActionText, elCount(chActionText), "Check 1000ms Task Counter from Core5 "); 
  snprintf( chExpectedText, elCount(chExpectedText), "1000ms Counter from Core5 is incrementing"); 
  TestStepAddActionExpected( chActionText, chExpectedText );
  A_DBGR_VariableRead( "Task_Core5_1000ms_Count", taskvalue);
  E_DBGR_VariableCheck("Task_Core5_1000ms_Count", taskvalue, Greater);
  
  /*******************************************************************************************************************************************************/    
    // Test Step 3: Set Breakpoint in file OS_task.c at the entry of Core4 1000ms task TASK( Task_Core4_1000ms ) & at the Function MngTSKR_1000msOS_Task()
  /*******************************************************************************************************************************************************/

  snprintf( chActionText, elCount(chActionText), "Set Breakpoint in file OS_task.c at the entry of Core0 1000ms task TASK( Task_Core4_1000ms ), Run SW & check Break point got hit "); 
  snprintf( chExpectedText, elCount(chExpectedText), "Verify Breakpoint got hit at Core4 1000ms task TASK( Task_Core4_1000ms )"); 
  TestStepAddActionExpected( chActionText, chExpectedText );
  A_DBGR_BreakpointSet("Os_Entry_Task_Core4_1000ms");  
  A_DBGR_Go(); 
  E_DBGR_BreakpointCheckForHalt("Os_Entry_Task_Core4_1000ms");
  
  
  snprintf( chActionText, elCount(chActionText), "Run Software and check breakpoint got hit at function MngTSKR_1000msOS_TaskCPU4();   "); 
  snprintf( chExpectedText, elCount(chExpectedText), "Verify Software is Running and breakpoint got hit at function MngTSKR_1000msOS_TaskCPU4()"); 
  TestStepAddActionExpected( chActionText, chExpectedText );
  A_DBGR_BreakpointDeleteAll();
  A_DBGR_BreakpointSet("MngTSKR_1000msOS_TaskCPU4");
  A_DBGR_Go(); 
  E_DBGR_BreakpointCheckForHalt("MngTSKR_1000msOS_TaskCPU4");
 
}

/***************************************************************************************************
----------------------------------------------------------------------------------------------------
Test case name:  TC_L30SW_Q-36655359: test case to verify the functionality of interface MngTSKR_TASKOS_TaskCPUx to trigger during normal task execution for CPU4 which is called from core4 1000ms task. (MngTSKR_1000msOS_TaskCPU4)
----------------------------------------------------------------------------------------------------
Description:  test case to verify the functionality of interface MngTSKR_TASKOS_TaskCPUx to trigger during normal task execution for CPU4 which is called from core4 1000ms task. (MngTSKR_1000msOS_TaskCPU4()

***************************************************************************************************/
testcase Testcase_to_verify_the_interface_MngTSKR_TASKOS_TaskCPUx_to_trigger_normal_task_execution_when_called_from_1000ms_task_for_CPU5()
{
  /***************************************************************************************************************/    
                                                // Variable Definition
  /***************************************************************************************************************/ 
  
  long taskvalue;
  
  /***************************************************************************************************************/    
                                               // Local Values
  /***************************************************************************************************************/ 
  

  
  /***************************************************************************************************************/    
                                              // Test Case Info
  /***************************************************************************************************************/
  setWriteDbgLevel(DebugOff);
  snprintf( chTestTitle, elCount(chTestTitle), "Testcase_to_verify_the_interface_MngTSKR_TASKOS_TaskCPUx_to_trigger_normal_task_execution_when_called_from_1000ms_task_for_CPU5" );
  snprintf( chTestDescription, elCount(chTestDescription), "Purpose: test case to verify the functionality of interface MngTSKR_TASKOS_TaskCPUx to trigger during normal task execution for CPU5 which is called from core5 1000ms task. (MngTSKR_1000msOS_TaskCPU5()");
  TestCaseAddInfo( chTestTitle, "TC_L30SW_QT_36655360", chTestDescription );

  /***************************************************************************************************************/    
                                              // Start of Test Case
  /***************************************************************************************************************/
  
  /***************************************************************************************************************/    
                                              // Test Step 1 PRECONDITIONS
  /***************************************************************************************************************/
  
  snprintf( chActionText, elCount(chActionText), "Flash the Software and ECU is running"); 
  snprintf( chExpectedText, elCount(chExpectedText), "ECU should be in running state"); 
  TestStepAddActionExpected( chActionText, chExpectedText );

  A_DBGR_BreakpointDeleteAll();
  A_DBGR_RnGo();
  E_DBGR_CheckState(T32_State_Running);
  

   /***************************************************************************************************************/    
            // Test Step 2: Check all cores are in running state                                   
  /***************************************************************************************************************/
  
  //Check Core0 is running
  snprintf( chActionText, elCount(chActionText), "Check 1000ms Task Counter from Core0 "); 
  snprintf( chExpectedText, elCount(chExpectedText), "1000ms Counter from Core0 is incrementing"); 
  TestStepAddActionExpected( chActionText, chExpectedText );
  A_DBGR_VariableRead( "Task_Core0_1000ms_Count", taskvalue);
  E_DBGR_VariableCheck("Task_Core0_1000ms_Count", taskvalue, Greater);
  
  //Check Core1 is running
  snprintf( chActionText, elCount(chActionText), "Check 1000ms Task Counter from Core1 "); 
  snprintf( chExpectedText, elCount(chExpectedText), "1000ms Counter from Core1 is incrementing"); 
  TestStepAddActionExpected( chActionText, chExpectedText );
  A_DBGR_VariableRead( "Task_Core1_1000ms_Count", taskvalue);
  E_DBGR_VariableCheck("Task_Core1_1000ms_Count", taskvalue, Greater);
  
  //Check Core2 is running
  snprintf( chActionText, elCount(chActionText), "Check 1000ms Task Counter from Core2 "); 
  snprintf( chExpectedText, elCount(chExpectedText), "1000ms Counter from Core2 is incrementing"); 
  TestStepAddActionExpected( chActionText, chExpectedText );
  A_DBGR_VariableRead( "Task_Core2_1000ms_Count", taskvalue);
  E_DBGR_VariableCheck("Task_Core2_1000ms_Count", taskvalue, Greater);
    
  //Check Core3 is running
  snprintf( chActionText, elCount(chActionText), "Check 1000ms Task Counter from Core3 "); 
  snprintf( chExpectedText, elCount(chExpectedText), "1000ms Counter from Core3 is incrementing"); 
  TestStepAddActionExpected( chActionText, chExpectedText );
  A_DBGR_VariableRead( "Task_Core3_1000ms_Count", taskvalue);
  E_DBGR_VariableCheck("Task_Core3_1000ms_Count", taskvalue, Greater);
    
  //Check Core4 is running
  snprintf( chActionText, elCount(chActionText), "Check 1000ms Task Counter from Core4 "); 
  snprintf( chExpectedText, elCount(chExpectedText), "1000ms Counter from Core4 is incrementing"); 
  TestStepAddActionExpected( chActionText, chExpectedText );
  A_DBGR_VariableRead( "Task_Core4_1000ms_Count", taskvalue);
  E_DBGR_VariableCheck("Task_Core4_1000ms_Count", taskvalue, Greater);
    
  //Check Core5 is running
  snprintf( chActionText, elCount(chActionText), "Check 1000ms Task Counter from Core5 "); 
  snprintf( chExpectedText, elCount(chExpectedText), "1000ms Counter from Core5 is incrementing"); 
  TestStepAddActionExpected( chActionText, chExpectedText );
  A_DBGR_VariableRead( "Task_Core5_1000ms_Count", taskvalue);
  E_DBGR_VariableCheck("Task_Core5_1000ms_Count", taskvalue, Greater);
  
  /*******************************************************************************************************************************************************/    
    // Test Step 3: Set Breakpoint in file OS_task.c at the entry of Core4 1000ms task TASK( Task_Core5_1000ms ) & at the Function MngTSKR_1000msOS_Task()
  /*******************************************************************************************************************************************************/

  snprintf( chActionText, elCount(chActionText), "Set Breakpoint in file OS_task.c at the entry of Core0 1000ms task TASK( Task_Core5_1000ms ), Run SW & check Break point got hit "); 
  snprintf( chExpectedText, elCount(chExpectedText), "Verify Breakpoint got hit at Core5 1000ms task TASK( Task_Core5_1000ms )"); 
  TestStepAddActionExpected( chActionText, chExpectedText );
  A_DBGR_BreakpointSet("Os_Entry_Task_Core5_1000ms");  
  A_DBGR_Go(); 
  E_DBGR_BreakpointCheckForHalt("Os_Entry_Task_Core5_1000ms");
  
  
  snprintf( chActionText, elCount(chActionText), "Run Software and check breakpoint got hit at function MngTSKR_1000msOS_TaskCPU5();   "); 
  snprintf( chExpectedText, elCount(chExpectedText), "Verify Software is Running and breakpoint got hit at function MngTSKR_1000msOS_TaskCPU5()"); 
  TestStepAddActionExpected( chActionText, chExpectedText );
  A_DBGR_BreakpointDeleteAll();
  A_DBGR_BreakpointSet("MngTSKR_1000msOS_TaskCPU5");
  A_DBGR_Go(); 
  E_DBGR_BreakpointCheckForHalt("MngTSKR_1000msOS_TaskCPU5");
}





/***************************************************************************************************
----------------------------------------------------------------------------------------------------
Test case name:  TC_L30SW_QT_36449718: The_Software_shall_Report_GetHWIO_b_LockstepStN_status_as_NoFailure_for_the_LockstepDualCPU_comparison_for_CPU_Core_0
----------------------------------------------------------------------------------------------------
Description:  Verify NoFailure: since no comparison errors occurred since the last request for the first lockstep CPU ID = 0.

***************************************************************************************************/
testcase The_Software_shall_Report_GetHWIO_b_LockstepStN_status_as_NoFailure_for_the_LockstepDualCPU_comparison_for_CPU_Core_0()
{
  /***************************************************************************************************************/    
                                                // Variable Definition
  /***************************************************************************************************************/ 
  
  long taskvalue;
  
  /***************************************************************************************************************/    
                                               // Local Values
  /***************************************************************************************************************/ 
  

  
  /***************************************************************************************************************/    
                                              // Test Case Info
  /***************************************************************************************************************/
  setWriteDbgLevel(DebugOff);
  snprintf( chTestTitle, elCount(chTestTitle), "The_Software_shall_Report_GetHWIO_b_LockstepStN_status_as_NoFailure_for_the_LockstepDualCPU_comparison_for_CPU_Core_0" );
  snprintf( chTestDescription, elCount(chTestDescription), "Purose:  Verify NoFailure: since no comparison errors occurred since the last request for the first lockstep CPU ID = 0.");
  TestCaseAddInfo( chTestTitle, "TC_L30SW_QT_36449718", chTestDescription );

  /***************************************************************************************************************/    
                                              // Start of Test Case
  /***************************************************************************************************************/
  
  /***************************************************************************************************************/    
                                              // Test Step 1 PRECONDITIONS
  /***************************************************************************************************************/
  
  snprintf( chActionText, elCount(chActionText), "Flash the Software and ECU is running"); 
  snprintf( chExpectedText, elCount(chExpectedText), "ECU should be in running state"); 
  TestStepAddActionExpected( chActionText, chExpectedText );

  A_DBGR_BreakpointDeleteAll();
  A_DBGR_RnGo();
  E_DBGR_CheckState(T32_State_Running);
  

   /***************************************************************************************************************/    
            // Test Step 2: Check all cores are in running state                                   
  /***************************************************************************************************************/
  
  //Check Core0 is running
  snprintf( chActionText, elCount(chActionText), "Check 1000ms Task Counter from Core0 "); 
  snprintf( chExpectedText, elCount(chExpectedText), "1000ms Counter from Core0 is incrementing"); 
  TestStepAddActionExpected( chActionText, chExpectedText );
  A_DBGR_VariableRead( "Task_Core0_1000ms_Count", taskvalue);
  E_DBGR_VariableCheck("Task_Core0_1000ms_Count", taskvalue, Greater);
  
  //Check Core1 is running
  snprintf( chActionText, elCount(chActionText), "Check 1000ms Task Counter from Core1 "); 
  snprintf( chExpectedText, elCount(chExpectedText), "1000ms Counter from Core1 is incrementing"); 
  TestStepAddActionExpected( chActionText, chExpectedText );
  A_DBGR_VariableRead( "Task_Core1_1000ms_Count", taskvalue);
  E_DBGR_VariableCheck("Task_Core1_1000ms_Count", taskvalue, Greater);
  
  //Check Core2 is running
  snprintf( chActionText, elCount(chActionText), "Check 1000ms Task Counter from Core2 "); 
  snprintf( chExpectedText, elCount(chExpectedText), "1000ms Counter from Core2 is incrementing"); 
  TestStepAddActionExpected( chActionText, chExpectedText );
  A_DBGR_VariableRead( "Task_Core2_1000ms_Count", taskvalue);
  E_DBGR_VariableCheck("Task_Core2_1000ms_Count", taskvalue, Greater);
    
  //Check Core3 is running
  snprintf( chActionText, elCount(chActionText), "Check 1000ms Task Counter from Core3 "); 
  snprintf( chExpectedText, elCount(chExpectedText), "1000ms Counter from Core3 is incrementing"); 
  TestStepAddActionExpected( chActionText, chExpectedText );
  A_DBGR_VariableRead( "Task_Core3_1000ms_Count", taskvalue);
  E_DBGR_VariableCheck("Task_Core3_1000ms_Count", taskvalue, Greater);
    
  //Check Core4 is running
  snprintf( chActionText, elCount(chActionText), "Check 1000ms Task Counter from Core4 "); 
  snprintf( chExpectedText, elCount(chExpectedText), "1000ms Counter from Core4 is incrementing"); 
  TestStepAddActionExpected( chActionText, chExpectedText );
  A_DBGR_VariableRead( "Task_Core4_1000ms_Count", taskvalue);
  E_DBGR_VariableCheck("Task_Core4_1000ms_Count", taskvalue, Greater);
    
  //Check Core5 is running
  snprintf( chActionText, elCount(chActionText), "Check 1000ms Task Counter from Core5 "); 
  snprintf( chExpectedText, elCount(chExpectedText), "1000ms Counter from Core5 is incrementing"); 
  TestStepAddActionExpected( chActionText, chExpectedText );
  A_DBGR_VariableRead( "Task_Core5_1000ms_Count", taskvalue);
  E_DBGR_VariableCheck("Task_Core5_1000ms_Count", taskvalue, Greater);
  
  /*******************************************************************************************************************************************************/    
    // Test Step 3: Add Breakpoint in test_lockstep_hwio.c file at function: void Test_GetHWIO_b_LockstepStN( void )
  /*******************************************************************************************************************************************************/

  snprintf( chActionText, elCount(chActionText), "Set Breakpoint in file: Test_Lockstep File at function Test_GetHWIO_b_LockstepStN() "); 
  snprintf( chExpectedText, elCount(chExpectedText), "Verify Breakpoint got hit at Test_GetHWIO_b_LockstepStN()"); 
  TestStepAddActionExpected( chActionText, chExpectedText );
  A_DBGR_BreakpointSet("Test_GetHWIO_b_LockstepStN");  
  A_DBGR_Go(); 
  E_DBGR_BreakpointCheckForHalt("Test_GetHWIO_b_LockstepStN");
  
  /*******************************************************************************************************************************************************/    
    // Test Step 4: Add coreId variable in watch window and change coreId = 0 (core0).
  /*******************************************************************************************************************************************************/
  
  // change core id = 0
  snprintf( chActionText, elCount(chActionText), "set core id = 0"); 
  snprintf( chExpectedText, elCount(chExpectedText), "core id = 0"); 
  TestStepAddActionExpected( chActionText, chExpectedText );
  A_DBGR_VariableSet("coreId", "0");
  E_DBGR_VariableCheck("coreId", 0, Equal); 
  
  /*******************************************************************************************************************************************************/    
    // Test Step 5: Set Breakpoint at  fucntion GetHWIO_b_LockstepStN(BYTE cpuId) case 0 & Check Breakpoint got hit
  /*******************************************************************************************************************************************************/
  
  snprintf( chActionText, elCount(chActionText), "Run Software and check breakpoint got hit at Case 1, Core ID = 1   "); 
  snprintf( chExpectedText, elCount(chExpectedText), "Verify Software is Running and breakpoint got hit at Case1, Core ID = 1"); 
  TestStepAddActionExpected( chActionText, chExpectedText );
  A_DBGR_BreakpointDeleteAll();
  A_DBGR_BreakpointSet("P:0x80825D8E");
  A_DBGR_Go(); 
  E_DBGR_BreakpointCheckForHalt("P:0x80825D8E");

  /*******************************************************************************************************************************************************/    
    // Test Step 6: Check retvalpassCounter value before and after the increment to verify that function working correctly
  /*******************************************************************************************************************************************************/
  
  snprintf( chActionText, elCount(chActionText), "Run Software and check breakpoint got hit at retvalpassCounter "); 
  snprintf( chExpectedText, elCount(chExpectedText), "Verify Software is Running and breakpoint got hit retvalpassCounter"); 
  TestStepAddActionExpected( chActionText, chExpectedText );
  A_DBGR_BreakpointDeleteAll();
  A_DBGR_BreakpointSet("P:0x808323A4"); 
  A_DBGR_Go(); 
  E_DBGR_BreakpointCheckForHalt("P:0x808323A4");
  
  
  
  snprintf( chActionText, elCount(chActionText), "Check variable retvalpassCounter shall increment "); 
  snprintf( chExpectedText, elCount(chExpectedText), "retvalpassCounter incrementing"); 
  TestStepAddActionExpected( chActionText, chExpectedText );
  A_DBGR_VariableRead( "retvalpassCounter", taskvalue);
  A_DBGR_Go(); 
  E_DBGR_VariableCheck("retvalpassCounter", taskvalue, Greater);
 
}

/***************************************************************************************************
----------------------------------------------------------------------------------------------------
Test case name:  TC_L30SW_QT_36449719: The_Software_shall_Report_GetHWIO_b_LockstepStN_status_as_NoFailure_for_the_LockstepDualCPU_comparison_for_CPU_Core_1
----------------------------------------------------------------------------------------------------
Description:  Verify NoFailure: since no comparison errors occurred since the last request for the first lockstep CPU ID = 1.

***************************************************************************************************/
testcase The_Software_shall_Report_GetHWIO_b_LockstepStN_status_as_NoFailure_for_the_LockstepDualCPU_comparison_for_CPU_Core_1()
{
  /***************************************************************************************************************/    
                                                // Variable Definition
  /***************************************************************************************************************/ 
  
  long taskvalue;
  
  /***************************************************************************************************************/    
                                               // Local Values
  /***************************************************************************************************************/ 
  

  
  /***************************************************************************************************************/    
                                              // Test Case Info
  /***************************************************************************************************************/
  setWriteDbgLevel(DebugOff);
  snprintf( chTestTitle, elCount(chTestTitle), "The_Software_shall_Report_GetHWIO_b_LockstepStN_status_as_NoFailure_for_the_LockstepDualCPU_comparison_for_CPU_Core_1" );
  snprintf( chTestDescription, elCount(chTestDescription), "Purose:  Verify NoFailure: since no comparison errors occurred since the last request for the first lockstep CPU ID = 1.");
  TestCaseAddInfo( chTestTitle, "TC_L30SW_QT_36449719", chTestDescription );

  /***************************************************************************************************************/    
                                              // Start of Test Case
  /***************************************************************************************************************/
  
  /***************************************************************************************************************/    
                                              // Test Step 1 PRECONDITIONS
  /***************************************************************************************************************/
  
  snprintf( chActionText, elCount(chActionText), "Flash the Software and ECU is running"); 
  snprintf( chExpectedText, elCount(chExpectedText), "ECU should be in running state"); 
  TestStepAddActionExpected( chActionText, chExpectedText );

  A_DBGR_BreakpointDeleteAll();
  A_DBGR_RnGo();
  E_DBGR_CheckState(T32_State_Running);
  

   /***************************************************************************************************************/    
            // Test Step 2: Check all cores are in running state                                   
  /***************************************************************************************************************/
  
  //Check Core0 is running
  snprintf( chActionText, elCount(chActionText), "Check 1000ms Task Counter from Core0 "); 
  snprintf( chExpectedText, elCount(chExpectedText), "1000ms Counter from Core0 is incrementing"); 
  TestStepAddActionExpected( chActionText, chExpectedText );
  A_DBGR_VariableRead( "Task_Core0_1000ms_Count", taskvalue);
  E_DBGR_VariableCheck("Task_Core0_1000ms_Count", taskvalue, Greater);
  
  //Check Core1 is running
  snprintf( chActionText, elCount(chActionText), "Check 1000ms Task Counter from Core1 "); 
  snprintf( chExpectedText, elCount(chExpectedText), "1000ms Counter from Core1 is incrementing"); 
  TestStepAddActionExpected( chActionText, chExpectedText );
  A_DBGR_VariableRead( "Task_Core1_1000ms_Count", taskvalue);
  E_DBGR_VariableCheck("Task_Core1_1000ms_Count", taskvalue, Greater);
  
  //Check Core2 is running
  snprintf( chActionText, elCount(chActionText), "Check 1000ms Task Counter from Core2 "); 
  snprintf( chExpectedText, elCount(chExpectedText), "1000ms Counter from Core2 is incrementing"); 
  TestStepAddActionExpected( chActionText, chExpectedText );
  A_DBGR_VariableRead( "Task_Core2_1000ms_Count", taskvalue);
  E_DBGR_VariableCheck("Task_Core2_1000ms_Count", taskvalue, Greater);
    
  //Check Core3 is running
  snprintf( chActionText, elCount(chActionText), "Check 1000ms Task Counter from Core3 "); 
  snprintf( chExpectedText, elCount(chExpectedText), "1000ms Counter from Core3 is incrementing"); 
  TestStepAddActionExpected( chActionText, chExpectedText );
  A_DBGR_VariableRead( "Task_Core3_1000ms_Count", taskvalue);
  E_DBGR_VariableCheck("Task_Core3_1000ms_Count", taskvalue, Greater);
    
  //Check Core4 is running
  snprintf( chActionText, elCount(chActionText), "Check 1000ms Task Counter from Core4 "); 
  snprintf( chExpectedText, elCount(chExpectedText), "1000ms Counter from Core4 is incrementing"); 
  TestStepAddActionExpected( chActionText, chExpectedText );
  A_DBGR_VariableRead( "Task_Core4_1000ms_Count", taskvalue);
  E_DBGR_VariableCheck("Task_Core4_1000ms_Count", taskvalue, Greater);
    
  //Check Core5 is running
  snprintf( chActionText, elCount(chActionText), "Check 1000ms Task Counter from Core5 "); 
  snprintf( chExpectedText, elCount(chExpectedText), "1000ms Counter from Core5 is incrementing"); 
  TestStepAddActionExpected( chActionText, chExpectedText );
  A_DBGR_VariableRead( "Task_Core5_1000ms_Count", taskvalue);
  E_DBGR_VariableCheck("Task_Core5_1000ms_Count", taskvalue, Greater);
  
  /*******************************************************************************************************************************************************/    
    // Test Step 3: Add Breakpoint in test_lockstep_hwio.c file at function: void Test_GetHWIO_b_LockstepStN( void )
  /*******************************************************************************************************************************************************/

  snprintf( chActionText, elCount(chActionText), "Set Breakpoint in file: Test_Lockstep File at function Test_GetHWIO_b_LockstepStN() "); 
  snprintf( chExpectedText, elCount(chExpectedText), "Verify Breakpoint got hit at Test_GetHWIO_b_LockstepStN()"); 
  TestStepAddActionExpected( chActionText, chExpectedText );
  A_DBGR_BreakpointSet("Test_GetHWIO_b_LockstepStN");  
  A_DBGR_Go(); 
  E_DBGR_BreakpointCheckForHalt("Test_GetHWIO_b_LockstepStN");
  
  /*******************************************************************************************************************************************************/    
    // Test Step 4: Add coreId variable in watch window and change coreId = 0 (core0).
  /*******************************************************************************************************************************************************/
  
  // change core id = 0
  snprintf( chActionText, elCount(chActionText), "set core id = 0"); 
  snprintf( chExpectedText, elCount(chExpectedText), "core id = 0"); 
  TestStepAddActionExpected( chActionText, chExpectedText );
  A_DBGR_VariableSet("coreId", "0");
  E_DBGR_VariableCheck("coreId", 0, Equal); 
  
  /*******************************************************************************************************************************************************/    
    // Test Step 5: Set Breakpoint at  fucntion GetHWIO_b_LockstepStN(BYTE cpuId) case 0 & Check Breakpoint got hit
  /*******************************************************************************************************************************************************/
  
  snprintf( chActionText, elCount(chActionText), "Run Software and check breakpoint got hit at Case 1, Core ID = 1   "); 
  snprintf( chExpectedText, elCount(chExpectedText), "Verify Software is Running and breakpoint got hit at Case1, Core ID = 1"); 
  TestStepAddActionExpected( chActionText, chExpectedText );
  A_DBGR_BreakpointDeleteAll();
  A_DBGR_BreakpointSet("P:0x80825D8E");
  A_DBGR_Go(); 
  E_DBGR_BreakpointCheckForHalt("P:0x80825D8E");

  /*******************************************************************************************************************************************************/    
    // Test Step 6: Check retvalpassCounter value before and after the increment to verify that function working correctly
  /*******************************************************************************************************************************************************/
  
  snprintf( chActionText, elCount(chActionText), "Run Software and check breakpoint got hit at retvalpassCounter "); 
  snprintf( chExpectedText, elCount(chExpectedText), "Verify Software is Running and breakpoint got hit retvalpassCounter"); 
  TestStepAddActionExpected( chActionText, chExpectedText );
  A_DBGR_BreakpointDeleteAll();
  A_DBGR_BreakpointSet("P:0x808323A4"); 
  A_DBGR_Go(); 
  E_DBGR_BreakpointCheckForHalt("P:0x808323A4");
  
  
  
  snprintf( chActionText, elCount(chActionText), "Check variable retvalpassCounter shall increment "); 
  snprintf( chExpectedText, elCount(chExpectedText), "retvalpassCounter incrementing"); 
  TestStepAddActionExpected( chActionText, chExpectedText );
  A_DBGR_VariableRead( "retvalpassCounter", taskvalue);
  A_DBGR_Go(); 
  E_DBGR_VariableCheck("retvalpassCounter", taskvalue, Greater);
 
}



/***************************************************************************************************
----------------------------------------------------------------------------------------------------
Test case name:  TC_L30SW_QT_36542231: Testcase_to_verify_the_functionality_of_interface_CntrlRBSR_Background_to_check_the_background_CPU_is_active_for_Core0
----------------------------------------------------------------------------------------------------
Description:  test case to verify the functionality of interface CntrlRBSR_Background() to check the background CPU is active for core0.

***************************************************************************************************/
testcase Testcase_to_verify_the_functionality_of_interface_CntrlRBSR_Background_to_check_the_background_CPU_is_active_for_Core0()
{
  /***************************************************************************************************************/    
                                                // Variable Definition
  /***************************************************************************************************************/ 
  
  long taskvalue;
  
  /***************************************************************************************************************/    
                                               // Local Values
  /***************************************************************************************************************/ 
  

  
  /***************************************************************************************************************/    
                                              // Test Case Info
  /***************************************************************************************************************/
  setWriteDbgLevel(DebugOff);
  snprintf( chTestTitle, elCount(chTestTitle), "Testcase_to_verify_the_functionality_of_interface_CntrlRBSR_Background_to_check_the_background_CPU_is_active_for_Core0" );
  snprintf( chTestDescription, elCount(chTestDescription), "Purpose: test case to verify the functionality of interface CntrlRBSR_Background() to check the background CPU is active for core0.");
  TestCaseAddInfo( chTestTitle, "TC_L30SW_QT_36542231", chTestDescription );

  /***************************************************************************************************************/    
                                              // Start of Test Case
  /***************************************************************************************************************/
  
  /***************************************************************************************************************/    
                                              // Test Step 1 PRECONDITIONS
  /***************************************************************************************************************/
  
  snprintf( chActionText, elCount(chActionText), "Flash the Software and ECU is running"); 
  snprintf( chExpectedText, elCount(chExpectedText), "ECU should be in running state"); 
  TestStepAddActionExpected( chActionText, chExpectedText );

  A_DBGR_BreakpointDeleteAll();
  A_DBGR_RnGo();
  E_DBGR_CheckState(T32_State_Running);
  

   /***************************************************************************************************************/    
            // Test Step 2: Check all cores are in running state                                   
  /***************************************************************************************************************/
  
  //Check Core0 is running
  snprintf( chActionText, elCount(chActionText), "Check 1000ms Task Counter from Core0 "); 
  snprintf( chExpectedText, elCount(chExpectedText), "1000ms Counter from Core0 is incrementing"); 
  TestStepAddActionExpected( chActionText, chExpectedText );
  A_DBGR_VariableRead( "Task_Core0_1000ms_Count", taskvalue);
  E_DBGR_VariableCheck("Task_Core0_1000ms_Count", taskvalue, Greater);
  
  //Check Core1 is running
  snprintf( chActionText, elCount(chActionText), "Check 1000ms Task Counter from Core1 "); 
  snprintf( chExpectedText, elCount(chExpectedText), "1000ms Counter from Core1 is incrementing"); 
  TestStepAddActionExpected( chActionText, chExpectedText );
  A_DBGR_VariableRead( "Task_Core1_1000ms_Count", taskvalue);
  E_DBGR_VariableCheck("Task_Core1_1000ms_Count", taskvalue, Greater);
  
  //Check Core2 is running
  snprintf( chActionText, elCount(chActionText), "Check 1000ms Task Counter from Core2 "); 
  snprintf( chExpectedText, elCount(chExpectedText), "1000ms Counter from Core2 is incrementing"); 
  TestStepAddActionExpected( chActionText, chExpectedText );
  A_DBGR_VariableRead( "Task_Core2_1000ms_Count", taskvalue);
  E_DBGR_VariableCheck("Task_Core2_1000ms_Count", taskvalue, Greater);
    
  //Check Core3 is running
  snprintf( chActionText, elCount(chActionText), "Check 1000ms Task Counter from Core3 "); 
  snprintf( chExpectedText, elCount(chExpectedText), "1000ms Counter from Core3 is incrementing"); 
  TestStepAddActionExpected( chActionText, chExpectedText );
  A_DBGR_VariableRead( "Task_Core3_1000ms_Count", taskvalue);
  E_DBGR_VariableCheck("Task_Core3_1000ms_Count", taskvalue, Greater);
    
  //Check Core4 is running
  snprintf( chActionText, elCount(chActionText), "Check 1000ms Task Counter from Core4 "); 
  snprintf( chExpectedText, elCount(chExpectedText), "1000ms Counter from Core4 is incrementing"); 
  TestStepAddActionExpected( chActionText, chExpectedText );
  A_DBGR_VariableRead( "Task_Core4_1000ms_Count", taskvalue);
  E_DBGR_VariableCheck("Task_Core4_1000ms_Count", taskvalue, Greater);
    
  //Check Core5 is running
  snprintf( chActionText, elCount(chActionText), "Check 1000ms Task Counter from Core5 "); 
  snprintf( chExpectedText, elCount(chExpectedText), "1000ms Counter from Core5 is incrementing"); 
  TestStepAddActionExpected( chActionText, chExpectedText );
  A_DBGR_VariableRead( "Task_Core5_1000ms_Count", taskvalue);
  E_DBGR_VariableCheck("Task_Core5_1000ms_Count", taskvalue, Greater);
  
  /*******************************************************************************************************************************************************/    
    // Test Step 3: Set breakpoint in file main.c in function FUNC(boolean, OS_CALLOUT_CODE) Os_Cbk_Idle(void) at line if( CORE0 == coreId)
  /*******************************************************************************************************************************************************/

  snprintf( chActionText, elCount(chActionText), "set breakpoint in file main.c in function FUNC(boolean, OS_CALLOUT_CODE) Os_Cbk_Idle(void) at line if( CORE0 == coreId) "); 
  snprintf( chExpectedText, elCount(chExpectedText), "Verify Breakpoint got hit at function FUNC(boolean, OS_CALLOUT_CODE) Os_Cbk_Idle(void) at line if( CORE0 == coreId)"); 
  TestStepAddActionExpected( chActionText, chExpectedText );
  A_DBGR_R();
  A_DBGR_VariableSet("coreId", "0");
  A_DBGR_BreakpointSet("P:0x8083AEA4");  
  A_DBGR_Go(); 
  E_DBGR_BreakpointCheckForHalt("P:0x8083AEA4");
  
  
  snprintf( chActionText, elCount(chActionText), "Run Software and check breakpoint got hit at function CntrlRBSR_Background()"); 
  snprintf( chExpectedText, elCount(chExpectedText), "Verify Software is Running and breakpoint got hit at function CntrlRBSR_Background()"); 
  TestStepAddActionExpected( chActionText, chExpectedText );
  A_DBGR_BreakpointDeleteAll();
  
  A_DBGR_BreakpointSet("CntrlRBSR_Background");
  A_DBGR_Go(); 
  E_DBGR_BreakpointCheckForHalt("CntrlRBSR_Background");
 
}



/***************************************************************************************************
----------------------------------------------------------------------------------------------------
Test case name:  TC_L30SW_QT_36542232: Testcase_to_verify_the_functionality_of_interface_CntrlRBSR_Background_to_check_the_background_CPU_is_active_for_Core1
----------------------------------------------------------------------------------------------------
Description:  test case to verify the functionality of interface CntrlRBSR_Background() to check the background CPU is active for core1.

***************************************************************************************************/
testcase Testcase_to_verify_the_functionality_of_interface_CntrlRBSR_Background_to_check_the_background_CPU_is_active_for_Core1()
{
  /***************************************************************************************************************/    
                                                // Variable Definition
  /***************************************************************************************************************/ 
  
  long taskvalue;
  
  /***************************************************************************************************************/    
                                               // Local Values
  /***************************************************************************************************************/ 
  

  
  /***************************************************************************************************************/    
                                              // Test Case Info
  /***************************************************************************************************************/
  setWriteDbgLevel(DebugOff);
  snprintf( chTestTitle, elCount(chTestTitle), "Testcase_to_verify_the_functionality_of_interface_CntrlRBSR_Background_to_check_the_background_CPU_is_active_for_Core1" );
  snprintf( chTestDescription, elCount(chTestDescription), "Purpose: test case to verify the functionality of interface CntrlRBSR_BackgroundCPU1() to check the background CPU is active for core1.");
  TestCaseAddInfo( chTestTitle, "TC_L30SW_QT_36542232", chTestDescription );

  /***************************************************************************************************************/    
                                              // Start of Test Case
  /***************************************************************************************************************/
  
  /***************************************************************************************************************/    
                                              // Test Step 1 PRECONDITIONS
  /***************************************************************************************************************/
  
  snprintf( chActionText, elCount(chActionText), "Flash the Software and ECU is running"); 
  snprintf( chExpectedText, elCount(chExpectedText), "ECU should be in running state"); 
  TestStepAddActionExpected( chActionText, chExpectedText );

  A_DBGR_BreakpointDeleteAll();
  A_DBGR_RnGo();
  E_DBGR_CheckState(T32_State_Running);
  

   /***************************************************************************************************************/    
            // Test Step 2: Check all cores are in running state                                   
  /***************************************************************************************************************/
  
  //Check Core0 is running
  snprintf( chActionText, elCount(chActionText), "Check 1000ms Task Counter from Core0 "); 
  snprintf( chExpectedText, elCount(chExpectedText), "1000ms Counter from Core0 is incrementing"); 
  TestStepAddActionExpected( chActionText, chExpectedText );
  A_DBGR_VariableRead( "Task_Core0_1000ms_Count", taskvalue);
  E_DBGR_VariableCheck("Task_Core0_1000ms_Count", taskvalue, Greater);
  
  //Check Core1 is running
  snprintf( chActionText, elCount(chActionText), "Check 1000ms Task Counter from Core1 "); 
  snprintf( chExpectedText, elCount(chExpectedText), "1000ms Counter from Core1 is incrementing"); 
  TestStepAddActionExpected( chActionText, chExpectedText );
  A_DBGR_VariableRead( "Task_Core1_1000ms_Count", taskvalue);
  E_DBGR_VariableCheck("Task_Core1_1000ms_Count", taskvalue, Greater);
  
  //Check Core2 is running
  snprintf( chActionText, elCount(chActionText), "Check 1000ms Task Counter from Core2 "); 
  snprintf( chExpectedText, elCount(chExpectedText), "1000ms Counter from Core2 is incrementing"); 
  TestStepAddActionExpected( chActionText, chExpectedText );
  A_DBGR_VariableRead( "Task_Core2_1000ms_Count", taskvalue);
  E_DBGR_VariableCheck("Task_Core2_1000ms_Count", taskvalue, Greater);
    
  //Check Core3 is running
  snprintf( chActionText, elCount(chActionText), "Check 1000ms Task Counter from Core3 "); 
  snprintf( chExpectedText, elCount(chExpectedText), "1000ms Counter from Core3 is incrementing"); 
  TestStepAddActionExpected( chActionText, chExpectedText );
  A_DBGR_VariableRead( "Task_Core3_1000ms_Count", taskvalue);
  E_DBGR_VariableCheck("Task_Core3_1000ms_Count", taskvalue, Greater);
    
  //Check Core4 is running
  snprintf( chActionText, elCount(chActionText), "Check 1000ms Task Counter from Core4 "); 
  snprintf( chExpectedText, elCount(chExpectedText), "1000ms Counter from Core4 is incrementing"); 
  TestStepAddActionExpected( chActionText, chExpectedText );
  A_DBGR_VariableRead( "Task_Core4_1000ms_Count", taskvalue);
  E_DBGR_VariableCheck("Task_Core4_1000ms_Count", taskvalue, Greater);
    
  //Check Core5 is running
  snprintf( chActionText, elCount(chActionText), "Check 1000ms Task Counter from Core5 "); 
  snprintf( chExpectedText, elCount(chExpectedText), "1000ms Counter from Core5 is incrementing"); 
  TestStepAddActionExpected( chActionText, chExpectedText );
  A_DBGR_VariableRead( "Task_Core5_1000ms_Count", taskvalue);
  E_DBGR_VariableCheck("Task_Core5_1000ms_Count", taskvalue, Greater);
  
  /*******************************************************************************************************************************************************/    
    // Test Step 3: Set breakpoint in file main.c in function FUNC(boolean, OS_CALLOUT_CODE) Os_Cbk_Idle(void) at line if( CORE0 == coreId)
  /*******************************************************************************************************************************************************/

  snprintf( chActionText, elCount(chActionText), "set breakpoint in file main.c in function FUNC(boolean, OS_CALLOUT_CODE) Os_Cbk_Idle(void) at line if( CORE1 == coreId) "); 
  snprintf( chExpectedText, elCount(chExpectedText), "Verify Breakpoint got hit at function FUNC(boolean, OS_CALLOUT_CODE) Os_Cbk_Idle(void) at line if( CORE1 == coreId)"); 
  TestStepAddActionExpected( chActionText, chExpectedText );
  A_DBGR_R();
  A_DBGR_VariableSet("coreId", "1");
  A_DBGR_BreakpointSet("P:0x8083AEAE");  
  A_DBGR_Go(); 
  E_DBGR_BreakpointCheckForHalt("P:0x8083AEAE");
  
  
  snprintf( chActionText, elCount(chActionText), "Run Software and check breakpoint got hit at function CntrlRBSR_BackgroundCPU1()"); 
  snprintf( chExpectedText, elCount(chExpectedText), "Verify Software is Running and breakpoint got hit at function CntrlRBSR_BackgroundCPU1()"); 
  TestStepAddActionExpected( chActionText, chExpectedText );
  A_DBGR_BreakpointDeleteAll();
  
  A_DBGR_BreakpointSet("CntrlRBSR_BackgroundCPU1");
  A_DBGR_Go(); 
  E_DBGR_BreakpointCheckForHalt("CntrlRBSR_BackgroundCPU1");
 
}


/***************************************************************************************************
----------------------------------------------------------------------------------------------------
Test case name:  TC_L30SW_QT_36542233: Testcase_to_verify_the_functionality_of_interface_CntrlRBSR_Background_to_check_the_background_CPU_is_active_for_Core2
----------------------------------------------------------------------------------------------------
Description:  test case to verify the functionality of interface CntrlRBSR_Background() to check the background CPU is active for core2.

***************************************************************************************************/
testcase Testcase_to_verify_the_functionality_of_interface_CntrlRBSR_Background_to_check_the_background_CPU_is_active_for_Core2()
{
  /***************************************************************************************************************/    
                                                // Variable Definition
  /***************************************************************************************************************/ 
  
  long taskvalue;
  
  /***************************************************************************************************************/    
                                               // Local Values
  /***************************************************************************************************************/ 
  

  
  /***************************************************************************************************************/    
                                              // Test Case Info
  /***************************************************************************************************************/
  setWriteDbgLevel(DebugOff);
  snprintf( chTestTitle, elCount(chTestTitle), "Testcase_to_verify_the_functionality_of_interface_CntrlRBSR_Background_to_check_the_background_CPU_is_active_for_Core2" );
  snprintf( chTestDescription, elCount(chTestDescription), "Purpose: test case to verify the functionality of interface CntrlRBSR_BackgroundCPU2() to check the background CPU is active for core2.");
  TestCaseAddInfo( chTestTitle, "TC_L30SW_QT_36542233", chTestDescription );

  /***************************************************************************************************************/    
                                              // Start of Test Case
  /***************************************************************************************************************/
  
  /***************************************************************************************************************/    
                                              // Test Step 1 PRECONDITIONS
  /***************************************************************************************************************/
  
  snprintf( chActionText, elCount(chActionText), "Flash the Software and ECU is running"); 
  snprintf( chExpectedText, elCount(chExpectedText), "ECU should be in running state"); 
  TestStepAddActionExpected( chActionText, chExpectedText );

  A_DBGR_BreakpointDeleteAll();
  A_DBGR_RnGo();
  E_DBGR_CheckState(T32_State_Running);
  

   /***************************************************************************************************************/    
            // Test Step 2: Check all cores are in running state                                   
  /***************************************************************************************************************/
  
  //Check Core0 is running
  snprintf( chActionText, elCount(chActionText), "Check 1000ms Task Counter from Core0 "); 
  snprintf( chExpectedText, elCount(chExpectedText), "1000ms Counter from Core0 is incrementing"); 
  TestStepAddActionExpected( chActionText, chExpectedText );
  A_DBGR_VariableRead( "Task_Core0_1000ms_Count", taskvalue);
  E_DBGR_VariableCheck("Task_Core0_1000ms_Count", taskvalue, Greater);
  
  //Check Core1 is running
  snprintf( chActionText, elCount(chActionText), "Check 1000ms Task Counter from Core1 "); 
  snprintf( chExpectedText, elCount(chExpectedText), "1000ms Counter from Core1 is incrementing"); 
  TestStepAddActionExpected( chActionText, chExpectedText );
  A_DBGR_VariableRead( "Task_Core1_1000ms_Count", taskvalue);
  E_DBGR_VariableCheck("Task_Core1_1000ms_Count", taskvalue, Greater);
  
  //Check Core2 is running
  snprintf( chActionText, elCount(chActionText), "Check 1000ms Task Counter from Core2 "); 
  snprintf( chExpectedText, elCount(chExpectedText), "1000ms Counter from Core2 is incrementing"); 
  TestStepAddActionExpected( chActionText, chExpectedText );
  A_DBGR_VariableRead( "Task_Core2_1000ms_Count", taskvalue);
  E_DBGR_VariableCheck("Task_Core2_1000ms_Count", taskvalue, Greater);
    
  //Check Core3 is running
  snprintf( chActionText, elCount(chActionText), "Check 1000ms Task Counter from Core3 "); 
  snprintf( chExpectedText, elCount(chExpectedText), "1000ms Counter from Core3 is incrementing"); 
  TestStepAddActionExpected( chActionText, chExpectedText );
  A_DBGR_VariableRead( "Task_Core3_1000ms_Count", taskvalue);
  E_DBGR_VariableCheck("Task_Core3_1000ms_Count", taskvalue, Greater);
    
  //Check Core4 is running
  snprintf( chActionText, elCount(chActionText), "Check 1000ms Task Counter from Core4 "); 
  snprintf( chExpectedText, elCount(chExpectedText), "1000ms Counter from Core4 is incrementing"); 
  TestStepAddActionExpected( chActionText, chExpectedText );
  A_DBGR_VariableRead( "Task_Core4_1000ms_Count", taskvalue);
  E_DBGR_VariableCheck("Task_Core4_1000ms_Count", taskvalue, Greater);
    
  //Check Core5 is running
  snprintf( chActionText, elCount(chActionText), "Check 1000ms Task Counter from Core5 "); 
  snprintf( chExpectedText, elCount(chExpectedText), "1000ms Counter from Core5 is incrementing"); 
  TestStepAddActionExpected( chActionText, chExpectedText );
  A_DBGR_VariableRead( "Task_Core5_1000ms_Count", taskvalue);
  E_DBGR_VariableCheck("Task_Core5_1000ms_Count", taskvalue, Greater);
  
  /*******************************************************************************************************************************************************/    
    // Test Step 3: Set breakpoint in file main.c in function FUNC(boolean, OS_CALLOUT_CODE) Os_Cbk_Idle(void) at line if( CORE2 == coreId)
  /*******************************************************************************************************************************************************/

  snprintf( chActionText, elCount(chActionText), "set breakpoint in file main.c in function FUNC(boolean, OS_CALLOUT_CODE) Os_Cbk_Idle(void) at line if( CORE2 == coreId) "); 
  snprintf( chExpectedText, elCount(chExpectedText), "Verify Breakpoint got hit at function FUNC(boolean, OS_CALLOUT_CODE) Os_Cbk_Idle(void) at line if( CORE2 == coreId)"); 
  TestStepAddActionExpected( chActionText, chExpectedText );
  A_DBGR_R();
  A_DBGR_VariableSet("coreId", "2");
  A_DBGR_BreakpointSet("P:0x8083AEB8");  
  A_DBGR_Go(); 
  E_DBGR_BreakpointCheckForHalt("P:0x8083AEB8");
  
  
  snprintf( chActionText, elCount(chActionText), "Run Software and check breakpoint got hit at function CntrlRBSR_BackgroundCPU2()"); 
  snprintf( chExpectedText, elCount(chExpectedText), "Verify Software is Running and breakpoint got hit at function CntrlRBSR_BackgroundCPU2()"); 
  TestStepAddActionExpected( chActionText, chExpectedText );
  A_DBGR_BreakpointDeleteAll();
  
  A_DBGR_BreakpointSet("CntrlRBSR_BackgroundCPU2");
  A_DBGR_Go(); 
  E_DBGR_BreakpointCheckForHalt("CntrlRBSR_BackgroundCPU2");
 
}



/***************************************************************************************************
----------------------------------------------------------------------------------------------------
Test case name:  TC_L30SW_QT_36542234: Testcase_to_verify_the_functionality_of_interface_CntrlRBSR_Background_to_check_the_background_CPU_is_active_for_Core3
----------------------------------------------------------------------------------------------------
Description:  test case to verify the functionality of interface CntrlRBSR_Background() to check the background CPU is active for core3.

***************************************************************************************************/
testcase Testcase_to_verify_the_functionality_of_interface_CntrlRBSR_Background_to_check_the_background_CPU_is_active_for_Core3()
{
  /***************************************************************************************************************/    
                                                // Variable Definition
  /***************************************************************************************************************/ 
  
  long taskvalue;
  
  /***************************************************************************************************************/    
                                               // Local Values
  /***************************************************************************************************************/ 
  

  
  /***************************************************************************************************************/    
                                              // Test Case Info
  /***************************************************************************************************************/
  setWriteDbgLevel(DebugOff);
  snprintf( chTestTitle, elCount(chTestTitle), "Testcase_to_verify_the_functionality_of_interface_CntrlRBSR_Background_to_check_the_background_CPU_is_active_for_Core3" );
  snprintf( chTestDescription, elCount(chTestDescription), "Purpose: test case to verify the functionality of interface CntrlRBSR_BackgroundCPU2() to check the background CPU is active for core3.");
  TestCaseAddInfo( chTestTitle, "TC_L30SW_QT_36542234", chTestDescription );

  /***************************************************************************************************************/    
                                              // Start of Test Case
  /***************************************************************************************************************/
  
  /***************************************************************************************************************/    
                                              // Test Step 1 PRECONDITIONS
  /***************************************************************************************************************/
  
  snprintf( chActionText, elCount(chActionText), "Flash the Software and ECU is running"); 
  snprintf( chExpectedText, elCount(chExpectedText), "ECU should be in running state"); 
  TestStepAddActionExpected( chActionText, chExpectedText );

  A_DBGR_BreakpointDeleteAll();
  A_DBGR_RnGo();
  E_DBGR_CheckState(T32_State_Running);
  

   /***************************************************************************************************************/    
            // Test Step 2: Check all cores are in running state                                   
  /***************************************************************************************************************/
  
  //Check Core0 is running
  snprintf( chActionText, elCount(chActionText), "Check 1000ms Task Counter from Core0 "); 
  snprintf( chExpectedText, elCount(chExpectedText), "1000ms Counter from Core0 is incrementing"); 
  TestStepAddActionExpected( chActionText, chExpectedText );
  A_DBGR_VariableRead( "Task_Core0_1000ms_Count", taskvalue);
  E_DBGR_VariableCheck("Task_Core0_1000ms_Count", taskvalue, Greater);
  
  //Check Core1 is running
  snprintf( chActionText, elCount(chActionText), "Check 1000ms Task Counter from Core1 "); 
  snprintf( chExpectedText, elCount(chExpectedText), "1000ms Counter from Core1 is incrementing"); 
  TestStepAddActionExpected( chActionText, chExpectedText );
  A_DBGR_VariableRead( "Task_Core1_1000ms_Count", taskvalue);
  E_DBGR_VariableCheck("Task_Core1_1000ms_Count", taskvalue, Greater);
  
  //Check Core2 is running
  snprintf( chActionText, elCount(chActionText), "Check 1000ms Task Counter from Core2 "); 
  snprintf( chExpectedText, elCount(chExpectedText), "1000ms Counter from Core2 is incrementing"); 
  TestStepAddActionExpected( chActionText, chExpectedText );
  A_DBGR_VariableRead( "Task_Core2_1000ms_Count", taskvalue);
  E_DBGR_VariableCheck("Task_Core2_1000ms_Count", taskvalue, Greater);
    
  //Check Core3 is running
  snprintf( chActionText, elCount(chActionText), "Check 1000ms Task Counter from Core3 "); 
  snprintf( chExpectedText, elCount(chExpectedText), "1000ms Counter from Core3 is incrementing"); 
  TestStepAddActionExpected( chActionText, chExpectedText );
  A_DBGR_VariableRead( "Task_Core3_1000ms_Count", taskvalue);
  E_DBGR_VariableCheck("Task_Core3_1000ms_Count", taskvalue, Greater);
    
  //Check Core4 is running
  snprintf( chActionText, elCount(chActionText), "Check 1000ms Task Counter from Core4 "); 
  snprintf( chExpectedText, elCount(chExpectedText), "1000ms Counter from Core4 is incrementing"); 
  TestStepAddActionExpected( chActionText, chExpectedText );
  A_DBGR_VariableRead( "Task_Core4_1000ms_Count", taskvalue);
  E_DBGR_VariableCheck("Task_Core4_1000ms_Count", taskvalue, Greater);
    
  //Check Core5 is running
  snprintf( chActionText, elCount(chActionText), "Check 1000ms Task Counter from Core5 "); 
  snprintf( chExpectedText, elCount(chExpectedText), "1000ms Counter from Core5 is incrementing"); 
  TestStepAddActionExpected( chActionText, chExpectedText );
  A_DBGR_VariableRead( "Task_Core5_1000ms_Count", taskvalue);
  E_DBGR_VariableCheck("Task_Core5_1000ms_Count", taskvalue, Greater);
  
  /*******************************************************************************************************************************************************/    
    // Test Step 3: Set breakpoint in file main.c in function FUNC(boolean, OS_CALLOUT_CODE) Os_Cbk_Idle(void) at line if( CORE3 == coreId)
  /*******************************************************************************************************************************************************/

  snprintf( chActionText, elCount(chActionText), "set breakpoint in file main.c in function FUNC(boolean, OS_CALLOUT_CODE) Os_Cbk_Idle(void) at line if( CORE3 == coreId) "); 
  snprintf( chExpectedText, elCount(chExpectedText), "Verify Breakpoint got hit at function FUNC(boolean, OS_CALLOUT_CODE) Os_Cbk_Idle(void) at line if( CORE3 == coreId)"); 
  TestStepAddActionExpected( chActionText, chExpectedText );
  A_DBGR_R();
  A_DBGR_VariableSet("coreId", "3");
  A_DBGR_BreakpointSet("P:0x8083AEC2");  
  A_DBGR_Go(); 
  E_DBGR_BreakpointCheckForHalt("P:0x8083AEC2");
  
  
  snprintf( chActionText, elCount(chActionText), "Run Software and check breakpoint got hit at function CntrlRBSR_BackgroundCPU3()"); 
  snprintf( chExpectedText, elCount(chExpectedText), "Verify Software is Running and breakpoint got hit at function CntrlRBSR_BackgroundCP3()"); 
  TestStepAddActionExpected( chActionText, chExpectedText );
  A_DBGR_BreakpointDeleteAll();
  
  A_DBGR_BreakpointSet("CntrlRBSR_BackgroundCPU3");
  A_DBGR_Go(); 
  E_DBGR_BreakpointCheckForHalt("CntrlRBSR_BackgroundCPU3");
 
}



/***************************************************************************************************
----------------------------------------------------------------------------------------------------
Test case name:  TC_L30SW_QT_36542235: Testcase_to_verify_the_functionality_of_interface_CntrlRBSR_Background_to_check_the_background_CPU_is_active_for_Core4
----------------------------------------------------------------------------------------------------
Description:  test case to verify the functionality of interface CntrlRBSR_Background() to check the background CPU is active for core4.

***************************************************************************************************/
testcase Testcase_to_verify_the_functionality_of_interface_CntrlRBSR_Background_to_check_the_background_CPU_is_active_for_Core4()
{
  /***************************************************************************************************************/    
                                                // Variable Definition
  /***************************************************************************************************************/ 
  
  long taskvalue;
  
  /***************************************************************************************************************/    
                                               // Local Values
  /***************************************************************************************************************/ 
  

  
  /***************************************************************************************************************/    
                                              // Test Case Info
  /***************************************************************************************************************/
  setWriteDbgLevel(DebugOff);
  snprintf( chTestTitle, elCount(chTestTitle), "Testcase_to_verify_the_functionality_of_interface_CntrlRBSR_Background_to_check_the_background_CPU_is_active_for_Core4" );
  snprintf( chTestDescription, elCount(chTestDescription), "Purpose: test case to verify the functionality of interface CntrlRBSR_BackgroundCPU2() to check the background CPU is active for core4.");
  TestCaseAddInfo( chTestTitle, "TC_L30SW_QT_36542235", chTestDescription );

  /***************************************************************************************************************/    
                                              // Start of Test Case
  /***************************************************************************************************************/
  
  /***************************************************************************************************************/    
                                              // Test Step 1 PRECONDITIONS
  /***************************************************************************************************************/
  
  snprintf( chActionText, elCount(chActionText), "Flash the Software and ECU is running"); 
  snprintf( chExpectedText, elCount(chExpectedText), "ECU should be in running state"); 
  TestStepAddActionExpected( chActionText, chExpectedText );

  A_DBGR_BreakpointDeleteAll();
  A_DBGR_RnGo();
  E_DBGR_CheckState(T32_State_Running);
  

   /***************************************************************************************************************/    
            // Test Step 2: Check all cores are in running state                                   
  /***************************************************************************************************************/
  
  //Check Core0 is running
  snprintf( chActionText, elCount(chActionText), "Check 1000ms Task Counter from Core0 "); 
  snprintf( chExpectedText, elCount(chExpectedText), "1000ms Counter from Core0 is incrementing"); 
  TestStepAddActionExpected( chActionText, chExpectedText );
  A_DBGR_VariableRead( "Task_Core0_1000ms_Count", taskvalue);
  E_DBGR_VariableCheck("Task_Core0_1000ms_Count", taskvalue, Greater);
  
  //Check Core1 is running
  snprintf( chActionText, elCount(chActionText), "Check 1000ms Task Counter from Core1 "); 
  snprintf( chExpectedText, elCount(chExpectedText), "1000ms Counter from Core1 is incrementing"); 
  TestStepAddActionExpected( chActionText, chExpectedText );
  A_DBGR_VariableRead( "Task_Core1_1000ms_Count", taskvalue);
  E_DBGR_VariableCheck("Task_Core1_1000ms_Count", taskvalue, Greater);
  
  //Check Core2 is running
  snprintf( chActionText, elCount(chActionText), "Check 1000ms Task Counter from Core2 "); 
  snprintf( chExpectedText, elCount(chExpectedText), "1000ms Counter from Core2 is incrementing"); 
  TestStepAddActionExpected( chActionText, chExpectedText );
  A_DBGR_VariableRead( "Task_Core2_1000ms_Count", taskvalue);
  E_DBGR_VariableCheck("Task_Core2_1000ms_Count", taskvalue, Greater);
    
  //Check Core3 is running
  snprintf( chActionText, elCount(chActionText), "Check 1000ms Task Counter from Core3 "); 
  snprintf( chExpectedText, elCount(chExpectedText), "1000ms Counter from Core3 is incrementing"); 
  TestStepAddActionExpected( chActionText, chExpectedText );
  A_DBGR_VariableRead( "Task_Core3_1000ms_Count", taskvalue);
  E_DBGR_VariableCheck("Task_Core3_1000ms_Count", taskvalue, Greater);
    
  //Check Core4 is running
  snprintf( chActionText, elCount(chActionText), "Check 1000ms Task Counter from Core4 "); 
  snprintf( chExpectedText, elCount(chExpectedText), "1000ms Counter from Core4 is incrementing"); 
  TestStepAddActionExpected( chActionText, chExpectedText );
  A_DBGR_VariableRead( "Task_Core4_1000ms_Count", taskvalue);
  E_DBGR_VariableCheck("Task_Core4_1000ms_Count", taskvalue, Greater);
    
  //Check Core5 is running
  snprintf( chActionText, elCount(chActionText), "Check 1000ms Task Counter from Core5 "); 
  snprintf( chExpectedText, elCount(chExpectedText), "1000ms Counter from Core5 is incrementing"); 
  TestStepAddActionExpected( chActionText, chExpectedText );
  A_DBGR_VariableRead( "Task_Core5_1000ms_Count", taskvalue);
  E_DBGR_VariableCheck("Task_Core5_1000ms_Count", taskvalue, Greater);
  
  /*******************************************************************************************************************************************************/    
    // Test Step 3: Set breakpoint in file main.c in function FUNC(boolean, OS_CALLOUT_CODE) Os_Cbk_Idle(void) at line if( CORE4 == coreId)
  /*******************************************************************************************************************************************************/

  snprintf( chActionText, elCount(chActionText), "set breakpoint in file main.c in function FUNC(boolean, OS_CALLOUT_CODE) Os_Cbk_Idle(void) at line if( CORE4 == coreId) "); 
  snprintf( chExpectedText, elCount(chExpectedText), "Verify Breakpoint got hit at function FUNC(boolean, OS_CALLOUT_CODE) Os_Cbk_Idle(void) at line if( CORE4 == coreId)"); 
  TestStepAddActionExpected( chActionText, chExpectedText );
  A_DBGR_R();
  A_DBGR_VariableSet("coreId", "4");
  A_DBGR_BreakpointSet("P:0x8083AECC");  
  A_DBGR_Go(); 
  E_DBGR_BreakpointCheckForHalt("P:0x8083AECC");
  
  
  snprintf( chActionText, elCount(chActionText), "Run Software and check breakpoint got hit at function CntrlRBSR_BackgroundCPU4()"); 
  snprintf( chExpectedText, elCount(chExpectedText), "Verify Software is Running and breakpoint got hit at function CntrlRBSR_BackgroundCP4()"); 
  TestStepAddActionExpected( chActionText, chExpectedText );
  A_DBGR_BreakpointDeleteAll();
  
  A_DBGR_BreakpointSet("CntrlRBSR_BackgroundCPU4");
  A_DBGR_Go(); 
  E_DBGR_BreakpointCheckForHalt("CntrlRBSR_BackgroundCPU4");
 
}



/***************************************************************************************************
----------------------------------------------------------------------------------------------------
Test case name:  TC_L30SW_QT_36542235: Testcase_to_verify_the_functionality_of_interface_CntrlRBSR_Background_to_check_the_background_CPU_is_active_for_Core5
----------------------------------------------------------------------------------------------------
Description:  test case to verify the functionality of interface CntrlRBSR_Background() to check the background CPU is active for core5.

***************************************************************************************************/
testcase Testcase_to_verify_the_functionality_of_interface_CntrlRBSR_Background_to_check_the_background_CPU_is_active_for_Core5()
{
  /***************************************************************************************************************/    
                                                // Variable Definition
  /***************************************************************************************************************/ 
  
  long taskvalue;
  
  /***************************************************************************************************************/    
                                               // Local Values
  /***************************************************************************************************************/ 
  

  
  /***************************************************************************************************************/    
                                              // Test Case Info
  /***************************************************************************************************************/
  setWriteDbgLevel(DebugOff);
  snprintf( chTestTitle, elCount(chTestTitle), "Testcase_to_verify_the_functionality_of_interface_CntrlRBSR_Background_to_check_the_background_CPU_is_active_for_Core5" );
  snprintf( chTestDescription, elCount(chTestDescription), "Purpose: test case to verify the functionality of interface CntrlRBSR_BackgroundCPU2() to check the background CPU is active for core5.");
  TestCaseAddInfo( chTestTitle, "TC_L30SW_QT_36542236", chTestDescription );

  /***************************************************************************************************************/    
                                              // Start of Test Case
  /***************************************************************************************************************/
  
  /***************************************************************************************************************/    
                                              // Test Step 1 PRECONDITIONS
  /***************************************************************************************************************/
  
  snprintf( chActionText, elCount(chActionText), "Flash the Software and ECU is running"); 
  snprintf( chExpectedText, elCount(chExpectedText), "ECU should be in running state"); 
  TestStepAddActionExpected( chActionText, chExpectedText );

  A_DBGR_BreakpointDeleteAll();
  A_DBGR_RnGo();
  E_DBGR_CheckState(T32_State_Running);
  

   /***************************************************************************************************************/    
            // Test Step 2: Check all cores are in running state                                   
  /***************************************************************************************************************/
  
  //Check Core0 is running
  snprintf( chActionText, elCount(chActionText), "Check 1000ms Task Counter from Core0 "); 
  snprintf( chExpectedText, elCount(chExpectedText), "1000ms Counter from Core0 is incrementing"); 
  TestStepAddActionExpected( chActionText, chExpectedText );
  A_DBGR_VariableRead( "Task_Core0_1000ms_Count", taskvalue);
  E_DBGR_VariableCheck("Task_Core0_1000ms_Count", taskvalue, Greater);
  
  //Check Core1 is running
  snprintf( chActionText, elCount(chActionText), "Check 1000ms Task Counter from Core1 "); 
  snprintf( chExpectedText, elCount(chExpectedText), "1000ms Counter from Core1 is incrementing"); 
  TestStepAddActionExpected( chActionText, chExpectedText );
  A_DBGR_VariableRead( "Task_Core1_1000ms_Count", taskvalue);
  E_DBGR_VariableCheck("Task_Core1_1000ms_Count", taskvalue, Greater);
  
  //Check Core2 is running
  snprintf( chActionText, elCount(chActionText), "Check 1000ms Task Counter from Core2 "); 
  snprintf( chExpectedText, elCount(chExpectedText), "1000ms Counter from Core2 is incrementing"); 
  TestStepAddActionExpected( chActionText, chExpectedText );
  A_DBGR_VariableRead( "Task_Core2_1000ms_Count", taskvalue);
  E_DBGR_VariableCheck("Task_Core2_1000ms_Count", taskvalue, Greater);
    
  //Check Core3 is running
  snprintf( chActionText, elCount(chActionText), "Check 1000ms Task Counter from Core3 "); 
  snprintf( chExpectedText, elCount(chExpectedText), "1000ms Counter from Core3 is incrementing"); 
  TestStepAddActionExpected( chActionText, chExpectedText );
  A_DBGR_VariableRead( "Task_Core3_1000ms_Count", taskvalue);
  E_DBGR_VariableCheck("Task_Core3_1000ms_Count", taskvalue, Greater);
    
  //Check Core4 is running
  snprintf( chActionText, elCount(chActionText), "Check 1000ms Task Counter from Core4 "); 
  snprintf( chExpectedText, elCount(chExpectedText), "1000ms Counter from Core4 is incrementing"); 
  TestStepAddActionExpected( chActionText, chExpectedText );
  A_DBGR_VariableRead( "Task_Core4_1000ms_Count", taskvalue);
  E_DBGR_VariableCheck("Task_Core4_1000ms_Count", taskvalue, Greater);
    
  //Check Core5 is running
  snprintf( chActionText, elCount(chActionText), "Check 1000ms Task Counter from Core5 "); 
  snprintf( chExpectedText, elCount(chExpectedText), "1000ms Counter from Core5 is incrementing"); 
  TestStepAddActionExpected( chActionText, chExpectedText );
  A_DBGR_VariableRead( "Task_Core5_1000ms_Count", taskvalue);
  E_DBGR_VariableCheck("Task_Core5_1000ms_Count", taskvalue, Greater);
  
  /*******************************************************************************************************************************************************/    
    // Test Step 3: Set breakpoint in file main.c in function FUNC(boolean, OS_CALLOUT_CODE) Os_Cbk_Idle(void) at line if( CORE5 == coreId)
  /*******************************************************************************************************************************************************/

  snprintf( chActionText, elCount(chActionText), "set breakpoint in file main.c in function FUNC(boolean, OS_CALLOUT_CODE) Os_Cbk_Idle(void) at line if( CORE5 == coreId) "); 
  snprintf( chExpectedText, elCount(chExpectedText), "Verify Breakpoint got hit at function FUNC(boolean, OS_CALLOUT_CODE) Os_Cbk_Idle(void) at line if( CORE5 == coreId)"); 
  TestStepAddActionExpected( chActionText, chExpectedText );
  A_DBGR_R();
  A_DBGR_VariableSet("coreId", "5");
  A_DBGR_BreakpointSet("P:0x8083AED6");  
  A_DBGR_Go(); 
  E_DBGR_BreakpointCheckForHalt("P:0x8083AED6");
  
  
  snprintf( chActionText, elCount(chActionText), "Run Software and check breakpoint got hit at function CntrlRBSR_BackgroundCPU5()"); 
  snprintf( chExpectedText, elCount(chExpectedText), "Verify Software is Running and breakpoint got hit at function CntrlRBSR_BackgroundCP5()"); 
  TestStepAddActionExpected( chActionText, chExpectedText );
  A_DBGR_BreakpointDeleteAll();
  
  A_DBGR_BreakpointSet("CntrlRBSR_BackgroundCPU5");
  A_DBGR_Go(); 
  E_DBGR_BreakpointCheckForHalt("CntrlRBSR_BackgroundCPU5");
 
}



/***************************************************************************************************
----------------------------------------------------------------------------------------------------
Test case name:  TC_L30SW_Q-36542206: Testcase_to_verify_the_functionality_of_interface_MngTSKR_e_OS_Error_shall_be_triggred_to_Check_OS_error_state_for_CPU0
----------------------------------------------------------------------------------------------------
Description:  Testcase_to_verify_the_functionality_of_interface_MngTSKR_e_OS_Error_shall_be_triggred_to_Check_OS_error_state_for_CPU0

***************************************************************************************************/
testcase Testcase_to_verify_the_functionality_of_interface_MngTSKR_e_OS_Error_shall_be_triggred_to_Check_OS_error_state_for_CPU0()
{
  /***************************************************************************************************************/    
                                                // Variable Definition
  /***************************************************************************************************************/ 
  
  long taskvalue;
  
  /***************************************************************************************************************/    
                                               // Local Values
  /***************************************************************************************************************/ 
  

  
  /***************************************************************************************************************/    
                                              // Test Case Info
  /***************************************************************************************************************/
  setWriteDbgLevel(DebugOff);
  snprintf( chTestTitle, elCount(chTestTitle), "Testcase_to_verify_the_functionality_of_interface_MngTSKR_e_OS_Error_shall_be_triggred_to_Check_OS_error_state_for_CPU0" );
  snprintf( chTestDescription, elCount(chTestDescription), "Purose: Testcase_to_verify_the_functionality_of_interface_MngTSKR_e_OS_Error_shall_be_triggred_to_Check_OS_error_state_for_CPU0");
  TestCaseAddInfo( chTestTitle, "TC_L30SW_Q-36542206", chTestDescription );

  /***************************************************************************************************************/    
                                              // Start of Test Case
  /***************************************************************************************************************/
  
  /***************************************************************************************************************/    
                                              // Test Step 1 PRECONDITIONS
  /***************************************************************************************************************/
  
  snprintf( chActionText, elCount(chActionText), "Flash the Software and ECU is running"); 
  snprintf( chExpectedText, elCount(chExpectedText), "ECU should be in running state"); 
  TestStepAddActionExpected( chActionText, chExpectedText );

  A_DBGR_BreakpointDeleteAll();
  A_DBGR_RnGo();
  E_DBGR_CheckState(T32_State_Running);
  

   /***************************************************************************************************************/    
            // Test Step 2: Check all cores are in running state                                   
  /***************************************************************************************************************/
  
  //Check Core0 is running
  snprintf( chActionText, elCount(chActionText), "Check 1000ms Task Counter from Core0 "); 
  snprintf( chExpectedText, elCount(chExpectedText), "1000ms Counter from Core0 is incrementing"); 
  TestStepAddActionExpected( chActionText, chExpectedText );
  A_DBGR_VariableRead( "Task_Core0_1000ms_Count", taskvalue);
  E_DBGR_VariableCheck("Task_Core0_1000ms_Count", taskvalue, Greater);
  
  //Check Core1 is running
  snprintf( chActionText, elCount(chActionText), "Check 1000ms Task Counter from Core1 "); 
  snprintf( chExpectedText, elCount(chExpectedText), "1000ms Counter from Core1 is incrementing"); 
  TestStepAddActionExpected( chActionText, chExpectedText );
  A_DBGR_VariableRead( "Task_Core1_1000ms_Count", taskvalue);
  E_DBGR_VariableCheck("Task_Core1_1000ms_Count", taskvalue, Greater);
  
  //Check Core2 is running
  snprintf( chActionText, elCount(chActionText), "Check 1000ms Task Counter from Core2 "); 
  snprintf( chExpectedText, elCount(chExpectedText), "1000ms Counter from Core2 is incrementing"); 
  TestStepAddActionExpected( chActionText, chExpectedText );
  A_DBGR_VariableRead( "Task_Core2_1000ms_Count", taskvalue);
  E_DBGR_VariableCheck("Task_Core2_1000ms_Count", taskvalue, Greater);
    
  //Check Core3 is running
  snprintf( chActionText, elCount(chActionText), "Check 1000ms Task Counter from Core3 "); 
  snprintf( chExpectedText, elCount(chExpectedText), "1000ms Counter from Core3 is incrementing"); 
  TestStepAddActionExpected( chActionText, chExpectedText );
  A_DBGR_VariableRead( "Task_Core3_1000ms_Count", taskvalue);
  E_DBGR_VariableCheck("Task_Core3_1000ms_Count", taskvalue, Greater);
    
  //Check Core4 is running
  snprintf( chActionText, elCount(chActionText), "Check 1000ms Task Counter from Core4 "); 
  snprintf( chExpectedText, elCount(chExpectedText), "1000ms Counter from Core4 is incrementing"); 
  TestStepAddActionExpected( chActionText, chExpectedText );
  A_DBGR_VariableRead( "Task_Core4_1000ms_Count", taskvalue);
  E_DBGR_VariableCheck("Task_Core4_1000ms_Count", taskvalue, Greater);
    
  //Check Core5 is running
  snprintf( chActionText, elCount(chActionText), "Check 1000ms Task Counter from Core5 "); 
  snprintf( chExpectedText, elCount(chExpectedText), "1000ms Counter from Core5 is incrementing"); 
  TestStepAddActionExpected( chActionText, chExpectedText );
  A_DBGR_VariableRead( "Task_Core5_1000ms_Count", taskvalue);
  E_DBGR_VariableCheck("Task_Core5_1000ms_Count", taskvalue, Greater);
  
  /***************************************************************************************************************/    
    // Test Step 3: Set breakpoint at function FUNC(void, OS_CALLOUT_CODE) ErrorHook(void) and  MngTSKR_e_OS_Error( ) and check function called
  /***************************************************************************************************************/

  snprintf( chActionText, elCount(chActionText), "Set Breakpoint at FUNC(void, OS_CALLOUT_CODE) PreTaskHook(void), Run SW & check Break point got hit "); 
  snprintf( chExpectedText, elCount(chExpectedText), "Verify Breakpoint got hit at FUNC(void, OS_CALLOUT_CODE) PreTaskHook(void)"); 
  TestStepAddActionExpected( chActionText, chExpectedText );
  A_DBGR_BreakpointSet("Os_Entry_Task_Core0_2pt5ms\\18"); 
  A_DBGR_Go(); 
  E_DBGR_BreakpointCheckForHalt("Os_Entry_Task_Core0_2pt5ms\\18");
  
  
  snprintf( chActionText, elCount(chActionText), "Run Software and check breakpoint got hit at function MngTSKR_e_PreTask();   "); 
  snprintf( chExpectedText, elCount(chExpectedText), "Verify Software is Running and breakpoint got hit at function MngTSKR_e_PreTask();"); 
  TestStepAddActionExpected( chActionText, chExpectedText );
  A_DBGR_BreakpointDeleteAll();
  A_DBGR_BreakpointSet("ErrorHook\\17"); 
  A_DBGR_Go(); 
  E_DBGR_BreakpointCheckForHalt("ErrorHook\\17");
 
}


/***************************************************************************************************
----------------------------------------------------------------------------------------------------
Test case name:  TC_L30SW_Q-36542207 Testcase_to_verify_the_functionality_of_interface_MngTSKR_e_OS_Error_shall_be_triggred_to_Check_OS_error_state_for_CPU1
----------------------------------------------------------------------------------------------------
Description:  Testcase_to_verify_the_functionality_of_interface_MngTSKR_e_OS_Error_shall_be_triggred_to_Check_OS_error_state_for_CPU1

***************************************************************************************************/
testcase Testcase_to_verify_the_functionality_of_interface_MngTSKR_e_OS_Error_shall_be_triggred_to_Check_OS_error_state_for_CPU1()
{
  /***************************************************************************************************************/    
                                                // Variable Definition
  /***************************************************************************************************************/ 
  
  long taskvalue;
  
  /***************************************************************************************************************/    
                                               // Local Values
  /***************************************************************************************************************/ 
  

  
  /***************************************************************************************************************/    
                                              // Test Case Info
  /***************************************************************************************************************/
  setWriteDbgLevel(DebugOff);
  snprintf( chTestTitle, elCount(chTestTitle), "Testcase_to_verify_the_functionality_of_interface_MngTSKR_e_OS_Error_shall_be_triggred_to_Check_OS_error_state_for_CPU1" );
  snprintf( chTestDescription, elCount(chTestDescription), "Purose: Testcase_to_verify_the_functionality_of_interface_MngTSKR_e_OS_Error_shall_be_triggred_to_Check_OS_error_state_for_CPU1");
  TestCaseAddInfo( chTestTitle, "TC_L30SW_Q-36542207", chTestDescription );

  /***************************************************************************************************************/    
                                              // Start of Test Case
  /***************************************************************************************************************/
  
  /***************************************************************************************************************/    
                                              // Test Step 1 PRECONDITIONS
  /***************************************************************************************************************/
  
  snprintf( chActionText, elCount(chActionText), "Flash the Software and ECU is running"); 
  snprintf( chExpectedText, elCount(chExpectedText), "ECU should be in running state"); 
  TestStepAddActionExpected( chActionText, chExpectedText );

  A_DBGR_BreakpointDeleteAll();
  A_DBGR_RnGo();
  E_DBGR_CheckState(T32_State_Running);
  

   /***************************************************************************************************************/    
            // Test Step 2: Check all cores are in running state                                   
  /***************************************************************************************************************/
  
  //Check Core0 is running
  snprintf( chActionText, elCount(chActionText), "Check 1000ms Task Counter from Core0 "); 
  snprintf( chExpectedText, elCount(chExpectedText), "1000ms Counter from Core0 is incrementing"); 
  TestStepAddActionExpected( chActionText, chExpectedText );
  A_DBGR_VariableRead( "Task_Core0_1000ms_Count", taskvalue);
  E_DBGR_VariableCheck("Task_Core0_1000ms_Count", taskvalue, Greater);
  
  //Check Core1 is running
  snprintf( chActionText, elCount(chActionText), "Check 1000ms Task Counter from Core1 "); 
  snprintf( chExpectedText, elCount(chExpectedText), "1000ms Counter from Core1 is incrementing"); 
  TestStepAddActionExpected( chActionText, chExpectedText );
  A_DBGR_VariableRead( "Task_Core1_1000ms_Count", taskvalue);
  E_DBGR_VariableCheck("Task_Core1_1000ms_Count", taskvalue, Greater);
  
  //Check Core2 is running
  snprintf( chActionText, elCount(chActionText), "Check 1000ms Task Counter from Core2 "); 
  snprintf( chExpectedText, elCount(chExpectedText), "1000ms Counter from Core2 is incrementing"); 
  TestStepAddActionExpected( chActionText, chExpectedText );
  A_DBGR_VariableRead( "Task_Core2_1000ms_Count", taskvalue);
  E_DBGR_VariableCheck("Task_Core2_1000ms_Count", taskvalue, Greater);
    
  //Check Core3 is running
  snprintf( chActionText, elCount(chActionText), "Check 1000ms Task Counter from Core3 "); 
  snprintf( chExpectedText, elCount(chExpectedText), "1000ms Counter from Core3 is incrementing"); 
  TestStepAddActionExpected( chActionText, chExpectedText );
  A_DBGR_VariableRead( "Task_Core3_1000ms_Count", taskvalue);
  E_DBGR_VariableCheck("Task_Core3_1000ms_Count", taskvalue, Greater);
    
  //Check Core4 is running
  snprintf( chActionText, elCount(chActionText), "Check 1000ms Task Counter from Core4 "); 
  snprintf( chExpectedText, elCount(chExpectedText), "1000ms Counter from Core4 is incrementing"); 
  TestStepAddActionExpected( chActionText, chExpectedText );
  A_DBGR_VariableRead( "Task_Core4_1000ms_Count", taskvalue);
  E_DBGR_VariableCheck("Task_Core4_1000ms_Count", taskvalue, Greater);
    
  //Check Core5 is running
  snprintf( chActionText, elCount(chActionText), "Check 1000ms Task Counter from Core5 "); 
  snprintf( chExpectedText, elCount(chExpectedText), "1000ms Counter from Core5 is incrementing"); 
  TestStepAddActionExpected( chActionText, chExpectedText );
  A_DBGR_VariableRead( "Task_Core5_1000ms_Count", taskvalue);
  E_DBGR_VariableCheck("Task_Core5_1000ms_Count", taskvalue, Greater);
  
  /***************************************************************************************************************/    
    // Test Step 3: Set breakpoint at function FUNC(void, OS_CALLOUT_CODE) ErrorHook(void) and  MngTSKR_e_OS_Error( ) and check function called
  /***************************************************************************************************************/

  snprintf( chActionText, elCount(chActionText), "Set Breakpoint at FUNC(void, OS_CALLOUT_CODE) PreTaskHook(void), Run SW & check Break point got hit "); 
  snprintf( chExpectedText, elCount(chExpectedText), "Verify Breakpoint got hit at FUNC(void, OS_CALLOUT_CODE) PreTaskHook(void)"); 
  TestStepAddActionExpected( chActionText, chExpectedText );
  A_DBGR_BreakpointSet("Os_Entry_Task_Core1_2pt5ms\15"); 
  A_DBGR_Go(); 
  E_DBGR_BreakpointCheckForHalt("Os_Entry_Task_Core1_2pt5ms\15");
  
  
  snprintf( chActionText, elCount(chActionText), "Run Software and check breakpoint got hit at function MngTSKR_e_PreTask();   "); 
  snprintf( chExpectedText, elCount(chExpectedText), "Verify Software is Running and breakpoint got hit at function MngTSKR_e_PreTask();"); 
  TestStepAddActionExpected( chActionText, chExpectedText );
  A_DBGR_BreakpointDeleteAll();
  A_DBGR_BreakpointSet("ErrorHook\\21"); 
  A_DBGR_Go(); 
  E_DBGR_BreakpointCheckForHalt("ErrorHook\\21");
 
}



/***************************************************************************************************
----------------------------------------------------------------------------------------------------
Test case name:  TC_L30SW_Q-36542208: Testcase_to_verify_the_functionality_of_interface_MngTSKR_e_OS_Error_shall_be_triggred_to_Check_OS_error_state_for_CPU2
----------------------------------------------------------------------------------------------------
Description:  Testcase_to_verify_the_functionality_of_interface_MngTSKR_e_OS_Error_shall_be_triggred_to_Check_OS_error_state_for_CPU2

***************************************************************************************************/
testcase Testcase_to_verify_the_functionality_of_interface_MngTSKR_e_OS_Error_shall_be_triggred_to_Check_OS_error_state_for_CPU2()
{
  /***************************************************************************************************************/    
                                                // Variable Definition
  /***************************************************************************************************************/ 
  
  long taskvalue;
  
  /***************************************************************************************************************/    
                                               // Local Values
  /***************************************************************************************************************/ 
  

  
  /***************************************************************************************************************/    
                                              // Test Case Info
  /***************************************************************************************************************/
  setWriteDbgLevel(DebugOff);
  snprintf( chTestTitle, elCount(chTestTitle), "Testcase_to_verify_the_functionality_of_interface_MngTSKR_e_OS_Error_shall_be_triggred_to_Check_OS_error_state_for_CPU2" );
  snprintf( chTestDescription, elCount(chTestDescription), "Purose: Testcase_to_verify_the_functionality_of_interface_MngTSKR_e_OS_Error_shall_be_triggred_to_Check_OS_error_state_for_CPU2");
  TestCaseAddInfo( chTestTitle, "TC_L30SW_Q-36542208", chTestDescription );

  /***************************************************************************************************************/    
                                              // Start of Test Case
  /***************************************************************************************************************/
  
  /***************************************************************************************************************/    
                                              // Test Step 1 PRECONDITIONS
  /***************************************************************************************************************/
  
  snprintf( chActionText, elCount(chActionText), "Flash the Software and ECU is running"); 
  snprintf( chExpectedText, elCount(chExpectedText), "ECU should be in running state"); 
  TestStepAddActionExpected( chActionText, chExpectedText );

  A_DBGR_BreakpointDeleteAll();
  A_DBGR_RnGo();
  E_DBGR_CheckState(T32_State_Running);
  

   /***************************************************************************************************************/    
            // Test Step 2: Check all cores are in running state                                   
  /***************************************************************************************************************/
  
  //Check Core0 is running
  snprintf( chActionText, elCount(chActionText), "Check 1000ms Task Counter from Core0 "); 
  snprintf( chExpectedText, elCount(chExpectedText), "1000ms Counter from Core0 is incrementing"); 
  TestStepAddActionExpected( chActionText, chExpectedText );
  A_DBGR_VariableRead( "Task_Core0_1000ms_Count", taskvalue);
  E_DBGR_VariableCheck("Task_Core0_1000ms_Count", taskvalue, Greater);
  
  //Check Core1 is running
  snprintf( chActionText, elCount(chActionText), "Check 1000ms Task Counter from Core1 "); 
  snprintf( chExpectedText, elCount(chExpectedText), "1000ms Counter from Core1 is incrementing"); 
  TestStepAddActionExpected( chActionText, chExpectedText );
  A_DBGR_VariableRead( "Task_Core1_1000ms_Count", taskvalue);
  E_DBGR_VariableCheck("Task_Core1_1000ms_Count", taskvalue, Greater);
  
  //Check Core2 is running
  snprintf( chActionText, elCount(chActionText), "Check 1000ms Task Counter from Core2 "); 
  snprintf( chExpectedText, elCount(chExpectedText), "1000ms Counter from Core2 is incrementing"); 
  TestStepAddActionExpected( chActionText, chExpectedText );
  A_DBGR_VariableRead( "Task_Core2_1000ms_Count", taskvalue);
  E_DBGR_VariableCheck("Task_Core2_1000ms_Count", taskvalue, Greater);
    
  //Check Core3 is running
  snprintf( chActionText, elCount(chActionText), "Check 1000ms Task Counter from Core3 "); 
  snprintf( chExpectedText, elCount(chExpectedText), "1000ms Counter from Core3 is incrementing"); 
  TestStepAddActionExpected( chActionText, chExpectedText );
  A_DBGR_VariableRead( "Task_Core3_1000ms_Count", taskvalue);
  E_DBGR_VariableCheck("Task_Core3_1000ms_Count", taskvalue, Greater);
    
  //Check Core4 is running
  snprintf( chActionText, elCount(chActionText), "Check 1000ms Task Counter from Core4 "); 
  snprintf( chExpectedText, elCount(chExpectedText), "1000ms Counter from Core4 is incrementing"); 
  TestStepAddActionExpected( chActionText, chExpectedText );
  A_DBGR_VariableRead( "Task_Core4_1000ms_Count", taskvalue);
  E_DBGR_VariableCheck("Task_Core4_1000ms_Count", taskvalue, Greater);
    
  //Check Core5 is running
  snprintf( chActionText, elCount(chActionText), "Check 1000ms Task Counter from Core5 "); 
  snprintf( chExpectedText, elCount(chExpectedText), "1000ms Counter from Core5 is incrementing"); 
  TestStepAddActionExpected( chActionText, chExpectedText );
  A_DBGR_VariableRead( "Task_Core5_1000ms_Count", taskvalue);
  E_DBGR_VariableCheck("Task_Core5_1000ms_Count", taskvalue, Greater);
  
  /***************************************************************************************************************/    
    // Test Step 3: Set breakpoint at function FUNC(void, OS_CALLOUT_CODE) ErrorHook(void) and  MngTSKR_e_OS_Error( ) and check function called
  /***************************************************************************************************************/

  snprintf( chActionText, elCount(chActionText), "Set Breakpoint at FUNC(void, OS_CALLOUT_CODE) PreTaskHook(void), Run SW & check Break point got hit "); 
  snprintf( chExpectedText, elCount(chExpectedText), "Verify Breakpoint got hit at FUNC(void, OS_CALLOUT_CODE) PreTaskHook(void)"); 
  TestStepAddActionExpected( chActionText, chExpectedText );
  A_DBGR_BreakpointSet("Os_Entry_Task_Core2_2pt5ms\23"); 
  A_DBGR_Go(); 
  E_DBGR_BreakpointCheckForHalt("Os_Entry_Task_Core2_2pt5ms\23");
  
  
  snprintf( chActionText, elCount(chActionText), "Run Software and check breakpoint got hit at function MngTSKR_e_PreTask();   "); 
  snprintf( chExpectedText, elCount(chExpectedText), "Verify Software is Running and breakpoint got hit at function MngTSKR_e_PreTask();"); 
  TestStepAddActionExpected( chActionText, chExpectedText );
  A_DBGR_BreakpointDeleteAll();
  A_DBGR_BreakpointSet("ErrorHook\\25"); 
  A_DBGR_Go(); 
  E_DBGR_BreakpointCheckForHalt("ErrorHook\\25");
 
}





/***************************************************************************************************
----------------------------------------------------------------------------------------------------
Test case name:  TC_L30SW_Q-36542209: Testcase_to_verify_the_functionality_of_interface_MngTSKR_e_OS_Error_shall_be_triggred_to_Check_OS_error_state_for_CPU3
----------------------------------------------------------------------------------------------------
Description:  Testcase_to_verify_the_functionality_of_interface_MngTSKR_e_OS_Error_shall_be_triggred_to_Check_OS_error_state_for_CPU3

***************************************************************************************************/
testcase Testcase_to_verify_the_functionality_of_interface_MngTSKR_e_OS_Error_shall_be_triggred_to_Check_OS_error_state_for_CPU3()
{
  /***************************************************************************************************************/    
                                                // Variable Definition
  /***************************************************************************************************************/ 
  
  long taskvalue;
  
  /***************************************************************************************************************/    
                                               // Local Values
  /***************************************************************************************************************/ 
  

  
  /***************************************************************************************************************/    
                                              // Test Case Info
  /***************************************************************************************************************/
  setWriteDbgLevel(DebugOff);
  snprintf( chTestTitle, elCount(chTestTitle), "Testcase_to_verify_the_functionality_of_interface_MngTSKR_e_OS_Error_shall_be_triggred_to_Check_OS_error_state_for_CPU3" );
  snprintf( chTestDescription, elCount(chTestDescription), "Purose: Testcase_to_verify_the_functionality_of_interface_MngTSKR_e_OS_Error_shall_be_triggred_to_Check_OS_error_state_for_CPU3");
  TestCaseAddInfo( chTestTitle, "TC_L30SW_Q-36542209", chTestDescription );

  /***************************************************************************************************************/    
                                              // Start of Test Case
  /***************************************************************************************************************/
  
  /***************************************************************************************************************/    
                                              // Test Step 1 PRECONDITIONS
  /***************************************************************************************************************/
  
  snprintf( chActionText, elCount(chActionText), "Flash the Software and ECU is running"); 
  snprintf( chExpectedText, elCount(chExpectedText), "ECU should be in running state"); 
  TestStepAddActionExpected( chActionText, chExpectedText );

  A_DBGR_BreakpointDeleteAll();
  A_DBGR_RnGo();
  E_DBGR_CheckState(T32_State_Running);
  

   /***************************************************************************************************************/    
            // Test Step 2: Check all cores are in running state                                   
  /***************************************************************************************************************/
  
  //Check Core0 is running
  snprintf( chActionText, elCount(chActionText), "Check 1000ms Task Counter from Core0 "); 
  snprintf( chExpectedText, elCount(chExpectedText), "1000ms Counter from Core0 is incrementing"); 
  TestStepAddActionExpected( chActionText, chExpectedText );
  A_DBGR_VariableRead( "Task_Core0_1000ms_Count", taskvalue);
  E_DBGR_VariableCheck("Task_Core0_1000ms_Count", taskvalue, Greater);
  
  //Check Core1 is running
  snprintf( chActionText, elCount(chActionText), "Check 1000ms Task Counter from Core1 "); 
  snprintf( chExpectedText, elCount(chExpectedText), "1000ms Counter from Core1 is incrementing"); 
  TestStepAddActionExpected( chActionText, chExpectedText );
  A_DBGR_VariableRead( "Task_Core1_1000ms_Count", taskvalue);
  E_DBGR_VariableCheck("Task_Core1_1000ms_Count", taskvalue, Greater);
  
  //Check Core2 is running
  snprintf( chActionText, elCount(chActionText), "Check 1000ms Task Counter from Core2 "); 
  snprintf( chExpectedText, elCount(chExpectedText), "1000ms Counter from Core2 is incrementing"); 
  TestStepAddActionExpected( chActionText, chExpectedText );
  A_DBGR_VariableRead( "Task_Core2_1000ms_Count", taskvalue);
  E_DBGR_VariableCheck("Task_Core2_1000ms_Count", taskvalue, Greater);
    
  //Check Core3 is running
  snprintf( chActionText, elCount(chActionText), "Check 1000ms Task Counter from Core3 "); 
  snprintf( chExpectedText, elCount(chExpectedText), "1000ms Counter from Core3 is incrementing"); 
  TestStepAddActionExpected( chActionText, chExpectedText );
  A_DBGR_VariableRead( "Task_Core3_1000ms_Count", taskvalue);
  E_DBGR_VariableCheck("Task_Core3_1000ms_Count", taskvalue, Greater);
    
  //Check Core4 is running
  snprintf( chActionText, elCount(chActionText), "Check 1000ms Task Counter from Core4 "); 
  snprintf( chExpectedText, elCount(chExpectedText), "1000ms Counter from Core4 is incrementing"); 
  TestStepAddActionExpected( chActionText, chExpectedText );
  A_DBGR_VariableRead( "Task_Core4_1000ms_Count", taskvalue);
  E_DBGR_VariableCheck("Task_Core4_1000ms_Count", taskvalue, Greater);
    
  //Check Core5 is running
  snprintf( chActionText, elCount(chActionText), "Check 1000ms Task Counter from Core5 "); 
  snprintf( chExpectedText, elCount(chExpectedText), "1000ms Counter from Core5 is incrementing"); 
  TestStepAddActionExpected( chActionText, chExpectedText );
  A_DBGR_VariableRead( "Task_Core5_1000ms_Count", taskvalue);
  E_DBGR_VariableCheck("Task_Core5_1000ms_Count", taskvalue, Greater);
  
  /***************************************************************************************************************/    
    // Test Step 3: Set breakpoint at function FUNC(void, OS_CALLOUT_CODE) ErrorHook(void) and  MngTSKR_e_OS_Error( ) and check function called
  /***************************************************************************************************************/

  snprintf( chActionText, elCount(chActionText), "Set Breakpoint at FUNC(void, OS_CALLOUT_CODE) PreTaskHook(void), Run SW & check Break point got hit "); 
  snprintf( chExpectedText, elCount(chExpectedText), "Verify Breakpoint got hit at FUNC(void, OS_CALLOUT_CODE) PreTaskHook(void)"); 
  TestStepAddActionExpected( chActionText, chExpectedText );
  A_DBGR_BreakpointSet("Os_Entry_Task_Core3_2pt5ms\23"); 
  A_DBGR_Go(); 
  E_DBGR_BreakpointCheckForHalt("Os_Entry_Task_Core3_2pt5ms\23");
  
  
  snprintf( chActionText, elCount(chActionText), "Run Software and check breakpoint got hit at function MngTSKR_e_PreTask();   "); 
  snprintf( chExpectedText, elCount(chExpectedText), "Verify Software is Running and breakpoint got hit at function MngTSKR_e_PreTask();"); 
  TestStepAddActionExpected( chActionText, chExpectedText );
  A_DBGR_BreakpointDeleteAll();
  A_DBGR_BreakpointSet("ErrorHook\\29"); 
  A_DBGR_Go(); 
  E_DBGR_BreakpointCheckForHalt("ErrorHook\\29");
 
}





/***************************************************************************************************
----------------------------------------------------------------------------------------------------
Test case name:  TC_L30SW_Q-36542210: Testcase_to_verify_the_functionality_of_interface_MngTSKR_e_OS_Error_shall_be_triggred_to_Check_OS_error_state_for_CPU4
----------------------------------------------------------------------------------------------------
Description:  Testcase_to_verify_the_functionality_of_interface_MngTSKR_e_OS_Error_shall_be_triggred_to_Check_OS_error_state_for_CPU4

***************************************************************************************************/
testcase Testcase_to_verify_the_functionality_of_interface_MngTSKR_e_OS_Error_shall_be_triggred_to_Check_OS_error_state_for_CPU4()
{
  /***************************************************************************************************************/    
                                                // Variable Definition
  /***************************************************************************************************************/ 
  
  long taskvalue;
  
  /***************************************************************************************************************/    
                                               // Local Values
  /***************************************************************************************************************/ 
  

  
  /***************************************************************************************************************/    
                                              // Test Case Info
  /***************************************************************************************************************/
  setWriteDbgLevel(DebugOff);
  snprintf( chTestTitle, elCount(chTestTitle), "Testcase_to_verify_the_functionality_of_interface_MngTSKR_e_OS_Error_shall_be_triggred_to_Check_OS_error_state_for_CPU4" );
  snprintf( chTestDescription, elCount(chTestDescription), "Purose: Testcase_to_verify_the_functionality_of_interface_MngTSKR_e_OS_Error_shall_be_triggred_to_Check_OS_error_state_for_CPU4");
  TestCaseAddInfo( chTestTitle, "TC_L30SW_Q-36542210", chTestDescription );

  /***************************************************************************************************************/    
                                              // Start of Test Case
  /***************************************************************************************************************/
  
  /***************************************************************************************************************/    
                                              // Test Step 1 PRECONDITIONS
  /***************************************************************************************************************/
  
  snprintf( chActionText, elCount(chActionText), "Flash the Software and ECU is running"); 
  snprintf( chExpectedText, elCount(chExpectedText), "ECU should be in running state"); 
  TestStepAddActionExpected( chActionText, chExpectedText );

  A_DBGR_BreakpointDeleteAll();
  A_DBGR_RnGo();
  E_DBGR_CheckState(T32_State_Running);
  

   /***************************************************************************************************************/    
            // Test Step 2: Check all cores are in running state                                   
  /***************************************************************************************************************/
  
  //Check Core0 is running
  snprintf( chActionText, elCount(chActionText), "Check 1000ms Task Counter from Core0 "); 
  snprintf( chExpectedText, elCount(chExpectedText), "1000ms Counter from Core0 is incrementing"); 
  TestStepAddActionExpected( chActionText, chExpectedText );
  A_DBGR_VariableRead( "Task_Core0_1000ms_Count", taskvalue);
  E_DBGR_VariableCheck("Task_Core0_1000ms_Count", taskvalue, Greater);
  
  //Check Core1 is running
  snprintf( chActionText, elCount(chActionText), "Check 1000ms Task Counter from Core1 "); 
  snprintf( chExpectedText, elCount(chExpectedText), "1000ms Counter from Core1 is incrementing"); 
  TestStepAddActionExpected( chActionText, chExpectedText );
  A_DBGR_VariableRead( "Task_Core1_1000ms_Count", taskvalue);
  E_DBGR_VariableCheck("Task_Core1_1000ms_Count", taskvalue, Greater);
  
  //Check Core2 is running
  snprintf( chActionText, elCount(chActionText), "Check 1000ms Task Counter from Core2 "); 
  snprintf( chExpectedText, elCount(chExpectedText), "1000ms Counter from Core2 is incrementing"); 
  TestStepAddActionExpected( chActionText, chExpectedText );
  A_DBGR_VariableRead( "Task_Core2_1000ms_Count", taskvalue);
  E_DBGR_VariableCheck("Task_Core2_1000ms_Count", taskvalue, Greater);
    
  //Check Core3 is running
  snprintf( chActionText, elCount(chActionText), "Check 1000ms Task Counter from Core3 "); 
  snprintf( chExpectedText, elCount(chExpectedText), "1000ms Counter from Core3 is incrementing"); 
  TestStepAddActionExpected( chActionText, chExpectedText );
  A_DBGR_VariableRead( "Task_Core3_1000ms_Count", taskvalue);
  E_DBGR_VariableCheck("Task_Core3_1000ms_Count", taskvalue, Greater);
    
  //Check Core4 is running
  snprintf( chActionText, elCount(chActionText), "Check 1000ms Task Counter from Core4 "); 
  snprintf( chExpectedText, elCount(chExpectedText), "1000ms Counter from Core4 is incrementing"); 
  TestStepAddActionExpected( chActionText, chExpectedText );
  A_DBGR_VariableRead( "Task_Core4_1000ms_Count", taskvalue);
  E_DBGR_VariableCheck("Task_Core4_1000ms_Count", taskvalue, Greater);
    
  //Check Core5 is running
  snprintf( chActionText, elCount(chActionText), "Check 1000ms Task Counter from Core5 "); 
  snprintf( chExpectedText, elCount(chExpectedText), "1000ms Counter from Core5 is incrementing"); 
  TestStepAddActionExpected( chActionText, chExpectedText );
  A_DBGR_VariableRead( "Task_Core5_1000ms_Count", taskvalue);
  E_DBGR_VariableCheck("Task_Core5_1000ms_Count", taskvalue, Greater);
  
  /***************************************************************************************************************/    
    // Test Step 3: Set breakpoint at function FUNC(void, OS_CALLOUT_CODE) ErrorHook(void) and  MngTSKR_e_OS_Error( ) and check function called
  /***************************************************************************************************************/

  snprintf( chActionText, elCount(chActionText), "Set Breakpoint at FUNC(void, OS_CALLOUT_CODE) PreTaskHook(void), Run SW & check Break point got hit "); 
  snprintf( chExpectedText, elCount(chExpectedText), "Verify Breakpoint got hit at FUNC(void, OS_CALLOUT_CODE) PreTaskHook(void)"); 
  TestStepAddActionExpected( chActionText, chExpectedText );
  A_DBGR_BreakpointSet("Os_Entry_Task_Core3_2pt5ms\23"); 
  A_DBGR_Go(); 
  E_DBGR_BreakpointCheckForHalt("Os_Entry_Task_Core3_2pt5ms\23");
  
  
  snprintf( chActionText, elCount(chActionText), "Run Software and check breakpoint got hit at function MngTSKR_e_PreTask();   "); 
  snprintf( chExpectedText, elCount(chExpectedText), "Verify Software is Running and breakpoint got hit at function MngTSKR_e_PreTask();"); 
  TestStepAddActionExpected( chActionText, chExpectedText );
  A_DBGR_BreakpointDeleteAll();
  A_DBGR_BreakpointSet("ErrorHook\\33"); 
  A_DBGR_Go(); 
  E_DBGR_BreakpointCheckForHalt("ErrorHook\\33");
 
}




/***************************************************************************************************
----------------------------------------------------------------------------------------------------
Test case name:  TC_L30SW_Q-36542211: Testcase_to_verify_the_functionality_of_interface_MngTSKR_e_OS_Error_shall_be_triggred_to_Check_OS_error_state_for_CPU5
----------------------------------------------------------------------------------------------------
Description:  Testcase_to_verify_the_functionality_of_interface_MngTSKR_e_OS_Error_shall_be_triggred_to_Check_OS_error_state_for_CPU5

***************************************************************************************************/
testcase Testcase_to_verify_the_functionality_of_interface_MngTSKR_e_OS_Error_shall_be_triggred_to_Check_OS_error_state_for_CPU5()
{
  /***************************************************************************************************************/    
                                                // Variable Definition
  /***************************************************************************************************************/ 
  
  long taskvalue;
  
  /***************************************************************************************************************/    
                                               // Local Values
  /***************************************************************************************************************/ 
  

  
  /***************************************************************************************************************/    
                                              // Test Case Info
  /***************************************************************************************************************/
  setWriteDbgLevel(DebugOff);
  snprintf( chTestTitle, elCount(chTestTitle), "Testcase_to_verify_the_functionality_of_interface_MngTSKR_e_OS_Error_shall_be_triggred_to_Check_OS_error_state_for_CPU4" );
  snprintf( chTestDescription, elCount(chTestDescription), "Purose: Testcase_to_verify_the_functionality_of_interface_MngTSKR_e_OS_Error_shall_be_triggred_to_Check_OS_error_state_for_CPU4");
  TestCaseAddInfo( chTestTitle, "TC_L30SW_Q-36542211", chTestDescription );

  /***************************************************************************************************************/    
                                              // Start of Test Case
  /***************************************************************************************************************/
  
  /***************************************************************************************************************/    
                                              // Test Step 1 PRECONDITIONS
  /***************************************************************************************************************/
  
  snprintf( chActionText, elCount(chActionText), "Flash the Software and ECU is running"); 
  snprintf( chExpectedText, elCount(chExpectedText), "ECU should be in running state"); 
  TestStepAddActionExpected( chActionText, chExpectedText );

  A_DBGR_BreakpointDeleteAll();
  A_DBGR_RnGo();
  E_DBGR_CheckState(T32_State_Running);
  

   /***************************************************************************************************************/    
            // Test Step 2: Check all cores are in running state                                   
  /***************************************************************************************************************/
  
  //Check Core0 is running
  snprintf( chActionText, elCount(chActionText), "Check 1000ms Task Counter from Core0 "); 
  snprintf( chExpectedText, elCount(chExpectedText), "1000ms Counter from Core0 is incrementing"); 
  TestStepAddActionExpected( chActionText, chExpectedText );
  A_DBGR_VariableRead( "Task_Core0_1000ms_Count", taskvalue);
  E_DBGR_VariableCheck("Task_Core0_1000ms_Count", taskvalue, Greater);
  
  //Check Core1 is running
  snprintf( chActionText, elCount(chActionText), "Check 1000ms Task Counter from Core1 "); 
  snprintf( chExpectedText, elCount(chExpectedText), "1000ms Counter from Core1 is incrementing"); 
  TestStepAddActionExpected( chActionText, chExpectedText );
  A_DBGR_VariableRead( "Task_Core1_1000ms_Count", taskvalue);
  E_DBGR_VariableCheck("Task_Core1_1000ms_Count", taskvalue, Greater);
  
  //Check Core2 is running
  snprintf( chActionText, elCount(chActionText), "Check 1000ms Task Counter from Core2 "); 
  snprintf( chExpectedText, elCount(chExpectedText), "1000ms Counter from Core2 is incrementing"); 
  TestStepAddActionExpected( chActionText, chExpectedText );
  A_DBGR_VariableRead( "Task_Core2_1000ms_Count", taskvalue);
  E_DBGR_VariableCheck("Task_Core2_1000ms_Count", taskvalue, Greater);
    
  //Check Core3 is running
  snprintf( chActionText, elCount(chActionText), "Check 1000ms Task Counter from Core3 "); 
  snprintf( chExpectedText, elCount(chExpectedText), "1000ms Counter from Core3 is incrementing"); 
  TestStepAddActionExpected( chActionText, chExpectedText );
  A_DBGR_VariableRead( "Task_Core3_1000ms_Count", taskvalue);
  E_DBGR_VariableCheck("Task_Core3_1000ms_Count", taskvalue, Greater);
    
  //Check Core4 is running
  snprintf( chActionText, elCount(chActionText), "Check 1000ms Task Counter from Core4 "); 
  snprintf( chExpectedText, elCount(chExpectedText), "1000ms Counter from Core4 is incrementing"); 
  TestStepAddActionExpected( chActionText, chExpectedText );
  A_DBGR_VariableRead( "Task_Core4_1000ms_Count", taskvalue);
  E_DBGR_VariableCheck("Task_Core4_1000ms_Count", taskvalue, Greater);
    
  //Check Core5 is running
  snprintf( chActionText, elCount(chActionText), "Check 1000ms Task Counter from Core5 "); 
  snprintf( chExpectedText, elCount(chExpectedText), "1000ms Counter from Core5 is incrementing"); 
  TestStepAddActionExpected( chActionText, chExpectedText );
  A_DBGR_VariableRead( "Task_Core5_1000ms_Count", taskvalue);
  E_DBGR_VariableCheck("Task_Core5_1000ms_Count", taskvalue, Greater);
  
  /***************************************************************************************************************/    
    // Test Step 3: Set breakpoint at function FUNC(void, OS_CALLOUT_CODE) ErrorHook(void) and  MngTSKR_e_OS_Error( ) and check function called
  /***************************************************************************************************************/

  snprintf( chActionText, elCount(chActionText), "Set Breakpoint at FUNC(void, OS_CALLOUT_CODE) PreTaskHook(void), Run SW & check Break point got hit "); 
  snprintf( chExpectedText, elCount(chExpectedText), "Verify Breakpoint got hit at FUNC(void, OS_CALLOUT_CODE) PreTaskHook(void)"); 
  TestStepAddActionExpected( chActionText, chExpectedText );
  A_DBGR_BreakpointSet("Os_Entry_Task_Core3_2pt5ms\23"); 
  A_DBGR_Go(); 
  E_DBGR_BreakpointCheckForHalt("Os_Entry_Task_Core3_2pt5ms\23");
  
  
  snprintf( chActionText, elCount(chActionText), "Run Software and check breakpoint got hit at function MngTSKR_e_PreTask();   "); 
  snprintf( chExpectedText, elCount(chExpectedText), "Verify Software is Running and breakpoint got hit at function MngTSKR_e_PreTask();"); 
  TestStepAddActionExpected( chActionText, chExpectedText );
  A_DBGR_BreakpointDeleteAll();
  A_DBGR_BreakpointSet("ErrorHook\\37"); 
  A_DBGR_Go(); 
  E_DBGR_BreakpointCheckForHalt("ErrorHook\\37");
 
}



/***************************************************************************************************
----------------------------------------------------------------------------------------------------
Test case name:  TC_L30SW_QT_36542225: Testcase_to_verify_the_functionality_of_interface_CntrlRBSR_CntrlrReset()_to_check_the_interface_is_called_in_startuphook_from_core0
----------------------------------------------------------------------------------------------------
Description:  test case to verify the functionality of interface CntrlRBSR_CntrlrReset() to check the interface is called in startuphook from core0.

***************************************************************************************************/
testcase Testcase_to_verify_functionality_of_interface_CntrlRBSR_CntrlrReset_to_check_the_interface_is_called_in_startuphook_from_core0()
{
  /***************************************************************************************************************/    
                                                // Variable Definition
  /***************************************************************************************************************/ 
  
  long taskvalue;
  
  /***************************************************************************************************************/    
                                               // Local Values
  /***************************************************************************************************************/ 
  

  
  /***************************************************************************************************************/    
                                              // Test Case Info
  /***************************************************************************************************************/
  setWriteDbgLevel(DebugOff);
  snprintf( chTestTitle, elCount(chTestTitle), "Testcase_to_verify_the_functionality_of_interface_CntrlRBSR_CntrlrReset_to_check_the_interface_is_called_in_startuphook_from_core0" );
  snprintf( chTestDescription, elCount(chTestDescription), "Purpose: test case to verify the functionality of interface CntrlRBSR_CntrlrReset() to check the interface is called in startuphook from core0.");
  TestCaseAddInfo( chTestTitle, "TC_L30SW_QT_36542225", chTestDescription );

  /***************************************************************************************************************/    
                                              // Start of Test Case
  /***************************************************************************************************************/
  
  /***************************************************************************************************************/    
                                              // Test Step 1 PRECONDITIONS
  /***************************************************************************************************************/
  
  snprintf( chActionText, elCount(chActionText), "Flash the Software and ECU is running"); 
  snprintf( chExpectedText, elCount(chExpectedText), "ECU should be in running state"); 
  TestStepAddActionExpected( chActionText, chExpectedText );

  A_DBGR_BreakpointDeleteAll();
  A_DBGR_RnGo();
  E_DBGR_CheckState(T32_State_Running);
  

   /***************************************************************************************************************/    
            // Test Step 2: Check all cores are in running state                                   
  /***************************************************************************************************************/
  
  //Check Core0 is running
  snprintf( chActionText, elCount(chActionText), "Check 1000ms Task Counter from Core0 "); 
  snprintf( chExpectedText, elCount(chExpectedText), "1000ms Counter from Core0 is incrementing"); 
  TestStepAddActionExpected( chActionText, chExpectedText );
  A_DBGR_VariableRead( "Task_Core0_1000ms_Count", taskvalue);
  E_DBGR_VariableCheck("Task_Core0_1000ms_Count", taskvalue, Greater);
  
  //Check Core1 is running
  snprintf( chActionText, elCount(chActionText), "Check 1000ms Task Counter from Core1 "); 
  snprintf( chExpectedText, elCount(chExpectedText), "1000ms Counter from Core1 is incrementing"); 
  TestStepAddActionExpected( chActionText, chExpectedText );
  A_DBGR_VariableRead( "Task_Core1_1000ms_Count", taskvalue);
  E_DBGR_VariableCheck("Task_Core1_1000ms_Count", taskvalue, Greater);
  
  //Check Core2 is running
  snprintf( chActionText, elCount(chActionText), "Check 1000ms Task Counter from Core2 "); 
  snprintf( chExpectedText, elCount(chExpectedText), "1000ms Counter from Core2 is incrementing"); 
  TestStepAddActionExpected( chActionText, chExpectedText );
  A_DBGR_VariableRead( "Task_Core2_1000ms_Count", taskvalue);
  E_DBGR_VariableCheck("Task_Core2_1000ms_Count", taskvalue, Greater);
    
  //Check Core3 is running
  snprintf( chActionText, elCount(chActionText), "Check 1000ms Task Counter from Core3 "); 
  snprintf( chExpectedText, elCount(chExpectedText), "1000ms Counter from Core3 is incrementing"); 
  TestStepAddActionExpected( chActionText, chExpectedText );
  A_DBGR_VariableRead( "Task_Core3_1000ms_Count", taskvalue);
  E_DBGR_VariableCheck("Task_Core3_1000ms_Count", taskvalue, Greater);
    
  //Check Core4 is running
  snprintf( chActionText, elCount(chActionText), "Check 1000ms Task Counter from Core4 "); 
  snprintf( chExpectedText, elCount(chExpectedText), "1000ms Counter from Core4 is incrementing"); 
  TestStepAddActionExpected( chActionText, chExpectedText );
  A_DBGR_VariableRead( "Task_Core4_1000ms_Count", taskvalue);
  E_DBGR_VariableCheck("Task_Core4_1000ms_Count", taskvalue, Greater);
    
  //Check Core5 is running
  snprintf( chActionText, elCount(chActionText), "Check 1000ms Task Counter from Core5 "); 
  snprintf( chExpectedText, elCount(chExpectedText), "1000ms Counter from Core5 is incrementing"); 
  TestStepAddActionExpected( chActionText, chExpectedText );
  A_DBGR_VariableRead( "Task_Core5_1000ms_Count", taskvalue);
  E_DBGR_VariableCheck("Task_Core5_1000ms_Count", taskvalue, Greater);
  
  /*******************************************************************************************************************************************************/    
    // Test Step 3: set breakpoint in file main.c in function FUNC(void, OS_CALLOUT_CODE) StartupHook(void) at line if( CORE0 == coreId)
  /*******************************************************************************************************************************************************/

  snprintf( chActionText, elCount(chActionText), "set breakpoint in file main.c in function FUNC(void, OS_CALLOUT_CODE) StartupHook(void) at line if( CORE0 == coreId) "); 
  snprintf( chExpectedText, elCount(chExpectedText), "Verify Breakpoint got hit at function FUNC(boolean, OS_CALLOUT_CODE) StartupHook(void) at line if( CORE0 == coreId)"); 
  TestStepAddActionExpected( chActionText, chExpectedText );
  A_DBGR_R();
  A_DBGR_BreakpointSet("StartupHook");  
  A_DBGR_Go(); 
  E_DBGR_BreakpointCheckForHalt("StartupHook");
  
  
  snprintf( chActionText, elCount(chActionText), "Run Software and check breakpoint got hit at function CntrlRBSR_CntrlrReset()"); 
  snprintf( chExpectedText, elCount(chExpectedText), "Verify Software is Running and breakpoint got hit at function CntrlRBSR_CntrlrReset()"); 
  TestStepAddActionExpected( chActionText, chExpectedText );
  
  A_DBGR_BreakpointDeleteAll();
  A_DBGR_VariableSet("coreId", "0");
  A_DBGR_BreakpointSet("CntrlRBSR_CntrlrReset");
  A_DBGR_Go(); 
  A_DBGR_Go(); 
  E_DBGR_BreakpointCheckForHalt("CntrlRBSR_CntrlrReset");
 
}



/***************************************************************************************************
----------------------------------------------------------------------------------------------------
Test case name:  TC_L30SW_QT_36542226: Testcase_to_verify_the_functionality_of_interface_CntrlRBSR_CntrlrReset()_to_check_the_interface_is_called_in_startuphook_from_core1
----------------------------------------------------------------------------------------------------
Description:  test case to verify the functionality of interface CntrlRBSR_CntrlrReset() to check the interface is called in startuphook from core1.

***************************************************************************************************/
testcase Testcase_to_verify_functionality_of_interface_CntrlRBSR_CntrlrReset_to_check_the_interface_is_called_in_startuphook_from_core1()
{
  /***************************************************************************************************************/    
                                                // Variable Definition
  /***************************************************************************************************************/ 
  
  long taskvalue;
  
  /***************************************************************************************************************/    
                                               // Local Values
  /***************************************************************************************************************/ 
  

  
  /***************************************************************************************************************/    
                                              // Test Case Info
  /***************************************************************************************************************/
  setWriteDbgLevel(DebugOff);
  snprintf( chTestTitle, elCount(chTestTitle), "Testcase_to_verify_the_functionality_of_interface_CntrlRBSR_CntrlrReset()_to_check_the_interface_is_called_in_startuphook_from_core1" );
  snprintf( chTestDescription, elCount(chTestDescription), "Purpose: test case to verify the functionality of interface CntrlRBSR_CntrlrReset() to check the interface is called in startuphook from core1.");
  TestCaseAddInfo( chTestTitle, "TC_L30SW_QT_36542226", chTestDescription );

  /***************************************************************************************************************/    
                                              // Start of Test Case
  /***************************************************************************************************************/
  
  /***************************************************************************************************************/    
                                              // Test Step 1 PRECONDITIONS
  /***************************************************************************************************************/
  
  snprintf( chActionText, elCount(chActionText), "Flash the Software and ECU is running"); 
  snprintf( chExpectedText, elCount(chExpectedText), "ECU should be in running state"); 
  TestStepAddActionExpected( chActionText, chExpectedText );

  A_DBGR_BreakpointDeleteAll();
  A_DBGR_RnGo();
  E_DBGR_CheckState(T32_State_Running);
  

   /***************************************************************************************************************/    
            // Test Step 2: Check all cores are in running state                                   
  /***************************************************************************************************************/
  
  //Check Core0 is running
  snprintf( chActionText, elCount(chActionText), "Check 1000ms Task Counter from Core0 "); 
  snprintf( chExpectedText, elCount(chExpectedText), "1000ms Counter from Core0 is incrementing"); 
  TestStepAddActionExpected( chActionText, chExpectedText );
  A_DBGR_VariableRead( "Task_Core0_1000ms_Count", taskvalue);
  E_DBGR_VariableCheck("Task_Core0_1000ms_Count", taskvalue, Greater);
  
  //Check Core1 is running
  snprintf( chActionText, elCount(chActionText), "Check 1000ms Task Counter from Core1 "); 
  snprintf( chExpectedText, elCount(chExpectedText), "1000ms Counter from Core1 is incrementing"); 
  TestStepAddActionExpected( chActionText, chExpectedText );
  A_DBGR_VariableRead( "Task_Core1_1000ms_Count", taskvalue);
  E_DBGR_VariableCheck("Task_Core1_1000ms_Count", taskvalue, Greater);
  
  //Check Core2 is running
  snprintf( chActionText, elCount(chActionText), "Check 1000ms Task Counter from Core2 "); 
  snprintf( chExpectedText, elCount(chExpectedText), "1000ms Counter from Core2 is incrementing"); 
  TestStepAddActionExpected( chActionText, chExpectedText );
  A_DBGR_VariableRead( "Task_Core2_1000ms_Count", taskvalue);
  E_DBGR_VariableCheck("Task_Core2_1000ms_Count", taskvalue, Greater);
    
  //Check Core3 is running
  snprintf( chActionText, elCount(chActionText), "Check 1000ms Task Counter from Core3 "); 
  snprintf( chExpectedText, elCount(chExpectedText), "1000ms Counter from Core3 is incrementing"); 
  TestStepAddActionExpected( chActionText, chExpectedText );
  A_DBGR_VariableRead( "Task_Core3_1000ms_Count", taskvalue);
  E_DBGR_VariableCheck("Task_Core3_1000ms_Count", taskvalue, Greater);
    
  //Check Core4 is running
  snprintf( chActionText, elCount(chActionText), "Check 1000ms Task Counter from Core4 "); 
  snprintf( chExpectedText, elCount(chExpectedText), "1000ms Counter from Core4 is incrementing"); 
  TestStepAddActionExpected( chActionText, chExpectedText );
  A_DBGR_VariableRead( "Task_Core4_1000ms_Count", taskvalue);
  E_DBGR_VariableCheck("Task_Core4_1000ms_Count", taskvalue, Greater);
    
  //Check Core5 is running
  snprintf( chActionText, elCount(chActionText), "Check 1000ms Task Counter from Core5 "); 
  snprintf( chExpectedText, elCount(chExpectedText), "1000ms Counter from Core5 is incrementing"); 
  TestStepAddActionExpected( chActionText, chExpectedText );
  A_DBGR_VariableRead( "Task_Core5_1000ms_Count", taskvalue);
  E_DBGR_VariableCheck("Task_Core5_1000ms_Count", taskvalue, Greater);
  
  /*******************************************************************************************************************************************************/    
    // Test Step 3: set breakpoint in file main.c in function FUNC(void, OS_CALLOUT_CODE) StartupHook(void) at line if( CORE0 == coreId)
  /*******************************************************************************************************************************************************/

  snprintf( chActionText, elCount(chActionText), "set breakpoint in file main.c in function FUNC(void, OS_CALLOUT_CODE) StartupHook(void) at line if( CORE1 == coreId) "); 
  snprintf( chExpectedText, elCount(chExpectedText), "Verify Breakpoint got hit at function FUNC(boolean, OS_CALLOUT_CODE) StartupHook(void) at line if( CORE1 == coreId)"); 
  TestStepAddActionExpected( chActionText, chExpectedText );
  A_DBGR_R();
  A_DBGR_BreakpointSet("StartupHook");  
  A_DBGR_Go(); 
  E_DBGR_BreakpointCheckForHalt("StartupHook");
  
  
  snprintf( chActionText, elCount(chActionText), "Run Software and check breakpoint got hit at function CntrlRBSR_CntrlrResetCPU1()"); 
  snprintf( chExpectedText, elCount(chExpectedText), "Verify Software is Running and breakpoint got hit at function CntrlRBSR_CntrlrResetCPU1()"); 
  TestStepAddActionExpected( chActionText, chExpectedText );
  
  A_DBGR_BreakpointDeleteAll();
  A_DBGR_VariableSet("coreId", "1");
  A_DBGR_BreakpointSet("CntrlRBSR_CntrlrResetCPU1");
  A_DBGR_Go(); 
   A_DBGR_Go(); 
  E_DBGR_BreakpointCheckForHalt("CntrlRBSR_CntrlrResetCPU1");
 
}


/***************************************************************************************************
----------------------------------------------------------------------------------------------------
Test case name:  TC_L30SW_QT_36542227: Testcase_to_verify_the_functionality_of_interface_CntrlRBSR_CntrlrReset()_to_check_the_interface_is_called_in_startuphook_from_core2
----------------------------------------------------------------------------------------------------
Description:  test case to verify the functionality of interface CntrlRBSR_CntrlrReset() to check the interface is called in startuphook from core2.

***************************************************************************************************/
testcase Testcase_to_verify_functionality_of_interface_CntrlRBSR_CntrlrReset_to_check_the_interface_is_called_in_startuphook_from_core2()
{
  /***************************************************************************************************************/    
                                                // Variable Definition
  /***************************************************************************************************************/ 
  
  long taskvalue;
  
  /***************************************************************************************************************/    
                                               // Local Values
  /***************************************************************************************************************/ 
  

  
  /***************************************************************************************************************/    
                                              // Test Case Info
  /***************************************************************************************************************/
  setWriteDbgLevel(DebugOff);
  snprintf( chTestTitle, elCount(chTestTitle), "Testcase_to_verify_the_functionality_of_interface_CntrlRBSR_CntrlrReset()_to_check_the_interface_is_called_in_startuphook_from_core2" );
  snprintf( chTestDescription, elCount(chTestDescription), "Purpose: test case to verify the functionality of interface CntrlRBSR_CntrlrReset() to check the interface is called in startuphook from core2.");
  TestCaseAddInfo( chTestTitle, "TC_L30SW_QT_36542227", chTestDescription );

  /***************************************************************************************************************/    
                                              // Start of Test Case
  /***************************************************************************************************************/
  
  /***************************************************************************************************************/    
                                              // Test Step 1 PRECONDITIONS
  /***************************************************************************************************************/
  
  snprintf( chActionText, elCount(chActionText), "Flash the Software and ECU is running"); 
  snprintf( chExpectedText, elCount(chExpectedText), "ECU should be in running state"); 
  TestStepAddActionExpected( chActionText, chExpectedText );

  A_DBGR_BreakpointDeleteAll();
  A_DBGR_RnGo();
  E_DBGR_CheckState(T32_State_Running);
  

   /***************************************************************************************************************/    
            // Test Step 2: Check all cores are in running state                                   
  /***************************************************************************************************************/
  
  //Check Core0 is running
  snprintf( chActionText, elCount(chActionText), "Check 1000ms Task Counter from Core0 "); 
  snprintf( chExpectedText, elCount(chExpectedText), "1000ms Counter from Core0 is incrementing"); 
  TestStepAddActionExpected( chActionText, chExpectedText );
  A_DBGR_VariableRead( "Task_Core0_1000ms_Count", taskvalue);
  E_DBGR_VariableCheck("Task_Core0_1000ms_Count", taskvalue, Greater);
  
  //Check Core1 is running
  snprintf( chActionText, elCount(chActionText), "Check 1000ms Task Counter from Core1 "); 
  snprintf( chExpectedText, elCount(chExpectedText), "1000ms Counter from Core1 is incrementing"); 
  TestStepAddActionExpected( chActionText, chExpectedText );
  A_DBGR_VariableRead( "Task_Core1_1000ms_Count", taskvalue);
  E_DBGR_VariableCheck("Task_Core1_1000ms_Count", taskvalue, Greater);
  
  //Check Core2 is running
  snprintf( chActionText, elCount(chActionText), "Check 1000ms Task Counter from Core2 "); 
  snprintf( chExpectedText, elCount(chExpectedText), "1000ms Counter from Core2 is incrementing"); 
  TestStepAddActionExpected( chActionText, chExpectedText );
  A_DBGR_VariableRead( "Task_Core2_1000ms_Count", taskvalue);
  E_DBGR_VariableCheck("Task_Core2_1000ms_Count", taskvalue, Greater);
    
  //Check Core3 is running
  snprintf( chActionText, elCount(chActionText), "Check 1000ms Task Counter from Core3 "); 
  snprintf( chExpectedText, elCount(chExpectedText), "1000ms Counter from Core3 is incrementing"); 
  TestStepAddActionExpected( chActionText, chExpectedText );
  A_DBGR_VariableRead( "Task_Core3_1000ms_Count", taskvalue);
  E_DBGR_VariableCheck("Task_Core3_1000ms_Count", taskvalue, Greater);
    
  //Check Core4 is running
  snprintf( chActionText, elCount(chActionText), "Check 1000ms Task Counter from Core4 "); 
  snprintf( chExpectedText, elCount(chExpectedText), "1000ms Counter from Core4 is incrementing"); 
  TestStepAddActionExpected( chActionText, chExpectedText );
  A_DBGR_VariableRead( "Task_Core4_1000ms_Count", taskvalue);
  E_DBGR_VariableCheck("Task_Core4_1000ms_Count", taskvalue, Greater);
    
  //Check Core5 is running
  snprintf( chActionText, elCount(chActionText), "Check 1000ms Task Counter from Core5 "); 
  snprintf( chExpectedText, elCount(chExpectedText), "1000ms Counter from Core5 is incrementing"); 
  TestStepAddActionExpected( chActionText, chExpectedText );
  A_DBGR_VariableRead( "Task_Core5_1000ms_Count", taskvalue);
  E_DBGR_VariableCheck("Task_Core5_1000ms_Count", taskvalue, Greater);
  
  /*******************************************************************************************************************************************************/    
    // Test Step 3: set breakpoint in file main.c in function FUNC(void, OS_CALLOUT_CODE) StartupHook(void) at line if( CORE2 == coreId)
  /*******************************************************************************************************************************************************/

  snprintf( chActionText, elCount(chActionText), "set breakpoint in file main.c in function FUNC(void, OS_CALLOUT_CODE) StartupHook(void) at line if( CORE2 == coreId) "); 
  snprintf( chExpectedText, elCount(chExpectedText), "Verify Breakpoint got hit at function FUNC(boolean, OS_CALLOUT_CODE) StartupHook(void) at line if( CORE2 == coreId)"); 
  TestStepAddActionExpected( chActionText, chExpectedText );
  A_DBGR_R();
  A_DBGR_BreakpointSet("StartupHook");  
  A_DBGR_Go(); 
  E_DBGR_BreakpointCheckForHalt("StartupHook");
  
  
  snprintf( chActionText, elCount(chActionText), "Run Software and check breakpoint got hit at function CntrlRBSR_CntrlrResetCPU2()"); 
  snprintf( chExpectedText, elCount(chExpectedText), "Verify Software is Running and breakpoint got hit at function CntrlRBSR_CntrlrResetCPU2()"); 
  TestStepAddActionExpected( chActionText, chExpectedText );
  
  A_DBGR_BreakpointDeleteAll();
  A_DBGR_VariableSet("coreId", "2");  
  A_DBGR_BreakpointSet("CntrlRBSR_CntrlrResetCPU2");
  A_DBGR_Go(); 
   A_DBGR_Go(); 
  E_DBGR_BreakpointCheckForHalt("CntrlRBSR_CntrlrResetCPU2");
 
}



/***************************************************************************************************
----------------------------------------------------------------------------------------------------
Test case name:  TC_L30SW_QT_36542228: Testcase_to_verify_the_functionality_of_interface_CntrlRBSR_CntrlrReset()_to_check_the_interface_is_called_in_startuphook_from_core3
----------------------------------------------------------------------------------------------------
Description:  test case to verify the functionality of interface CntrlRBSR_CntrlrReset() to check the interface is called in startuphook from core3.

***************************************************************************************************/
testcase Testcase_to_verify_functionality_of_interface_CntrlRBSR_CntrlrReset_to_check_the_interface_is_called_in_startuphook_from_core3()
{
  /***************************************************************************************************************/    
                                                // Variable Definition
  /***************************************************************************************************************/ 
  
  long taskvalue;
  
  /***************************************************************************************************************/    
                                               // Local Values
  /***************************************************************************************************************/ 
  

  
  /***************************************************************************************************************/    
                                              // Test Case Info
  /***************************************************************************************************************/
  setWriteDbgLevel(DebugOff);
  snprintf( chTestTitle, elCount(chTestTitle), "Testcase_to_verify_the_functionality_of_interface_CntrlRBSR_CntrlrReset()_to_check_the_interface_is_called_in_startuphook_from_core3" );
  snprintf( chTestDescription, elCount(chTestDescription), "Purpose: test case to verify the functionality of interface CntrlRBSR_CntrlrReset() to check the interface is called in startuphook from core3.");
  TestCaseAddInfo( chTestTitle, "TC_L30SW_QT_36542228", chTestDescription );

  /***************************************************************************************************************/    
                                              // Start of Test Case
  /***************************************************************************************************************/
  
  /***************************************************************************************************************/    
                                              // Test Step 1 PRECONDITIONS
  /***************************************************************************************************************/
  
  snprintf( chActionText, elCount(chActionText), "Flash the Software and ECU is running"); 
  snprintf( chExpectedText, elCount(chExpectedText), "ECU should be in running state"); 
  TestStepAddActionExpected( chActionText, chExpectedText );

  A_DBGR_BreakpointDeleteAll();
  A_DBGR_RnGo();
  E_DBGR_CheckState(T32_State_Running);
  

   /***************************************************************************************************************/    
            // Test Step 2: Check all cores are in running state                                   
  /***************************************************************************************************************/
  
  //Check Core0 is running
  snprintf( chActionText, elCount(chActionText), "Check 1000ms Task Counter from Core0 "); 
  snprintf( chExpectedText, elCount(chExpectedText), "1000ms Counter from Core0 is incrementing"); 
  TestStepAddActionExpected( chActionText, chExpectedText );
  A_DBGR_VariableRead( "Task_Core0_1000ms_Count", taskvalue);
  E_DBGR_VariableCheck("Task_Core0_1000ms_Count", taskvalue, Greater);
  
  //Check Core1 is running
  snprintf( chActionText, elCount(chActionText), "Check 1000ms Task Counter from Core1 "); 
  snprintf( chExpectedText, elCount(chExpectedText), "1000ms Counter from Core1 is incrementing"); 
  TestStepAddActionExpected( chActionText, chExpectedText );
  A_DBGR_VariableRead( "Task_Core1_1000ms_Count", taskvalue);
  E_DBGR_VariableCheck("Task_Core1_1000ms_Count", taskvalue, Greater);
  
  //Check Core2 is running
  snprintf( chActionText, elCount(chActionText), "Check 1000ms Task Counter from Core2 "); 
  snprintf( chExpectedText, elCount(chExpectedText), "1000ms Counter from Core2 is incrementing"); 
  TestStepAddActionExpected( chActionText, chExpectedText );
  A_DBGR_VariableRead( "Task_Core2_1000ms_Count", taskvalue);
  E_DBGR_VariableCheck("Task_Core2_1000ms_Count", taskvalue, Greater);
    
  //Check Core3 is running
  snprintf( chActionText, elCount(chActionText), "Check 1000ms Task Counter from Core3 "); 
  snprintf( chExpectedText, elCount(chExpectedText), "1000ms Counter from Core3 is incrementing"); 
  TestStepAddActionExpected( chActionText, chExpectedText );
  A_DBGR_VariableRead( "Task_Core3_1000ms_Count", taskvalue);
  E_DBGR_VariableCheck("Task_Core3_1000ms_Count", taskvalue, Greater);
    
  //Check Core4 is running
  snprintf( chActionText, elCount(chActionText), "Check 1000ms Task Counter from Core4 "); 
  snprintf( chExpectedText, elCount(chExpectedText), "1000ms Counter from Core4 is incrementing"); 
  TestStepAddActionExpected( chActionText, chExpectedText );
  A_DBGR_VariableRead( "Task_Core4_1000ms_Count", taskvalue);
  E_DBGR_VariableCheck("Task_Core4_1000ms_Count", taskvalue, Greater);
    
  //Check Core5 is running
  snprintf( chActionText, elCount(chActionText), "Check 1000ms Task Counter from Core5 "); 
  snprintf( chExpectedText, elCount(chExpectedText), "1000ms Counter from Core5 is incrementing"); 
  TestStepAddActionExpected( chActionText, chExpectedText );
  A_DBGR_VariableRead( "Task_Core5_1000ms_Count", taskvalue);
  E_DBGR_VariableCheck("Task_Core5_1000ms_Count", taskvalue, Greater);
  
  /*******************************************************************************************************************************************************/    
    // Test Step 3: set breakpoint in file main.c in function FUNC(void, OS_CALLOUT_CODE) StartupHook(void) at line if( CORE3 == coreId)
  /*******************************************************************************************************************************************************/

  snprintf( chActionText, elCount(chActionText), "set breakpoint in file main.c in function FUNC(void, OS_CALLOUT_CODE) StartupHook(void) at line if( CORE3 == coreId) "); 
  snprintf( chExpectedText, elCount(chExpectedText), "Verify Breakpoint got hit at function FUNC(boolean, OS_CALLOUT_CODE) StartupHook(void) at line if( CORE3 == coreId)"); 
  TestStepAddActionExpected( chActionText, chExpectedText );
  A_DBGR_R();
  A_DBGR_BreakpointSet("StartupHook");  
  A_DBGR_Go(); 
  E_DBGR_BreakpointCheckForHalt("StartupHook");
  
  
  snprintf( chActionText, elCount(chActionText), "Run Software and check breakpoint got hit at function CntrlRBSR_CntrlrResetCPU3()"); 
  snprintf( chExpectedText, elCount(chExpectedText), "Verify Software is Running and breakpoint got hit at function CntrlRBSR_CntrlrResetCP3()"); 
  TestStepAddActionExpected( chActionText, chExpectedText );
  
  A_DBGR_BreakpointDeleteAll();
  A_DBGR_VariableSet("coreId", "3");  
  A_DBGR_BreakpointSet("CntrlRBSR_CntrlrResetCPU3");
  A_DBGR_Go(); 
   A_DBGR_Go(); 
  E_DBGR_BreakpointCheckForHalt("CntrlRBSR_CntrlrResetCPU3");
 
}



/***************************************************************************************************
----------------------------------------------------------------------------------------------------
Test case name:  TC_L30SW_QT_36542229: Testcase_to_verify_the_functionality_of_interface_CntrlRBSR_CntrlrReset()_to_check_the_interface_is_called_in_startuphook_from_core4
----------------------------------------------------------------------------------------------------
Description:  test case to verify the functionality of interface CntrlRBSR_CntrlrReset() to check the interface is called in startuphook from core4.

***************************************************************************************************/
testcase Testcase_to_verify_functionality_of_interface_CntrlRBSR_CntrlrReset_to_check_the_interface_is_called_in_startuphook_from_core4()
{
  /***************************************************************************************************************/    
                                                // Variable Definition
  /***************************************************************************************************************/ 
  
  long taskvalue;
  
  /***************************************************************************************************************/    
                                               // Local Values
  /***************************************************************************************************************/ 
  

  
  /***************************************************************************************************************/    
                                              // Test Case Info
  /***************************************************************************************************************/
  setWriteDbgLevel(DebugOff);
  snprintf( chTestTitle, elCount(chTestTitle), "Testcase_to_verify_the_functionality_of_interface_CntrlRBSR_CntrlrReset()_to_check_the_interface_is_called_in_startuphook_from_core4" );
  snprintf( chTestDescription, elCount(chTestDescription), "Purpose: test case to verify the functionality of interface CntrlRBSR_CntrlrReset() to check the interface is called in startuphook from core4.");
  TestCaseAddInfo( chTestTitle, "TC_L30SW_QT_36542229", chTestDescription );

  /***************************************************************************************************************/    
                                              // Start of Test Case
  /***************************************************************************************************************/
  
  /***************************************************************************************************************/    
                                              // Test Step 1 PRECONDITIONS
  /***************************************************************************************************************/
  
  snprintf( chActionText, elCount(chActionText), "Flash the Software and ECU is running"); 
  snprintf( chExpectedText, elCount(chExpectedText), "ECU should be in running state"); 
  TestStepAddActionExpected( chActionText, chExpectedText );

  A_DBGR_BreakpointDeleteAll();
  A_DBGR_RnGo();
  E_DBGR_CheckState(T32_State_Running);
  

   /***************************************************************************************************************/    
            // Test Step 2: Check all cores are in running state                                   
  /***************************************************************************************************************/
  
  //Check Core0 is running
  snprintf( chActionText, elCount(chActionText), "Check 1000ms Task Counter from Core0 "); 
  snprintf( chExpectedText, elCount(chExpectedText), "1000ms Counter from Core0 is incrementing"); 
  TestStepAddActionExpected( chActionText, chExpectedText );
  A_DBGR_VariableRead( "Task_Core0_1000ms_Count", taskvalue);
  E_DBGR_VariableCheck("Task_Core0_1000ms_Count", taskvalue, Greater);
  
  //Check Core1 is running
  snprintf( chActionText, elCount(chActionText), "Check 1000ms Task Counter from Core1 "); 
  snprintf( chExpectedText, elCount(chExpectedText), "1000ms Counter from Core1 is incrementing"); 
  TestStepAddActionExpected( chActionText, chExpectedText );
  A_DBGR_VariableRead( "Task_Core1_1000ms_Count", taskvalue);
  E_DBGR_VariableCheck("Task_Core1_1000ms_Count", taskvalue, Greater);
  
  //Check Core2 is running
  snprintf( chActionText, elCount(chActionText), "Check 1000ms Task Counter from Core2 "); 
  snprintf( chExpectedText, elCount(chExpectedText), "1000ms Counter from Core2 is incrementing"); 
  TestStepAddActionExpected( chActionText, chExpectedText );
  A_DBGR_VariableRead( "Task_Core2_1000ms_Count", taskvalue);
  E_DBGR_VariableCheck("Task_Core2_1000ms_Count", taskvalue, Greater);
    
  //Check Core3 is running
  snprintf( chActionText, elCount(chActionText), "Check 1000ms Task Counter from Core3 "); 
  snprintf( chExpectedText, elCount(chExpectedText), "1000ms Counter from Core3 is incrementing"); 
  TestStepAddActionExpected( chActionText, chExpectedText );
  A_DBGR_VariableRead( "Task_Core3_1000ms_Count", taskvalue);
  E_DBGR_VariableCheck("Task_Core3_1000ms_Count", taskvalue, Greater);
    
  //Check Core4 is running
  snprintf( chActionText, elCount(chActionText), "Check 1000ms Task Counter from Core4 "); 
  snprintf( chExpectedText, elCount(chExpectedText), "1000ms Counter from Core4 is incrementing"); 
  TestStepAddActionExpected( chActionText, chExpectedText );
  A_DBGR_VariableRead( "Task_Core4_1000ms_Count", taskvalue);
  E_DBGR_VariableCheck("Task_Core4_1000ms_Count", taskvalue, Greater);
    
  //Check Core5 is running
  snprintf( chActionText, elCount(chActionText), "Check 1000ms Task Counter from Core5 "); 
  snprintf( chExpectedText, elCount(chExpectedText), "1000ms Counter from Core5 is incrementing"); 
  TestStepAddActionExpected( chActionText, chExpectedText );
  A_DBGR_VariableRead( "Task_Core5_1000ms_Count", taskvalue);
  E_DBGR_VariableCheck("Task_Core5_1000ms_Count", taskvalue, Greater);
  
  /*******************************************************************************************************************************************************/    
    // Test Step 3: set breakpoint in file main.c in function FUNC(void, OS_CALLOUT_CODE) StartupHook(void) at line if( CORE4 == coreId)
  /*******************************************************************************************************************************************************/

  snprintf( chActionText, elCount(chActionText), "set breakpoint in file main.c in function FUNC(void, OS_CALLOUT_CODE) StartupHook(void) at line if( CORE4 == coreId) "); 
  snprintf( chExpectedText, elCount(chExpectedText), "Verify Breakpoint got hit at function FUNC(boolean, OS_CALLOUT_CODE) StartupHook(void) at line if( CORE4 == coreId)"); 
  TestStepAddActionExpected( chActionText, chExpectedText );
  A_DBGR_R();
  A_DBGR_BreakpointSet("StartupHook");  
  A_DBGR_Go(); 
  E_DBGR_BreakpointCheckForHalt("StartupHook");
  
  
  snprintf( chActionText, elCount(chActionText), "Run Software and check breakpoint got hit at function CntrlRBSR_CntrlrResetCPU4()"); 
  snprintf( chExpectedText, elCount(chExpectedText), "Verify Software is Running and breakpoint got hit at function CntrlRBSR_CntrlrResetCP4()"); 
  TestStepAddActionExpected( chActionText, chExpectedText );
  
  A_DBGR_BreakpointDeleteAll();
  A_DBGR_VariableSet("coreId", "4");  
  A_DBGR_BreakpointSet("CntrlRBSR_CntrlrResetCPU4");
  A_DBGR_Go();
   A_DBGR_Go(); 
  E_DBGR_BreakpointCheckForHalt("CntrlRBSR_CntrlrResetCPU4");
 
}



/***************************************************************************************************
----------------------------------------------------------------------------------------------------
Test case name:  TC_L30SW_QT_36542230: Testcase_to_verify_the_functionality_of_interface_CntrlRBSR_CntrlrReset()_to_check_the_interface_is_called_in_startuphook_from_core5
----------------------------------------------------------------------------------------------------
Description:  test case to verify the functionality of interface CntrlRBSR_CntrlrReset() to check the interface is called in startuphook from core5.

***************************************************************************************************/
testcase Testcase_to_verify_functionality_of_interface_CntrlRBSR_CntrlrReset_to_check_the_interface_is_called_in_startuphook_from_core5()
{
  /***************************************************************************************************************/    
                                                // Variable Definition
  /***************************************************************************************************************/ 
  
  long taskvalue;
  
  /***************************************************************************************************************/    
                                               // Local Values
  /***************************************************************************************************************/ 
  

  
  /***************************************************************************************************************/    
                                              // Test Case Info
  /***************************************************************************************************************/
  setWriteDbgLevel(DebugOff);
  snprintf( chTestTitle, elCount(chTestTitle), "Testcase_to_verify_the_functionality_of_interface_CntrlRBSR_CntrlrReset()_to_check_the_interface_is_called_in_startuphook_from_core5" );
  snprintf( chTestDescription, elCount(chTestDescription), "Purpose: test case to verify the functionality of interface CntrlRBSR_CntrlrReset() to check the interface is called in startuphook from core5.");
  TestCaseAddInfo( chTestTitle, "TC_L30SW_QT_36542230", chTestDescription );

  /***************************************************************************************************************/    
                                              // Start of Test Case
  /***************************************************************************************************************/
  
  /***************************************************************************************************************/    
                                              // Test Step 1 PRECONDITIONS
  /***************************************************************************************************************/
  
  snprintf( chActionText, elCount(chActionText), "Flash the Software and ECU is running"); 
  snprintf( chExpectedText, elCount(chExpectedText), "ECU should be in running state"); 
  TestStepAddActionExpected( chActionText, chExpectedText );

  A_DBGR_BreakpointDeleteAll();
  A_DBGR_RnGo();
  E_DBGR_CheckState(T32_State_Running);
  

   /***************************************************************************************************************/    
            // Test Step 2: Check all cores are in running state                                   
  /***************************************************************************************************************/
  
  //Check Core0 is running
  snprintf( chActionText, elCount(chActionText), "Check 1000ms Task Counter from Core0 "); 
  snprintf( chExpectedText, elCount(chExpectedText), "1000ms Counter from Core0 is incrementing"); 
  TestStepAddActionExpected( chActionText, chExpectedText );
  A_DBGR_VariableRead( "Task_Core0_1000ms_Count", taskvalue);
  E_DBGR_VariableCheck("Task_Core0_1000ms_Count", taskvalue, Greater);
  
  //Check Core1 is running
  snprintf( chActionText, elCount(chActionText), "Check 1000ms Task Counter from Core1 "); 
  snprintf( chExpectedText, elCount(chExpectedText), "1000ms Counter from Core1 is incrementing"); 
  TestStepAddActionExpected( chActionText, chExpectedText );
  A_DBGR_VariableRead( "Task_Core1_1000ms_Count", taskvalue);
  E_DBGR_VariableCheck("Task_Core1_1000ms_Count", taskvalue, Greater);
  
  //Check Core2 is running
  snprintf( chActionText, elCount(chActionText), "Check 1000ms Task Counter from Core2 "); 
  snprintf( chExpectedText, elCount(chExpectedText), "1000ms Counter from Core2 is incrementing"); 
  TestStepAddActionExpected( chActionText, chExpectedText );
  A_DBGR_VariableRead( "Task_Core2_1000ms_Count", taskvalue);
  E_DBGR_VariableCheck("Task_Core2_1000ms_Count", taskvalue, Greater);
    
  //Check Core3 is running
  snprintf( chActionText, elCount(chActionText), "Check 1000ms Task Counter from Core3 "); 
  snprintf( chExpectedText, elCount(chExpectedText), "1000ms Counter from Core3 is incrementing"); 
  TestStepAddActionExpected( chActionText, chExpectedText );
  A_DBGR_VariableRead( "Task_Core3_1000ms_Count", taskvalue);
  E_DBGR_VariableCheck("Task_Core3_1000ms_Count", taskvalue, Greater);
    
  //Check Core4 is running
  snprintf( chActionText, elCount(chActionText), "Check 1000ms Task Counter from Core4 "); 
  snprintf( chExpectedText, elCount(chExpectedText), "1000ms Counter from Core4 is incrementing"); 
  TestStepAddActionExpected( chActionText, chExpectedText );
  A_DBGR_VariableRead( "Task_Core4_1000ms_Count", taskvalue);
  E_DBGR_VariableCheck("Task_Core4_1000ms_Count", taskvalue, Greater);
    
  //Check Core5 is running
  snprintf( chActionText, elCount(chActionText), "Check 1000ms Task Counter from Core5 "); 
  snprintf( chExpectedText, elCount(chExpectedText), "1000ms Counter from Core5 is incrementing"); 
  TestStepAddActionExpected( chActionText, chExpectedText );
  A_DBGR_VariableRead( "Task_Core5_1000ms_Count", taskvalue);
  E_DBGR_VariableCheck("Task_Core5_1000ms_Count", taskvalue, Greater);
  
  /*******************************************************************************************************************************************************/    
    // Test Step 3: set breakpoint in file main.c in function FUNC(void, OS_CALLOUT_CODE) StartupHook(void) at line if( CORE5 == coreId)
  /*******************************************************************************************************************************************************/

  snprintf( chActionText, elCount(chActionText), "set breakpoint in file main.c in function FUNC(void, OS_CALLOUT_CODE) StartupHook(void) at line if( CORE5 == coreId) "); 
  snprintf( chExpectedText, elCount(chExpectedText), "Verify Breakpoint got hit at function FUNC(boolean, OS_CALLOUT_CODE) StartupHook(void) at line if( CORE5 == coreId)"); 
  TestStepAddActionExpected( chActionText, chExpectedText );
  A_DBGR_R();
  A_DBGR_BreakpointSet("StartupHook"); 
  A_DBGR_Go(); 
  E_DBGR_BreakpointCheckForHalt("StartupHook");
  
  
  snprintf( chActionText, elCount(chActionText), "Run Software and check breakpoint got hit at function CntrlRBSR_CntrlrResetCPU5()"); 
  snprintf( chExpectedText, elCount(chExpectedText), "Verify Software is Running and breakpoint got hit at function CntrlRBSR_CntrlrResetCP5()"); 
  TestStepAddActionExpected( chActionText, chExpectedText );
  A_DBGR_BreakpointDeleteAll();
  A_DBGR_VariableSet("coreId", "5");
  A_DBGR_BreakpointSet("CntrlRBSR_CntrlrResetCPU5"); 
  A_DBGR_Go(); 
   A_DBGR_Go(); 
  E_DBGR_BreakpointCheckForHalt("CntrlRBSR_CntrlrResetCPU5");
 
}


  
/***************************************************************************************************
----------------------------------------------------------------------------------------------------
Test case name:  TC_L30SW_QT_36649665: test_case_to_verify_the_functionality_of_interface_DsblHWIO_Interrupts()_to_prohibits_all_interrupts_from_pre-empting_the_core0_task_and_interrupt__for_CPU0
----------------------------------------------------------------------------------------------------
Description:  test_case_to_verify_the_functionality_of_interface_DsblHWIO_Interrupts()_to_prohibits_all_interrupts_from_pre-empting_the_core0_task_and_interrupt__for_CPU0

***************************************************************************************************/
testcase test_case_to_verify_the_functionality_of_interface_DsblHWIO_Interrupt_to_prohibits_all_interrupts_the_core0()
{
  /***************************************************************************************************************/    
                                                // Variable Definition
  /***************************************************************************************************************/ 
  
  long taskvalue;
  
  /***************************************************************************************************************/    
                                               // Local Values
  /***************************************************************************************************************/ 
  

  
  /***************************************************************************************************************/    
                                              // Test Case Info
  /***************************************************************************************************************/
  setWriteDbgLevel(DebugOff);
  snprintf( chTestTitle, elCount(chTestTitle), "test_case_to_verify_the_functionality_of_interface_DsblHWIO_Interrupt_to_prohibits_all_interrupts_from_pre_empting_the_core0_task_and_interrupt__for_CPU0" );
  snprintf( chTestDescription, elCount(chTestDescription), "Purpose: test_case_to_verify_the_functionality_of_interface_DsblHWIO_Interrupt_to_prohibits_all_interrupts_from_pre_empting_the_core0_task_and_interrupt__for_CPU0.");
  TestCaseAddInfo( chTestTitle, "TC_L30SW_QT_36649669", chTestDescription );

  /***************************************************************************************************************/    
                                              // Start of Test Case
  /***************************************************************************************************************/
  
  /***************************************************************************************************************/    
                                              // Test Step 1 PRECONDITIONS
  /***************************************************************************************************************/
  
  snprintf( chActionText, elCount(chActionText), "Flash the Software and ECU is running"); 
  snprintf( chExpectedText, elCount(chExpectedText), "ECU should be in running state"); 
  TestStepAddActionExpected( chActionText, chExpectedText );

  A_DBGR_BreakpointDeleteAll();
  A_DBGR_RnGo();
  E_DBGR_CheckState(T32_State_Running);
  

   /***************************************************************************************************************/    
            // Test Step 2: Check all cores are in running state                                   
  /***************************************************************************************************************/
  
  //Check Core0 is running
  snprintf( chActionText, elCount(chActionText), "Check 1000ms Task Counter from Core0 "); 
  snprintf( chExpectedText, elCount(chExpectedText), "1000ms Counter from Core0 is incrementing"); 
  TestStepAddActionExpected( chActionText, chExpectedText );
  A_DBGR_VariableRead( "Task_Core0_1000ms_Count", taskvalue);
  E_DBGR_VariableCheck("Task_Core0_1000ms_Count", taskvalue, Greater);
  
  //Check Core1 is running
  snprintf( chActionText, elCount(chActionText), "Check 1000ms Task Counter from Core1 "); 
  snprintf( chExpectedText, elCount(chExpectedText), "1000ms Counter from Core1 is incrementing"); 
  TestStepAddActionExpected( chActionText, chExpectedText );
  A_DBGR_VariableRead( "Task_Core1_1000ms_Count", taskvalue);
  E_DBGR_VariableCheck("Task_Core1_1000ms_Count", taskvalue, Greater);
  
  //Check Core2 is running
  snprintf( chActionText, elCount(chActionText), "Check 1000ms Task Counter from Core2 "); 
  snprintf( chExpectedText, elCount(chExpectedText), "1000ms Counter from Core2 is incrementing"); 
  TestStepAddActionExpected( chActionText, chExpectedText );
  A_DBGR_VariableRead( "Task_Core2_1000ms_Count", taskvalue);
  E_DBGR_VariableCheck("Task_Core2_1000ms_Count", taskvalue, Greater);
    
  //Check Core3 is running
  snprintf( chActionText, elCount(chActionText), "Check 1000ms Task Counter from Core3 "); 
  snprintf( chExpectedText, elCount(chExpectedText), "1000ms Counter from Core3 is incrementing"); 
  TestStepAddActionExpected( chActionText, chExpectedText );
  A_DBGR_VariableRead( "Task_Core3_1000ms_Count", taskvalue);
  E_DBGR_VariableCheck("Task_Core3_1000ms_Count", taskvalue, Greater);
    
  //Check Core4 is running
  snprintf( chActionText, elCount(chActionText), "Check 1000ms Task Counter from Core4 "); 
  snprintf( chExpectedText, elCount(chExpectedText), "1000ms Counter from Core4 is incrementing"); 
  TestStepAddActionExpected( chActionText, chExpectedText );
  A_DBGR_VariableRead( "Task_Core4_1000ms_Count", taskvalue);
  E_DBGR_VariableCheck("Task_Core4_1000ms_Count", taskvalue, Greater);
    
  //Check Core5 is running
  snprintf( chActionText, elCount(chActionText), "Check 1000ms Task Counter from Core5 "); 
  snprintf( chExpectedText, elCount(chExpectedText), "1000ms Counter from Core5 is incrementing"); 
  TestStepAddActionExpected( chActionText, chExpectedText );
  A_DBGR_VariableRead( "Task_Core5_1000ms_Count", taskvalue);
  E_DBGR_VariableCheck("Task_Core5_1000ms_Count", taskvalue, Greater);
  
  /*******************************************************************************************************************************************************/    
    // Test Step 3: set SetCore0Flag=1 to Enable funtion Os_Test_EnblDsblHWIO_Nest_Interrupts_core()
  /*******************************************************************************************************************************************************/

  snprintf( chActionText, elCount(chActionText), "set SetCore0Flag=1 to Enable funtion Os_Test_EnblDsblHWIO_Nest_Interrupts_core() "); 
  snprintf( chExpectedText, elCount(chExpectedText), "Verify SetCore0Flag=1 to Enable funtion Os_Test_EnblDsblHWIO_Nest_Interrupts_core() "); 
  TestStepAddActionExpected( chActionText, chExpectedText );
//  A_DBGR_R();
//  A_DBGR_Go();
  A_DBGR_VariableSet("SetCore0Flag", "1");
  A_DBGR_VariableSet("interruptWait", "0");
  //A_DBGR_VariableSet("interruptWait", "0"); 
  //A_DBGR_Go(); 
  
  /***************************************************************************************************************/    
        // Test Step 4 check the task counters for  the core0 stopped.
  /***************************************************************************************************************/
  //testWaitForTimeout(1000);
  //Check All tasks of Core0 are stopped
  snprintf( chActionText, elCount(chActionText), "Check 2pt5ms Task Counter from Core0 "); 
  snprintf( chExpectedText, elCount(chExpectedText), "2pt5ms Counter from Core0 is stop incrementing"); 
  //TestStepAddActionExpected( chActionText, chExpectedText );
  A_DBGR_VariableRead( "Task_Core0_2pt5ms_Count", taskvalue);
  E_DBGR_VariableCheck("Task_Core0_2pt5ms_Count", taskvalue, Equal);
  
  snprintf( chActionText, elCount(chActionText), "Check 5ms Task Counter from Core0 "); 
  snprintf( chExpectedText, elCount(chExpectedText), "5ms Counter from Core0 is stop incrementing"); 
  TestStepAddActionExpected( chActionText, chExpectedText );
  A_DBGR_VariableRead( "Task_Core0_5ms_Count", taskvalue);
  E_DBGR_VariableCheck("Task_Core0_5ms_Count", taskvalue, Equal);
  
  snprintf( chActionText, elCount(chActionText), "Check 10ms Task Counter from Core0 "); 
  snprintf( chExpectedText, elCount(chExpectedText), "10ms Counter from Core0 is stop incrementing"); 
  TestStepAddActionExpected( chActionText, chExpectedText );
  A_DBGR_VariableRead( "Task_Core0_10ms_Count", taskvalue);
  E_DBGR_VariableCheck("Task_Core0_10ms_Count", taskvalue, Equal);  
  
  snprintf( chActionText, elCount(chActionText), "Check 25ms Task Counter from Core0 "); 
  snprintf( chExpectedText, elCount(chExpectedText), "25ms Counter from Core0 is stop incrementing"); 
  TestStepAddActionExpected( chActionText, chExpectedText );
  A_DBGR_VariableRead( "Task_Core0_25ms_Count", taskvalue);
  E_DBGR_VariableCheck("Task_Core0_25ms_Count", taskvalue, Equal);  

  snprintf( chActionText, elCount(chActionText), "Check 50ms Task Counter from Core0 "); 
  snprintf( chExpectedText, elCount(chExpectedText), "50ms Counter from Core0 is stop incrementing"); 
  TestStepAddActionExpected( chActionText, chExpectedText );
  A_DBGR_VariableRead( "Task_Core0_50ms_Count", taskvalue);
  E_DBGR_VariableCheck("Task_Core0_50ms_Count", taskvalue, Equal);
  
  snprintf( chActionText, elCount(chActionText), "Check 250ms Task Counter from Core0 "); 
  snprintf( chExpectedText, elCount(chExpectedText), "250ms Counter from Core0 is stop incrementing"); 
  TestStepAddActionExpected( chActionText, chExpectedText );
  A_DBGR_VariableRead( "Task_Core0_250ms_Count", taskvalue);
  E_DBGR_VariableCheck("Task_Core0_250ms_Count", taskvalue, Equal);
  
  snprintf( chActionText, elCount(chActionText), "Check 100ms Task Counter from Core0 "); 
  snprintf( chExpectedText, elCount(chExpectedText), "100ms Counter from Core0 is stop incrementing"); 
  TestStepAddActionExpected( chActionText, chExpectedText );
  A_DBGR_VariableRead( "Task_Core0_100ms_Count", taskvalue);
  E_DBGR_VariableCheck("Task_Core0_100ms_Count", taskvalue, Equal); 

  snprintf( chActionText, elCount(chActionText), "Check 500ms Task Counter from Core0 "); 
  snprintf( chExpectedText, elCount(chExpectedText), "500ms Counter from Core0 is stop incrementing"); 
  TestStepAddActionExpected( chActionText, chExpectedText );
  A_DBGR_VariableRead( "Task_Core0_500ms_Count", taskvalue);
  E_DBGR_VariableCheck("Task_Core0_500ms_Count", taskvalue, Equal);
  
  snprintf( chActionText, elCount(chActionText), "Check 1000ms Task Counter from Core0 "); 
  snprintf( chExpectedText, elCount(chExpectedText), "1000ms Counter from Core0 is stop incrementing"); 
  TestStepAddActionExpected( chActionText, chExpectedText );
  A_DBGR_VariableRead( "Task_Core0_1000ms_Count", taskvalue);
  E_DBGR_VariableCheck("Task_Core0_1000ms_Count", taskvalue, Equal);
  
   //Check Core1 is running
  snprintf( chActionText, elCount(chActionText), "Check 1000ms Task Counter from Core1 "); 
  snprintf( chExpectedText, elCount(chExpectedText), "1000ms Counter from Core1 is incrementing"); 
  TestStepAddActionExpected( chActionText, chExpectedText );
  A_DBGR_VariableRead( "Task_Core1_1000ms_Count", taskvalue);
  E_DBGR_VariableCheck("Task_Core1_1000ms_Count", taskvalue, Greater);
  
  //Check Core2 is running
  snprintf( chActionText, elCount(chActionText), "Check 1000ms Task Counter from Core2 "); 
  snprintf( chExpectedText, elCount(chExpectedText), "1000ms Counter from Core2 is incrementing"); 
  TestStepAddActionExpected( chActionText, chExpectedText );
  A_DBGR_VariableRead( "Task_Core2_1000ms_Count", taskvalue);
  E_DBGR_VariableCheck("Task_Core2_1000ms_Count", taskvalue, Greater);
    
  //Check Core3 is running
  snprintf( chActionText, elCount(chActionText), "Check 1000ms Task Counter from Core3 "); 
  snprintf( chExpectedText, elCount(chExpectedText), "1000ms Counter from Core3 is incrementing"); 
  TestStepAddActionExpected( chActionText, chExpectedText );
  A_DBGR_VariableRead( "Task_Core3_1000ms_Count", taskvalue);
  E_DBGR_VariableCheck("Task_Core3_1000ms_Count", taskvalue, Greater);
    
  //Check Core4 is running
  snprintf( chActionText, elCount(chActionText), "Check 1000ms Task Counter from Core4 "); 
  snprintf( chExpectedText, elCount(chExpectedText), "1000ms Counter from Core4 is incrementing"); 
  TestStepAddActionExpected( chActionText, chExpectedText );
  A_DBGR_VariableRead( "Task_Core4_1000ms_Count", taskvalue);
  E_DBGR_VariableCheck("Task_Core4_1000ms_Count", taskvalue, Greater);
    
  //Check Core5 is running
  snprintf( chActionText, elCount(chActionText), "Check 1000ms Task Counter from Core5 "); 
  snprintf( chExpectedText, elCount(chExpectedText), "1000ms Counter from Core5 is incrementing"); 
  TestStepAddActionExpected( chActionText, chExpectedText );
  A_DBGR_VariableRead( "Task_Core5_1000ms_Count", taskvalue);
  E_DBGR_VariableCheck("Task_Core5_1000ms_Count", taskvalue, Greater);
  
  /*******************************************************************************************************************************************************/    
    // Test Step 6: set SetCore0Flag=0 to Disable funtion Os_Test_EnblDsblHWIO_Nest_Interrupts_core()
  /*******************************************************************************************************************************************************/
  snprintf( chActionText, elCount(chActionText), "set SetCore0Flag=0 to Disable funtion Os_Test_EnblDsblHWIO_Nest_Interrupts_core() "); 
  snprintf( chExpectedText, elCount(chExpectedText), "Verify SetCore0Flag=0 to Disable funtion Os_Test_EnblDsblHWIO_Nest_Interrupts_core() "); 
  TestStepAddActionExpected( chActionText, chExpectedText );
  
  A_DBGR_VariableSet("interruptWait", "1"); 
  A_DBGR_VariableSet("SetCore0Flag", "0"); 
  A_DBGR_VariableSet("interruptWait", "0"); 
  
}

/***************************************************************************************************
----------------------------------------------------------------------------------------------------
Test case name:  TC_L30SW_QT_36649665: test_case_to_verify_the_functionality_of_interface_DsblHWIO_Interrupts()_to_prohibits_all_interrupts_from_pre-empting_the_core1_task_and_interrupt__for_CPU1
----------------------------------------------------------------------------------------------------
Description:  test_case_to_verify_the_functionality_of_interface_DsblHWIO_Interrupts()_to_prohibits_all_interrupts_from_pre-empting_the_core1_task_and_interrupt__for_CPU1

***************************************************************************************************/
testcase test_case_to_verify_the_functionality_of_interface_DsblHWIO_Interrupt_to_prohibits_all_interrupts_the_core1()
{
  /***************************************************************************************************************/    
                                                // Variable Definition
  /***************************************************************************************************************/ 
  
  long taskvalue;
  
  /***************************************************************************************************************/    
                                               // Local Values
  /***************************************************************************************************************/ 
  

  
  /***************************************************************************************************************/    
                                              // Test Case Info
  /***************************************************************************************************************/
  setWriteDbgLevel(DebugOff);
  snprintf( chTestTitle, elCount(chTestTitle), "test_case_to_verify_the_functionality_of_interface_DsblHWIO_Interrupt_to_prohibits_all_interrupts_from_pre_empting_the_core1_task_and_interrupt__for_CPU1");
  snprintf( chTestDescription, elCount(chTestDescription), "Purpose:test_case_to_verify_the_functionality_of_interface_DsblHWIO_Interrupt_to_prohibits_all_interrupts_from_pre_empting_the_core1_task_and_interrupt__for_CPU1");
  TestCaseAddInfo( chTestTitle, "TC_L30SW_QT_36649665", chTestDescription );

  /***************************************************************************************************************/    
                                              // Start of Test Case
  /***************************************************************************************************************/
  
  /***************************************************************************************************************/    
                                              // Test Step 1 PRECONDITIONS
  /***************************************************************************************************************/
  
  snprintf( chActionText, elCount(chActionText), "Flash the Software and ECU is running"); 
  snprintf( chExpectedText, elCount(chExpectedText), "ECU should be in running state"); 
 

  A_DBGR_BreakpointDeleteAll();
  A_DBGR_RnGo();
  E_DBGR_CheckState(T32_State_Running);
  

   /***************************************************************************************************************/    
            // Test Step 2: Check all cores are in running state                                   
  /***************************************************************************************************************/
  
  //Check Core0 is running
  snprintf( chActionText, elCount(chActionText), "Check 1000ms Task Counter from Core0 "); 
  snprintf( chExpectedText, elCount(chExpectedText), "1000ms Counter from Core0 is incrementing"); 
  TestStepAddActionExpected( chActionText, chExpectedText );
  A_DBGR_VariableRead( "Task_Core0_1000ms_Count", taskvalue);
  E_DBGR_VariableCheck("Task_Core0_1000ms_Count", taskvalue, Greater);
  
  //Check Core1 is running
  snprintf( chActionText, elCount(chActionText), "Check 1000ms Task Counter from Core1 "); 
  snprintf( chExpectedText, elCount(chExpectedText), "1000ms Counter from Core1 is incrementing"); 
  TestStepAddActionExpected( chActionText, chExpectedText );
  A_DBGR_VariableRead( "Task_Core1_1000ms_Count", taskvalue);
  E_DBGR_VariableCheck("Task_Core1_1000ms_Count", taskvalue, Greater);
  
  //Check Core2 is running
  snprintf( chActionText, elCount(chActionText), "Check 1000ms Task Counter from Core2 "); 
  snprintf( chExpectedText, elCount(chExpectedText), "1000ms Counter from Core2 is incrementing"); 
  TestStepAddActionExpected( chActionText, chExpectedText );
  A_DBGR_VariableRead( "Task_Core2_1000ms_Count", taskvalue);
  E_DBGR_VariableCheck("Task_Core2_1000ms_Count", taskvalue, Greater);
    
  //Check Core3 is running
  snprintf( chActionText, elCount(chActionText), "Check 1000ms Task Counter from Core3 "); 
  snprintf( chExpectedText, elCount(chExpectedText), "1000ms Counter from Core3 is incrementing"); 
  TestStepAddActionExpected( chActionText, chExpectedText );
  A_DBGR_VariableRead( "Task_Core3_1000ms_Count", taskvalue);
  E_DBGR_VariableCheck("Task_Core3_1000ms_Count", taskvalue, Greater);
    
  //Check Core4 is running
  snprintf( chActionText, elCount(chActionText), "Check 1000ms Task Counter from Core4 "); 
  snprintf( chExpectedText, elCount(chExpectedText), "1000ms Counter from Core4 is incrementing"); 
  TestStepAddActionExpected( chActionText, chExpectedText );
  A_DBGR_VariableRead( "Task_Core4_1000ms_Count", taskvalue);
  E_DBGR_VariableCheck("Task_Core4_1000ms_Count", taskvalue, Greater);
    
  //Check Core5 is running
  snprintf( chActionText, elCount(chActionText), "Check 1000ms Task Counter from Core5 "); 
  snprintf( chExpectedText, elCount(chExpectedText), "1000ms Counter from Core5 is incrementing"); 
  TestStepAddActionExpected( chActionText, chExpectedText );
  A_DBGR_VariableRead( "Task_Core5_1000ms_Count", taskvalue);
  E_DBGR_VariableCheck("Task_Core5_1000ms_Count", taskvalue, Greater);
  
  /*******************************************************************************************************************************************************/    
    // Test Step 3: set SetCore1Flag=1 to Enable funtion Os_Test_EnblDsblHWIO_Nest_Interrupts_core()
  /*******************************************************************************************************************************************************/

  snprintf( chActionText, elCount(chActionText), "set SetCore1Flag=1 to Enable funtion Os_Test_EnblDsblHWIO_Nest_Interrupts_core() "); 
  snprintf( chExpectedText, elCount(chExpectedText), "Verify SetCore1Flag=1 to Enable funtion Os_Test_EnblDsblHWIO_Nest_Interrupts_core() "); 
  TestStepAddActionExpected( chActionText, chExpectedText );
//  A_DBGR_R();
//  A_DBGR_Go();
  A_DBGR_VariableSet("SetCore1Flag", "1");
  A_DBGR_VariableSet("interruptWait", "0");
  //A_DBGR_VariableSet("interruptWait", "0"); 
  //A_DBGR_Go(); 
  
  /***************************************************************************************************************/    
        // Test Step 4 check the task counters for  the Core1 stopped.
  /***************************************************************************************************************/

  //Check All tasks of Core1 are stopped
  snprintf( chActionText, elCount(chActionText), "Check 2pt5ms Task Counter from Core1 "); 
  snprintf( chExpectedText, elCount(chExpectedText), "2pt5ms Counter from Core1 is stop incrementing"); 
  //TestStepAddActionExpected( chActionText, chExpectedText );
  A_DBGR_VariableRead( "Task_Core1_2pt5ms_Count", taskvalue);
  E_DBGR_VariableCheck("Task_Core1_2pt5ms_Count", taskvalue, Equal);
  
  snprintf( chActionText, elCount(chActionText), "Check 5ms Task Counter from Core1 "); 
  snprintf( chExpectedText, elCount(chExpectedText), "5ms Counter from Core1 is stop incrementing"); 
  TestStepAddActionExpected( chActionText, chExpectedText );
  A_DBGR_VariableRead( "Task_Core1_5ms_Count", taskvalue);
  E_DBGR_VariableCheck("Task_Core1_5ms_Count", taskvalue, Equal);
  
  snprintf( chActionText, elCount(chActionText), "Check 10ms Task Counter from Core1 "); 
  snprintf( chExpectedText, elCount(chExpectedText), "10ms Counter from Core1 is stop incrementing"); 
  TestStepAddActionExpected( chActionText, chExpectedText );
  A_DBGR_VariableRead( "Task_Core1_10ms_Count", taskvalue);
  E_DBGR_VariableCheck("Task_Core1_10ms_Count", taskvalue, Equal);  
  
  snprintf( chActionText, elCount(chActionText), "Check 25ms Task Counter from Core1 "); 
  snprintf( chExpectedText, elCount(chExpectedText), "25ms Counter from Core1 is stop incrementing"); 
  TestStepAddActionExpected( chActionText, chExpectedText );
  A_DBGR_VariableRead( "Task_Core1_25ms_Count", taskvalue);
  E_DBGR_VariableCheck("Task_Core1_25ms_Count", taskvalue, Equal);  

  snprintf( chActionText, elCount(chActionText), "Check 50ms Task Counter from Core1 "); 
  snprintf( chExpectedText, elCount(chExpectedText), "50ms Counter from Core1 is stop incrementing"); 
  TestStepAddActionExpected( chActionText, chExpectedText );
  A_DBGR_VariableRead( "Task_Core1_50ms_Count", taskvalue);
  E_DBGR_VariableCheck("Task_Core1_50ms_Count", taskvalue, Equal);
  
  snprintf( chActionText, elCount(chActionText), "Check 250ms Task Counter from Core1 "); 
  snprintf( chExpectedText, elCount(chExpectedText), "250ms Counter from Core1 is stop incrementing"); 
  TestStepAddActionExpected( chActionText, chExpectedText );
  A_DBGR_VariableRead( "Task_Core1_250ms_Count", taskvalue);
  E_DBGR_VariableCheck("Task_Core1_250ms_Count", taskvalue, Equal);
  
  snprintf( chActionText, elCount(chActionText), "Check 100ms Task Counter from Core1 "); 
  snprintf( chExpectedText, elCount(chExpectedText), "100ms Counter from Core1 is stop incrementing"); 
  TestStepAddActionExpected( chActionText, chExpectedText );
  A_DBGR_VariableRead( "Task_Core1_100ms_Count", taskvalue);
  E_DBGR_VariableCheck("Task_Core1_100ms_Count", taskvalue, Equal); 

  snprintf( chActionText, elCount(chActionText), "Check 500ms Task Counter from Core1 "); 
  snprintf( chExpectedText, elCount(chExpectedText), "500ms Counter from Core1 is stop incrementing"); 
  TestStepAddActionExpected( chActionText, chExpectedText );
  A_DBGR_VariableRead( "Task_Core1_500ms_Count", taskvalue);
  E_DBGR_VariableCheck("Task_Core1_500ms_Count", taskvalue, Equal);
  
  snprintf( chActionText, elCount(chActionText), "Check 1000ms Task Counter from Core1 "); 
  snprintf( chExpectedText, elCount(chExpectedText), "1000ms Counter from Core1 is stop incrementing"); 
  TestStepAddActionExpected( chActionText, chExpectedText );
  A_DBGR_VariableRead( "Task_Core1_1000ms_Count", taskvalue);
  E_DBGR_VariableCheck("Task_Core1_1000ms_Count", taskvalue, Equal);
  
   //Check Core0 is running
  snprintf( chActionText, elCount(chActionText), "Check 1000ms Task Counter from Core0 "); 
  snprintf( chExpectedText, elCount(chExpectedText), "1000ms Counter from Core0 is incrementing"); 
  TestStepAddActionExpected( chActionText, chExpectedText );
  A_DBGR_VariableRead( "Task_Core0_1000ms_Count", taskvalue);
  E_DBGR_VariableCheck("Task_Core0_1000ms_Count", taskvalue, Greater);
  
  //Check Core2 is running
  snprintf( chActionText, elCount(chActionText), "Check 1000ms Task Counter from Core2 "); 
  snprintf( chExpectedText, elCount(chExpectedText), "1000ms Counter from Core2 is incrementing"); 
  TestStepAddActionExpected( chActionText, chExpectedText );
  A_DBGR_VariableRead( "Task_Core2_1000ms_Count", taskvalue);
  E_DBGR_VariableCheck("Task_Core2_1000ms_Count", taskvalue, Greater);
    
  //Check Core3 is running
  snprintf( chActionText, elCount(chActionText), "Check 1000ms Task Counter from Core3 "); 
  snprintf( chExpectedText, elCount(chExpectedText), "1000ms Counter from Core3 is incrementing"); 
  TestStepAddActionExpected( chActionText, chExpectedText );
  A_DBGR_VariableRead( "Task_Core3_1000ms_Count", taskvalue);
  E_DBGR_VariableCheck("Task_Core3_1000ms_Count", taskvalue, Greater);
    
  //Check Core4 is running
  snprintf( chActionText, elCount(chActionText), "Check 1000ms Task Counter from Core4 "); 
  snprintf( chExpectedText, elCount(chExpectedText), "1000ms Counter from Core4 is incrementing"); 
  TestStepAddActionExpected( chActionText, chExpectedText );
  A_DBGR_VariableRead( "Task_Core4_1000ms_Count", taskvalue);
  E_DBGR_VariableCheck("Task_Core4_1000ms_Count", taskvalue, Greater);
    
  //Check Core5 is running
  snprintf( chActionText, elCount(chActionText), "Check 1000ms Task Counter from Core5 "); 
  snprintf( chExpectedText, elCount(chExpectedText), "1000ms Counter from Core5 is incrementing"); 
  TestStepAddActionExpected( chActionText, chExpectedText );
  A_DBGR_VariableRead( "Task_Core5_1000ms_Count", taskvalue);
  E_DBGR_VariableCheck("Task_Core5_1000ms_Count", taskvalue, Greater);
  
  /*******************************************************************************************************************************************************/    
    // Test Step 5: set SetCore1Flag=0 to Disable funtion Os_Test_EnblDsblHWIO_Nest_Interrupts_core()
  /*******************************************************************************************************************************************************/
  snprintf( chActionText, elCount(chActionText), "set SetCore1Flag=0 to Disable funtion Os_Test_EnblDsblHWIO_Nest_Interrupts_core() "); 
  snprintf( chExpectedText, elCount(chExpectedText), "Verify SetCore1Flag=0 to Disable funtion Os_Test_EnblDsblHWIO_Nest_Interrupts_core() "); 
  TestStepAddActionExpected( chActionText, chExpectedText );
  
  A_DBGR_VariableSet("interruptWait", "1"); 
  A_DBGR_VariableSet("SetCore1Flag", "0"); 
  A_DBGR_VariableSet("interruptWait", "0"); 
  
}

/***************************************************************************************************
----------------------------------------------------------------------------------------------------
Test case name:  TC_L30SW_QT_36649666: test_case_to_verify_the_functionality_of_interface_DsblHWIO_Interrupts()_to_prohibits_all_interrupts_from_pre-empting_the_core2_task_and_interrupt__for_CPU2
----------------------------------------------------------------------------------------------------
Description:  test_case_to_verify_the_functionality_of_interface_DsblHWIO_Interrupts()_to_prohibits_all_interrupts_from_pre-empting_the_core2_task_and_interrupt__for_CPU2

***************************************************************************************************/
testcase test_case_to_verify_the_functionality_of_interface_DsblHWIO_Interrupt_to_prohibits_all_interrupts_the_core2()
{
  /***************************************************************************************************************/    
                                                // Variable Definition
  /***************************************************************************************************************/ 
  
  long taskvalue;
  
  /***************************************************************************************************************/    
                                               // Local Values
  /***************************************************************************************************************/ 
  

  
  /***************************************************************************************************************/    
                                              // Test Case Info
  /***************************************************************************************************************/
  setWriteDbgLevel(DebugOff);
  snprintf( chTestTitle, elCount(chTestTitle), "test_case_to_verify_the_functionality_of_interface_DsblHWIO_Interrupt_to_prohibits_all_interrupts_from_pre_empting_the_core2_task_and_interrupt__for_CPU2" );
  snprintf( chTestDescription, elCount(chTestDescription), "Purpose: test_case_to_verify_the_functionality_of_interface_DsblHWIO_Interrupt_to_prohibits_all_interrupts_from_pre_empting_the_core2_task_and_interrupt__for_CPU2.");
  TestCaseAddInfo( chTestTitle, "TC_L30SW_QT_36649666", chTestDescription );

  /***************************************************************************************************************/    
                                              // Start of Test Case
  /***************************************************************************************************************/
  
  /***************************************************************************************************************/    
                                              // Test Step 1 PRECONDITIONS
  /***************************************************************************************************************/
  
  snprintf( chActionText, elCount(chActionText), "Flash the Software and ECU is running"); 
  snprintf( chExpectedText, elCount(chExpectedText), "ECU should be in running state"); 
 // TestStepAddActionExpected( chActionText, chExpectedText );

  A_DBGR_BreakpointDeleteAll();
  A_DBGR_RnGo();
  E_DBGR_CheckState(T32_State_Running);
  

   /***************************************************************************************************************/    
            // Test Step 2: Check all cores are in running state                                   
  /***************************************************************************************************************/
  
  //Check Core0 is running
  snprintf( chActionText, elCount(chActionText), "Check 1000ms Task Counter from Core0 "); 
  snprintf( chExpectedText, elCount(chExpectedText), "1000ms Counter from Core0 is incrementing"); 
  TestStepAddActionExpected( chActionText, chExpectedText );
  A_DBGR_VariableRead( "Task_Core0_1000ms_Count", taskvalue);
  E_DBGR_VariableCheck("Task_Core0_1000ms_Count", taskvalue, Greater);
  
  //Check Core1 is running
  snprintf( chActionText, elCount(chActionText), "Check 1000ms Task Counter from Core1 "); 
  snprintf( chExpectedText, elCount(chExpectedText), "1000ms Counter from Core1 is incrementing"); 
  TestStepAddActionExpected( chActionText, chExpectedText );
  A_DBGR_VariableRead( "Task_Core1_1000ms_Count", taskvalue);
  E_DBGR_VariableCheck("Task_Core1_1000ms_Count", taskvalue, Greater);
  
  //Check Core2 is running
  snprintf( chActionText, elCount(chActionText), "Check 1000ms Task Counter from Core2 "); 
  snprintf( chExpectedText, elCount(chExpectedText), "1000ms Counter from Core2 is incrementing"); 
  TestStepAddActionExpected( chActionText, chExpectedText );
  A_DBGR_VariableRead( "Task_Core2_1000ms_Count", taskvalue);
  E_DBGR_VariableCheck("Task_Core2_1000ms_Count", taskvalue, Greater);
    
  //Check Core3 is running
  snprintf( chActionText, elCount(chActionText), "Check 1000ms Task Counter from Core3 "); 
  snprintf( chExpectedText, elCount(chExpectedText), "1000ms Counter from Core3 is incrementing"); 
  TestStepAddActionExpected( chActionText, chExpectedText );
  A_DBGR_VariableRead( "Task_Core3_1000ms_Count", taskvalue);
  E_DBGR_VariableCheck("Task_Core3_1000ms_Count", taskvalue, Greater);
    
  //Check Core4 is running
  snprintf( chActionText, elCount(chActionText), "Check 1000ms Task Counter from Core4 "); 
  snprintf( chExpectedText, elCount(chExpectedText), "1000ms Counter from Core4 is incrementing"); 
  TestStepAddActionExpected( chActionText, chExpectedText );
  A_DBGR_VariableRead( "Task_Core4_1000ms_Count", taskvalue);
  E_DBGR_VariableCheck("Task_Core4_1000ms_Count", taskvalue, Greater);
    
  //Check Core5 is running
  snprintf( chActionText, elCount(chActionText), "Check 1000ms Task Counter from Core5 "); 
  snprintf( chExpectedText, elCount(chExpectedText), "1000ms Counter from Core5 is incrementing"); 
  TestStepAddActionExpected( chActionText, chExpectedText );
  A_DBGR_VariableRead( "Task_Core5_1000ms_Count", taskvalue);
  E_DBGR_VariableCheck("Task_Core5_1000ms_Count", taskvalue, Greater);
  
  /*******************************************************************************************************************************************************/    
    // Test Step 3: set SetCore2Flag=1 to Enable funtion Os_Test_EnblDsblHWIO_Nest_Interrupts_core()
  /*******************************************************************************************************************************************************/

  snprintf( chActionText, elCount(chActionText), "set SetCore2Flag=1 to Enable funtion Os_Test_EnblDsblHWIO_Nest_Interrupts_core() "); 
  snprintf( chExpectedText, elCount(chExpectedText), "Verify SetCore2Flag=1 to Enable funtion Os_Test_EnblDsblHWIO_Nest_Interrupts_core() "); 
  TestStepAddActionExpected( chActionText, chExpectedText );
//  A_DBGR_R();
//  A_DBGR_Go();
  A_DBGR_VariableSet("SetCore2Flag", "1");
  A_DBGR_VariableSet("interruptWait", "0");
  //A_DBGR_VariableSet("interruptWait", "0"); 
  //A_DBGR_Go(); 
  
  /***************************************************************************************************************/    
        // Test Step 4 check the task counters for  the Core2 stopped.
  /***************************************************************************************************************/

  //Check All tasks of Core2 are stopped
  snprintf( chActionText, elCount(chActionText), "Check 2pt5ms Task Counter from Core2 "); 
  snprintf( chExpectedText, elCount(chExpectedText), "2pt5ms Counter from Core2 is stop incrementing"); 
  //TestStepAddActionExpected( chActionText, chExpectedText );
  A_DBGR_VariableRead( "Task_Core2_2pt5ms_Count", taskvalue);
  E_DBGR_VariableCheck("Task_Core2_2pt5ms_Count", taskvalue, Equal);
  
  snprintf( chActionText, elCount(chActionText), "Check 5ms Task Counter from Core2 "); 
  snprintf( chExpectedText, elCount(chExpectedText), "5ms Counter from Core2 is stop incrementing"); 
  TestStepAddActionExpected( chActionText, chExpectedText );
  A_DBGR_VariableRead( "Task_Core2_5ms_Count", taskvalue);
  E_DBGR_VariableCheck("Task_Core2_5ms_Count", taskvalue, Equal);
  
  snprintf( chActionText, elCount(chActionText), "Check 10ms Task Counter from Core2 "); 
  snprintf( chExpectedText, elCount(chExpectedText), "10ms Counter from Core2 is stop incrementing"); 
  TestStepAddActionExpected( chActionText, chExpectedText );
  A_DBGR_VariableRead( "Task_Core2_10ms_Count", taskvalue);
  E_DBGR_VariableCheck("Task_Core2_10ms_Count", taskvalue, Equal);  
  
  snprintf( chActionText, elCount(chActionText), "Check 25ms Task Counter from Core2 "); 
  snprintf( chExpectedText, elCount(chExpectedText), "25ms Counter from Core2 is stop incrementing"); 
  TestStepAddActionExpected( chActionText, chExpectedText );
  A_DBGR_VariableRead( "Task_Core2_25ms_Count", taskvalue);
  E_DBGR_VariableCheck("Task_Core2_25ms_Count", taskvalue, Equal);  

  snprintf( chActionText, elCount(chActionText), "Check 50ms Task Counter from Core2 "); 
  snprintf( chExpectedText, elCount(chExpectedText), "50ms Counter from Core2 is stop incrementing"); 
  TestStepAddActionExpected( chActionText, chExpectedText );
  A_DBGR_VariableRead( "Task_Core2_50ms_Count", taskvalue);
  E_DBGR_VariableCheck("Task_Core2_50ms_Count", taskvalue, Equal);
  
  snprintf( chActionText, elCount(chActionText), "Check 250ms Task Counter from Core2 "); 
  snprintf( chExpectedText, elCount(chExpectedText), "250ms Counter from Core2 is stop incrementing"); 
  TestStepAddActionExpected( chActionText, chExpectedText );
  A_DBGR_VariableRead( "Task_Core2_250ms_Count", taskvalue);
  E_DBGR_VariableCheck("Task_Core2_250ms_Count", taskvalue, Equal);
  
  snprintf( chActionText, elCount(chActionText), "Check 100ms Task Counter from Core2 "); 
  snprintf( chExpectedText, elCount(chExpectedText), "100ms Counter from Core2 is stop incrementing"); 
  TestStepAddActionExpected( chActionText, chExpectedText );
  A_DBGR_VariableRead( "Task_Core2_100ms_Count", taskvalue);
  E_DBGR_VariableCheck("Task_Core2_100ms_Count", taskvalue, Equal); 

  snprintf( chActionText, elCount(chActionText), "Check 500ms Task Counter from Core2 "); 
  snprintf( chExpectedText, elCount(chExpectedText), "500ms Counter from Core2 is stop incrementing"); 
  TestStepAddActionExpected( chActionText, chExpectedText );
  A_DBGR_VariableRead( "Task_Core2_500ms_Count", taskvalue);
  E_DBGR_VariableCheck("Task_Core2_500ms_Count", taskvalue, Equal);
  
  snprintf( chActionText, elCount(chActionText), "Check 1000ms Task Counter from Core2 "); 
  snprintf( chExpectedText, elCount(chExpectedText), "1000ms Counter from Core2 is stop incrementing"); 
  TestStepAddActionExpected( chActionText, chExpectedText );
  A_DBGR_VariableRead( "Task_Core2_1000ms_Count", taskvalue);
  E_DBGR_VariableCheck("Task_Core2_1000ms_Count", taskvalue, Equal);
  
   //Check Core0 is running
  snprintf( chActionText, elCount(chActionText), "Check 1000ms Task Counter from Core0 "); 
  snprintf( chExpectedText, elCount(chExpectedText), "1000ms Counter from Core0 is incrementing"); 
  TestStepAddActionExpected( chActionText, chExpectedText );
  A_DBGR_VariableRead( "Task_Core0_1000ms_Count", taskvalue);
  E_DBGR_VariableCheck("Task_Core0_1000ms_Count", taskvalue, Greater);
  
  //Check Core1 is running
  snprintf( chActionText, elCount(chActionText), "Check 1000ms Task Counter from Core1 "); 
  snprintf( chExpectedText, elCount(chExpectedText), "1000ms Counter from Core1 is incrementing"); 
  TestStepAddActionExpected( chActionText, chExpectedText );
  A_DBGR_VariableRead( "Task_Core1_1000ms_Count", taskvalue);
  E_DBGR_VariableCheck("Task_Core1_1000ms_Count", taskvalue, Greater);
    
  //Check Core3 is running
  snprintf( chActionText, elCount(chActionText), "Check 1000ms Task Counter from Core3 "); 
  snprintf( chExpectedText, elCount(chExpectedText), "1000ms Counter from Core3 is incrementing"); 
  TestStepAddActionExpected( chActionText, chExpectedText );
  A_DBGR_VariableRead( "Task_Core3_1000ms_Count", taskvalue);
  E_DBGR_VariableCheck("Task_Core3_1000ms_Count", taskvalue, Greater);
    
  //Check Core4 is running
  snprintf( chActionText, elCount(chActionText), "Check 1000ms Task Counter from Core4 "); 
  snprintf( chExpectedText, elCount(chExpectedText), "1000ms Counter from Core4 is incrementing"); 
  TestStepAddActionExpected( chActionText, chExpectedText );
  A_DBGR_VariableRead( "Task_Core4_1000ms_Count", taskvalue);
  E_DBGR_VariableCheck("Task_Core4_1000ms_Count", taskvalue, Greater);
    
  //Check Core5 is running
  snprintf( chActionText, elCount(chActionText), "Check 1000ms Task Counter from Core5 "); 
  snprintf( chExpectedText, elCount(chExpectedText), "1000ms Counter from Core5 is incrementing"); 
  TestStepAddActionExpected( chActionText, chExpectedText );
  A_DBGR_VariableRead( "Task_Core5_1000ms_Count", taskvalue);
  E_DBGR_VariableCheck("Task_Core5_1000ms_Count", taskvalue, Greater);
  
  /*******************************************************************************************************************************************************/    
    // Test Step 5: set SetCore2Flag=0 to Disable funtion Os_Test_EnblDsblHWIO_Nest_Interrupts_core()
  /*******************************************************************************************************************************************************/
  snprintf( chActionText, elCount(chActionText), "set SetCore2Flag=0 to Disable funtion Os_Test_EnblDsblHWIO_Nest_Interrupts_core() "); 
  snprintf( chExpectedText, elCount(chExpectedText), "Verify SetCore2Flag=0 to Disable funtion Os_Test_EnblDsblHWIO_Nest_Interrupts_core() "); 
  TestStepAddActionExpected( chActionText, chExpectedText );
  
  A_DBGR_VariableSet("interruptWait", "1"); 
  A_DBGR_VariableSet("SetCore2Flag", "0"); 
  A_DBGR_VariableSet("interruptWait", "0"); 
  
}

/***************************************************************************************************
----------------------------------------------------------------------------------------------------
Test case name:  TC_L30SW_QT_36649667: test_case_to_verify_the_functionality_of_interface_DsblHWIO_Interrupts()_to_prohibits_all_interrupts_from_pre-empting_the_core3_task_and_interrupt__for_CPU3
----------------------------------------------------------------------------------------------------
Description:  test_case_to_verify_the_functionality_of_interface_DsblHWIO_Interrupts()_to_prohibits_all_interrupts_from_pre-empting_the_core3_task_and_interrupt__for_CPU3

***************************************************************************************************/
testcase test_case_to_verify_the_functionality_of_interface_DsblHWIO_Interrupt_to_prohibits_all_interrupts_the_core3()
{
  /***************************************************************************************************************/    
                                                // Variable Definition
  /***************************************************************************************************************/ 
  
  long taskvalue;
  
  /***************************************************************************************************************/    
                                               // Local Values
  /***************************************************************************************************************/ 
  

  
  /***************************************************************************************************************/    
                                              // Test Case Info
  /***************************************************************************************************************/
  setWriteDbgLevel(DebugOff);
  snprintf( chTestTitle, elCount(chTestTitle), "test_case_to_verify_the_functionality_of_interface_DsblHWIO_Interrupt_to_prohibits_all_interrupts_from_pre_empting_the_core3_task_and_interrupt__for_CPU3" );
  snprintf( chTestDescription, elCount(chTestDescription), "Purpose: test_case_to_verify_the_functionality_of_interface_DsblHWIO_Interrupt_to_prohibits_all_interrupts_from_pre_empting_the_core3_task_and_interrupt__for_CPU3.");
  TestCaseAddInfo( chTestTitle, "TC_L30SW_QT_36649667", chTestDescription );

  /***************************************************************************************************************/    
                                              // Start of Test Case
  /***************************************************************************************************************/
  
  /***************************************************************************************************************/    
                                              // Test Step 1 PRECONDITIONS
  /***************************************************************************************************************/
  
  snprintf( chActionText, elCount(chActionText), "Flash the Software and ECU is running"); 
  snprintf( chExpectedText, elCount(chExpectedText), "ECU should be in running state"); 
  //TestStepAddActionExpected( chActionText, chExpectedText );

  A_DBGR_BreakpointDeleteAll();
  A_DBGR_RnGo();
  E_DBGR_CheckState(T32_State_Running);
  

   /***************************************************************************************************************/    
            // Test Step 2: Check all cores are in running state                                   
  /***************************************************************************************************************/
  
  //Check Core0 is running
  snprintf( chActionText, elCount(chActionText), "Check 1000ms Task Counter from Core0 "); 
  snprintf( chExpectedText, elCount(chExpectedText), "1000ms Counter from Core0 is incrementing"); 
  TestStepAddActionExpected( chActionText, chExpectedText );
  A_DBGR_VariableRead( "Task_Core0_1000ms_Count", taskvalue);
  E_DBGR_VariableCheck("Task_Core0_1000ms_Count", taskvalue, Greater);
  
  //Check Core1 is running
  snprintf( chActionText, elCount(chActionText), "Check 1000ms Task Counter from Core1 "); 
  snprintf( chExpectedText, elCount(chExpectedText), "1000ms Counter from Core1 is incrementing"); 
  TestStepAddActionExpected( chActionText, chExpectedText );
  A_DBGR_VariableRead( "Task_Core1_1000ms_Count", taskvalue);
  E_DBGR_VariableCheck("Task_Core1_1000ms_Count", taskvalue, Greater);
  
  //Check Core2 is running
  snprintf( chActionText, elCount(chActionText), "Check 1000ms Task Counter from Core2 "); 
  snprintf( chExpectedText, elCount(chExpectedText), "1000ms Counter from Core2 is incrementing"); 
  TestStepAddActionExpected( chActionText, chExpectedText );
  A_DBGR_VariableRead( "Task_Core2_1000ms_Count", taskvalue);
  E_DBGR_VariableCheck("Task_Core2_1000ms_Count", taskvalue, Greater);
    
  //Check Core3 is running
  snprintf( chActionText, elCount(chActionText), "Check 1000ms Task Counter from Core3 "); 
  snprintf( chExpectedText, elCount(chExpectedText), "1000ms Counter from Core3 is incrementing"); 
  TestStepAddActionExpected( chActionText, chExpectedText );
  A_DBGR_VariableRead( "Task_Core3_1000ms_Count", taskvalue);
  E_DBGR_VariableCheck("Task_Core3_1000ms_Count", taskvalue, Greater);
    
  //Check Core4 is running
  snprintf( chActionText, elCount(chActionText), "Check 1000ms Task Counter from Core4 "); 
  snprintf( chExpectedText, elCount(chExpectedText), "1000ms Counter from Core4 is incrementing"); 
  TestStepAddActionExpected( chActionText, chExpectedText );
  A_DBGR_VariableRead( "Task_Core4_1000ms_Count", taskvalue);
  E_DBGR_VariableCheck("Task_Core4_1000ms_Count", taskvalue, Greater);
    
  //Check Core5 is running
  snprintf( chActionText, elCount(chActionText), "Check 1000ms Task Counter from Core5 "); 
  snprintf( chExpectedText, elCount(chExpectedText), "1000ms Counter from Core5 is incrementing"); 
  TestStepAddActionExpected( chActionText, chExpectedText );
  A_DBGR_VariableRead( "Task_Core5_1000ms_Count", taskvalue);
  E_DBGR_VariableCheck("Task_Core5_1000ms_Count", taskvalue, Greater);
  
  /*******************************************************************************************************************************************************/    
    // Test Step 3: set SetCore3Flag=1 to Enable funtion Os_Test_EnblDsblHWIO_Nest_Interrupts_core()
  /*******************************************************************************************************************************************************/

  snprintf( chActionText, elCount(chActionText), "set SetCore3Flag=1 to Enable funtion Os_Test_EnblDsblHWIO_Nest_Interrupts_core() "); 
  snprintf( chExpectedText, elCount(chExpectedText), "Verify SetCore3Flag=1 to Enable funtion Os_Test_EnblDsblHWIO_Nest_Interrupts_core() "); 
  TestStepAddActionExpected( chActionText, chExpectedText );
//  A_DBGR_R();
//  A_DBGR_Go();
  A_DBGR_VariableSet("SetCore3Flag", "1");
  A_DBGR_VariableSet("interruptWait", "0");
  //A_DBGR_VariableSet("interruptWait", "0"); 
  //A_DBGR_Go(); 
  
   
  /***************************************************************************************************************/    
        // Test Step 4 check the task counters for  the Core3 stopped.
  /***************************************************************************************************************/

  //Check All tasks of Core3 are stopped
  snprintf( chActionText, elCount(chActionText), "Check 2pt5ms Task Counter from Core3 "); 
  snprintf( chExpectedText, elCount(chExpectedText), "2pt5ms Counter from Core3 is stop incrementing"); 
  //TestStepAddActionExpected( chActionText, chExpectedText );
  A_DBGR_VariableRead( "Task_Core3_2pt5ms_Count", taskvalue);
  E_DBGR_VariableCheck("Task_Core3_2pt5ms_Count", taskvalue, Equal);
  
  snprintf( chActionText, elCount(chActionText), "Check 5ms Task Counter from Core3 "); 
  snprintf( chExpectedText, elCount(chExpectedText), "5ms Counter from Core3 is stop incrementing"); 
  TestStepAddActionExpected( chActionText, chExpectedText );
  A_DBGR_VariableRead( "Task_Core3_5ms_Count", taskvalue);
  E_DBGR_VariableCheck("Task_Core3_5ms_Count", taskvalue, Equal);
  
  snprintf( chActionText, elCount(chActionText), "Check 10ms Task Counter from Core3 "); 
  snprintf( chExpectedText, elCount(chExpectedText), "10ms Counter from Core3 is stop incrementing"); 
  TestStepAddActionExpected( chActionText, chExpectedText );
  A_DBGR_VariableRead( "Task_Core3_10ms_Count", taskvalue);
  E_DBGR_VariableCheck("Task_Core3_10ms_Count", taskvalue, Equal);  
  
  snprintf( chActionText, elCount(chActionText), "Check 25ms Task Counter from Core3 "); 
  snprintf( chExpectedText, elCount(chExpectedText), "25ms Counter from Core3 is stop incrementing"); 
  TestStepAddActionExpected( chActionText, chExpectedText );
  A_DBGR_VariableRead( "Task_Core3_25ms_Count", taskvalue);
  E_DBGR_VariableCheck("Task_Core3_25ms_Count", taskvalue, Equal);  

  snprintf( chActionText, elCount(chActionText), "Check 50ms Task Counter from Core3 "); 
  snprintf( chExpectedText, elCount(chExpectedText), "50ms Counter from Core3 is stop incrementing"); 
  TestStepAddActionExpected( chActionText, chExpectedText );
  A_DBGR_VariableRead( "Task_Core3_50ms_Count", taskvalue);
  E_DBGR_VariableCheck("Task_Core3_50ms_Count", taskvalue, Equal);
  
  snprintf( chActionText, elCount(chActionText), "Check 250ms Task Counter from Core3 "); 
  snprintf( chExpectedText, elCount(chExpectedText), "250ms Counter from Core3 is stop incrementing"); 
  TestStepAddActionExpected( chActionText, chExpectedText );
  A_DBGR_VariableRead( "Task_Core3_250ms_Count", taskvalue);
  E_DBGR_VariableCheck("Task_Core3_250ms_Count", taskvalue, Equal);
  
  snprintf( chActionText, elCount(chActionText), "Check 100ms Task Counter from Core3 "); 
  snprintf( chExpectedText, elCount(chExpectedText), "100ms Counter from Core3 is stop incrementing"); 
  TestStepAddActionExpected( chActionText, chExpectedText );
  A_DBGR_VariableRead( "Task_Core3_100ms_Count", taskvalue);
  E_DBGR_VariableCheck("Task_Core3_100ms_Count", taskvalue, Equal); 

  snprintf( chActionText, elCount(chActionText), "Check 500ms Task Counter from Core3 "); 
  snprintf( chExpectedText, elCount(chExpectedText), "500ms Counter from Core3 is stop incrementing"); 
  TestStepAddActionExpected( chActionText, chExpectedText );
  A_DBGR_VariableRead( "Task_Core3_500ms_Count", taskvalue);
  E_DBGR_VariableCheck("Task_Core3_500ms_Count", taskvalue, Equal);
  
  snprintf( chActionText, elCount(chActionText), "Check 1000ms Task Counter from Core3 "); 
  snprintf( chExpectedText, elCount(chExpectedText), "1000ms Counter from Core3 is stop incrementing"); 
  TestStepAddActionExpected( chActionText, chExpectedText );
  A_DBGR_VariableRead( "Task_Core3_1000ms_Count", taskvalue);
  E_DBGR_VariableCheck("Task_Core3_1000ms_Count", taskvalue, Equal);
  
   //Check Core0 is running
  snprintf( chActionText, elCount(chActionText), "Check 1000ms Task Counter from Core0 "); 
  snprintf( chExpectedText, elCount(chExpectedText), "1000ms Counter from Core0 is incrementing"); 
  TestStepAddActionExpected( chActionText, chExpectedText );
  A_DBGR_VariableRead( "Task_Core0_1000ms_Count", taskvalue);
  E_DBGR_VariableCheck("Task_Core0_1000ms_Count", taskvalue, Greater);
  
  //Check Core1 is running
  snprintf( chActionText, elCount(chActionText), "Check 1000ms Task Counter from Core1 "); 
  snprintf( chExpectedText, elCount(chExpectedText), "1000ms Counter from Core1 is incrementing"); 
  TestStepAddActionExpected( chActionText, chExpectedText );
  A_DBGR_VariableRead( "Task_Core1_1000ms_Count", taskvalue);
  E_DBGR_VariableCheck("Task_Core1_1000ms_Count", taskvalue, Greater);
    
  //Check Core2 is running
  snprintf( chActionText, elCount(chActionText), "Check 1000ms Task Counter from Core2 "); 
  snprintf( chExpectedText, elCount(chExpectedText), "1000ms Counter from Core2 is incrementing"); 
  TestStepAddActionExpected( chActionText, chExpectedText );
  A_DBGR_VariableRead( "Task_Core2_1000ms_Count", taskvalue);
  E_DBGR_VariableCheck("Task_Core2_1000ms_Count", taskvalue, Greater);
    
  //Check Core4 is running
  snprintf( chActionText, elCount(chActionText), "Check 1000ms Task Counter from Core4 "); 
  snprintf( chExpectedText, elCount(chExpectedText), "1000ms Counter from Core4 is incrementing"); 
  TestStepAddActionExpected( chActionText, chExpectedText );
  A_DBGR_VariableRead( "Task_Core4_1000ms_Count", taskvalue);
  E_DBGR_VariableCheck("Task_Core4_1000ms_Count", taskvalue, Greater);
    
  //Check Core5 is running
  snprintf( chActionText, elCount(chActionText), "Check 1000ms Task Counter from Core5 "); 
  snprintf( chExpectedText, elCount(chExpectedText), "1000ms Counter from Core5 is incrementing"); 
  TestStepAddActionExpected( chActionText, chExpectedText );
  A_DBGR_VariableRead( "Task_Core5_1000ms_Count", taskvalue);
  E_DBGR_VariableCheck("Task_Core5_1000ms_Count", taskvalue, Greater);
  
  /*******************************************************************************************************************************************************/    
    // Test Step 5: set SetCore3Flag=0 to Disable funtion Os_Test_EnblDsblHWIO_Nest_Interrupts_core()
  /*******************************************************************************************************************************************************/
  snprintf( chActionText, elCount(chActionText), "set SetCore3Flag=0 to Disable funtion Os_Test_EnblDsblHWIO_Nest_Interrupts_core() "); 
  snprintf( chExpectedText, elCount(chExpectedText), "Verify SetCore3Flag=0 to Disable funtion Os_Test_EnblDsblHWIO_Nest_Interrupts_core() "); 
  TestStepAddActionExpected( chActionText, chExpectedText );
  
  A_DBGR_VariableSet("interruptWait", "1"); 
  A_DBGR_VariableSet("SetCore3Flag", "0"); 
  A_DBGR_VariableSet("interruptWait", "0"); 
  
}

/***************************************************************************************************
----------------------------------------------------------------------------------------------------
Test case name:  TC_L30SW_QT_36649670: test_case_to_verify_the_functionality_of_interface_DsblHWIO_Interrupts()_to_prohibits_all_interrupts_from_pre-empting_the_core4_task_and_interrupt__for_CPU4
----------------------------------------------------------------------------------------------------
Description:  test_case_to_verify_the_functionality_of_interface_DsblHWIO_Interrupts()_to_prohibits_all_interrupts_from_pre-empting_the_core4_task_and_interrupt__for_CPU4

***************************************************************************************************/
testcase test_case_to_verify_the_functionality_of_interface_DsblHWIO_Interrupt_to_prohibits_all_interrupts_the_core4()
{
  /***************************************************************************************************************/    
                                                // Variable Definition
  /***************************************************************************************************************/ 
  
  long taskvalue;
  
  /***************************************************************************************************************/    
                                               // Local Values
  /***************************************************************************************************************/ 
  

  
  /***************************************************************************************************************/    
                                              // Test Case Info
  /***************************************************************************************************************/
  setWriteDbgLevel(DebugOff);
  snprintf( chTestTitle, elCount(chTestTitle), "test_case_to_verify_the_functionality_of_interface_DsblHWIO_Interrupt_to_prohibits_all_interrupts_from_pre_empting_the_core4_task_and_interrupt__for_CPU4" );
  snprintf( chTestDescription, elCount(chTestDescription), "Purpose: test_case_to_verify_the_functionality_of_interface_DsblHWIO_Interrupt_to_prohibits_all_interrupts_from_pre_empting_the_core4_task_and_interrupt__for_CPU4.");
  TestCaseAddInfo( chTestTitle, "TC_L30SW_QT_36649670", chTestDescription );

  /***************************************************************************************************************/    
                                              // Start of Test Case
  /***************************************************************************************************************/
  
  /***************************************************************************************************************/    
                                              // Test Step 1 PRECONDITIONS
  /***************************************************************************************************************/
  
  snprintf( chActionText, elCount(chActionText), "Flash the Software and ECU is running"); 
  snprintf( chExpectedText, elCount(chExpectedText), "ECU should be in running state"); 
  TestStepAddActionExpected( chActionText, chExpectedText );

  A_DBGR_BreakpointDeleteAll();
  A_DBGR_RnGo();
  E_DBGR_CheckState(T32_State_Running);
  

   /***************************************************************************************************************/    
            // Test Step 2: Check all cores are in running state                                   
  /***************************************************************************************************************/
  
  //Check Core0 is running
  snprintf( chActionText, elCount(chActionText), "Check 1000ms Task Counter from Core0 "); 
  snprintf( chExpectedText, elCount(chExpectedText), "1000ms Counter from Core0 is incrementing"); 
  TestStepAddActionExpected( chActionText, chExpectedText );
  A_DBGR_VariableRead( "Task_Core0_1000ms_Count", taskvalue);
  E_DBGR_VariableCheck("Task_Core0_1000ms_Count", taskvalue, Greater);
  
  //Check Core1 is running
  snprintf( chActionText, elCount(chActionText), "Check 1000ms Task Counter from Core1 "); 
  snprintf( chExpectedText, elCount(chExpectedText), "1000ms Counter from Core1 is incrementing"); 
  TestStepAddActionExpected( chActionText, chExpectedText );
  A_DBGR_VariableRead( "Task_Core1_1000ms_Count", taskvalue);
  E_DBGR_VariableCheck("Task_Core1_1000ms_Count", taskvalue, Greater);
  
  //Check Core2 is running
  snprintf( chActionText, elCount(chActionText), "Check 1000ms Task Counter from Core2 "); 
  snprintf( chExpectedText, elCount(chExpectedText), "1000ms Counter from Core2 is incrementing"); 
  TestStepAddActionExpected( chActionText, chExpectedText );
  A_DBGR_VariableRead( "Task_Core2_1000ms_Count", taskvalue);
  E_DBGR_VariableCheck("Task_Core2_1000ms_Count", taskvalue, Greater);
    
  //Check Core3 is running
  snprintf( chActionText, elCount(chActionText), "Check 1000ms Task Counter from Core3 "); 
  snprintf( chExpectedText, elCount(chExpectedText), "1000ms Counter from Core3 is incrementing"); 
  TestStepAddActionExpected( chActionText, chExpectedText );
  A_DBGR_VariableRead( "Task_Core3_1000ms_Count", taskvalue);
  E_DBGR_VariableCheck("Task_Core3_1000ms_Count", taskvalue, Greater);
    
  //Check Core4 is running
  snprintf( chActionText, elCount(chActionText), "Check 1000ms Task Counter from Core4 "); 
  snprintf( chExpectedText, elCount(chExpectedText), "1000ms Counter from Core4 is incrementing"); 
  TestStepAddActionExpected( chActionText, chExpectedText );
  A_DBGR_VariableRead( "Task_Core4_1000ms_Count", taskvalue);
  E_DBGR_VariableCheck("Task_Core4_1000ms_Count", taskvalue, Greater);
    
  //Check Core5 is running
  snprintf( chActionText, elCount(chActionText), "Check 1000ms Task Counter from Core5 "); 
  snprintf( chExpectedText, elCount(chExpectedText), "1000ms Counter from Core5 is incrementing"); 
  TestStepAddActionExpected( chActionText, chExpectedText );
  A_DBGR_VariableRead( "Task_Core5_1000ms_Count", taskvalue);
  E_DBGR_VariableCheck("Task_Core5_1000ms_Count", taskvalue, Greater);
  
  /*******************************************************************************************************************************************************/    
    // Test Step 3: set SetCore4Flag=1 to Enable funtion Os_Test_EnblDsblHWIO_Nest_Interrupts_core()
  /*******************************************************************************************************************************************************/

  snprintf( chActionText, elCount(chActionText), "set SetCore4Flag=1 to Enable funtion Os_Test_EnblDsblHWIO_Nest_Interrupts_core() "); 
  snprintf( chExpectedText, elCount(chExpectedText), "Verify SetCore4Flag=1 to Enable funtion Os_Test_EnblDsblHWIO_Nest_Interrupts_core() "); 
  TestStepAddActionExpected( chActionText, chExpectedText );
//  A_DBGR_R();
//  A_DBGR_Go();
  A_DBGR_VariableSet("SetCore4Flag", "1");
  A_DBGR_VariableSet("interruptWait", "0");
  //A_DBGR_VariableSet("interruptWait", "0"); 
  //A_DBGR_Go(); 
  
   
  /***************************************************************************************************************/    
        // Test Step 4 check the task counters for  the Core4 stopped.
  /***************************************************************************************************************/

  //Check All tasks of Core4 are stopped
  
//  snprintf( chActionText, elCount(chActionText), "Check 2pt5ms Task Counter from Core4 "); 
//  snprintf( chExpectedText, elCount(chExpectedText), "2pt5ms Counter from Core4 is stop incrementing"); 
//  TestStepAddActionExpected( chActionText, chExpectedText );
//  A_DBGR_VariableRead( "Task_Core4_2pt5ms_Count", taskvalue);
//  E_DBGR_VariableCheck("Task_Core4_2pt5ms_Count", taskvalue, Equal);
  
//  snprintf( chActionText, elCount(chActionText), "Check 5ms Task Counter from Core4 "); 
//  snprintf( chExpectedText, elCount(chExpectedText), "5ms Counter from Core4 is stop incrementing"); 
//  TestStepAddActionExpected( chActionText, chExpectedText );
//  A_DBGR_VariableRead( "Task_Core4_5ms_Count", taskvalue);
//  E_DBGR_VariableCheck("Task_Core4_5ms_Count", taskvalue, Equal);
  
//  snprintf( chActionText, elCount(chActionText), "Check 10ms Task Counter from Core4 "); 
//  snprintf( chExpectedText, elCount(chExpectedText), "10ms Counter from Core4 is stop incrementing"); 
//  TestStepAddActionExpected( chActionText, chExpectedText );
//  A_DBGR_VariableRead( "Task_Core4_10ms_Count", taskvalue);
//  E_DBGR_VariableCheck("Task_Core4_10ms_Count", taskvalue, Equal);  
  
//  snprintf( chActionText, elCount(chActionText), "Check 25ms Task Counter from Core4 "); 
//  snprintf( chExpectedText, elCount(chExpectedText), "25ms Counter from Core4 is stop incrementing"); 
//  TestStepAddActionExpected( chActionText, chExpectedText );
//  A_DBGR_VariableRead( "Task_Core4_25ms_Count", taskvalue);
//  E_DBGR_VariableCheck("Task_Core4_25ms_Count", taskvalue, Equal);  

//  snprintf( chActionText, elCount(chActionText), "Check 50ms Task Counter from Core4 "); 
//  snprintf( chExpectedText, elCount(chExpectedText), "50ms Counter from Core4 is stop incrementing"); 
//  TestStepAddActionExpected( chActionText, chExpectedText );
//  A_DBGR_VariableRead( "Task_Core4_50ms_Count", taskvalue);
//  E_DBGR_VariableCheck("Task_Core4_50ms_Count", taskvalue, Equal);
  
//  snprintf( chActionText, elCount(chActionText), "Check 250ms Task Counter from Core4 "); 
//  snprintf( chExpectedText, elCount(chExpectedText), "250ms Counter from Core4 is stop incrementing"); 
//  TestStepAddActionExpected( chActionText, chExpectedText );
//  A_DBGR_VariableRead( "Task_Core4_250ms_Count", taskvalue);
//  E_DBGR_VariableCheck("Task_Core4_250ms_Count", taskvalue, Equal);
  
//  snprintf( chActionText, elCount(chActionText), "Check 100ms Task Counter from Core4 "); 
//  snprintf( chExpectedText, elCount(chExpectedText), "100ms Counter from Core4 is stop incrementing"); 
//  TestStepAddActionExpected( chActionText, chExpectedText );
//  A_DBGR_VariableRead( "Task_Core4_100ms_Count", taskvalue);
//  E_DBGR_VariableCheck("Task_Core4_100ms_Count", taskvalue, Equal); 

//  snprintf( chActionText, elCount(chActionText), "Check 500ms Task Counter from Core4 "); 
//  snprintf( chExpectedText, elCount(chExpectedText), "500ms Counter from Core4 is stop incrementing"); 
//  TestStepAddActionExpected( chActionText, chExpectedText );
//  A_DBGR_VariableRead( "Task_Core4_500ms_Count", taskvalue);
//  E_DBGR_VariableCheck("Task_Core4_500ms_Count", taskvalue, Equal);
  
  snprintf( chActionText, elCount(chActionText), "Check 1000ms Task Counter from Core4 "); 
  snprintf( chExpectedText, elCount(chExpectedText), "1000ms Counter from Core4 is stop incrementing"); 
  TestStepAddActionExpected( chActionText, chExpectedText );
  A_DBGR_VariableRead( "Task_Core4_1000ms_Count", taskvalue);
  E_DBGR_VariableCheck("Task_Core4_1000ms_Count", taskvalue, Equal);
  
   //Check Core0 is running
  snprintf( chActionText, elCount(chActionText), "Check 1000ms Task Counter from Core0 "); 
  snprintf( chExpectedText, elCount(chExpectedText), "1000ms Counter from Core0 is incrementing"); 
  TestStepAddActionExpected( chActionText, chExpectedText );
  A_DBGR_VariableRead( "Task_Core0_1000ms_Count", taskvalue);
  E_DBGR_VariableCheck("Task_Core0_1000ms_Count", taskvalue, Greater);
  
  //Check Core1 is running
  snprintf( chActionText, elCount(chActionText), "Check 1000ms Task Counter from Core1 "); 
  snprintf( chExpectedText, elCount(chExpectedText), "1000ms Counter from Core1 is incrementing"); 
  TestStepAddActionExpected( chActionText, chExpectedText );
  A_DBGR_VariableRead( "Task_Core1_1000ms_Count", taskvalue);
  E_DBGR_VariableCheck("Task_Core1_1000ms_Count", taskvalue, Greater);
    
  //Check Core2 is running
  snprintf( chActionText, elCount(chActionText), "Check 1000ms Task Counter from Core2 "); 
  snprintf( chExpectedText, elCount(chExpectedText), "1000ms Counter from Core2 is incrementing"); 
  TestStepAddActionExpected( chActionText, chExpectedText );
  A_DBGR_VariableRead( "Task_Core2_1000ms_Count", taskvalue);
  E_DBGR_VariableCheck("Task_Core2_1000ms_Count", taskvalue, Greater);
    
  //Check Core3 is running
  snprintf( chActionText, elCount(chActionText), "Check 1000ms Task Counter from Core3 "); 
  snprintf( chExpectedText, elCount(chExpectedText), "1000ms Counter from Core3 is incrementing"); 
  TestStepAddActionExpected( chActionText, chExpectedText );
  A_DBGR_VariableRead( "Task_Core3_1000ms_Count", taskvalue);
  E_DBGR_VariableCheck("Task_Core3_1000ms_Count", taskvalue, Greater);
    
  //Check Core5 is running
  snprintf( chActionText, elCount(chActionText), "Check 1000ms Task Counter from Core5 "); 
  snprintf( chExpectedText, elCount(chExpectedText), "1000ms Counter from Core5 is incrementing"); 
  TestStepAddActionExpected( chActionText, chExpectedText );
  A_DBGR_VariableRead( "Task_Core5_1000ms_Count", taskvalue);
  E_DBGR_VariableCheck("Task_Core5_1000ms_Count", taskvalue, Greater);
  
  /*******************************************************************************************************************************************************/    
    // Test Step 5: set SetCore4Flag=0 to Disable funtion Os_Test_EnblDsblHWIO_Nest_Interrupts_core()
  /*******************************************************************************************************************************************************/
  snprintf( chActionText, elCount(chActionText), "set SetCore4Flag=0 to Disable funtion Os_Test_EnblDsblHWIO_Nest_Interrupts_core() "); 
  snprintf( chExpectedText, elCount(chExpectedText), "Verify SetCore4Flag=0 to Disable funtion Os_Test_EnblDsblHWIO_Nest_Interrupts_core() "); 
  TestStepAddActionExpected( chActionText, chExpectedText );
  
  A_DBGR_VariableSet("interruptWait", "1"); 
  A_DBGR_VariableSet("SetCore4Flag", "0"); 
  A_DBGR_VariableSet("interruptWait", "0"); 
  
}

/***************************************************************************************************
----------------------------------------------------------------------------------------------------
Test case name:  TC_L30SW_QT_36649668: test_case_to_verify_the_functionality_of_interface_DsblHWIO_Interrupts()_to_prohibits_all_interrupts_from_pre-empting_the_Core5_task_and_interrupt__for_CPU5
----------------------------------------------------------------------------------------------------
Description:  test_case_to_verify_the_functionality_of_interface_DsblHWIO_Interrupts()_to_prohibits_all_interrupts_from_pre-empting_the_Core5_task_and_interrupt__for_CPU5

***************************************************************************************************/
testcase test_case_to_verify_the_functionality_of_interface_DsblHWIO_Interrupt_to_prohibits_all_interrupts_the_core5()
{
  /***************************************************************************************************************/    
                                                // Variable Definition
  /***************************************************************************************************************/ 
  
  long taskvalue;
  
  /***************************************************************************************************************/    
                                               // Local Values
  /***************************************************************************************************************/ 
  

  
  /***************************************************************************************************************/    
                                              // Test Case Info
  /***************************************************************************************************************/
  setWriteDbgLevel(DebugOff);
  snprintf( chTestTitle, elCount(chTestTitle), "test_case_to_verify_the_functionality_of_interface_DsblHWIO_Interrupt_to_prohibits_all_interrupts_from_pre_empting_the_Core5_task_and_interrupt__for_CPU5" );
  snprintf( chTestDescription, elCount(chTestDescription), "Purpose: test_case_to_verify_the_functionality_of_interface_DsblHWIO_Interrupt_to_prohibits_all_interrupts_from_pre_empting_the_Core5_task_and_interrupt__for_CPU4.");
  TestCaseAddInfo( chTestTitle, "TC_L30SW_QT_36649668", chTestDescription );

  /***************************************************************************************************************/    
                                              // Start of Test Case
  /***************************************************************************************************************/
  
  /***************************************************************************************************************/    
                                              // Test Step 1 PRECONDITIONS
  /***************************************************************************************************************/
  
  snprintf( chActionText, elCount(chActionText), "Flash the Software and ECU is running"); 
  snprintf( chExpectedText, elCount(chExpectedText), "ECU should be in running state"); 
  //TestStepAddActionExpected( chActionText, chExpectedText );

  A_DBGR_BreakpointDeleteAll();
  A_DBGR_RnGo();
  E_DBGR_CheckState(T32_State_Running);
  

   /***************************************************************************************************************/    
            // Test Step 2: Check all cores are in running state                                   
  /***************************************************************************************************************/
  
  //Check Core0 is running
  snprintf( chActionText, elCount(chActionText), "Check 1000ms Task Counter from Core0 "); 
  snprintf( chExpectedText, elCount(chExpectedText), "1000ms Counter from Core0 is incrementing"); 
  TestStepAddActionExpected( chActionText, chExpectedText );
  A_DBGR_VariableRead( "Task_Core0_1000ms_Count", taskvalue);
  E_DBGR_VariableCheck("Task_Core0_1000ms_Count", taskvalue, Greater);
  
  //Check Core1 is running
  snprintf( chActionText, elCount(chActionText), "Check 1000ms Task Counter from Core1 "); 
  snprintf( chExpectedText, elCount(chExpectedText), "1000ms Counter from Core1 is incrementing"); 
  TestStepAddActionExpected( chActionText, chExpectedText );
  A_DBGR_VariableRead( "Task_Core1_1000ms_Count", taskvalue);
  E_DBGR_VariableCheck("Task_Core1_1000ms_Count", taskvalue, Greater);
  
  //Check Core2 is running
  snprintf( chActionText, elCount(chActionText), "Check 1000ms Task Counter from Core2 "); 
  snprintf( chExpectedText, elCount(chExpectedText), "1000ms Counter from Core2 is incrementing"); 
  TestStepAddActionExpected( chActionText, chExpectedText );
  A_DBGR_VariableRead( "Task_Core2_1000ms_Count", taskvalue);
  E_DBGR_VariableCheck("Task_Core2_1000ms_Count", taskvalue, Greater);
    
  //Check Core3 is running
  snprintf( chActionText, elCount(chActionText), "Check 1000ms Task Counter from Core3 "); 
  snprintf( chExpectedText, elCount(chExpectedText), "1000ms Counter from Core3 is incrementing"); 
  TestStepAddActionExpected( chActionText, chExpectedText );
  A_DBGR_VariableRead( "Task_Core3_1000ms_Count", taskvalue);
  E_DBGR_VariableCheck("Task_Core3_1000ms_Count", taskvalue, Greater);
    
  //Check Core4 is running
  snprintf( chActionText, elCount(chActionText), "Check 1000ms Task Counter from Core4 "); 
  snprintf( chExpectedText, elCount(chExpectedText), "1000ms Counter from Core4 is incrementing"); 
  TestStepAddActionExpected( chActionText, chExpectedText );
  A_DBGR_VariableRead( "Task_Core4_1000ms_Count", taskvalue);
  E_DBGR_VariableCheck("Task_Core4_1000ms_Count", taskvalue, Greater);
    
  //Check Core5 is running
  snprintf( chActionText, elCount(chActionText), "Check 1000ms Task Counter from Core5 "); 
  snprintf( chExpectedText, elCount(chExpectedText), "1000ms Counter from Core5 is incrementing"); 
  TestStepAddActionExpected( chActionText, chExpectedText );
  A_DBGR_VariableRead( "Task_Core5_1000ms_Count", taskvalue);
  E_DBGR_VariableCheck("Task_Core5_1000ms_Count", taskvalue, Greater);
  
  /*******************************************************************************************************************************************************/    
    // Test Step 3: set SetCore5Flag=1 to Enable funtion Os_Test_EnblDsblHWIO_Nest_Interrupts_core()
  /*******************************************************************************************************************************************************/

  snprintf( chActionText, elCount(chActionText), "set SetCore5Flag=1 to Enable funtion Os_Test_EnblDsblHWIO_Nest_Interrupts_core() "); 
  snprintf( chExpectedText, elCount(chExpectedText), "Verify SetCore5Flag=1 to Enable funtion Os_Test_EnblDsblHWIO_Nest_Interrupts_core() "); 
  TestStepAddActionExpected( chActionText, chExpectedText );
//  A_DBGR_R();
//  A_DBGR_Go();
  A_DBGR_VariableSet("SetCore5Flag", "1");
  A_DBGR_VariableSet("interruptWait", "0");
  //A_DBGR_VariableSet("interruptWait", "0"); 
  //A_DBGR_Go(); 
  
   
  /***************************************************************************************************************/    
        // Test Step 4 check the task counters for  the Core5 stopped.
  /***************************************************************************************************************/

  //Check All tasks of Core5 are stopped
  snprintf( chActionText, elCount(chActionText), "Check 2pt5ms Task Counter from Core5 "); 
//  snprintf( chExpectedText, elCount(chExpectedText), "2pt5ms Counter from Core5 is stop incrementing"); 
//  //TestStepAddActionExpected( chActionText, chExpectedText );
//  A_DBGR_VariableRead( "Task_Core5_2pt5ms_Count", taskvalue);
//  E_DBGR_VariableCheck("Task_Core5_2pt5ms_Count", taskvalue, Equal);
  
//  snprintf( chActionText, elCount(chActionText), "Check 5ms Task Counter from Core5 "); 
//  snprintf( chExpectedText, elCount(chExpectedText), "5ms Counter from Core5 is stop incrementing"); 
//  TestStepAddActionExpected( chActionText, chExpectedText );
//  A_DBGR_VariableRead( "Task_Core5_5ms_Count", taskvalue);
//  E_DBGR_VariableCheck("Task_Core5_5ms_Count", taskvalue, Equal);
  
//  snprintf( chActionText, elCount(chActionText), "Check 10ms Task Counter from Core5 "); 
//  snprintf( chExpectedText, elCount(chExpectedText), "10ms Counter from Core5 is stop incrementing"); 
//  TestStepAddActionExpected( chActionText, chExpectedText );
//  A_DBGR_VariableRead( "Task_Core5_10ms_Count", taskvalue);
//  E_DBGR_VariableCheck("Task_Core5_10ms_Count", taskvalue, Equal);  
  
//  snprintf( chActionText, elCount(chActionText), "Check 25ms Task Counter from Core5 "); 
//  snprintf( chExpectedText, elCount(chExpectedText), "25ms Counter from Core5 is stop incrementing"); 
//  TestStepAddActionExpected( chActionText, chExpectedText );
//  A_DBGR_VariableRead( "Task_Core5_25ms_Count", taskvalue);
//  E_DBGR_VariableCheck("Task_Core5_25ms_Count", taskvalue, Equal);  

//  snprintf( chActionText, elCount(chActionText), "Check 50ms Task Counter from Core5 "); 
//  snprintf( chExpectedText, elCount(chExpectedText), "50ms Counter from Core5 is stop incrementing"); 
//  TestStepAddActionExpected( chActionText, chExpectedText );
//  A_DBGR_VariableRead( "Task_Core5_50ms_Count", taskvalue);
//  E_DBGR_VariableCheck("Task_Core5_50ms_Count", taskvalue, Equal);
  
//  snprintf( chActionText, elCount(chActionText), "Check 250ms Task Counter from Core5 "); 
//  snprintf( chExpectedText, elCount(chExpectedText), "250ms Counter from Core5 is stop incrementing"); 
//  TestStepAddActionExpected( chActionText, chExpectedText );
//  A_DBGR_VariableRead( "Task_Core5_250ms_Count", taskvalue);
//  E_DBGR_VariableCheck("Task_Core5_250ms_Count", taskvalue, Equal);
  
//  snprintf( chActionText, elCount(chActionText), "Check 100ms Task Counter from Core5 "); 
//  snprintf( chExpectedText, elCount(chExpectedText), "100ms Counter from Core5 is stop incrementing"); 
//  TestStepAddActionExpected( chActionText, chExpectedText );
//  A_DBGR_VariableRead( "Task_Core5_100ms_Count", taskvalue);
//  E_DBGR_VariableCheck("Task_Core5_100ms_Count", taskvalue, Equal); 

//  snprintf( chActionText, elCount(chActionText), "Check 500ms Task Counter from Core5 "); 
//  snprintf( chExpectedText, elCount(chExpectedText), "500ms Counter from Core5 is stop incrementing"); 
//  TestStepAddActionExpected( chActionText, chExpectedText );
//  A_DBGR_VariableRead( "Task_Core5_500ms_Count", taskvalue);
//  E_DBGR_VariableCheck("Task_Core5_500ms_Count", taskvalue, Equal);
  
  snprintf( chActionText, elCount(chActionText), "Check 1000ms Task Counter from Core5 "); 
  snprintf( chExpectedText, elCount(chExpectedText), "1000ms Counter from Core5 is stop incrementing"); 
  TestStepAddActionExpected( chActionText, chExpectedText );
  A_DBGR_VariableRead( "Task_Core5_1000ms_Count", taskvalue);
  E_DBGR_VariableCheck("Task_Core5_1000ms_Count", taskvalue, Equal);
  
   //Check Core0 is running
  snprintf( chActionText, elCount(chActionText), "Check 1000ms Task Counter from Core0 "); 
  snprintf( chExpectedText, elCount(chExpectedText), "1000ms Counter from Core0 is incrementing"); 
  TestStepAddActionExpected( chActionText, chExpectedText );
  A_DBGR_VariableRead( "Task_Core0_1000ms_Count", taskvalue);
  E_DBGR_VariableCheck("Task_Core0_1000ms_Count", taskvalue, Greater);
  
  //Check Core1 is running
  snprintf( chActionText, elCount(chActionText), "Check 1000ms Task Counter from Core1 "); 
  snprintf( chExpectedText, elCount(chExpectedText), "1000ms Counter from Core1 is incrementing"); 
  TestStepAddActionExpected( chActionText, chExpectedText );
  A_DBGR_VariableRead( "Task_Core1_1000ms_Count", taskvalue);
  E_DBGR_VariableCheck("Task_Core1_1000ms_Count", taskvalue, Greater);
    
  //Check Core2 is running
  snprintf( chActionText, elCount(chActionText), "Check 1000ms Task Counter from Core2 "); 
  snprintf( chExpectedText, elCount(chExpectedText), "1000ms Counter from Core2 is incrementing"); 
  TestStepAddActionExpected( chActionText, chExpectedText );
  A_DBGR_VariableRead( "Task_Core2_1000ms_Count", taskvalue);
  E_DBGR_VariableCheck("Task_Core2_1000ms_Count", taskvalue, Greater);
    
  //Check Core3 is running
  snprintf( chActionText, elCount(chActionText), "Check 1000ms Task Counter from Core3 "); 
  snprintf( chExpectedText, elCount(chExpectedText), "1000ms Counter from Core3 is incrementing"); 
  TestStepAddActionExpected( chActionText, chExpectedText );
  A_DBGR_VariableRead( "Task_Core3_1000ms_Count", taskvalue);
  E_DBGR_VariableCheck("Task_Core3_1000ms_Count", taskvalue, Greater);
    
  //Check Core4 is running
  snprintf( chActionText, elCount(chActionText), "Check 1000ms Task Counter from Core4 "); 
  snprintf( chExpectedText, elCount(chExpectedText), "1000ms Counter from Core5 is incrementing"); 
  TestStepAddActionExpected( chActionText, chExpectedText );
  A_DBGR_VariableRead( "Task_Core4_1000ms_Count", taskvalue);
  E_DBGR_VariableCheck("Task_Core4_1000ms_Count", taskvalue, Greater);
  
  /*******************************************************************************************************************************************************/    
    // Test Step 5: set SetCore5Flag=0 to Disable funtion Os_Test_EnblDsblHWIO_Nest_Interrupts_core()
  /*******************************************************************************************************************************************************/
  snprintf( chActionText, elCount(chActionText), "set SetCore5Flag=0 to Disable funtion Os_Test_EnblDsblHWIO_Nest_Interrupts_core() "); 
  snprintf( chExpectedText, elCount(chExpectedText), "Verify SetCore5Flag=0 to Disable funtion Os_Test_EnblDsblHWIO_Nest_Interrupts_core() "); 
  TestStepAddActionExpected( chActionText, chExpectedText );
  
  A_DBGR_VariableSet("interruptWait", "1"); 
  A_DBGR_VariableSet("SetCore5Flag", "0"); 
  A_DBGR_VariableSet("interruptWait", "0"); 
  
}
/***************************************************************************************************
----------------------------------------------------------------------------------------------------
Test case name:  TC_L30SW_QT_36649663: test_case_to_verify_the_functionality_of_interface_DsblHWIO_Interrupts()_to_prohibits_all_interrupts_from_pre-empting_the_core0_task_and_interrupt__for_CPU0
----------------------------------------------------------------------------------------------------
Description:  test_case_to_verify_the_functionality_of_interface_DsblHWIO_Interrupts()_to_prohibits_all_interrupts_from_pre-empting_the_core0_task_and_interrupt__for_CPU0

***************************************************************************************************/
testcase test_case_to_verify_the_functionality_of_interface_EnblHWIO_Interrupts_to_Enable_core0_task_and_interrupt_for_CPU0()
{
  /***************************************************************************************************************/    
                                                // Variable Definition
  /***************************************************************************************************************/ 
  
  long taskvalue;
  
  /***************************************************************************************************************/    
                                               // Local Values
  /***************************************************************************************************************/ 
  

  
  /***************************************************************************************************************/    
                                              // Test Case Info
  /***************************************************************************************************************/
  setWriteDbgLevel(DebugOff);
  snprintf( chTestTitle, elCount(chTestTitle), "test_case_to_verify_the_functionality_of_interface_EnblHWIO_Interrupts_to_Enable_core0_task_and_interrupt_for_CPU0" );
  snprintf( chTestDescription, elCount(chTestDescription), "Purpose: test_case_to_verify_the_functionality_of_interface_EnblHWIO_Interrupts_to_Enable_core0_task_and_interrupt_for_CPU0.");
  TestCaseAddInfo( chTestTitle, "TC_L30SW_QT_36649663", chTestDescription );

  /***************************************************************************************************************/    
                                              // Start of Test Case
  /***************************************************************************************************************/
  
  /***************************************************************************************************************/    
                                              // Test Step 1 PRECONDITIONS
  /***************************************************************************************************************/
  
  snprintf( chActionText, elCount(chActionText), "Flash the Software and ECU is running"); 
  snprintf( chExpectedText, elCount(chExpectedText), "ECU should be in running state"); 
  TestStepAddActionExpected( chActionText, chExpectedText );

  A_DBGR_BreakpointDeleteAll();
  A_DBGR_RnGo();
  E_DBGR_CheckState(T32_State_Running);
  

   /***************************************************************************************************************/    
            // Test Step 2: Check all cores are in running state                                   
  /***************************************************************************************************************/
  
  //Check Core0 is running
  snprintf( chActionText, elCount(chActionText), "Check 1000ms Task Counter from Core0 "); 
  snprintf( chExpectedText, elCount(chExpectedText), "1000ms Counter from Core0 is incrementing"); 
  TestStepAddActionExpected( chActionText, chExpectedText );
  A_DBGR_VariableRead( "Task_Core0_1000ms_Count", taskvalue);
  E_DBGR_VariableCheck("Task_Core0_1000ms_Count", taskvalue, Greater);
  
  //Check Core1 is running
  snprintf( chActionText, elCount(chActionText), "Check 1000ms Task Counter from Core1 "); 
  snprintf( chExpectedText, elCount(chExpectedText), "1000ms Counter from Core1 is incrementing"); 
  TestStepAddActionExpected( chActionText, chExpectedText );
  A_DBGR_VariableRead( "Task_Core1_1000ms_Count", taskvalue);
  E_DBGR_VariableCheck("Task_Core1_1000ms_Count", taskvalue, Greater);
  
  //Check Core2 is running
  snprintf( chActionText, elCount(chActionText), "Check 1000ms Task Counter from Core2 "); 
  snprintf( chExpectedText, elCount(chExpectedText), "1000ms Counter from Core2 is incrementing"); 
  TestStepAddActionExpected( chActionText, chExpectedText );
  A_DBGR_VariableRead( "Task_Core2_1000ms_Count", taskvalue);
  E_DBGR_VariableCheck("Task_Core2_1000ms_Count", taskvalue, Greater);
    
  //Check Core3 is running
  snprintf( chActionText, elCount(chActionText), "Check 1000ms Task Counter from Core3 "); 
  snprintf( chExpectedText, elCount(chExpectedText), "1000ms Counter from Core3 is incrementing"); 
  TestStepAddActionExpected( chActionText, chExpectedText );
  A_DBGR_VariableRead( "Task_Core3_1000ms_Count", taskvalue);
  E_DBGR_VariableCheck("Task_Core3_1000ms_Count", taskvalue, Greater);
    
  //Check Core4 is running
  snprintf( chActionText, elCount(chActionText), "Check 1000ms Task Counter from Core4 "); 
  snprintf( chExpectedText, elCount(chExpectedText), "1000ms Counter from Core4 is incrementing"); 
  TestStepAddActionExpected( chActionText, chExpectedText );
  A_DBGR_VariableRead( "Task_Core4_1000ms_Count", taskvalue);
  E_DBGR_VariableCheck("Task_Core4_1000ms_Count", taskvalue, Greater);
    
  //Check Core5 is running
  snprintf( chActionText, elCount(chActionText), "Check 1000ms Task Counter from Core5 "); 
  snprintf( chExpectedText, elCount(chExpectedText), "1000ms Counter from Core5 is incrementing"); 
  TestStepAddActionExpected( chActionText, chExpectedText );
  A_DBGR_VariableRead( "Task_Core5_1000ms_Count", taskvalue);
  E_DBGR_VariableCheck("Task_Core5_1000ms_Count", taskvalue, Greater);
  
  /*******************************************************************************************************************************************************/    
    // Test Step 3: set SetCore0Flag=1 to Enable funtion Os_Test_EnblDsblHWIO_Nest_Interrupts_core()
  /*******************************************************************************************************************************************************/

  snprintf( chActionText, elCount(chActionText), "set SetCore0Flag=1 to Enable funtion Os_Test_EnblDsblHWIO_Nest_Interrupts_core() "); 
  snprintf( chExpectedText, elCount(chExpectedText), "Verify SetCore0Flag=1 to Enable funtion Os_Test_EnblDsblHWIO_Nest_Interrupts_core() "); 
  TestStepAddActionExpected( chActionText, chExpectedText );
//  A_DBGR_R();
//  A_DBGR_Go();
  A_DBGR_VariableSet("SetCore0Flag", "1");
  A_DBGR_VariableSet("interruptWait", "0");
  E_DBGR_VariableCheck("interruptWait", 0, Equal);
  //A_DBGR_VariableSet("interruptWait", "0"); 
  //A_DBGR_Go(); 
  
  /***************************************************************************************************************/    
        // Test Step 4 check the task counters for  the core0 stopped.
  /***************************************************************************************************************/
  //testWaitForTimeout(1000);
  //Check All tasks of Core0 are stopped
  snprintf( chActionText, elCount(chActionText), "Check 2pt5ms Task Counter from Core0 "); 
  snprintf( chExpectedText, elCount(chExpectedText), "2pt5ms Counter from Core0 is stop incrementing"); 
  TestStepAddActionExpected( chActionText, chExpectedText );
  A_DBGR_VariableRead( "Task_Core0_2pt5ms_Count", taskvalue);
  E_DBGR_VariableCheck("Task_Core0_2pt5ms_Count", taskvalue, Equal);
  
  snprintf( chActionText, elCount(chActionText), "Check 5ms Task Counter from Core0 "); 
  snprintf( chExpectedText, elCount(chExpectedText), "5ms Counter from Core0 is stop incrementing"); 
  TestStepAddActionExpected( chActionText, chExpectedText );
  A_DBGR_VariableRead( "Task_Core0_5ms_Count", taskvalue);
  E_DBGR_VariableCheck("Task_Core0_5ms_Count", taskvalue, Equal);
  
  snprintf( chActionText, elCount(chActionText), "Check 10ms Task Counter from Core0 "); 
  snprintf( chExpectedText, elCount(chExpectedText), "10ms Counter from Core0 is stop incrementing"); 
  TestStepAddActionExpected( chActionText, chExpectedText );
  A_DBGR_VariableRead( "Task_Core0_10ms_Count", taskvalue);
  E_DBGR_VariableCheck("Task_Core0_10ms_Count", taskvalue, Equal);  
  
  snprintf( chActionText, elCount(chActionText), "Check 25ms Task Counter from Core0 "); 
  snprintf( chExpectedText, elCount(chExpectedText), "25ms Counter from Core0 is stop incrementing"); 
  TestStepAddActionExpected( chActionText, chExpectedText );
  A_DBGR_VariableRead( "Task_Core0_25ms_Count", taskvalue);
  E_DBGR_VariableCheck("Task_Core0_25ms_Count", taskvalue, Equal);  

  snprintf( chActionText, elCount(chActionText), "Check 50ms Task Counter from Core0 "); 
  snprintf( chExpectedText, elCount(chExpectedText), "50ms Counter from Core0 is stop incrementing"); 
  TestStepAddActionExpected( chActionText, chExpectedText );
  A_DBGR_VariableRead( "Task_Core0_50ms_Count", taskvalue);
  E_DBGR_VariableCheck("Task_Core0_50ms_Count", taskvalue, Equal);
  
  snprintf( chActionText, elCount(chActionText), "Check 250ms Task Counter from Core0 "); 
  snprintf( chExpectedText, elCount(chExpectedText), "250ms Counter from Core0 is stop incrementing"); 
  TestStepAddActionExpected( chActionText, chExpectedText );
  A_DBGR_VariableRead( "Task_Core0_250ms_Count", taskvalue);
  E_DBGR_VariableCheck("Task_Core0_250ms_Count", taskvalue, Equal);
  
  snprintf( chActionText, elCount(chActionText), "Check 100ms Task Counter from Core0 "); 
  snprintf( chExpectedText, elCount(chExpectedText), "100ms Counter from Core0 is stop incrementing"); 
  TestStepAddActionExpected( chActionText, chExpectedText );
  A_DBGR_VariableRead( "Task_Core0_100ms_Count", taskvalue);
  E_DBGR_VariableCheck("Task_Core0_100ms_Count", taskvalue, Equal); 

  snprintf( chActionText, elCount(chActionText), "Check 500ms Task Counter from Core0 "); 
  snprintf( chExpectedText, elCount(chExpectedText), "500ms Counter from Core0 is stop incrementing"); 
  TestStepAddActionExpected( chActionText, chExpectedText );
  A_DBGR_VariableRead( "Task_Core0_500ms_Count", taskvalue);
  E_DBGR_VariableCheck("Task_Core0_500ms_Count", taskvalue, Equal);
  
  snprintf( chActionText, elCount(chActionText), "Check 1000ms Task Counter from Core0 "); 
  snprintf( chExpectedText, elCount(chExpectedText), "1000ms Counter from Core0 is stop incrementing"); 
  TestStepAddActionExpected( chActionText, chExpectedText );
  A_DBGR_VariableRead( "Task_Core0_1000ms_Count", taskvalue);
  E_DBGR_VariableCheck("Task_Core0_1000ms_Count", taskvalue, Equal);
  
   //Check Core1 is running
  snprintf( chActionText, elCount(chActionText), "Check 1000ms Task Counter from Core1 "); 
  snprintf( chExpectedText, elCount(chExpectedText), "1000ms Counter from Core1 is incrementing"); 
  TestStepAddActionExpected( chActionText, chExpectedText );
  A_DBGR_VariableRead( "Task_Core1_1000ms_Count", taskvalue);
  E_DBGR_VariableCheck("Task_Core1_1000ms_Count", taskvalue, Greater);
  
  //Check Core2 is running
  snprintf( chActionText, elCount(chActionText), "Check 1000ms Task Counter from Core2 "); 
  snprintf( chExpectedText, elCount(chExpectedText), "1000ms Counter from Core2 is incrementing"); 
  TestStepAddActionExpected( chActionText, chExpectedText );
  A_DBGR_VariableRead( "Task_Core2_1000ms_Count", taskvalue);
  E_DBGR_VariableCheck("Task_Core2_1000ms_Count", taskvalue, Greater);
    
  //Check Core3 is running
  snprintf( chActionText, elCount(chActionText), "Check 1000ms Task Counter from Core3 "); 
  snprintf( chExpectedText, elCount(chExpectedText), "1000ms Counter from Core3 is incrementing"); 
  TestStepAddActionExpected( chActionText, chExpectedText );
  A_DBGR_VariableRead( "Task_Core3_1000ms_Count", taskvalue);
  E_DBGR_VariableCheck("Task_Core3_1000ms_Count", taskvalue, Greater);
    
  //Check Core4 is running
  snprintf( chActionText, elCount(chActionText), "Check 1000ms Task Counter from Core4 "); 
  snprintf( chExpectedText, elCount(chExpectedText), "1000ms Counter from Core4 is incrementing"); 
  TestStepAddActionExpected( chActionText, chExpectedText );
  A_DBGR_VariableRead( "Task_Core4_1000ms_Count", taskvalue);
  E_DBGR_VariableCheck("Task_Core4_1000ms_Count", taskvalue, Greater);
    
  //Check Core5 is running
  snprintf( chActionText, elCount(chActionText), "Check 1000ms Task Counter from Core5 "); 
  snprintf( chExpectedText, elCount(chExpectedText), "1000ms Counter from Core5 is incrementing"); 
  TestStepAddActionExpected( chActionText, chExpectedText );
  A_DBGR_VariableRead( "Task_Core5_1000ms_Count", taskvalue);
  E_DBGR_VariableCheck("Task_Core5_1000ms_Count", taskvalue, Greater);
  
  /*******************************************************************************************************************************************************/    
    // Test Step 5: set SetCore0Flag=0 to Disable funtion Os_Test_EnblDsblHWIO_Nest_Interrupts_core()
  /*******************************************************************************************************************************************************/
  snprintf( chActionText, elCount(chActionText), "set SetCore0Flag=0 to Disable funtion Os_Test_EnblDsblHWIO_Nest_Interrupts_core() "); 
  snprintf( chExpectedText, elCount(chExpectedText), "Verify SetCore0Flag=0 to Disable funtion Os_Test_EnblDsblHWIO_Nest_Interrupts_core() "); 
  TestStepAddActionExpected( chActionText, chExpectedText );
  
  A_DBGR_VariableSet("interruptWait", "1"); 
  E_DBGR_VariableCheck("interruptWait", 1, Equal);
  
  /***************************************************************************************************************/    
     // Test Step 6: Check all cores are in running state after interruptWait set to 1                                  
  /***************************************************************************************************************/
  
  //Check Core0 is running
  snprintf( chActionText, elCount(chActionText), "Check 1000ms Task Counter from Core0 "); 
  snprintf( chExpectedText, elCount(chExpectedText), "1000ms Counter from Core0 is incrementing"); 
  TestStepAddActionExpected( chActionText, chExpectedText );
  A_DBGR_VariableRead( "Task_Core0_1000ms_Count", taskvalue);
  E_DBGR_VariableCheck("Task_Core0_1000ms_Count", taskvalue, Greater);
  
  //Check Core1 is running
  snprintf( chActionText, elCount(chActionText), "Check 1000ms Task Counter from Core1 "); 
  snprintf( chExpectedText, elCount(chExpectedText), "1000ms Counter from Core1 is incrementing"); 
  TestStepAddActionExpected( chActionText, chExpectedText );
  A_DBGR_VariableRead( "Task_Core1_1000ms_Count", taskvalue);
  E_DBGR_VariableCheck("Task_Core1_1000ms_Count", taskvalue, Greater);
  
  //Check Core2 is running
  snprintf( chActionText, elCount(chActionText), "Check 1000ms Task Counter from Core2 "); 
  snprintf( chExpectedText, elCount(chExpectedText), "1000ms Counter from Core2 is incrementing"); 
  TestStepAddActionExpected( chActionText, chExpectedText );
  A_DBGR_VariableRead( "Task_Core2_1000ms_Count", taskvalue);
  E_DBGR_VariableCheck("Task_Core2_1000ms_Count", taskvalue, Greater);
    
  //Check Core3 is running
  snprintf( chActionText, elCount(chActionText), "Check 1000ms Task Counter from Core3 "); 
  snprintf( chExpectedText, elCount(chExpectedText), "1000ms Counter from Core3 is incrementing"); 
  TestStepAddActionExpected( chActionText, chExpectedText );
  A_DBGR_VariableRead( "Task_Core3_1000ms_Count", taskvalue);
  E_DBGR_VariableCheck("Task_Core3_1000ms_Count", taskvalue, Greater);
    
  //Check Core4 is running
  snprintf( chActionText, elCount(chActionText), "Check 1000ms Task Counter from Core4 "); 
  snprintf( chExpectedText, elCount(chExpectedText), "1000ms Counter from Core4 is incrementing"); 
  TestStepAddActionExpected( chActionText, chExpectedText );
  A_DBGR_VariableRead( "Task_Core4_1000ms_Count", taskvalue);
  E_DBGR_VariableCheck("Task_Core4_1000ms_Count", taskvalue, Greater);
    
  //Check Core5 is running
  snprintf( chActionText, elCount(chActionText), "Check 1000ms Task Counter from Core5 "); 
  snprintf( chExpectedText, elCount(chExpectedText), "1000ms Counter from Core5 is incrementing"); 
  TestStepAddActionExpected( chActionText, chExpectedText );
  A_DBGR_VariableRead( "Task_Core5_1000ms_Count", taskvalue);
  E_DBGR_VariableCheck("Task_Core5_1000ms_Count", taskvalue, Greater);
  
  snprintf( chActionText, elCount(chActionText), "Reset Conditions "); 
  snprintf( chExpectedText, elCount(chExpectedText), "Reset Conditions "); 
  TestStepAddActionExpected( chActionText, chExpectedText );
  A_DBGR_VariableSet("SetCore0Flag", "0"); 
  A_DBGR_VariableSet("interruptWait", "0"); 
  E_DBGR_VariableCheck("interruptWait", 0, Equal);
  
}


/***************************************************************************************************
----------------------------------------------------------------------------------------------------
Test case name:  TC_L30SW_QT_36649659: test_case_to_verify_the_functionality_of_interface_DsblHWIO_Interrupts()_to_prohibits_all_interrupts_from_pre-empting_the_core1_task_and_interrupt__for_CPU1
----------------------------------------------------------------------------------------------------
Description:  test_case_to_verify_the_functionality_of_interface_DsblHWIO_Interrupts()_to_prohibits_all_interrupts_from_pre-empting_the_core1_task_and_interrupt__for_CPU1

***************************************************************************************************/
testcase test_case_to_verify_the_functionality_of_interface_EnblHWIO_Interrupts_to_Enable_core1_task_and_interrupt_for_CPU1()
{
  /***************************************************************************************************************/    
                                                // Variable Definition
  /***************************************************************************************************************/ 
  
  long taskvalue;
  
  /***************************************************************************************************************/    
                                               // Local Values
  /***************************************************************************************************************/ 
  

  
  /***************************************************************************************************************/    
                                              // Test Case Info
  /***************************************************************************************************************/
  setWriteDbgLevel(DebugOff);
  snprintf( chTestTitle, elCount(chTestTitle), "test_case_to_verify_the_functionality_of_interface_EnblHWIO_Interrupts_to_Enable_core1_task_and_interrupt_for_CPU1" );
  snprintf( chTestDescription, elCount(chTestDescription), "Purpose: test_case_to_verify_the_functionality_of_interface_EnblHWIO_Interrupts_to_Enable_core1_task_and_interrupt_for_CPU1");
  TestCaseAddInfo( chTestTitle, "TC_L30SW_QT_36649659", chTestDescription );

  /***************************************************************************************************************/    
                                              // Start of Test Case
  /***************************************************************************************************************/
  
  /***************************************************************************************************************/    
                                              // Test Step 1 PRECONDITIONS
  /***************************************************************************************************************/
  
  snprintf( chActionText, elCount(chActionText), "Flash the Software and ECU is running"); 
  snprintf( chExpectedText, elCount(chExpectedText), "ECU should be in running state"); 
  TestStepAddActionExpected( chActionText, chExpectedText );

  A_DBGR_BreakpointDeleteAll();
  A_DBGR_RnGo();
  E_DBGR_CheckState(T32_State_Running);
  

   /***************************************************************************************************************/    
            // Test Step 2: Check all cores are in running state                                   
  /***************************************************************************************************************/
  
  //Check Core0 is running
  snprintf( chActionText, elCount(chActionText), "Check 1000ms Task Counter from Core0 "); 
  snprintf( chExpectedText, elCount(chExpectedText), "1000ms Counter from Core0 is incrementing"); 
  TestStepAddActionExpected( chActionText, chExpectedText );
  A_DBGR_VariableRead( "Task_Core0_1000ms_Count", taskvalue);
  E_DBGR_VariableCheck("Task_Core0_1000ms_Count", taskvalue, Greater);
  
  //Check Core1 is running
  snprintf( chActionText, elCount(chActionText), "Check 1000ms Task Counter from Core1 "); 
  snprintf( chExpectedText, elCount(chExpectedText), "1000ms Counter from Core1 is incrementing"); 
  TestStepAddActionExpected( chActionText, chExpectedText );
  A_DBGR_VariableRead( "Task_Core1_1000ms_Count", taskvalue);
  E_DBGR_VariableCheck("Task_Core1_1000ms_Count", taskvalue, Greater);
  
  //Check Core2 is running
  snprintf( chActionText, elCount(chActionText), "Check 1000ms Task Counter from Core2 "); 
  snprintf( chExpectedText, elCount(chExpectedText), "1000ms Counter from Core2 is incrementing"); 
  TestStepAddActionExpected( chActionText, chExpectedText );
  A_DBGR_VariableRead( "Task_Core2_1000ms_Count", taskvalue);
  E_DBGR_VariableCheck("Task_Core2_1000ms_Count", taskvalue, Greater);
    
  //Check Core3 is running
  snprintf( chActionText, elCount(chActionText), "Check 1000ms Task Counter from Core3 "); 
  snprintf( chExpectedText, elCount(chExpectedText), "1000ms Counter from Core3 is incrementing"); 
  TestStepAddActionExpected( chActionText, chExpectedText );
  A_DBGR_VariableRead( "Task_Core3_1000ms_Count", taskvalue);
  E_DBGR_VariableCheck("Task_Core3_1000ms_Count", taskvalue, Greater);
    
  //Check Core4 is running
  snprintf( chActionText, elCount(chActionText), "Check 1000ms Task Counter from Core4 "); 
  snprintf( chExpectedText, elCount(chExpectedText), "1000ms Counter from Core4 is incrementing"); 
  TestStepAddActionExpected( chActionText, chExpectedText );
  A_DBGR_VariableRead( "Task_Core4_1000ms_Count", taskvalue);
  E_DBGR_VariableCheck("Task_Core4_1000ms_Count", taskvalue, Greater);
    
  //Check Core5 is running
  snprintf( chActionText, elCount(chActionText), "Check 1000ms Task Counter from Core5 "); 
  snprintf( chExpectedText, elCount(chExpectedText), "1000ms Counter from Core5 is incrementing"); 
  TestStepAddActionExpected( chActionText, chExpectedText );
  A_DBGR_VariableRead( "Task_Core5_1000ms_Count", taskvalue);
  E_DBGR_VariableCheck("Task_Core5_1000ms_Count", taskvalue, Greater);
  
  /*******************************************************************************************************************************************************/    
    // Test Step 3: set SetCore1Flag=1 to Enable funtion Os_Test_EnblDsblHWIO_Nest_Interrupts_core()
  /*******************************************************************************************************************************************************/

  snprintf( chActionText, elCount(chActionText), "set SetCore1Flag=1 to Enable funtion Os_Test_EnblDsblHWIO_Nest_Interrupts_core() "); 
  snprintf( chExpectedText, elCount(chExpectedText), "Verify SetCore1Flag=1 to Enable funtion Os_Test_EnblDsblHWIO_Nest_Interrupts_core() "); 
  TestStepAddActionExpected( chActionText, chExpectedText );
//  A_DBGR_R();
//  A_DBGR_Go();
  A_DBGR_VariableSet("SetCore1Flag", "1");
  A_DBGR_VariableSet("interruptWait", "0");
  E_DBGR_VariableCheck("interruptWait", 0, Equal);
  //A_DBGR_VariableSet("interruptWait", "0"); 
  //A_DBGR_Go(); 
  
  /***************************************************************************************************************/    
        // Test Step 4 check the task counters for  the Core1 stopped.
  /***************************************************************************************************************/

  //Check All tasks of Core1 are stopped
  snprintf( chActionText, elCount(chActionText), "Check 2pt5ms Task Counter from Core1 "); 
  snprintf( chExpectedText, elCount(chExpectedText), "2pt5ms Counter from Core1 is stop incrementing"); 
  TestStepAddActionExpected( chActionText, chExpectedText );
  A_DBGR_VariableRead( "Task_Core1_2pt5ms_Count", taskvalue);
  E_DBGR_VariableCheck("Task_Core1_2pt5ms_Count", taskvalue, Equal);
  
  snprintf( chActionText, elCount(chActionText), "Check 5ms Task Counter from Core1 "); 
  snprintf( chExpectedText, elCount(chExpectedText), "5ms Counter from Core1 is stop incrementing"); 
  TestStepAddActionExpected( chActionText, chExpectedText );
  A_DBGR_VariableRead( "Task_Core1_5ms_Count", taskvalue);
  E_DBGR_VariableCheck("Task_Core1_5ms_Count", taskvalue, Equal);
  
  snprintf( chActionText, elCount(chActionText), "Check 10ms Task Counter from Core1 "); 
  snprintf( chExpectedText, elCount(chExpectedText), "10ms Counter from Core1 is stop incrementing"); 
  TestStepAddActionExpected( chActionText, chExpectedText );
  A_DBGR_VariableRead( "Task_Core1_10ms_Count", taskvalue);
  E_DBGR_VariableCheck("Task_Core1_10ms_Count", taskvalue, Equal);  
  
  snprintf( chActionText, elCount(chActionText), "Check 25ms Task Counter from Core1 "); 
  snprintf( chExpectedText, elCount(chExpectedText), "25ms Counter from Core1 is stop incrementing"); 
  TestStepAddActionExpected( chActionText, chExpectedText );
  A_DBGR_VariableRead( "Task_Core1_25ms_Count", taskvalue);
  E_DBGR_VariableCheck("Task_Core1_25ms_Count", taskvalue, Equal);  

  snprintf( chActionText, elCount(chActionText), "Check 50ms Task Counter from Core1 "); 
  snprintf( chExpectedText, elCount(chExpectedText), "50ms Counter from Core1 is stop incrementing"); 
  TestStepAddActionExpected( chActionText, chExpectedText );
  A_DBGR_VariableRead( "Task_Core1_50ms_Count", taskvalue);
  E_DBGR_VariableCheck("Task_Core1_50ms_Count", taskvalue, Equal);
  
  snprintf( chActionText, elCount(chActionText), "Check 250ms Task Counter from Core1 "); 
  snprintf( chExpectedText, elCount(chExpectedText), "250ms Counter from Core1 is stop incrementing"); 
  TestStepAddActionExpected( chActionText, chExpectedText );
  A_DBGR_VariableRead( "Task_Core1_250ms_Count", taskvalue);
  E_DBGR_VariableCheck("Task_Core1_250ms_Count", taskvalue, Equal);
  
  snprintf( chActionText, elCount(chActionText), "Check 100ms Task Counter from Core1 "); 
  snprintf( chExpectedText, elCount(chExpectedText), "100ms Counter from Core1 is stop incrementing"); 
  TestStepAddActionExpected( chActionText, chExpectedText );
  A_DBGR_VariableRead( "Task_Core1_100ms_Count", taskvalue);
  E_DBGR_VariableCheck("Task_Core1_100ms_Count", taskvalue, Equal); 

  snprintf( chActionText, elCount(chActionText), "Check 500ms Task Counter from Core1 "); 
  snprintf( chExpectedText, elCount(chExpectedText), "500ms Counter from Core1 is stop incrementing"); 
  TestStepAddActionExpected( chActionText, chExpectedText );
  A_DBGR_VariableRead( "Task_Core1_500ms_Count", taskvalue);
  E_DBGR_VariableCheck("Task_Core1_500ms_Count", taskvalue, Equal);
  
  snprintf( chActionText, elCount(chActionText), "Check 1000ms Task Counter from Core1 "); 
  snprintf( chExpectedText, elCount(chExpectedText), "1000ms Counter from Core1 is stop incrementing"); 
  TestStepAddActionExpected( chActionText, chExpectedText );
  A_DBGR_VariableRead( "Task_Core1_1000ms_Count", taskvalue);
  E_DBGR_VariableCheck("Task_Core1_1000ms_Count", taskvalue, Equal);
  
   //Check Core0 is running
  snprintf( chActionText, elCount(chActionText), "Check 1000ms Task Counter from Core0 "); 
  snprintf( chExpectedText, elCount(chExpectedText), "1000ms Counter from Core0 is incrementing"); 
  TestStepAddActionExpected( chActionText, chExpectedText );
  A_DBGR_VariableRead( "Task_Core0_1000ms_Count", taskvalue);
  E_DBGR_VariableCheck("Task_Core0_1000ms_Count", taskvalue, Greater);
  
  //Check Core2 is running
  snprintf( chActionText, elCount(chActionText), "Check 1000ms Task Counter from Core2 "); 
  snprintf( chExpectedText, elCount(chExpectedText), "1000ms Counter from Core2 is incrementing"); 
  TestStepAddActionExpected( chActionText, chExpectedText );
  A_DBGR_VariableRead( "Task_Core2_1000ms_Count", taskvalue);
  E_DBGR_VariableCheck("Task_Core2_1000ms_Count", taskvalue, Greater);
    
  //Check Core3 is running
  snprintf( chActionText, elCount(chActionText), "Check 1000ms Task Counter from Core3 "); 
  snprintf( chExpectedText, elCount(chExpectedText), "1000ms Counter from Core3 is incrementing"); 
  TestStepAddActionExpected( chActionText, chExpectedText );
  A_DBGR_VariableRead( "Task_Core3_1000ms_Count", taskvalue);
  E_DBGR_VariableCheck("Task_Core3_1000ms_Count", taskvalue, Greater);
    
  //Check Core4 is running
  snprintf( chActionText, elCount(chActionText), "Check 1000ms Task Counter from Core4 "); 
  snprintf( chExpectedText, elCount(chExpectedText), "1000ms Counter from Core4 is incrementing"); 
  TestStepAddActionExpected( chActionText, chExpectedText );
  A_DBGR_VariableRead( "Task_Core4_1000ms_Count", taskvalue);
  E_DBGR_VariableCheck("Task_Core4_1000ms_Count", taskvalue, Greater);
    
  //Check Core5 is running
  snprintf( chActionText, elCount(chActionText), "Check 1000ms Task Counter from Core5 "); 
  snprintf( chExpectedText, elCount(chExpectedText), "1000ms Counter from Core5 is incrementing"); 
  TestStepAddActionExpected( chActionText, chExpectedText );
  A_DBGR_VariableRead( "Task_Core5_1000ms_Count", taskvalue);
  E_DBGR_VariableCheck("Task_Core5_1000ms_Count", taskvalue, Greater);
  
  /*******************************************************************************************************************************************************/    
    // Test Step 5: set SetCore1Flag=0 to Disable funtion Os_Test_EnblDsblHWIO_Nest_Interrupts_core()
  /*******************************************************************************************************************************************************/
  snprintf( chActionText, elCount(chActionText), "set SetCore1Flag=0 to Disable funtion Os_Test_EnblDsblHWIO_Nest_Interrupts_core() "); 
  snprintf( chExpectedText, elCount(chExpectedText), "Verify SetCore1Flag=0 to Disable funtion Os_Test_EnblDsblHWIO_Nest_Interrupts_core() "); 
  TestStepAddActionExpected( chActionText, chExpectedText );
  
  A_DBGR_VariableSet("interruptWait", "1");
  E_DBGR_VariableCheck("interruptWait", 1, Equal);
  
  /***************************************************************************************************************/    
     // Test Step 6: Check all cores are in running state after interruptWait set to 1                                  
  /***************************************************************************************************************/
  
  //Check Core0 is running
  snprintf( chActionText, elCount(chActionText), "Check 1000ms Task Counter from Core0 "); 
  snprintf( chExpectedText, elCount(chExpectedText), "1000ms Counter from Core0 is incrementing"); 
  TestStepAddActionExpected( chActionText, chExpectedText );
  A_DBGR_VariableRead( "Task_Core0_1000ms_Count", taskvalue);
  E_DBGR_VariableCheck("Task_Core0_1000ms_Count", taskvalue, Greater);
  
  //Check Core1 is running
  snprintf( chActionText, elCount(chActionText), "Check 1000ms Task Counter from Core1 "); 
  snprintf( chExpectedText, elCount(chExpectedText), "1000ms Counter from Core1 is incrementing"); 
  TestStepAddActionExpected( chActionText, chExpectedText );
  A_DBGR_VariableRead( "Task_Core1_1000ms_Count", taskvalue);
  E_DBGR_VariableCheck("Task_Core1_1000ms_Count", taskvalue, Greater);
  
  //Check Core2 is running
  snprintf( chActionText, elCount(chActionText), "Check 1000ms Task Counter from Core2 "); 
  snprintf( chExpectedText, elCount(chExpectedText), "1000ms Counter from Core2 is incrementing"); 
  TestStepAddActionExpected( chActionText, chExpectedText );
  A_DBGR_VariableRead( "Task_Core2_1000ms_Count", taskvalue);
  E_DBGR_VariableCheck("Task_Core2_1000ms_Count", taskvalue, Greater);
    
  //Check Core3 is running
  snprintf( chActionText, elCount(chActionText), "Check 1000ms Task Counter from Core3 "); 
  snprintf( chExpectedText, elCount(chExpectedText), "1000ms Counter from Core3 is incrementing"); 
  TestStepAddActionExpected( chActionText, chExpectedText );
  A_DBGR_VariableRead( "Task_Core3_1000ms_Count", taskvalue);
  E_DBGR_VariableCheck("Task_Core3_1000ms_Count", taskvalue, Greater);
    
  //Check Core4 is running
  snprintf( chActionText, elCount(chActionText), "Check 1000ms Task Counter from Core4 "); 
  snprintf( chExpectedText, elCount(chExpectedText), "1000ms Counter from Core4 is incrementing"); 
  TestStepAddActionExpected( chActionText, chExpectedText );
  A_DBGR_VariableRead( "Task_Core4_1000ms_Count", taskvalue);
  E_DBGR_VariableCheck("Task_Core4_1000ms_Count", taskvalue, Greater);
    
  //Check Core5 is running
  snprintf( chActionText, elCount(chActionText), "Check 1000ms Task Counter from Core5 "); 
  snprintf( chExpectedText, elCount(chExpectedText), "1000ms Counter from Core5 is incrementing"); 
  TestStepAddActionExpected( chActionText, chExpectedText );
  A_DBGR_VariableRead( "Task_Core5_1000ms_Count", taskvalue);
  E_DBGR_VariableCheck("Task_Core5_1000ms_Count", taskvalue, Greater);
  
  snprintf( chActionText, elCount(chActionText), "Reset Conditions "); 
  snprintf( chExpectedText, elCount(chExpectedText), "Reset Conditions "); 
  TestStepAddActionExpected( chActionText, chExpectedText );
  A_DBGR_VariableSet("SetCore1Flag", "0"); 
  A_DBGR_VariableSet("interruptWait", "0"); 
  E_DBGR_VariableCheck("interruptWait", 0, Equal);
  
}
/***************************************************************************************************
----------------------------------------------------------------------------------------------------
Test case name:  TC_L30SW_Q-36649666: test_case_to_verify_the_functionality_of_interface_DsblHWIO_Interrupts()_to_prohibits_all_interrupts_from_pre-empting_the_core2_task_and_interrupt__for_CPU2
----------------------------------------------------------------------------------------------------
Description:  test_case_to_verify_the_functionality_of_interface_DsblHWIO_Interrupts()_to_prohibits_all_interrupts_from_pre-empting_the_core2_task_and_interrupt__for_CPU2

***************************************************************************************************/
testcase test_case_to_verify_the_functionality_of_interface_EnblHWIO_Interrupts_to_Enable_core2_task_and_interrupt_for_CPU2()
{
  /***************************************************************************************************************/    
                                                // Variable Definition
  /***************************************************************************************************************/ 
  
  long taskvalue;
  
  /***************************************************************************************************************/    
                                               // Local Values
  /***************************************************************************************************************/ 
  

  
  /***************************************************************************************************************/    
                                              // Test Case Info
  /***************************************************************************************************************/
  setWriteDbgLevel(DebugOff);
  snprintf( chTestTitle, elCount(chTestTitle), "test_case_to_verify_the_functionality_of_interface_EnblHWIO_Interrupts_to_Enable_core2_task_and_interrupt_for_CPU2" );
  snprintf( chTestDescription, elCount(chTestDescription), "Purpose: test_case_to_verify_the_functionality_of_interface_EnblHWIO_Interrupts_to_Enable_core2_task_and_interrupt_for_CPU2.");
  TestCaseAddInfo( chTestTitle, "TC_L30SW_Q-349666", chTestDescription );

  /***************************************************************************************************************/    
                                              // Start of Test Case
  /***************************************************************************************************************/
  
  /***************************************************************************************************************/    
                                              // Test Step 1 PRECONDITIONS
  /***************************************************************************************************************/
  
  snprintf( chActionText, elCount(chActionText), "Flash the Software and ECU is running"); 
  snprintf( chExpectedText, elCount(chExpectedText), "ECU should be in running state"); 
  TestStepAddActionExpected( chActionText, chExpectedText );

  A_DBGR_BreakpointDeleteAll();
  A_DBGR_RnGo();
  E_DBGR_CheckState(T32_State_Running);
  

   /***************************************************************************************************************/    
            // Test Step 2: Check all cores are in running state                                   
  /***************************************************************************************************************/
  
  //Check Core0 is running
  snprintf( chActionText, elCount(chActionText), "Check 1000ms Task Counter from Core0 "); 
  snprintf( chExpectedText, elCount(chExpectedText), "1000ms Counter from Core0 is incrementing"); 
  TestStepAddActionExpected( chActionText, chExpectedText );
  A_DBGR_VariableRead( "Task_Core0_1000ms_Count", taskvalue);
  E_DBGR_VariableCheck("Task_Core0_1000ms_Count", taskvalue, Greater);
  
  //Check Core1 is running
  snprintf( chActionText, elCount(chActionText), "Check 1000ms Task Counter from Core1 "); 
  snprintf( chExpectedText, elCount(chExpectedText), "1000ms Counter from Core1 is incrementing"); 
  TestStepAddActionExpected( chActionText, chExpectedText );
  A_DBGR_VariableRead( "Task_Core1_1000ms_Count", taskvalue);
  E_DBGR_VariableCheck("Task_Core1_1000ms_Count", taskvalue, Greater);
  
  //Check Core2 is running
  snprintf( chActionText, elCount(chActionText), "Check 1000ms Task Counter from Core2 "); 
  snprintf( chExpectedText, elCount(chExpectedText), "1000ms Counter from Core2 is incrementing"); 
  TestStepAddActionExpected( chActionText, chExpectedText );
  A_DBGR_VariableRead( "Task_Core2_1000ms_Count", taskvalue);
  E_DBGR_VariableCheck("Task_Core2_1000ms_Count", taskvalue, Greater);
    
  //Check Core3 is running
  snprintf( chActionText, elCount(chActionText), "Check 1000ms Task Counter from Core3 "); 
  snprintf( chExpectedText, elCount(chExpectedText), "1000ms Counter from Core3 is incrementing"); 
  TestStepAddActionExpected( chActionText, chExpectedText );
  A_DBGR_VariableRead( "Task_Core3_1000ms_Count", taskvalue);
  E_DBGR_VariableCheck("Task_Core3_1000ms_Count", taskvalue, Greater);
    
  //Check Core4 is running
  snprintf( chActionText, elCount(chActionText), "Check 1000ms Task Counter from Core4 "); 
  snprintf( chExpectedText, elCount(chExpectedText), "1000ms Counter from Core4 is incrementing"); 
  TestStepAddActionExpected( chActionText, chExpectedText );
  A_DBGR_VariableRead( "Task_Core4_1000ms_Count", taskvalue);
  E_DBGR_VariableCheck("Task_Core4_1000ms_Count", taskvalue, Greater);
    
  //Check Core5 is running
  snprintf( chActionText, elCount(chActionText), "Check 1000ms Task Counter from Core5 "); 
  snprintf( chExpectedText, elCount(chExpectedText), "1000ms Counter from Core5 is incrementing"); 
  TestStepAddActionExpected( chActionText, chExpectedText );
  A_DBGR_VariableRead( "Task_Core5_1000ms_Count", taskvalue);
  E_DBGR_VariableCheck("Task_Core5_1000ms_Count", taskvalue, Greater);
  
  /*******************************************************************************************************************************************************/    
    // Test Step 3: set SetCore2Flag=1 to Enable funtion Os_Test_EnblDsblHWIO_Nest_Interrupts_core()
  /*******************************************************************************************************************************************************/

  snprintf( chActionText, elCount(chActionText), "set SetCore2Flag=1 to Enable funtion Os_Test_EnblDsblHWIO_Nest_Interrupts_core() "); 
  snprintf( chExpectedText, elCount(chExpectedText), "Verify SetCore2Flag=1 to Enable funtion Os_Test_EnblDsblHWIO_Nest_Interrupts_core() "); 
  TestStepAddActionExpected( chActionText, chExpectedText );
//  A_DBGR_R();
//  A_DBGR_Go();
  A_DBGR_VariableSet("SetCore2Flag", "1");
  A_DBGR_VariableSet("interruptWait", "0");
 E_DBGR_VariableCheck("interruptWait", 0, Equal);
  //A_DBGR_Go(); 
  
  /***************************************************************************************************************/    
        // Test Step 4 check the task counters for  the Core2 stopped.
  /***************************************************************************************************************/

  //Check All tasks of Core2 are stopped
  snprintf( chActionText, elCount(chActionText), "Check 2pt5ms Task Counter from Core2 "); 
  snprintf( chExpectedText, elCount(chExpectedText), "2pt5ms Counter from Core2 is stop incrementing"); 
  TestStepAddActionExpected( chActionText, chExpectedText );
  A_DBGR_VariableRead( "Task_Core2_2pt5ms_Count", taskvalue);
  E_DBGR_VariableCheck("Task_Core2_2pt5ms_Count", taskvalue, Equal);
  
  snprintf( chActionText, elCount(chActionText), "Check 5ms Task Counter from Core2 "); 
  snprintf( chExpectedText, elCount(chExpectedText), "5ms Counter from Core2 is stop incrementing"); 
  TestStepAddActionExpected( chActionText, chExpectedText );
  A_DBGR_VariableRead( "Task_Core2_5ms_Count", taskvalue);
  E_DBGR_VariableCheck("Task_Core2_5ms_Count", taskvalue, Equal);
  
  snprintf( chActionText, elCount(chActionText), "Check 10ms Task Counter from Core2 "); 
  snprintf( chExpectedText, elCount(chExpectedText), "10ms Counter from Core2 is stop incrementing"); 
  TestStepAddActionExpected( chActionText, chExpectedText );
  A_DBGR_VariableRead( "Task_Core2_10ms_Count", taskvalue);
  E_DBGR_VariableCheck("Task_Core2_10ms_Count", taskvalue, Equal);  
  
  snprintf( chActionText, elCount(chActionText), "Check 25ms Task Counter from Core2 "); 
  snprintf( chExpectedText, elCount(chExpectedText), "25ms Counter from Core2 is stop incrementing"); 
  TestStepAddActionExpected( chActionText, chExpectedText );
  A_DBGR_VariableRead( "Task_Core2_25ms_Count", taskvalue);
  E_DBGR_VariableCheck("Task_Core2_25ms_Count", taskvalue, Equal);  

  snprintf( chActionText, elCount(chActionText), "Check 50ms Task Counter from Core2 "); 
  snprintf( chExpectedText, elCount(chExpectedText), "50ms Counter from Core2 is stop incrementing"); 
  TestStepAddActionExpected( chActionText, chExpectedText );
  A_DBGR_VariableRead( "Task_Core2_50ms_Count", taskvalue);
  E_DBGR_VariableCheck("Task_Core2_50ms_Count", taskvalue, Equal);
  
  snprintf( chActionText, elCount(chActionText), "Check 250ms Task Counter from Core2 "); 
  snprintf( chExpectedText, elCount(chExpectedText), "250ms Counter from Core2 is stop incrementing"); 
  TestStepAddActionExpected( chActionText, chExpectedText );
  A_DBGR_VariableRead( "Task_Core2_250ms_Count", taskvalue);
  E_DBGR_VariableCheck("Task_Core2_250ms_Count", taskvalue, Equal);
  
  snprintf( chActionText, elCount(chActionText), "Check 100ms Task Counter from Core2 "); 
  snprintf( chExpectedText, elCount(chExpectedText), "100ms Counter from Core2 is stop incrementing"); 
  TestStepAddActionExpected( chActionText, chExpectedText );
  A_DBGR_VariableRead( "Task_Core2_100ms_Count", taskvalue);
  E_DBGR_VariableCheck("Task_Core2_100ms_Count", taskvalue, Equal); 

  snprintf( chActionText, elCount(chActionText), "Check 500ms Task Counter from Core2 "); 
  snprintf( chExpectedText, elCount(chExpectedText), "500ms Counter from Core2 is stop incrementing"); 
  TestStepAddActionExpected( chActionText, chExpectedText );
  A_DBGR_VariableRead( "Task_Core2_500ms_Count", taskvalue);
  E_DBGR_VariableCheck("Task_Core2_500ms_Count", taskvalue, Equal);
  
  snprintf( chActionText, elCount(chActionText), "Check 1000ms Task Counter from Core2 "); 
  snprintf( chExpectedText, elCount(chExpectedText), "1000ms Counter from Core2 is stop incrementing"); 
  TestStepAddActionExpected( chActionText, chExpectedText );
  A_DBGR_VariableRead( "Task_Core2_1000ms_Count", taskvalue);
  E_DBGR_VariableCheck("Task_Core2_1000ms_Count", taskvalue, Equal);
  
   //Check Core0 is running
  snprintf( chActionText, elCount(chActionText), "Check 1000ms Task Counter from Core0 "); 
  snprintf( chExpectedText, elCount(chExpectedText), "1000ms Counter from Core0 is incrementing"); 
  TestStepAddActionExpected( chActionText, chExpectedText );
  A_DBGR_VariableRead( "Task_Core0_1000ms_Count", taskvalue);
  E_DBGR_VariableCheck("Task_Core0_1000ms_Count", taskvalue, Greater);
  
  //Check Core1 is running
  snprintf( chActionText, elCount(chActionText), "Check 1000ms Task Counter from Core1 "); 
  snprintf( chExpectedText, elCount(chExpectedText), "1000ms Counter from Core1 is incrementing"); 
  TestStepAddActionExpected( chActionText, chExpectedText );
  A_DBGR_VariableRead( "Task_Core1_1000ms_Count", taskvalue);
  E_DBGR_VariableCheck("Task_Core1_1000ms_Count", taskvalue, Greater);
    
  //Check Core3 is running
  snprintf( chActionText, elCount(chActionText), "Check 1000ms Task Counter from Core3 "); 
  snprintf( chExpectedText, elCount(chExpectedText), "1000ms Counter from Core3 is incrementing"); 
  TestStepAddActionExpected( chActionText, chExpectedText );
  A_DBGR_VariableRead( "Task_Core3_1000ms_Count", taskvalue);
  E_DBGR_VariableCheck("Task_Core3_1000ms_Count", taskvalue, Greater);
    
  //Check Core4 is running
  snprintf( chActionText, elCount(chActionText), "Check 1000ms Task Counter from Core4 "); 
  snprintf( chExpectedText, elCount(chExpectedText), "1000ms Counter from Core4 is incrementing"); 
  TestStepAddActionExpected( chActionText, chExpectedText );
  A_DBGR_VariableRead( "Task_Core4_1000ms_Count", taskvalue);
  E_DBGR_VariableCheck("Task_Core4_1000ms_Count", taskvalue, Greater);
    
  //Check Core5 is running
  snprintf( chActionText, elCount(chActionText), "Check 1000ms Task Counter from Core5 "); 
  snprintf( chExpectedText, elCount(chExpectedText), "1000ms Counter from Core5 is incrementing"); 
  TestStepAddActionExpected( chActionText, chExpectedText );
  A_DBGR_VariableRead( "Task_Core5_1000ms_Count", taskvalue);
  E_DBGR_VariableCheck("Task_Core5_1000ms_Count", taskvalue, Greater);
  
  /*******************************************************************************************************************************************************/    
    // Test Step 4: set SetCore2Flag=0 to Disable funtion Os_Test_EnblDsblHWIO_Nest_Interrupts_core()
  /*******************************************************************************************************************************************************/
  snprintf( chActionText, elCount(chActionText), "set SetCore2Flag=0 to Disable funtion Os_Test_EnblDsblHWIO_Nest_Interrupts_core() "); 
  snprintf( chExpectedText, elCount(chExpectedText), "Verify SetCore2Flag=0 to Disable funtion Os_Test_EnblDsblHWIO_Nest_Interrupts_core() "); 
  TestStepAddActionExpected( chActionText, chExpectedText );
  
  A_DBGR_VariableSet("interruptWait", "1"); 
  E_DBGR_VariableCheck("interruptWait", 1, Equal);
  
    /***************************************************************************************************************/    
     // Test Step 6: Check all cores are in running state after interruptWait set to 1                                  
  /***************************************************************************************************************/
  
  //Check Core0 is running
  snprintf( chActionText, elCount(chActionText), "Check 1000ms Task Counter from Core0 "); 
  snprintf( chExpectedText, elCount(chExpectedText), "1000ms Counter from Core0 is incrementing"); 
  TestStepAddActionExpected( chActionText, chExpectedText );
  A_DBGR_VariableRead( "Task_Core0_1000ms_Count", taskvalue);
  E_DBGR_VariableCheck("Task_Core0_1000ms_Count", taskvalue, Greater);
  
  //Check Core1 is running
  snprintf( chActionText, elCount(chActionText), "Check 1000ms Task Counter from Core1 "); 
  snprintf( chExpectedText, elCount(chExpectedText), "1000ms Counter from Core1 is incrementing"); 
  TestStepAddActionExpected( chActionText, chExpectedText );
  A_DBGR_VariableRead( "Task_Core1_1000ms_Count", taskvalue);
  E_DBGR_VariableCheck("Task_Core1_1000ms_Count", taskvalue, Greater);
  
  //Check Core2 is running
  snprintf( chActionText, elCount(chActionText), "Check 1000ms Task Counter from Core2 "); 
  snprintf( chExpectedText, elCount(chExpectedText), "1000ms Counter from Core2 is incrementing"); 
  TestStepAddActionExpected( chActionText, chExpectedText );
  A_DBGR_VariableRead( "Task_Core2_1000ms_Count", taskvalue);
  E_DBGR_VariableCheck("Task_Core2_1000ms_Count", taskvalue, Greater);
    
  //Check Core3 is running
  snprintf( chActionText, elCount(chActionText), "Check 1000ms Task Counter from Core3 "); 
  snprintf( chExpectedText, elCount(chExpectedText), "1000ms Counter from Core3 is incrementing"); 
  TestStepAddActionExpected( chActionText, chExpectedText );
  A_DBGR_VariableRead( "Task_Core3_1000ms_Count", taskvalue);
  E_DBGR_VariableCheck("Task_Core3_1000ms_Count", taskvalue, Greater);
    
  //Check Core4 is running
  snprintf( chActionText, elCount(chActionText), "Check 1000ms Task Counter from Core4 "); 
  snprintf( chExpectedText, elCount(chExpectedText), "1000ms Counter from Core4 is incrementing"); 
  TestStepAddActionExpected( chActionText, chExpectedText );
  A_DBGR_VariableRead( "Task_Core4_1000ms_Count", taskvalue);
  E_DBGR_VariableCheck("Task_Core4_1000ms_Count", taskvalue, Greater);
    
  //Check Core5 is running
  snprintf( chActionText, elCount(chActionText), "Check 1000ms Task Counter from Core5 "); 
  snprintf( chExpectedText, elCount(chExpectedText), "1000ms Counter from Core5 is incrementing"); 
  TestStepAddActionExpected( chActionText, chExpectedText );
  A_DBGR_VariableRead( "Task_Core5_1000ms_Count", taskvalue);
  E_DBGR_VariableCheck("Task_Core5_1000ms_Count", taskvalue, Greater);
  
  
  snprintf( chActionText, elCount(chActionText), "Reset Conditions "); 
  snprintf( chExpectedText, elCount(chExpectedText), "Reset Conditions "); 
  TestStepAddActionExpected( chActionText, chExpectedText );
  A_DBGR_VariableSet("SetCore2Flag", "0"); 
  A_DBGR_VariableSet("interruptWait", "0"); 
  E_DBGR_VariableCheck("interruptWait", 0, Equal);
  
}

/***************************************************************************************************
----------------------------------------------------------------------------------------------------
Test case name:  TC_L30SW_Q-36649666: test_case_to_verify_the_functionality_of_interface_DsblHWIO_Interrupts()_to_prohibits_all_interrupts_from_pre-empting_the_core3_task_and_interrupt__for_CPU3
----------------------------------------------------------------------------------------------------
Description:  test_case_to_verify_the_functionality_of_interface_DsblHWIO_Interrupts()_to_prohibits_all_interrupts_from_pre-empting_the_core3_task_and_interrupt__for_CPU3

***************************************************************************************************/
testcase test_case_to_verify_the_functionality_of_interface_EnblHWIO_Interrupts_to_Enable_core3_task_and_interrupt_for_CPU3()
{
  /***************************************************************************************************************/    
                                                // Variable Definition
  /***************************************************************************************************************/ 
  
  long taskvalue;
  
  /***************************************************************************************************************/    
                                               // Local Values
  /***************************************************************************************************************/ 
  

  
  /***************************************************************************************************************/    
                                              // Test Case Info
  /***************************************************************************************************************/
  setWriteDbgLevel(DebugOff);
  snprintf( chTestTitle, elCount(chTestTitle), "test_case_to_verify_the_functionality_of_interface_EnblHWIO_Interrupts_to_Enable_core3_task_and_interrupt_for_CPU3" );
  snprintf( chTestDescription, elCount(chTestDescription), "Purpose: test_case_to_verify_the_functionality_of_interface_EnblHWIO_Interrupts_to_Enable_core3_task_and_interrupt_for_CPU3.");
  TestCaseAddInfo( chTestTitle, "TC_L30SW_Q-349666", chTestDescription );

  /***************************************************************************************************************/    
                                              // Start of Test Case
  /***************************************************************************************************************/
  
  /***************************************************************************************************************/    
                                              // Test Step 1 PRECONDITIONS
  /***************************************************************************************************************/
  
  snprintf( chActionText, elCount(chActionText), "Flash the Software and ECU is running"); 
  snprintf( chExpectedText, elCount(chExpectedText), "ECU should be in running state"); 
  TestStepAddActionExpected( chActionText, chExpectedText );

  A_DBGR_BreakpointDeleteAll();
  A_DBGR_RnGo();
  E_DBGR_CheckState(T32_State_Running);
  

   /***************************************************************************************************************/    
            // Test Step 2: Check all cores are in running state                                   
  /***************************************************************************************************************/
  
  //Check Core0 is running
  snprintf( chActionText, elCount(chActionText), "Check 1000ms Task Counter from Core0 "); 
  snprintf( chExpectedText, elCount(chExpectedText), "1000ms Counter from Core0 is incrementing"); 
  TestStepAddActionExpected( chActionText, chExpectedText );
  A_DBGR_VariableRead( "Task_Core0_1000ms_Count", taskvalue);
  E_DBGR_VariableCheck("Task_Core0_1000ms_Count", taskvalue, Greater);
  
  //Check Core1 is running
  snprintf( chActionText, elCount(chActionText), "Check 1000ms Task Counter from Core1 "); 
  snprintf( chExpectedText, elCount(chExpectedText), "1000ms Counter from Core1 is incrementing"); 
  TestStepAddActionExpected( chActionText, chExpectedText );
  A_DBGR_VariableRead( "Task_Core1_1000ms_Count", taskvalue);
  E_DBGR_VariableCheck("Task_Core1_1000ms_Count", taskvalue, Greater);
  
  //Check Core2 is running
  snprintf( chActionText, elCount(chActionText), "Check 1000ms Task Counter from Core2 "); 
  snprintf( chExpectedText, elCount(chExpectedText), "1000ms Counter from Core2 is incrementing"); 
  TestStepAddActionExpected( chActionText, chExpectedText );
  A_DBGR_VariableRead( "Task_Core2_1000ms_Count", taskvalue);
  E_DBGR_VariableCheck("Task_Core2_1000ms_Count", taskvalue, Greater);
    
  //Check Core3 is running
  snprintf( chActionText, elCount(chActionText), "Check 1000ms Task Counter from Core3 "); 
  snprintf( chExpectedText, elCount(chExpectedText), "1000ms Counter from Core3 is incrementing"); 
  TestStepAddActionExpected( chActionText, chExpectedText );
  A_DBGR_VariableRead( "Task_Core3_1000ms_Count", taskvalue);
  E_DBGR_VariableCheck("Task_Core3_1000ms_Count", taskvalue, Greater);
    
  //Check Core4 is running
  snprintf( chActionText, elCount(chActionText), "Check 1000ms Task Counter from Core4 "); 
  snprintf( chExpectedText, elCount(chExpectedText), "1000ms Counter from Core4 is incrementing"); 
  TestStepAddActionExpected( chActionText, chExpectedText );
  A_DBGR_VariableRead( "Task_Core4_1000ms_Count", taskvalue);
  E_DBGR_VariableCheck("Task_Core4_1000ms_Count", taskvalue, Greater);
    
  //Check Core5 is running
  snprintf( chActionText, elCount(chActionText), "Check 1000ms Task Counter from Core5 "); 
  snprintf( chExpectedText, elCount(chExpectedText), "1000ms Counter from Core5 is incrementing"); 
  TestStepAddActionExpected( chActionText, chExpectedText );
  A_DBGR_VariableRead( "Task_Core5_1000ms_Count", taskvalue);
  E_DBGR_VariableCheck("Task_Core5_1000ms_Count", taskvalue, Greater);
  
  /*******************************************************************************************************************************************************/    
    // Test Step 3: set SetCore3Flag=1 to Enable funtion Os_Test_EnblDsblHWIO_Nest_Interrupts_core()
  /*******************************************************************************************************************************************************/

  snprintf( chActionText, elCount(chActionText), "set SetCore3Flag=1 to Enable funtion Os_Test_EnblDsblHWIO_Nest_Interrupts_core() "); 
  snprintf( chExpectedText, elCount(chExpectedText), "Verify SetCore3Flag=1 to Enable funtion Os_Test_EnblDsblHWIO_Nest_Interrupts_core() "); 
  TestStepAddActionExpected( chActionText, chExpectedText );
//  A_DBGR_R();
//  A_DBGR_Go();
  A_DBGR_VariableSet("SetCore3Flag", "1");
  A_DBGR_VariableSet("interruptWait", "0");
  E_DBGR_VariableCheck("interruptWait", 0, Equal);
  //A_DBGR_VariableSet("interruptWait", "0"); 
  //A_DBGR_Go(); 
  
   
  /***************************************************************************************************************/    
        // Test Step 4 check the task counters for  the Core3 stopped.
  /***************************************************************************************************************/

  //Check All tasks of Core3 are stopped
  snprintf( chActionText, elCount(chActionText), "Check 2pt5ms Task Counter from Core3 "); 
  snprintf( chExpectedText, elCount(chExpectedText), "2pt5ms Counter from Core3 is stop incrementing"); 
  TestStepAddActionExpected( chActionText, chExpectedText );
  A_DBGR_VariableRead( "Task_Core3_2pt5ms_Count", taskvalue);
  E_DBGR_VariableCheck("Task_Core3_2pt5ms_Count", taskvalue, Equal);
  
  snprintf( chActionText, elCount(chActionText), "Check 5ms Task Counter from Core3 "); 
  snprintf( chExpectedText, elCount(chExpectedText), "5ms Counter from Core3 is stop incrementing"); 
  TestStepAddActionExpected( chActionText, chExpectedText );
  A_DBGR_VariableRead( "Task_Core3_5ms_Count", taskvalue);
  E_DBGR_VariableCheck("Task_Core3_5ms_Count", taskvalue, Equal);
  
  snprintf( chActionText, elCount(chActionText), "Check 10ms Task Counter from Core3 "); 
  snprintf( chExpectedText, elCount(chExpectedText), "10ms Counter from Core3 is stop incrementing"); 
  TestStepAddActionExpected( chActionText, chExpectedText );
  A_DBGR_VariableRead( "Task_Core3_10ms_Count", taskvalue);
  E_DBGR_VariableCheck("Task_Core3_10ms_Count", taskvalue, Equal);  
  
  snprintf( chActionText, elCount(chActionText), "Check 25ms Task Counter from Core3 "); 
  snprintf( chExpectedText, elCount(chExpectedText), "25ms Counter from Core3 is stop incrementing"); 
  TestStepAddActionExpected( chActionText, chExpectedText );
  A_DBGR_VariableRead( "Task_Core3_25ms_Count", taskvalue);
  E_DBGR_VariableCheck("Task_Core3_25ms_Count", taskvalue, Equal);  

  snprintf( chActionText, elCount(chActionText), "Check 50ms Task Counter from Core3 "); 
  snprintf( chExpectedText, elCount(chExpectedText), "50ms Counter from Core3 is stop incrementing"); 
  TestStepAddActionExpected( chActionText, chExpectedText );
  A_DBGR_VariableRead( "Task_Core3_50ms_Count", taskvalue);
  E_DBGR_VariableCheck("Task_Core3_50ms_Count", taskvalue, Equal);
  
  snprintf( chActionText, elCount(chActionText), "Check 250ms Task Counter from Core3 "); 
  snprintf( chExpectedText, elCount(chExpectedText), "250ms Counter from Core3 is stop incrementing"); 
  TestStepAddActionExpected( chActionText, chExpectedText );
  A_DBGR_VariableRead( "Task_Core3_250ms_Count", taskvalue);
  E_DBGR_VariableCheck("Task_Core3_250ms_Count", taskvalue, Equal);
  
  snprintf( chActionText, elCount(chActionText), "Check 100ms Task Counter from Core3 "); 
  snprintf( chExpectedText, elCount(chExpectedText), "100ms Counter from Core3 is stop incrementing"); 
  TestStepAddActionExpected( chActionText, chExpectedText );
  A_DBGR_VariableRead( "Task_Core3_100ms_Count", taskvalue);
  E_DBGR_VariableCheck("Task_Core3_100ms_Count", taskvalue, Equal); 

  snprintf( chActionText, elCount(chActionText), "Check 500ms Task Counter from Core3 "); 
  snprintf( chExpectedText, elCount(chExpectedText), "500ms Counter from Core3 is stop incrementing"); 
  TestStepAddActionExpected( chActionText, chExpectedText );
  A_DBGR_VariableRead( "Task_Core3_500ms_Count", taskvalue);
  E_DBGR_VariableCheck("Task_Core3_500ms_Count", taskvalue, Equal);
  
  snprintf( chActionText, elCount(chActionText), "Check 1000ms Task Counter from Core3 "); 
  snprintf( chExpectedText, elCount(chExpectedText), "1000ms Counter from Core3 is stop incrementing"); 
  TestStepAddActionExpected( chActionText, chExpectedText );
  A_DBGR_VariableRead( "Task_Core3_1000ms_Count", taskvalue);
  E_DBGR_VariableCheck("Task_Core3_1000ms_Count", taskvalue, Equal);
  
   //Check Core0 is running
  snprintf( chActionText, elCount(chActionText), "Check 1000ms Task Counter from Core0 "); 
  snprintf( chExpectedText, elCount(chExpectedText), "1000ms Counter from Core0 is incrementing"); 
  TestStepAddActionExpected( chActionText, chExpectedText );
  A_DBGR_VariableRead( "Task_Core0_1000ms_Count", taskvalue);
  E_DBGR_VariableCheck("Task_Core0_1000ms_Count", taskvalue, Greater);
  
  //Check Core1 is running
  snprintf( chActionText, elCount(chActionText), "Check 1000ms Task Counter from Core1 "); 
  snprintf( chExpectedText, elCount(chExpectedText), "1000ms Counter from Core1 is incrementing"); 
  TestStepAddActionExpected( chActionText, chExpectedText );
  A_DBGR_VariableRead( "Task_Core1_1000ms_Count", taskvalue);
  E_DBGR_VariableCheck("Task_Core1_1000ms_Count", taskvalue, Greater);
    
  //Check Core2 is running
  snprintf( chActionText, elCount(chActionText), "Check 1000ms Task Counter from Core2 "); 
  snprintf( chExpectedText, elCount(chExpectedText), "1000ms Counter from Core2 is incrementing"); 
  TestStepAddActionExpected( chActionText, chExpectedText );
  A_DBGR_VariableRead( "Task_Core2_1000ms_Count", taskvalue);
  E_DBGR_VariableCheck("Task_Core2_1000ms_Count", taskvalue, Greater);
    
  //Check Core4 is running
  snprintf( chActionText, elCount(chActionText), "Check 1000ms Task Counter from Core4 "); 
  snprintf( chExpectedText, elCount(chExpectedText), "1000ms Counter from Core4 is incrementing"); 
  TestStepAddActionExpected( chActionText, chExpectedText );
  A_DBGR_VariableRead( "Task_Core4_1000ms_Count", taskvalue);
  E_DBGR_VariableCheck("Task_Core4_1000ms_Count", taskvalue, Greater);
    
  //Check Core5 is running
  snprintf( chActionText, elCount(chActionText), "Check 1000ms Task Counter from Core5 "); 
  snprintf( chExpectedText, elCount(chExpectedText), "1000ms Counter from Core5 is incrementing"); 
  TestStepAddActionExpected( chActionText, chExpectedText );
  A_DBGR_VariableRead( "Task_Core5_1000ms_Count", taskvalue);
  E_DBGR_VariableCheck("Task_Core5_1000ms_Count", taskvalue, Greater);
  
  /*******************************************************************************************************************************************************/    
    // Test Step 5: set SetCore3Flag=0 to Disable funtion Os_Test_EnblDsblHWIO_Nest_Interrupts_core()
  /*******************************************************************************************************************************************************/
  snprintf( chActionText, elCount(chActionText), "set SetCore3Flag=0 to Disable funtion Os_Test_EnblDsblHWIO_Nest_Interrupts_core() "); 
  snprintf( chExpectedText, elCount(chExpectedText), "Verify SetCore3Flag=0 to Disable funtion Os_Test_EnblDsblHWIO_Nest_Interrupts_core() "); 
  TestStepAddActionExpected( chActionText, chExpectedText );
  
  A_DBGR_VariableSet("interruptWait", "1"); 
  E_DBGR_VariableCheck("interruptWait", 1, Equal);
  
    /***************************************************************************************************************/    
     // Test Step 6: Check all cores are in running state after interruptWait set to 1                                  
  /***************************************************************************************************************/
  
  //Check Core0 is running
  snprintf( chActionText, elCount(chActionText), "Check 1000ms Task Counter from Core0 "); 
  snprintf( chExpectedText, elCount(chExpectedText), "1000ms Counter from Core0 is incrementing"); 
  TestStepAddActionExpected( chActionText, chExpectedText );
  A_DBGR_VariableRead( "Task_Core0_1000ms_Count", taskvalue);
  E_DBGR_VariableCheck("Task_Core0_1000ms_Count", taskvalue, Greater);
  
  //Check Core1 is running
  snprintf( chActionText, elCount(chActionText), "Check 1000ms Task Counter from Core1 "); 
  snprintf( chExpectedText, elCount(chExpectedText), "1000ms Counter from Core1 is incrementing"); 
  TestStepAddActionExpected( chActionText, chExpectedText );
  A_DBGR_VariableRead( "Task_Core1_1000ms_Count", taskvalue);
  E_DBGR_VariableCheck("Task_Core1_1000ms_Count", taskvalue, Greater);
  
  //Check Core2 is running
  snprintf( chActionText, elCount(chActionText), "Check 1000ms Task Counter from Core2 "); 
  snprintf( chExpectedText, elCount(chExpectedText), "1000ms Counter from Core2 is incrementing"); 
  TestStepAddActionExpected( chActionText, chExpectedText );
  A_DBGR_VariableRead( "Task_Core2_1000ms_Count", taskvalue);
  E_DBGR_VariableCheck("Task_Core2_1000ms_Count", taskvalue, Greater);
    
  //Check Core3 is running
  snprintf( chActionText, elCount(chActionText), "Check 1000ms Task Counter from Core3 "); 
  snprintf( chExpectedText, elCount(chExpectedText), "1000ms Counter from Core3 is incrementing"); 
  TestStepAddActionExpected( chActionText, chExpectedText );
  A_DBGR_VariableRead( "Task_Core3_1000ms_Count", taskvalue);
  E_DBGR_VariableCheck("Task_Core3_1000ms_Count", taskvalue, Greater);
    
  //Check Core4 is running
  snprintf( chActionText, elCount(chActionText), "Check 1000ms Task Counter from Core4 "); 
  snprintf( chExpectedText, elCount(chExpectedText), "1000ms Counter from Core4 is incrementing"); 
  TestStepAddActionExpected( chActionText, chExpectedText );
  A_DBGR_VariableRead( "Task_Core4_1000ms_Count", taskvalue);
  E_DBGR_VariableCheck("Task_Core4_1000ms_Count", taskvalue, Greater);
    
  //Check Core5 is running
  snprintf( chActionText, elCount(chActionText), "Check 1000ms Task Counter from Core5 "); 
  snprintf( chExpectedText, elCount(chExpectedText), "1000ms Counter from Core5 is incrementing"); 
  TestStepAddActionExpected( chActionText, chExpectedText );
  A_DBGR_VariableRead( "Task_Core5_1000ms_Count", taskvalue);
  E_DBGR_VariableCheck("Task_Core5_1000ms_Count", taskvalue, Greater);
  
  
  snprintf( chActionText, elCount(chActionText), "Reset Conditions "); 
  snprintf( chExpectedText, elCount(chExpectedText), "Reset Conditions "); 
  TestStepAddActionExpected( chActionText, chExpectedText );
  A_DBGR_VariableSet("SetCore3Flag", "0"); 
  A_DBGR_VariableSet("interruptWait", "0"); 
  E_DBGR_VariableCheck("interruptWait", 0, Equal);
  
}

/***************************************************************************************************
----------------------------------------------------------------------------------------------------
Test case name:  TC_L30SW_Q-36649666: test_case_to_verify_the_functionality_of_interface_DsblHWIO_Interrupts()_to_prohibits_all_interrupts_from_pre-empting_the_core4_task_and_interrupt__for_CPU4
----------------------------------------------------------------------------------------------------
Description:  test_case_to_verify_the_functionality_of_interface_DsblHWIO_Interrupts()_to_prohibits_all_interrupts_from_pre-empting_the_core4_task_and_interrupt__for_CPU4

***************************************************************************************************/
testcase test_case_to_verify_the_functionality_of_interface_EnblHWIO_Interrupts_to_Enable_core4_task_and_interrupt_for_CPU4()
{
  /***************************************************************************************************************/    
                                                // Variable Definition
  /***************************************************************************************************************/ 
  
  long taskvalue;
  
  /***************************************************************************************************************/    
                                               // Local Values
  /***************************************************************************************************************/ 
  

  
  /***************************************************************************************************************/    
                                              // Test Case Info
  /***************************************************************************************************************/
  setWriteDbgLevel(DebugOff);
  snprintf( chTestTitle, elCount(chTestTitle), "test_case_to_verify_the_functionality_of_interface_EnblHWIO_Interrupts_to_Enable_core4_task_and_interrupt_for_CPU4" );
  snprintf( chTestDescription, elCount(chTestDescription), "Purpose: test_case_to_verify_the_functionality_of_interface_EnblHWIO_Interrupts_to_Enable_core4_task_and_interrupt_for_CPU4.");
  TestCaseAddInfo( chTestTitle, "TC_L30SW_Q-36649666", chTestDescription );

  /***************************************************************************************************************/    
                                              // Start of Test Case
  /***************************************************************************************************************/
  
  /***************************************************************************************************************/    
                                              // Test Step 1 PRECONDITIONS
  /***************************************************************************************************************/
  
  snprintf( chActionText, elCount(chActionText), "Flash the Software and ECU is running"); 
  snprintf( chExpectedText, elCount(chExpectedText), "ECU should be in running state"); 
  TestStepAddActionExpected( chActionText, chExpectedText );

  A_DBGR_BreakpointDeleteAll();
  A_DBGR_RnGo();
  E_DBGR_CheckState(T32_State_Running);
  

   /***************************************************************************************************************/    
            // Test Step 2: Check all cores are in running state                                   
  /***************************************************************************************************************/
  
  //Check Core0 is running
  snprintf( chActionText, elCount(chActionText), "Check 1000ms Task Counter from Core0 "); 
  snprintf( chExpectedText, elCount(chExpectedText), "1000ms Counter from Core0 is incrementing"); 
  TestStepAddActionExpected( chActionText, chExpectedText );
  A_DBGR_VariableRead( "Task_Core0_1000ms_Count", taskvalue);
  E_DBGR_VariableCheck("Task_Core0_1000ms_Count", taskvalue, Greater);
  
  //Check Core1 is running
  snprintf( chActionText, elCount(chActionText), "Check 1000ms Task Counter from Core1 "); 
  snprintf( chExpectedText, elCount(chExpectedText), "1000ms Counter from Core1 is incrementing"); 
  TestStepAddActionExpected( chActionText, chExpectedText );
  A_DBGR_VariableRead( "Task_Core1_1000ms_Count", taskvalue);
  E_DBGR_VariableCheck("Task_Core1_1000ms_Count", taskvalue, Greater);
  
  //Check Core2 is running
  snprintf( chActionText, elCount(chActionText), "Check 1000ms Task Counter from Core2 "); 
  snprintf( chExpectedText, elCount(chExpectedText), "1000ms Counter from Core2 is incrementing"); 
  TestStepAddActionExpected( chActionText, chExpectedText );
  A_DBGR_VariableRead( "Task_Core2_1000ms_Count", taskvalue);
  E_DBGR_VariableCheck("Task_Core2_1000ms_Count", taskvalue, Greater);
    
  //Check Core3 is running
  snprintf( chActionText, elCount(chActionText), "Check 1000ms Task Counter from Core3 "); 
  snprintf( chExpectedText, elCount(chExpectedText), "1000ms Counter from Core3 is incrementing"); 
  TestStepAddActionExpected( chActionText, chExpectedText );
  A_DBGR_VariableRead( "Task_Core3_1000ms_Count", taskvalue);
  E_DBGR_VariableCheck("Task_Core3_1000ms_Count", taskvalue, Greater);
    
  //Check Core4 is running
  snprintf( chActionText, elCount(chActionText), "Check 1000ms Task Counter from Core4 "); 
  snprintf( chExpectedText, elCount(chExpectedText), "1000ms Counter from Core4 is incrementing"); 
  TestStepAddActionExpected( chActionText, chExpectedText );
  A_DBGR_VariableRead( "Task_Core4_1000ms_Count", taskvalue);
  E_DBGR_VariableCheck("Task_Core4_1000ms_Count", taskvalue, Greater);
    
  //Check Core5 is running
  snprintf( chActionText, elCount(chActionText), "Check 1000ms Task Counter from Core5 "); 
  snprintf( chExpectedText, elCount(chExpectedText), "1000ms Counter from Core5 is incrementing"); 
  TestStepAddActionExpected( chActionText, chExpectedText );
  A_DBGR_VariableRead( "Task_Core5_1000ms_Count", taskvalue);
  E_DBGR_VariableCheck("Task_Core5_1000ms_Count", taskvalue, Greater);
  
  /*******************************************************************************************************************************************************/    
    // Test Step 3: set SetCore4Flag=1 to Enable funtion Os_Test_EnblDsblHWIO_Nest_Interrupts_core()
  /*******************************************************************************************************************************************************/

  snprintf( chActionText, elCount(chActionText), "set SetCore4Flag=1 to Enable funtion Os_Test_EnblDsblHWIO_Nest_Interrupts_core() "); 
  snprintf( chExpectedText, elCount(chExpectedText), "Verify SetCore4Flag=1 to Enable funtion Os_Test_EnblDsblHWIO_Nest_Interrupts_core() "); 
  TestStepAddActionExpected( chActionText, chExpectedText );
//  A_DBGR_R();
//  A_DBGR_Go();
  A_DBGR_VariableSet("SetCore4Flag", "1");
  A_DBGR_VariableSet("interruptWait", "0");
  E_DBGR_VariableCheck("interruptWait", 0, Equal);
  //A_DBGR_VariableSet("interruptWait", "0"); 
  //A_DBGR_Go(); 
  
   
  /***************************************************************************************************************/    
        // Test Step 4 check the task counters for  the Core4 stopped.
  /***************************************************************************************************************/

  //Check All tasks of Core4 are stopped
  
//  snprintf( chActionText, elCount(chActionText), "Check 2pt5ms Task Counter from Core4 "); 
//  snprintf( chExpectedText, elCount(chExpectedText), "2pt5ms Counter from Core4 is stop incrementing"); 
//  TestStepAddActionExpected( chActionText, chExpectedText );
//  A_DBGR_VariableRead( "Task_Core4_2pt5ms_Count", taskvalue);
//  E_DBGR_VariableCheck("Task_Core4_2pt5ms_Count", taskvalue, Equal);
  
//  snprintf( chActionText, elCount(chActionText), "Check 5ms Task Counter from Core4 "); 
//  snprintf( chExpectedText, elCount(chExpectedText), "5ms Counter from Core4 is stop incrementing"); 
//  TestStepAddActionExpected( chActionText, chExpectedText );
//  A_DBGR_VariableRead( "Task_Core4_5ms_Count", taskvalue);
//  E_DBGR_VariableCheck("Task_Core4_5ms_Count", taskvalue, Equal);
  
//  snprintf( chActionText, elCount(chActionText), "Check 10ms Task Counter from Core4 "); 
//  snprintf( chExpectedText, elCount(chExpectedText), "10ms Counter from Core4 is stop incrementing"); 
//  TestStepAddActionExpected( chActionText, chExpectedText );
//  A_DBGR_VariableRead( "Task_Core4_10ms_Count", taskvalue);
//  E_DBGR_VariableCheck("Task_Core4_10ms_Count", taskvalue, Equal);  
  
//  snprintf( chActionText, elCount(chActionText), "Check 25ms Task Counter from Core4 "); 
//  snprintf( chExpectedText, elCount(chExpectedText), "25ms Counter from Core4 is stop incrementing"); 
//  TestStepAddActionExpected( chActionText, chExpectedText );
//  A_DBGR_VariableRead( "Task_Core4_25ms_Count", taskvalue);
//  E_DBGR_VariableCheck("Task_Core4_25ms_Count", taskvalue, Equal);  

//  snprintf( chActionText, elCount(chActionText), "Check 50ms Task Counter from Core4 "); 
//  snprintf( chExpectedText, elCount(chExpectedText), "50ms Counter from Core4 is stop incrementing"); 
//  TestStepAddActionExpected( chActionText, chExpectedText );
//  A_DBGR_VariableRead( "Task_Core4_50ms_Count", taskvalue);
//  E_DBGR_VariableCheck("Task_Core4_50ms_Count", taskvalue, Equal);
  
//  snprintf( chActionText, elCount(chActionText), "Check 250ms Task Counter from Core4 "); 
//  snprintf( chExpectedText, elCount(chExpectedText), "250ms Counter from Core4 is stop incrementing"); 
//  TestStepAddActionExpected( chActionText, chExpectedText );
//  A_DBGR_VariableRead( "Task_Core4_250ms_Count", taskvalue);
//  E_DBGR_VariableCheck("Task_Core4_250ms_Count", taskvalue, Equal);
  
//  snprintf( chActionText, elCount(chActionText), "Check 100ms Task Counter from Core4 "); 
//  snprintf( chExpectedText, elCount(chExpectedText), "100ms Counter from Core4 is stop incrementing"); 
//  TestStepAddActionExpected( chActionText, chExpectedText );
//  A_DBGR_VariableRead( "Task_Core4_100ms_Count", taskvalue);
//  E_DBGR_VariableCheck("Task_Core4_100ms_Count", taskvalue, Equal); 

//  snprintf( chActionText, elCount(chActionText), "Check 500ms Task Counter from Core4 "); 
//  snprintf( chExpectedText, elCount(chExpectedText), "500ms Counter from Core4 is stop incrementing"); 
//  TestStepAddActionExpected( chActionText, chExpectedText );
//  A_DBGR_VariableRead( "Task_Core4_500ms_Count", taskvalue);
//  E_DBGR_VariableCheck("Task_Core4_500ms_Count", taskvalue, Equal);
  
  snprintf( chActionText, elCount(chActionText), "Check 1000ms Task Counter from Core4 "); 
  snprintf( chExpectedText, elCount(chExpectedText), "1000ms Counter from Core4 is stop incrementing"); 
  TestStepAddActionExpected( chActionText, chExpectedText );
  A_DBGR_VariableRead( "Task_Core4_1000ms_Count", taskvalue);
  E_DBGR_VariableCheck("Task_Core4_1000ms_Count", taskvalue, Equal);
  
   //Check Core0 is running
  snprintf( chActionText, elCount(chActionText), "Check 1000ms Task Counter from Core0 "); 
  snprintf( chExpectedText, elCount(chExpectedText), "1000ms Counter from Core0 is incrementing"); 
  TestStepAddActionExpected( chActionText, chExpectedText );
  A_DBGR_VariableRead( "Task_Core0_1000ms_Count", taskvalue);
  E_DBGR_VariableCheck("Task_Core0_1000ms_Count", taskvalue, Greater);
  
  //Check Core1 is running
  snprintf( chActionText, elCount(chActionText), "Check 1000ms Task Counter from Core1 "); 
  snprintf( chExpectedText, elCount(chExpectedText), "1000ms Counter from Core1 is incrementing"); 
  TestStepAddActionExpected( chActionText, chExpectedText );
  A_DBGR_VariableRead( "Task_Core1_1000ms_Count", taskvalue);
  E_DBGR_VariableCheck("Task_Core1_1000ms_Count", taskvalue, Greater);
    
  //Check Core2 is running
  snprintf( chActionText, elCount(chActionText), "Check 1000ms Task Counter from Core2 "); 
  snprintf( chExpectedText, elCount(chExpectedText), "1000ms Counter from Core2 is incrementing"); 
  TestStepAddActionExpected( chActionText, chExpectedText );
  A_DBGR_VariableRead( "Task_Core2_1000ms_Count", taskvalue);
  E_DBGR_VariableCheck("Task_Core2_1000ms_Count", taskvalue, Greater);
    
  //Check Core3 is running
  snprintf( chActionText, elCount(chActionText), "Check 1000ms Task Counter from Core3 "); 
  snprintf( chExpectedText, elCount(chExpectedText), "1000ms Counter from Core3 is incrementing"); 
  TestStepAddActionExpected( chActionText, chExpectedText );
  A_DBGR_VariableRead( "Task_Core3_1000ms_Count", taskvalue);
  E_DBGR_VariableCheck("Task_Core3_1000ms_Count", taskvalue, Greater);
    
  //Check Core5 is running
  snprintf( chActionText, elCount(chActionText), "Check 1000ms Task Counter from Core5 "); 
  snprintf( chExpectedText, elCount(chExpectedText), "1000ms Counter from Core5 is incrementing"); 
  TestStepAddActionExpected( chActionText, chExpectedText );
  A_DBGR_VariableRead( "Task_Core5_1000ms_Count", taskvalue);
  E_DBGR_VariableCheck("Task_Core5_1000ms_Count", taskvalue, Greater);
  
  /*******************************************************************************************************************************************************/    
    // Test Step 5: set SetCore4Flag=0 to Disable funtion Os_Test_EnblDsblHWIO_Nest_Interrupts_core()
  /*******************************************************************************************************************************************************/
  snprintf( chActionText, elCount(chActionText), "set SetCore4Flag=0 to Disable funtion Os_Test_EnblDsblHWIO_Nest_Interrupts_core() "); 
  snprintf( chExpectedText, elCount(chExpectedText), "Verify SetCore4Flag=0 to Disable funtion Os_Test_EnblDsblHWIO_Nest_Interrupts_core() "); 
  TestStepAddActionExpected( chActionText, chExpectedText );
  
  A_DBGR_VariableSet("interruptWait", "1"); 
  E_DBGR_VariableCheck("interruptWait", 1, Equal);
  
    /***************************************************************************************************************/    
     // Test Step 6: Check all cores are in running state after interruptWait set to 1                                  
  /***************************************************************************************************************/
  
  //Check Core0 is running
  snprintf( chActionText, elCount(chActionText), "Check 1000ms Task Counter from Core0 "); 
  snprintf( chExpectedText, elCount(chExpectedText), "1000ms Counter from Core0 is incrementing"); 
  TestStepAddActionExpected( chActionText, chExpectedText );
  A_DBGR_VariableRead( "Task_Core0_1000ms_Count", taskvalue);
  E_DBGR_VariableCheck("Task_Core0_1000ms_Count", taskvalue, Greater);
  
  //Check Core1 is running
  snprintf( chActionText, elCount(chActionText), "Check 1000ms Task Counter from Core1 "); 
  snprintf( chExpectedText, elCount(chExpectedText), "1000ms Counter from Core1 is incrementing"); 
  TestStepAddActionExpected( chActionText, chExpectedText );
  A_DBGR_VariableRead( "Task_Core1_1000ms_Count", taskvalue);
  E_DBGR_VariableCheck("Task_Core1_1000ms_Count", taskvalue, Greater);
  
  //Check Core2 is running
  snprintf( chActionText, elCount(chActionText), "Check 1000ms Task Counter from Core2 "); 
  snprintf( chExpectedText, elCount(chExpectedText), "1000ms Counter from Core2 is incrementing"); 
  TestStepAddActionExpected( chActionText, chExpectedText );
  A_DBGR_VariableRead( "Task_Core2_1000ms_Count", taskvalue);
  E_DBGR_VariableCheck("Task_Core2_1000ms_Count", taskvalue, Greater);
    
  //Check Core3 is running
  snprintf( chActionText, elCount(chActionText), "Check 1000ms Task Counter from Core3 "); 
  snprintf( chExpectedText, elCount(chExpectedText), "1000ms Counter from Core3 is incrementing"); 
  TestStepAddActionExpected( chActionText, chExpectedText );
  A_DBGR_VariableRead( "Task_Core3_1000ms_Count", taskvalue);
  E_DBGR_VariableCheck("Task_Core3_1000ms_Count", taskvalue, Greater);
    
  //Check Core4 is running
  snprintf( chActionText, elCount(chActionText), "Check 1000ms Task Counter from Core4 "); 
  snprintf( chExpectedText, elCount(chExpectedText), "1000ms Counter from Core4 is incrementing"); 
  TestStepAddActionExpected( chActionText, chExpectedText );
  A_DBGR_VariableRead( "Task_Core4_1000ms_Count", taskvalue);
  E_DBGR_VariableCheck("Task_Core4_1000ms_Count", taskvalue, Greater);
    
  //Check Core5 is running
  snprintf( chActionText, elCount(chActionText), "Check 1000ms Task Counter from Core5 "); 
  snprintf( chExpectedText, elCount(chExpectedText), "1000ms Counter from Core5 is incrementing"); 
  TestStepAddActionExpected( chActionText, chExpectedText );
  A_DBGR_VariableRead( "Task_Core5_1000ms_Count", taskvalue);
  E_DBGR_VariableCheck("Task_Core5_1000ms_Count", taskvalue, Greater);
  
  
  snprintf( chActionText, elCount(chActionText), "Reset Conditions "); 
  snprintf( chExpectedText, elCount(chExpectedText), "Reset Conditions "); 
  TestStepAddActionExpected( chActionText, chExpectedText );
  A_DBGR_VariableSet("SetCore4Flag", "0"); 
  A_DBGR_VariableSet("interruptWait", "0"); 
  E_DBGR_VariableCheck("interruptWait", 0, Equal);

  
}

/***************************************************************************************************
----------------------------------------------------------------------------------------------------
Test case name:  TC_L30SW_Q-36649666: test_case_to_verify_the_functionality_of_interface_DsblHWIO_Interrupts()_to_prohibits_all_interrupts_from_pre-empting_the_Core5_task_and_interrupt__for_CPU5
----------------------------------------------------------------------------------------------------
Description:  test_case_to_verify_the_functionality_of_interface_DsblHWIO_Interrupts()_to_prohibits_all_interrupts_from_pre-empting_the_Core5_task_and_interrupt__for_CPU5

***************************************************************************************************/
testcase test_case_to_verify_the_functionality_of_interface_EnblHWIO_Interrupts_to_Enable_core5_task_and_interrupt_for_CPU5()
{
  /***************************************************************************************************************/    
                                                // Variable Definition
  /***************************************************************************************************************/ 
  
  long taskvalue;
  
  /***************************************************************************************************************/    
                                               // Local Values
  /***************************************************************************************************************/ 
  

  
  /***************************************************************************************************************/    
                                              // Test Case Info
  /***************************************************************************************************************/
  setWriteDbgLevel(DebugOff);
  snprintf( chTestTitle, elCount(chTestTitle), "test_case_to_verify_the_functionality_of_interface_EnblHWIO_Interrupts_to_Enable_core5_task_and_interrupt_for_CPU5" );
  snprintf( chTestDescription, elCount(chTestDescription), "Purpose: test_case_to_verify_the_functionality_of_interface_EnblHWIO_Interrupts_to_Enable_core5_task_and_interrupt_for_CPU5.");
  TestCaseAddInfo( chTestTitle, "TC_L30SW_Q-366466", chTestDescription );

  /***************************************************************************************************************/    
                                              // Start of Test Case
  /***************************************************************************************************************/
  
  /***************************************************************************************************************/    
                                              // Test Step 1 PRECONDITIONS
  /***************************************************************************************************************/
  
  snprintf( chActionText, elCount(chActionText), "Flash the Software and ECU is running"); 
  snprintf( chExpectedText, elCount(chExpectedText), "ECU should be in running state"); 
  TestStepAddActionExpected( chActionText, chExpectedText );

  A_DBGR_BreakpointDeleteAll();
  A_DBGR_RnGo();
  E_DBGR_CheckState(T32_State_Running);
  

   /***************************************************************************************************************/    
            // Test Step 2: Check all cores are in running state                                   
  /***************************************************************************************************************/
  
  //Check Core0 is running
  snprintf( chActionText, elCount(chActionText), "Check 1000ms Task Counter from Core0 "); 
  snprintf( chExpectedText, elCount(chExpectedText), "1000ms Counter from Core0 is incrementing"); 
  TestStepAddActionExpected( chActionText, chExpectedText );
  A_DBGR_VariableRead( "Task_Core0_1000ms_Count", taskvalue);
  E_DBGR_VariableCheck("Task_Core0_1000ms_Count", taskvalue, Greater);
  
  //Check Core1 is running
  snprintf( chActionText, elCount(chActionText), "Check 1000ms Task Counter from Core1 "); 
  snprintf( chExpectedText, elCount(chExpectedText), "1000ms Counter from Core1 is incrementing"); 
  TestStepAddActionExpected( chActionText, chExpectedText );
  A_DBGR_VariableRead( "Task_Core1_1000ms_Count", taskvalue);
  E_DBGR_VariableCheck("Task_Core1_1000ms_Count", taskvalue, Greater);
  
  //Check Core2 is running
  snprintf( chActionText, elCount(chActionText), "Check 1000ms Task Counter from Core2 "); 
  snprintf( chExpectedText, elCount(chExpectedText), "1000ms Counter from Core2 is incrementing"); 
  TestStepAddActionExpected( chActionText, chExpectedText );
  A_DBGR_VariableRead( "Task_Core2_1000ms_Count", taskvalue);
  E_DBGR_VariableCheck("Task_Core2_1000ms_Count", taskvalue, Greater);
    
  //Check Core3 is running
  snprintf( chActionText, elCount(chActionText), "Check 1000ms Task Counter from Core3 "); 
  snprintf( chExpectedText, elCount(chExpectedText), "1000ms Counter from Core3 is incrementing"); 
  TestStepAddActionExpected( chActionText, chExpectedText );
  A_DBGR_VariableRead( "Task_Core3_1000ms_Count", taskvalue);
  E_DBGR_VariableCheck("Task_Core3_1000ms_Count", taskvalue, Greater);
    
  //Check Core4 is running
  snprintf( chActionText, elCount(chActionText), "Check 1000ms Task Counter from Core4 "); 
  snprintf( chExpectedText, elCount(chExpectedText), "1000ms Counter from Core4 is incrementing"); 
  TestStepAddActionExpected( chActionText, chExpectedText );
  A_DBGR_VariableRead( "Task_Core4_1000ms_Count", taskvalue);
  E_DBGR_VariableCheck("Task_Core4_1000ms_Count", taskvalue, Greater);
    
  //Check Core5 is running
  snprintf( chActionText, elCount(chActionText), "Check 1000ms Task Counter from Core5 "); 
  snprintf( chExpectedText, elCount(chExpectedText), "1000ms Counter from Core5 is incrementing"); 
  TestStepAddActionExpected( chActionText, chExpectedText );
  A_DBGR_VariableRead( "Task_Core5_1000ms_Count", taskvalue);
  E_DBGR_VariableCheck("Task_Core5_1000ms_Count", taskvalue, Greater);
  
  /*******************************************************************************************************************************************************/    
    // Test Step 3: set SetCore5Flag=1 to Enable funtion Os_Test_EnblDsblHWIO_Nest_Interrupts_core()
  /*******************************************************************************************************************************************************/

  snprintf( chActionText, elCount(chActionText), "set SetCore5Flag=1 to Enable funtion Os_Test_EnblDsblHWIO_Nest_Interrupts_core() "); 
  snprintf( chExpectedText, elCount(chExpectedText), "Verify SetCore5Flag=1 to Enable funtion Os_Test_EnblDsblHWIO_Nest_Interrupts_core() "); 
  TestStepAddActionExpected( chActionText, chExpectedText );
//  A_DBGR_R();
//  A_DBGR_Go();
  A_DBGR_VariableSet("SetCore5Flag", "1");
  A_DBGR_VariableSet("interruptWait", "0");
  E_DBGR_VariableCheck("interruptWait", 0, Equal);
  //A_DBGR_VariableSet("interruptWait", "0"); 
  //A_DBGR_Go(); 
  
   
  /***************************************************************************************************************/    
        // Test Step 4 check the task counters for  the Core5 stopped.
  /***************************************************************************************************************/

  //Check All tasks of Core5 are stopped
  snprintf( chActionText, elCount(chActionText), "Check 2pt5ms Task Counter from Core5 "); 
//  snprintf( chExpectedText, elCount(chExpectedText), "2pt5ms Counter from Core5 is stop incrementing"); 
//  //TestStepAddActionExpected( chActionText, chExpectedText );
//  A_DBGR_VariableRead( "Task_Core5_2pt5ms_Count", taskvalue);
//  E_DBGR_VariableCheck("Task_Core5_2pt5ms_Count", taskvalue, Equal);
  
//  snprintf( chActionText, elCount(chActionText), "Check 5ms Task Counter from Core5 "); 
//  snprintf( chExpectedText, elCount(chExpectedText), "5ms Counter from Core5 is stop incrementing"); 
//  TestStepAddActionExpected( chActionText, chExpectedText );
//  A_DBGR_VariableRead( "Task_Core5_5ms_Count", taskvalue);
//  E_DBGR_VariableCheck("Task_Core5_5ms_Count", taskvalue, Equal);
  
//  snprintf( chActionText, elCount(chActionText), "Check 10ms Task Counter from Core5 "); 
//  snprintf( chExpectedText, elCount(chExpectedText), "10ms Counter from Core5 is stop incrementing"); 
//  TestStepAddActionExpected( chActionText, chExpectedText );
//  A_DBGR_VariableRead( "Task_Core5_10ms_Count", taskvalue);
//  E_DBGR_VariableCheck("Task_Core5_10ms_Count", taskvalue, Equal);  
  
//  snprintf( chActionText, elCount(chActionText), "Check 25ms Task Counter from Core5 "); 
//  snprintf( chExpectedText, elCount(chExpectedText), "25ms Counter from Core5 is stop incrementing"); 
//  TestStepAddActionExpected( chActionText, chExpectedText );
//  A_DBGR_VariableRead( "Task_Core5_25ms_Count", taskvalue);
//  E_DBGR_VariableCheck("Task_Core5_25ms_Count", taskvalue, Equal);  

//  snprintf( chActionText, elCount(chActionText), "Check 50ms Task Counter from Core5 "); 
//  snprintf( chExpectedText, elCount(chExpectedText), "50ms Counter from Core5 is stop incrementing"); 
//  TestStepAddActionExpected( chActionText, chExpectedText );
//  A_DBGR_VariableRead( "Task_Core5_50ms_Count", taskvalue);
//  E_DBGR_VariableCheck("Task_Core5_50ms_Count", taskvalue, Equal);
  
//  snprintf( chActionText, elCount(chActionText), "Check 250ms Task Counter from Core5 "); 
//  snprintf( chExpectedText, elCount(chExpectedText), "250ms Counter from Core5 is stop incrementing"); 
//  TestStepAddActionExpected( chActionText, chExpectedText );
//  A_DBGR_VariableRead( "Task_Core5_250ms_Count", taskvalue);
//  E_DBGR_VariableCheck("Task_Core5_250ms_Count", taskvalue, Equal);
  
//  snprintf( chActionText, elCount(chActionText), "Check 100ms Task Counter from Core5 "); 
//  snprintf( chExpectedText, elCount(chExpectedText), "100ms Counter from Core5 is stop incrementing"); 
//  TestStepAddActionExpected( chActionText, chExpectedText );
//  A_DBGR_VariableRead( "Task_Core5_100ms_Count", taskvalue);
//  E_DBGR_VariableCheck("Task_Core5_100ms_Count", taskvalue, Equal); 

//  snprintf( chActionText, elCount(chActionText), "Check 500ms Task Counter from Core5 "); 
//  snprintf( chExpectedText, elCount(chExpectedText), "500ms Counter from Core5 is stop incrementing"); 
//  TestStepAddActionExpected( chActionText, chExpectedText );
//  A_DBGR_VariableRead( "Task_Core5_500ms_Count", taskvalue);
//  E_DBGR_VariableCheck("Task_Core5_500ms_Count", taskvalue, Equal);
  
  snprintf( chActionText, elCount(chActionText), "Check 1000ms Task Counter from Core5 "); 
  snprintf( chExpectedText, elCount(chExpectedText), "1000ms Counter from Core5 is stop incrementing"); 
  TestStepAddActionExpected( chActionText, chExpectedText );
  A_DBGR_VariableRead( "Task_Core5_1000ms_Count", taskvalue);
  E_DBGR_VariableCheck("Task_Core5_1000ms_Count", taskvalue, Equal);
  
   //Check Core0 is running
  snprintf( chActionText, elCount(chActionText), "Check 1000ms Task Counter from Core0 "); 
  snprintf( chExpectedText, elCount(chExpectedText), "1000ms Counter from Core0 is incrementing"); 
  TestStepAddActionExpected( chActionText, chExpectedText );
  A_DBGR_VariableRead( "Task_Core0_1000ms_Count", taskvalue);
  E_DBGR_VariableCheck("Task_Core0_1000ms_Count", taskvalue, Greater);
  
  //Check Core1 is running
  snprintf( chActionText, elCount(chActionText), "Check 1000ms Task Counter from Core1 "); 
  snprintf( chExpectedText, elCount(chExpectedText), "1000ms Counter from Core1 is incrementing"); 
  TestStepAddActionExpected( chActionText, chExpectedText );
  A_DBGR_VariableRead( "Task_Core1_1000ms_Count", taskvalue);
  E_DBGR_VariableCheck("Task_Core1_1000ms_Count", taskvalue, Greater);
    
  //Check Core2 is running
  snprintf( chActionText, elCount(chActionText), "Check 1000ms Task Counter from Core2 "); 
  snprintf( chExpectedText, elCount(chExpectedText), "1000ms Counter from Core2 is incrementing"); 
  TestStepAddActionExpected( chActionText, chExpectedText );
  A_DBGR_VariableRead( "Task_Core2_1000ms_Count", taskvalue);
  E_DBGR_VariableCheck("Task_Core2_1000ms_Count", taskvalue, Greater);
    
  //Check Core3 is running
  snprintf( chActionText, elCount(chActionText), "Check 1000ms Task Counter from Core3 "); 
  snprintf( chExpectedText, elCount(chExpectedText), "1000ms Counter from Core3 is incrementing"); 
  TestStepAddActionExpected( chActionText, chExpectedText );
  A_DBGR_VariableRead( "Task_Core3_1000ms_Count", taskvalue);
  E_DBGR_VariableCheck("Task_Core3_1000ms_Count", taskvalue, Greater);
    
  //Check Core4 is running
  snprintf( chActionText, elCount(chActionText), "Check 1000ms Task Counter from Core4 "); 
  snprintf( chExpectedText, elCount(chExpectedText), "1000ms Counter from Core5 is incrementing"); 
  TestStepAddActionExpected( chActionText, chExpectedText );
  A_DBGR_VariableRead( "Task_Core4_1000ms_Count", taskvalue);
  E_DBGR_VariableCheck("Task_Core4_1000ms_Count", taskvalue, Greater);
  
  /*******************************************************************************************************************************************************/    
    // Test Step 5: set SetCore5Flag=0 to Disable funtion Os_Test_EnblDsblHWIO_Nest_Interrupts_core()
  /*******************************************************************************************************************************************************/
  snprintf( chActionText, elCount(chActionText), "set SetCore5Flag=0 to Disable funtion Os_Test_EnblDsblHWIO_Nest_Interrupts_core() "); 
  snprintf( chExpectedText, elCount(chExpectedText), "Verify SetCore5Flag=0 to Disable funtion Os_Test_EnblDsblHWIO_Nest_Interrupts_core() "); 
  TestStepAddActionExpected( chActionText, chExpectedText );
  
  A_DBGR_VariableSet("interruptWait", "1"); 
  E_DBGR_VariableCheck("interruptWait", 1, Equal);
  
    /***************************************************************************************************************/    
     // Test Step 6: Check all cores are in running state after interruptWait set to 1                                  
  /***************************************************************************************************************/
  
  //Check Core0 is running
  snprintf( chActionText, elCount(chActionText), "Check 1000ms Task Counter from Core0 "); 
  snprintf( chExpectedText, elCount(chExpectedText), "1000ms Counter from Core0 is incrementing"); 
  TestStepAddActionExpected( chActionText, chExpectedText );
  A_DBGR_VariableRead( "Task_Core0_1000ms_Count", taskvalue);
  E_DBGR_VariableCheck("Task_Core0_1000ms_Count", taskvalue, Greater);
  
  //Check Core1 is running
  snprintf( chActionText, elCount(chActionText), "Check 1000ms Task Counter from Core1 "); 
  snprintf( chExpectedText, elCount(chExpectedText), "1000ms Counter from Core1 is incrementing"); 
  TestStepAddActionExpected( chActionText, chExpectedText );
  A_DBGR_VariableRead( "Task_Core1_1000ms_Count", taskvalue);
  E_DBGR_VariableCheck("Task_Core1_1000ms_Count", taskvalue, Greater);
  
  //Check Core2 is running
  snprintf( chActionText, elCount(chActionText), "Check 1000ms Task Counter from Core2 "); 
  snprintf( chExpectedText, elCount(chExpectedText), "1000ms Counter from Core2 is incrementing"); 
  TestStepAddActionExpected( chActionText, chExpectedText );
  A_DBGR_VariableRead( "Task_Core2_1000ms_Count", taskvalue);
  E_DBGR_VariableCheck("Task_Core2_1000ms_Count", taskvalue, Greater);
    
  //Check Core3 is running
  snprintf( chActionText, elCount(chActionText), "Check 1000ms Task Counter from Core3 "); 
  snprintf( chExpectedText, elCount(chExpectedText), "1000ms Counter from Core3 is incrementing"); 
  TestStepAddActionExpected( chActionText, chExpectedText );
  A_DBGR_VariableRead( "Task_Core3_1000ms_Count", taskvalue);
  E_DBGR_VariableCheck("Task_Core3_1000ms_Count", taskvalue, Greater);
    
  //Check Core4 is running
  snprintf( chActionText, elCount(chActionText), "Check 1000ms Task Counter from Core4 "); 
  snprintf( chExpectedText, elCount(chExpectedText), "1000ms Counter from Core4 is incrementing"); 
  TestStepAddActionExpected( chActionText, chExpectedText );
  A_DBGR_VariableRead( "Task_Core4_1000ms_Count", taskvalue);
  E_DBGR_VariableCheck("Task_Core4_1000ms_Count", taskvalue, Greater);
    
  //Check Core5 is running
  snprintf( chActionText, elCount(chActionText), "Check 1000ms Task Counter from Core5 "); 
  snprintf( chExpectedText, elCount(chExpectedText), "1000ms Counter from Core5 is incrementing"); 
  TestStepAddActionExpected( chActionText, chExpectedText );
  A_DBGR_VariableRead( "Task_Core5_1000ms_Count", taskvalue);
  E_DBGR_VariableCheck("Task_Core5_1000ms_Count", taskvalue, Greater);
  
  
  snprintf( chActionText, elCount(chActionText), "Reset Conditions "); 
  snprintf( chExpectedText, elCount(chExpectedText), "Reset Conditions "); 
  TestStepAddActionExpected( chActionText, chExpectedText );
  A_DBGR_VariableSet("SetCore5Flag", "0"); 
  A_DBGR_VariableSet("interruptWait", "0"); 
  E_DBGR_VariableCheck("interruptWait", 0, Equal);
  
}

/***************************************************************************************************
----------------------------------------------------------------------------------------------------
Test case name:  TC_L30SW_QT_36832677: test_case_to_verify_the_functionality_of_interface_DsblHWIO_Interrupts()_to_prohibits_all_interrupts_from_pre-empting_the_Core5_task_and_interrupt__for_CPU5
----------------------------------------------------------------------------------------------------
Description:  test_case_to_verify_the_functionality_of_interface_DsblHWIO_Interrupts()_to_prohibits_all_interrupts_from_pre-empting_the_Core5_task_and_interrupt__for_CPU5

***************************************************************************************************/
testcase test_case_to_verify_the_functionality_of_interface_GetHWIO_Pct_CPU_Utilization_to_check_percentage_of_CPU_utilization_for_core0()
{
  /***************************************************************************************************************/    
                                                // Variable Definition
  /***************************************************************************************************************/ 
  
  long taskvalue;
  float CPUUtilization, CPUUtilization_before_delay, CPUUtilization_after_delay;
  
  
  /***************************************************************************************************************/    
                                               // Local Values
  /***************************************************************************************************************/ 
  

  
  /***************************************************************************************************************/    
                                              // Test Case Info
  /***************************************************************************************************************/
  setWriteDbgLevel(DebugOff);
  snprintf( chTestTitle, elCount(chTestTitle), "test_case_to_verify_the_functionality_of_interface_GetHWIO_Pct_CPU_Utilization_to_check_percentage_of_CPU_utilization_for_core0" );
  snprintf( chTestDescription, elCount(chTestDescription), "Purpose: test_case_to_verify_the_functionality_of_interface_GetHWIO_Pct_CPU_Utilization_to_check_percentage_of_CPU_utilization_for_core0.");
  TestCaseAddInfo( chTestTitle, "TC_L30SW_QT_36832677", chTestDescription );

  /***************************************************************************************************************/    
                                              // Start of Test Case
  /***************************************************************************************************************/
  
  /***************************************************************************************************************/    
                                              // Test Step 1 PRECONDITIONS
  /***************************************************************************************************************/
  
  snprintf( chActionText, elCount(chActionText), "Flash the Software and ECU is running"); 
  snprintf( chExpectedText, elCount(chExpectedText), "ECU should be in running state"); 
  TestStepAddActionExpected( chActionText, chExpectedText );

  A_DBGR_BreakpointDeleteAll();
  A_DBGR_RnGo();
  E_DBGR_CheckState(T32_State_Running);
  

   /***************************************************************************************************************/    
            // Test Step 2: Check all cores are in running state                                   
  /***************************************************************************************************************/
  
  //Check Core0 is running
  snprintf( chActionText, elCount(chActionText), "Check 1000ms Task Counter from Core0 "); 
  snprintf( chExpectedText, elCount(chExpectedText), "1000ms Counter from Core0 is incrementing"); 
  TestStepAddActionExpected( chActionText, chExpectedText );
  A_DBGR_VariableRead( "Task_Core0_1000ms_Count", taskvalue);
  E_DBGR_VariableCheck("Task_Core0_1000ms_Count", taskvalue, Greater);
  
  //Check Core1 is running
  snprintf( chActionText, elCount(chActionText), "Check 1000ms Task Counter from Core1 "); 
  snprintf( chExpectedText, elCount(chExpectedText), "1000ms Counter from Core1 is incrementing"); 
  TestStepAddActionExpected( chActionText, chExpectedText );
  A_DBGR_VariableRead( "Task_Core1_1000ms_Count", taskvalue);
  E_DBGR_VariableCheck("Task_Core1_1000ms_Count", taskvalue, Greater);
  
  //Check Core2 is running
  snprintf( chActionText, elCount(chActionText), "Check 1000ms Task Counter from Core2 "); 
  snprintf( chExpectedText, elCount(chExpectedText), "1000ms Counter from Core2 is incrementing"); 
  TestStepAddActionExpected( chActionText, chExpectedText );
  A_DBGR_VariableRead( "Task_Core2_1000ms_Count", taskvalue);
  E_DBGR_VariableCheck("Task_Core2_1000ms_Count", taskvalue, Greater);
    
  //Check Core3 is running
  snprintf( chActionText, elCount(chActionText), "Check 1000ms Task Counter from Core3 "); 
  snprintf( chExpectedText, elCount(chExpectedText), "1000ms Counter from Core3 is incrementing"); 
  TestStepAddActionExpected( chActionText, chExpectedText );
  A_DBGR_VariableRead( "Task_Core3_1000ms_Count", taskvalue);
  E_DBGR_VariableCheck("Task_Core3_1000ms_Count", taskvalue, Greater);
    
  //Check Core4 is running
  snprintf( chActionText, elCount(chActionText), "Check 1000ms Task Counter from Core4 "); 
  snprintf( chExpectedText, elCount(chExpectedText), "1000ms Counter from Core4 is incrementing"); 
  TestStepAddActionExpected( chActionText, chExpectedText );
  A_DBGR_VariableRead( "Task_Core4_1000ms_Count", taskvalue);
  E_DBGR_VariableCheck("Task_Core4_1000ms_Count", taskvalue, Greater);
    
  //Check Core5 is running
  snprintf( chActionText, elCount(chActionText), "Check 1000ms Task Counter from Core5 "); 
  snprintf( chExpectedText, elCount(chExpectedText), "1000ms Counter from Core5 is incrementing"); 
  TestStepAddActionExpected( chActionText, chExpectedText );
  A_DBGR_VariableRead( "Task_Core5_1000ms_Count", taskvalue);
  E_DBGR_VariableCheck("Task_Core5_1000ms_Count", taskvalue, Greater);
  
   /*******************************************************************************************************************************************************/    
    // Test Step 3: Set CpuUtilization for Core0
  /*******************************************************************************************************************************************************/ 
  
  snprintf( chActionText, elCount(chActionText), "Set CpuUtilization for Core0"); 
  snprintf( chExpectedText, elCount(chExpectedText), "Set CpuUtilization for Core0"); 
  TestStepAddActionExpected( chActionText, chExpectedText );
  A_DBGR_VariableSet("CPU_Utilization_Core0", "1");
  E_DBGR_VariableCheck("CPU_Utilization_Core0", 1, Equal);
  
  /******************************************************************************************************************************************************/    
    // Test Step 4: Read CpuUtilization for Core 0
  /*******************************************************************************************************************************************************/

  snprintf( chActionText, elCount(chActionText), "Call funtion Os_Test_GetHWIO_Pct_CPU_Utilization() "); 
  snprintf( chExpectedText, elCount(chExpectedText), "Verify CpuUtilization  variable in funtion Os_Test_GetHWIO_Pct_CPU_Utilization() "); 
  TestStepAddActionExpected( chActionText, chExpectedText );
  A_DBGR_VariableRead("CpuUtilization", taskvalue);
  E_DBGR_VariableCheck("CPU_Utilization_Core0", 1, Equal);
    
  CPUUtilization_before_delay=taskvalue*(0.003051);
  write("CPUUtilization_before_delay is %f",CPUUtilization_before_delay);
  
  /******************************************************************************************************************************************************/ 
 // Test Step 5: Set dealy in Core0 by setting FlagCore_OS_0=1
  /*******************************************************************************************************************************************************/ 
  
  snprintf( chActionText, elCount(chActionText), "Set dealy in Core0 "); 
  snprintf( chExpectedText, elCount(chExpectedText), "check dealy in Core0"); 
  TestStepAddActionExpected( chActionText, chExpectedText );
  A_DBGR_VariableSet("FlagCore_OS_0", "1");
  E_DBGR_VariableCheck("FlagCore_OS_0", 1, Equal);
  
  /******************************************************************************************************************************************************/    
    // Test Step 6: Read CpuUtilization for Core 0 after delay
  /*******************************************************************************************************************************************************/

  snprintf( chActionText, elCount(chActionText), "Call funtion Os_Test_GetHWIO_Pct_CPU_Utilization() "); 
  snprintf( chExpectedText, elCount(chExpectedText), "After delay verify CpuUtilization  variable in funtion Os_Test_GetHWIO_Pct_CPU_Utilization() "); 
  TestStepAddActionExpected( chActionText, chExpectedText );
  A_DBGR_VariableRead( "CpuUtilization", taskvalue);
  E_DBGR_VariableCheck("FlagCore_OS_0", 1, Equal);
  
  
  CPUUtilization_after_delay=taskvalue*(0.003051);
  write("CPUUtilization_after_delay is %f",CPUUtilization_after_delay);
  
  
  if(CPUUtilization_after_delay > CPUUtilization_before_delay)
  {
    CPUUtilization = CPUUtilization_after_delay - CPUUtilization_before_delay;
    testStepPass("","CpuUtilization is %f",CPUUtilization);
  }
  else
  {
    CPUUtilization = CPUUtilization_after_delay - CPUUtilization_before_delay;
    testStepFail("","CpuUtilization is %f",CPUUtilization);
  }

  
  /*******************************************************************************************************************************************************/    
    // Test Step 7: Remove dealy in Core0 by setting FlagCore_OS_0=0
  /*******************************************************************************************************************************************************/ 
  
  snprintf( chActionText, elCount(chActionText), "Remove dealy in Core0 "); 
  snprintf( chExpectedText, elCount(chExpectedText), "Remove dealy in Core0"); 
  TestStepAddActionExpected( chActionText, chExpectedText );
  A_DBGR_VariableSet("FlagCore_OS_0", "0");
  E_DBGR_VariableCheck("FlagCore_OS_0", 0, Equal);
  
  /*******************************************************************************************************************************************************/    
    // Test Step 8: Set CPU_Utilization_Core0=0 for Core0
  /*******************************************************************************************************************************************************/ 
  
  snprintf( chActionText, elCount(chActionText), "Set CPU_Utilization_Core0=0 for Core0"); 
  snprintf( chExpectedText, elCount(chExpectedText), "Set CPU_Utilization_Core0=0 for Core0"); 
  TestStepAddActionExpected( chActionText, chExpectedText );
  A_DBGR_VariableSet("CPU_Utilization_Core0", "0");
  E_DBGR_VariableCheck("CPU_Utilization_Core0", 0, Equal);

}

/***************************************************************************************************
----------------------------------------------------------------------------------------------------
Test case name:  TC_L30SW_QT_36832678: test_case_to_verify_the_functionality_of_interface_GetHWIO_Pct_CPU_Utilization_to_check_percentage_of_CPU_utilization_for_core1
----------------------------------------------------------------------------------------------------
Description:  test_case_to_verify_the_functionality_of_interface_GetHWIO_Pct_CPU_Utilization_to_check_percentage_of_CPU_utilization_for_core1

***************************************************************************************************/
testcase test_case_to_verify_the_functionality_of_interface_GetHWIO_Pct_CPU_Utilization_to_check_percentage_of_CPU_utilization_for_core1()
{
  /***************************************************************************************************************/    
                                                // Variable Definition
  /***************************************************************************************************************/ 
  
  long taskvalue;
  float CPUUtilization, CPUUtilization_before_delay, CPUUtilization_after_delay;
  
  /***************************************************************************************************************/    
                                               // Local Values
  /***************************************************************************************************************/ 
  

  
  /***************************************************************************************************************/    
                                              // Test Case Info
  /***************************************************************************************************************/
  setWriteDbgLevel(DebugOff);
  snprintf( chTestTitle, elCount(chTestTitle), "test_case_to_verify_the_functionality_of_interface_GetHWIO_Pct_CPU_Utilization_to_check_percentage_of_CPU_utilization_for_core1" );
  snprintf( chTestDescription, elCount(chTestDescription), "Purpose: test_case_to_verify_the_functionality_of_interface_GetHWIO_Pct_CPU_Utilization_to_check_percentage_of_CPU_utilization_for_core1.");
  TestCaseAddInfo( chTestTitle, "TC_L30SW_QT_36832678", chTestDescription );

  /***************************************************************************************************************/    
                                              // Start of Test Case
  /***************************************************************************************************************/
  
  /***************************************************************************************************************/    
                                              // Test Step 1 PRECONDITIONS
  /***************************************************************************************************************/
  
  snprintf( chActionText, elCount(chActionText), "Flash the Software and ECU is running"); 
  snprintf( chExpectedText, elCount(chExpectedText), "ECU should be in running state"); 
  TestStepAddActionExpected( chActionText, chExpectedText );

  A_DBGR_BreakpointDeleteAll();
  A_DBGR_RnGo();
  E_DBGR_CheckState(T32_State_Running);
  

   /***************************************************************************************************************/    
            // Test Step 2: Check all cores are in running state                                   
  /***************************************************************************************************************/
  
  //Check Core0 is running
  snprintf( chActionText, elCount(chActionText), "Check 1000ms Task Counter from Core0 "); 
  snprintf( chExpectedText, elCount(chExpectedText), "1000ms Counter from Core0 is incrementing"); 
  TestStepAddActionExpected( chActionText, chExpectedText );
  A_DBGR_VariableRead( "Task_Core0_1000ms_Count", taskvalue);
  E_DBGR_VariableCheck("Task_Core0_1000ms_Count", taskvalue, Greater);
  
  //Check Core1 is running
  snprintf( chActionText, elCount(chActionText), "Check 1000ms Task Counter from Core1 "); 
  snprintf( chExpectedText, elCount(chExpectedText), "1000ms Counter from Core1 is incrementing"); 
  TestStepAddActionExpected( chActionText, chExpectedText );
  A_DBGR_VariableRead( "Task_Core1_1000ms_Count", taskvalue);
  E_DBGR_VariableCheck("Task_Core1_1000ms_Count", taskvalue, Greater);
  
  //Check Core2 is running
  snprintf( chActionText, elCount(chActionText), "Check 1000ms Task Counter from Core2 "); 
  snprintf( chExpectedText, elCount(chExpectedText), "1000ms Counter from Core2 is incrementing"); 
  TestStepAddActionExpected( chActionText, chExpectedText );
  A_DBGR_VariableRead( "Task_Core2_1000ms_Count", taskvalue);
  E_DBGR_VariableCheck("Task_Core2_1000ms_Count", taskvalue, Greater);
    
  //Check Core3 is running
  snprintf( chActionText, elCount(chActionText), "Check 1000ms Task Counter from Core3 "); 
  snprintf( chExpectedText, elCount(chExpectedText), "1000ms Counter from Core3 is incrementing"); 
  TestStepAddActionExpected( chActionText, chExpectedText );
  A_DBGR_VariableRead( "Task_Core3_1000ms_Count", taskvalue);
  E_DBGR_VariableCheck("Task_Core3_1000ms_Count", taskvalue, Greater);
    
  //Check Core4 is running
  snprintf( chActionText, elCount(chActionText), "Check 1000ms Task Counter from Core4 "); 
  snprintf( chExpectedText, elCount(chExpectedText), "1000ms Counter from Core4 is incrementing"); 
  TestStepAddActionExpected( chActionText, chExpectedText );
  A_DBGR_VariableRead( "Task_Core4_1000ms_Count", taskvalue);
  E_DBGR_VariableCheck("Task_Core4_1000ms_Count", taskvalue, Greater);
    
  //Check Core5 is running
  snprintf( chActionText, elCount(chActionText), "Check 1000ms Task Counter from Core5 "); 
  snprintf( chExpectedText, elCount(chExpectedText), "1000ms Counter from Core5 is incrementing"); 
  TestStepAddActionExpected( chActionText, chExpectedText );
  A_DBGR_VariableRead( "Task_Core5_1000ms_Count", taskvalue);
  E_DBGR_VariableCheck("Task_Core5_1000ms_Count", taskvalue, Greater);
  
  
  /*******************************************************************************************************************************************************/    
    // Test Step 3: Set CpuUtilization for Core1
  /*******************************************************************************************************************************************************/ 
  
  snprintf( chActionText, elCount(chActionText), "Set CpuUtilization for Core1"); 
  snprintf( chExpectedText, elCount(chExpectedText), "Set CpuUtilization for Core1"); 
  TestStepAddActionExpected( chActionText, chExpectedText );
  A_DBGR_VariableSet("CPU_Utilization_Core1", "1");
  E_DBGR_VariableCheck("CPU_Utilization_Core1", 1, Equal);
  
  /*******************************************************************************************************************************************************/    
    // Test Step 4: Read CpuUtilization
  /*******************************************************************************************************************************************************/

  snprintf( chActionText, elCount(chActionText), "Call funtion Os_Test_GetHWIO_Pct_CPU_Utilization() "); 
  snprintf( chExpectedText, elCount(chExpectedText), "Verify CpuUtilizatio  variable in funtion Os_Test_GetHWIO_Pct_CPU_Utilization() "); 
  TestStepAddActionExpected( chActionText, chExpectedText );
  A_DBGR_VariableRead( "CpuUtilization", taskvalue);
  E_DBGR_VariableCheck("CPU_Utilization_Core1", 1, Equal);
  
  CPUUtilization_before_delay=taskvalue*(0.003051);
  write("CPUUtilization_before_delay for core 1 is %f",CPUUtilization_before_delay);
  
  /******************************************************************************************************************************************************/ 
 // Test Step 5: Set dealy in Core1 by setting FlagCore_OS_1=1
  /*******************************************************************************************************************************************************/ 
  
  snprintf( chActionText, elCount(chActionText), "Set dealy in Core1 "); 
  snprintf( chExpectedText, elCount(chExpectedText), "check dealy in Core1"); 
  TestStepAddActionExpected( chActionText, chExpectedText );
  A_DBGR_VariableSet("FlagCore_OS_1", "1");
  E_DBGR_VariableCheck("FlagCore_OS_1", 1, Equal);
    /*******************************************************************************************************************************************************/    
    // Test Step 6: Read CpuUtilization after delay
  /*******************************************************************************************************************************************************/

  snprintf( chActionText, elCount(chActionText), "Call funtion Os_Test_GetHWIO_Pct_CPU_Utilization() "); 
  snprintf( chExpectedText, elCount(chExpectedText), "after delay Verify CpuUtilizatio  variable in funtion Os_Test_GetHWIO_Pct_CPU_Utilization() "); 
  TestStepAddActionExpected( chActionText, chExpectedText );
  A_DBGR_VariableRead( "CpuUtilization", taskvalue);
  E_DBGR_VariableCheck("FlagCore_OS_1", 1, Equal);
  
  CPUUtilization_after_delay=taskvalue*(0.003051);
  write("CPUUtilization_after_delay is %f",CPUUtilization_after_delay);
  
  
  if(CPUUtilization_after_delay > CPUUtilization_before_delay)
  {
    CPUUtilization = CPUUtilization_after_delay - CPUUtilization_before_delay;
    testStepPass("","CpuUtilization is %f",CPUUtilization);
  }
  else
  {
    CPUUtilization = CPUUtilization_after_delay - CPUUtilization_before_delay;
    testStepFail("","CpuUtilization is %f",CPUUtilization);
  }
  
  /*******************************************************************************************************************************************************/    
    // Test Step 7: Remove dealy in Core1 by setting FlagCore_OS_1=0
  /*******************************************************************************************************************************************************/ 
  
  snprintf( chActionText, elCount(chActionText), "Remove dealy in Core1 "); 
  snprintf( chExpectedText, elCount(chExpectedText), "Remove dealy in Core1"); 
  TestStepAddActionExpected( chActionText, chExpectedText );
  A_DBGR_VariableSet("FlagCore_OS_1", "0");
  E_DBGR_VariableCheck("FlagCore_OS_1", 0, Equal);
  
    /*******************************************************************************************************************************************************/    
    // Test Step 5: Set CPU_Utilization_Core1=0 for Core1
  /*******************************************************************************************************************************************************/ 
  
  snprintf( chActionText, elCount(chActionText), "Setting back CPU_Utilization_Core1 to 0"); 
  snprintf( chExpectedText, elCount(chExpectedText), "Setting back CPU_Utilization_Core1 to 0"); 
  TestStepAddActionExpected( chActionText, chExpectedText );
  A_DBGR_VariableSet("CPU_Utilization_Core1", "0");
  E_DBGR_VariableCheck("CPU_Utilization_Core1", 0, Equal);
   


}

/***************************************************************************************************
----------------------------------------------------------------------------------------------------
Test case name:  TC_L30SW_QT_36832679: test_case_to_verify_the_functionality_of_interface_GetHWIO_Pct_CPU_Utilization_to_check_percentage_of_CPU_utilization_for_core2
----------------------------------------------------------------------------------------------------
Description:  test_case_to_verify_the_functionality_of_interface_GetHWIO_Pct_CPU_Utilization_to_check_percentage_of_CPU_utilization_for_core2

***************************************************************************************************/
testcase test_case_to_verify_the_functionality_of_interface_GetHWIO_Pct_CPU_Utilization_to_check_percentage_of_CPU_utilization_for_core2()
{
  /***************************************************************************************************************/    
                                                // Variable Definition
  /***************************************************************************************************************/ 
  
  long taskvalue;
   float CPUUtilization, CPUUtilization_before_delay, CPUUtilization_after_delay;;
  
  /***************************************************************************************************************/    
                                               // Local Values
  /***************************************************************************************************************/ 
  

  
  /***************************************************************************************************************/    
                                              // Test Case Info
  /***************************************************************************************************************/
  setWriteDbgLevel(DebugOff);
  snprintf( chTestTitle, elCount(chTestTitle), "test_case_to_verify_the_functionality_of_interface_GetHWIO_Pct_CPU_Utilization_to_check_percentage_of_CPU_utilization_for_core2" );
  snprintf( chTestDescription, elCount(chTestDescription), "Purpose: test_case_to_verify_the_functionality_of_interface_GetHWIO_Pct_CPU_Utilization_to_check_percentage_of_CPU_utilization_for_core2.");
  TestCaseAddInfo( chTestTitle, "TC_L30SW_QT_36832679", chTestDescription );

  /***************************************************************************************************************/    
                                              // Start of Test Case
  /***************************************************************************************************************/
  
  /***************************************************************************************************************/    
                                              // Test Step 1 PRECONDITIONS
  /***************************************************************************************************************/
  
  snprintf( chActionText, elCount(chActionText), "Flash the Software and ECU is running"); 
  snprintf( chExpectedText, elCount(chExpectedText), "ECU should be in running state"); 
  TestStepAddActionExpected( chActionText, chExpectedText );

  A_DBGR_BreakpointDeleteAll();
  A_DBGR_RnGo();
  E_DBGR_CheckState(T32_State_Running);
  

   /***************************************************************************************************************/    
            // Test Step 2: Check all cores are in running state                                   
  /***************************************************************************************************************/
  
  //Check Core0 is running
  snprintf( chActionText, elCount(chActionText), "Check 1000ms Task Counter from Core0 "); 
  snprintf( chExpectedText, elCount(chExpectedText), "1000ms Counter from Core0 is incrementing"); 
  TestStepAddActionExpected( chActionText, chExpectedText );
  A_DBGR_VariableRead( "Task_Core0_1000ms_Count", taskvalue);
  E_DBGR_VariableCheck("Task_Core0_1000ms_Count", taskvalue, Greater);
  
  //Check Core1 is running
  snprintf( chActionText, elCount(chActionText), "Check 1000ms Task Counter from Core1 "); 
  snprintf( chExpectedText, elCount(chExpectedText), "1000ms Counter from Core1 is incrementing"); 
  TestStepAddActionExpected( chActionText, chExpectedText );
  A_DBGR_VariableRead( "Task_Core1_1000ms_Count", taskvalue);
  E_DBGR_VariableCheck("Task_Core1_1000ms_Count", taskvalue, Greater);
  
  //Check Core2 is running
  snprintf( chActionText, elCount(chActionText), "Check 1000ms Task Counter from Core2 "); 
  snprintf( chExpectedText, elCount(chExpectedText), "1000ms Counter from Core2 is incrementing"); 
  TestStepAddActionExpected( chActionText, chExpectedText );
  A_DBGR_VariableRead( "Task_Core2_1000ms_Count", taskvalue);
  E_DBGR_VariableCheck("Task_Core2_1000ms_Count", taskvalue, Greater);
    
  //Check Core3 is running
  snprintf( chActionText, elCount(chActionText), "Check 1000ms Task Counter from Core3 "); 
  snprintf( chExpectedText, elCount(chExpectedText), "1000ms Counter from Core3 is incrementing"); 
  TestStepAddActionExpected( chActionText, chExpectedText );
  A_DBGR_VariableRead( "Task_Core3_1000ms_Count", taskvalue);
  E_DBGR_VariableCheck("Task_Core3_1000ms_Count", taskvalue, Greater);
    
  //Check Core4 is running
  snprintf( chActionText, elCount(chActionText), "Check 1000ms Task Counter from Core4 "); 
  snprintf( chExpectedText, elCount(chExpectedText), "1000ms Counter from Core4 is incrementing"); 
  TestStepAddActionExpected( chActionText, chExpectedText );
  A_DBGR_VariableRead( "Task_Core4_1000ms_Count", taskvalue);
  E_DBGR_VariableCheck("Task_Core4_1000ms_Count", taskvalue, Greater);
    
  //Check Core5 is running
  snprintf( chActionText, elCount(chActionText), "Check 1000ms Task Counter from Core5 "); 
  snprintf( chExpectedText, elCount(chExpectedText), "1000ms Counter from Core5 is incrementing"); 
  TestStepAddActionExpected( chActionText, chExpectedText );
  A_DBGR_VariableRead( "Task_Core5_1000ms_Count", taskvalue);
  E_DBGR_VariableCheck("Task_Core5_1000ms_Count", taskvalue, Greater);
  
  
  /*******************************************************************************************************************************************************/    
    // Test Step 3: Set CpuUtilization for Core2
  /*******************************************************************************************************************************************************/ 
  
  snprintf( chActionText, elCount(chActionText), "Set CpuUtilization for Core2"); 
  snprintf( chExpectedText, elCount(chExpectedText), "Set CpuUtilization for Core2"); 
  TestStepAddActionExpected( chActionText, chExpectedText );
  A_DBGR_VariableSet("CPU_Utilization_Core2", "1");
  E_DBGR_VariableCheck("CPU_Utilization_Core2", 1, Equal);
  
  /*******************************************************************************************************************************************************/    
    // Test Step 4: Read CpuUtilization
  /*******************************************************************************************************************************************************/

  snprintf( chActionText, elCount(chActionText), "Call funtion Os_Test_GetHWIO_Pct_CPU_Utilization() "); 
  snprintf( chExpectedText, elCount(chExpectedText), "Verify CpuUtilizatio  variable in funtion Os_Test_GetHWIO_Pct_CPU_Utilization() "); 
  TestStepAddActionExpected( chActionText, chExpectedText );
  A_DBGR_VariableRead( "CpuUtilization", taskvalue);
  E_DBGR_VariableCheck("CPU_Utilization_Core2", 1, Equal);
  
  CPUUtilization_before_delay=taskvalue*(0.003051);
  write("CPUUtilization_before_delay for core2 is %f",CPUUtilization_before_delay);
  
    /******************************************************************************************************************************************************/ 
 // Test Step 5: Set dealy in Core2 by setting FlagCore_OS_2=1
  /*******************************************************************************************************************************************************/ 
  
  snprintf( chActionText, elCount(chActionText), "Set dealy in Core2 "); 
  snprintf( chExpectedText, elCount(chExpectedText), "check dealy in Core2"); 
  TestStepAddActionExpected( chActionText, chExpectedText );
  A_DBGR_VariableSet("FlagCore_OS_2", "1");
  E_DBGR_VariableCheck("FlagCore_OS_2", 1, Equal);
  
    /*******************************************************************************************************************************************************/    
    // Test Step 6: Read CpuUtilization
  /*******************************************************************************************************************************************************/

  snprintf( chActionText, elCount(chActionText), "Call funtion Os_Test_GetHWIO_Pct_CPU_Utilization() "); 
  snprintf( chExpectedText, elCount(chExpectedText), "Verify CpuUtilizatio  variable in funtion Os_Test_GetHWIO_Pct_CPU_Utilization() "); 
  TestStepAddActionExpected( chActionText, chExpectedText );
  A_DBGR_VariableRead( "CpuUtilization", taskvalue);
  E_DBGR_VariableCheck("FlagCore_OS_2", 1, Equal);
  
  
  CPUUtilization_after_delay=taskvalue*(0.003051);
  write("CPUUtilization_after_delay fore core 2 is %f",CPUUtilization_after_delay);
  
  
  if(CPUUtilization_after_delay > CPUUtilization_before_delay)
  {
    CPUUtilization = CPUUtilization_after_delay - CPUUtilization_before_delay;
    testStepPass("","CpuUtilization for core 2 is %f",CPUUtilization);
  }
  else
  {
    CPUUtilization = CPUUtilization_after_delay - CPUUtilization_before_delay;
    testStepFail("","CpuUtilization for core 2 is %f",CPUUtilization);
  }
  
  
  /*******************************************************************************************************************************************************/    
    // Test Step 7: Remove dealy in Core2 by setting FlagCore_OS_2=0
  /*******************************************************************************************************************************************************/ 
  
  snprintf( chActionText, elCount(chActionText), "Remove dealy in Core2 "); 
  snprintf( chExpectedText, elCount(chExpectedText), "Remove dealy in Core2"); 
  TestStepAddActionExpected( chActionText, chExpectedText );
  A_DBGR_VariableSet("FlagCore_OS_2", "0");
  E_DBGR_VariableCheck("FlagCore_OS_2", 0, Equal);
   
    /*******************************************************************************************************************************************************/    
    // Test Step 8: Set CPU_Utilization_Core2=0 for Core2
  /*******************************************************************************************************************************************************/ 
  
  snprintf( chActionText, elCount(chActionText), "Setting back CPU_Utilization_Core2 to 0"); 
  snprintf( chExpectedText, elCount(chExpectedText), "Setting back CPU_Utilization_Core2 to 0"); 
  TestStepAddActionExpected( chActionText, chExpectedText );
  A_DBGR_VariableSet("CPU_Utilization_Core2", "0");
  E_DBGR_VariableCheck("CPU_Utilization_Core2", 0, Equal);


}

/***************************************************************************************************
----------------------------------------------------------------------------------------------------
Test case name:  TC_L30SW_QT_36832680: test_case_to_verify_the_functionality_of_interface_GetHWIO_Pct_CPU_Utilization_to_check_percentage_of_CPU_utilization_for_core3
----------------------------------------------------------------------------------------------------
Description:  test_case_to_verify_the_functionality_of_interface_GetHWIO_Pct_CPU_Utilization_to_check_percentage_of_CPU_utilization_for_core3

***************************************************************************************************/
testcase test_case_to_verify_the_functionality_of_interface_GetHWIO_Pct_CPU_Utilization_to_check_percentage_of_CPU_utilization_for_core3()
{
  /***************************************************************************************************************/    
                                                // Variable Definition
  /***************************************************************************************************************/ 
  
  long taskvalue;
   float CPUUtilization, CPUUtilization_before_delay, CPUUtilization_after_delay;
  
  /***************************************************************************************************************/    
                                               // Local Values
  /***************************************************************************************************************/ 
  

  
  /***************************************************************************************************************/    
                                              // Test Case Info
  /***************************************************************************************************************/
  setWriteDbgLevel(DebugOff);
  snprintf( chTestTitle, elCount(chTestTitle), "test_case_to_verify_the_functionality_of_interface_GetHWIO_Pct_CPU_Utilization_to_check_percentage_of_CPU_utilization_for_core3" );
  snprintf( chTestDescription, elCount(chTestDescription), "Purpose: test_case_to_verify_the_functionality_of_interface_GetHWIO_Pct_CPU_Utilization_to_check_percentage_of_CPU_utilization_for_core3.");
  TestCaseAddInfo( chTestTitle, "TC_L30SW_QT_36832680", chTestDescription );

  /***************************************************************************************************************/    
                                              // Start of Test Case
  /***************************************************************************************************************/
  
  /***************************************************************************************************************/    
                                              // Test Step 1 PRECONDITIONS
  /***************************************************************************************************************/
  
  snprintf( chActionText, elCount(chActionText), "Flash the Software and ECU is running"); 
  snprintf( chExpectedText, elCount(chExpectedText), "ECU should be in running state"); 
  TestStepAddActionExpected( chActionText, chExpectedText );

  A_DBGR_BreakpointDeleteAll();
  A_DBGR_RnGo();
  E_DBGR_CheckState(T32_State_Running);
  

   /***************************************************************************************************************/    
            // Test Step 2: Check all cores are in running state                                   
  /***************************************************************************************************************/
  
  //Check Core0 is running
  snprintf( chActionText, elCount(chActionText), "Check 1000ms Task Counter from Core0 "); 
  snprintf( chExpectedText, elCount(chExpectedText), "1000ms Counter from Core0 is incrementing"); 
  TestStepAddActionExpected( chActionText, chExpectedText );
  A_DBGR_VariableRead( "Task_Core0_1000ms_Count", taskvalue);
  E_DBGR_VariableCheck("Task_Core0_1000ms_Count", taskvalue, Greater);
  
  //Check Core1 is running
  snprintf( chActionText, elCount(chActionText), "Check 1000ms Task Counter from Core1 "); 
  snprintf( chExpectedText, elCount(chExpectedText), "1000ms Counter from Core1 is incrementing"); 
  TestStepAddActionExpected( chActionText, chExpectedText );
  A_DBGR_VariableRead( "Task_Core1_1000ms_Count", taskvalue);
  E_DBGR_VariableCheck("Task_Core1_1000ms_Count", taskvalue, Greater);
  
  //Check Core2 is running
  snprintf( chActionText, elCount(chActionText), "Check 1000ms Task Counter from Core2 "); 
  snprintf( chExpectedText, elCount(chExpectedText), "1000ms Counter from Core2 is incrementing"); 
  TestStepAddActionExpected( chActionText, chExpectedText );
  A_DBGR_VariableRead( "Task_Core2_1000ms_Count", taskvalue);
  E_DBGR_VariableCheck("Task_Core2_1000ms_Count", taskvalue, Greater);
    
  //Check Core3 is running
  snprintf( chActionText, elCount(chActionText), "Check 1000ms Task Counter from Core3 "); 
  snprintf( chExpectedText, elCount(chExpectedText), "1000ms Counter from Core3 is incrementing"); 
  TestStepAddActionExpected( chActionText, chExpectedText );
  A_DBGR_VariableRead( "Task_Core3_1000ms_Count", taskvalue);
  E_DBGR_VariableCheck("Task_Core3_1000ms_Count", taskvalue, Greater);
    
  //Check Core4 is running
  snprintf( chActionText, elCount(chActionText), "Check 1000ms Task Counter from Core4 "); 
  snprintf( chExpectedText, elCount(chExpectedText), "1000ms Counter from Core4 is incrementing"); 
  TestStepAddActionExpected( chActionText, chExpectedText );
  A_DBGR_VariableRead( "Task_Core4_1000ms_Count", taskvalue);
  E_DBGR_VariableCheck("Task_Core4_1000ms_Count", taskvalue, Greater);
    
  //Check Core5 is running
  snprintf( chActionText, elCount(chActionText), "Check 1000ms Task Counter from Core5 "); 
  snprintf( chExpectedText, elCount(chExpectedText), "1000ms Counter from Core5 is incrementing"); 
  TestStepAddActionExpected( chActionText, chExpectedText );
  A_DBGR_VariableRead( "Task_Core5_1000ms_Count", taskvalue);
  E_DBGR_VariableCheck("Task_Core5_1000ms_Count", taskvalue, Greater);
  
  
  /*******************************************************************************************************************************************************/    
    // Test Step 3: Set CpuUtilization for Core3
  /*******************************************************************************************************************************************************/ 
  
  snprintf( chActionText, elCount(chActionText), "Set CpuUtilization for Core3"); 
  snprintf( chExpectedText, elCount(chExpectedText), "Set CpuUtilization for Core3"); 
  TestStepAddActionExpected( chActionText, chExpectedText );
  A_DBGR_VariableSet("CPU_Utilization_Core3", "1");
  E_DBGR_VariableCheck("CPU_Utilization_Core3", 1, Equal);
  
  /*******************************************************************************************************************************************************/    
    // Test Step 4: Read CpuUtilization
  /*******************************************************************************************************************************************************/

  snprintf( chActionText, elCount(chActionText), "Call funtion Os_Test_GetHWIO_Pct_CPU_Utilization() "); 
  snprintf( chExpectedText, elCount(chExpectedText), "Verify CpuUtilizatio  variable in funtion Os_Test_GetHWIO_Pct_CPU_Utilization() "); 
  TestStepAddActionExpected( chActionText, chExpectedText );
  A_DBGR_VariableRead( "CpuUtilization", taskvalue);
  E_DBGR_VariableCheck("CPU_Utilization_Core3", 1, Equal);
  
  CPUUtilization_before_delay=taskvalue*(0.003051);
  write("CPUUtilization_before_delay fore core3 is %f",CPUUtilization_before_delay);
  
    /******************************************************************************************************************************************************/ 
 // Test Step 5: Set dealy in Core3 by setting FlagCore_OS_3=1
  /*******************************************************************************************************************************************************/ 
  
  snprintf( chActionText, elCount(chActionText), "Set dealy in Core3 "); 
  snprintf( chExpectedText, elCount(chExpectedText), "check dealy in Core3"); 
  TestStepAddActionExpected( chActionText, chExpectedText );
  A_DBGR_VariableSet("FlagCore_OS_3", "1");
  E_DBGR_VariableCheck("FlagCore_OS_3", 1, Equal);
  
    /*******************************************************************************************************************************************************/    
    // Test Step 6: Read CpuUtilization
  /*******************************************************************************************************************************************************/

  snprintf( chActionText, elCount(chActionText), "Call funtion Os_Test_GetHWIO_Pct_CPU_Utilization() "); 
  snprintf( chExpectedText, elCount(chExpectedText), "Verify CpuUtilizatio  variable in funtion Os_Test_GetHWIO_Pct_CPU_Utilization() "); 
  TestStepAddActionExpected( chActionText, chExpectedText );
  A_DBGR_VariableRead( "CpuUtilization", taskvalue);
  E_DBGR_VariableCheck("FlagCore_OS_3", 1, Equal);
  
  
  CPUUtilization_after_delay=taskvalue*(0.003051);
  write("CPUUtilization_after_delay for core3 is %f",CPUUtilization_after_delay);
  
  
  if(CPUUtilization_after_delay > CPUUtilization_before_delay)
  {
    CPUUtilization = CPUUtilization_after_delay - CPUUtilization_before_delay;
    testStepPass("","CpuUtilization for Core3 is %f",CPUUtilization);
  }
  else
  {
    CPUUtilization = CPUUtilization_after_delay - CPUUtilization_before_delay;
    testStepFail("","CpuUtilization fore Core3 is %f",CPUUtilization);
  }
  
  
  /*******************************************************************************************************************************************************/    
    // Test Step 7: Remove dealy in Core3 by setting FlagCore_OS_3=0
  /*******************************************************************************************************************************************************/ 
  
  snprintf( chActionText, elCount(chActionText), "Remove dealy in Core3 "); 
  snprintf( chExpectedText, elCount(chExpectedText), "Remove dealy in Core3"); 
  TestStepAddActionExpected( chActionText, chExpectedText );
  A_DBGR_VariableSet("FlagCore_OS_3", "0");
  E_DBGR_VariableCheck("FlagCore_OS_3", 0, Equal);
  
    /*******************************************************************************************************************************************************/    
    // Test Step 8: Set CPU_Utilization_Core3=0 for Core3
  /*******************************************************************************************************************************************************/ 
  
  snprintf( chActionText, elCount(chActionText), "Setting back CPU_Utilization_Core3 to 0"); 
  snprintf( chExpectedText, elCount(chExpectedText), "Setting back CPU_Utilization_Core3 to 0"); 
  TestStepAddActionExpected( chActionText, chExpectedText );
  A_DBGR_VariableSet("CPU_Utilization_Core3", "0");
  E_DBGR_VariableCheck("CPU_Utilization_Core3", 0, Equal);
   


}

/***************************************************************************************************
----------------------------------------------------------------------------------------------------
Test case name:  TC_L30SW_QT_36832681: test_case_to_verify_the_functionality_of_interface_GetHWIO_Pct_CPU_Utilization_to_check_percentage_of_CPU_utilization_for_core4
----------------------------------------------------------------------------------------------------
Description:  test_case_to_verify_the_functionality_of_interface_GetHWIO_Pct_CPU_Utilization_to_check_percentage_of_CPU_utilization_for_core4

***************************************************************************************************/
testcase test_case_to_verify_the_functionality_of_interface_GetHWIO_Pct_CPU_Utilization_to_check_percentage_of_CPU_utilization_for_core4()
{
  /***************************************************************************************************************/    
                                                // Variable Definition
  /***************************************************************************************************************/ 
  
  long taskvalue;
   float CPUUtilization, CPUUtilization_before_delay, CPUUtilization_after_delay;
  
  /***************************************************************************************************************/    
                                               // Local Values
  /***************************************************************************************************************/ 
  

  
  /***************************************************************************************************************/    
                                              // Test Case Info
  /***************************************************************************************************************/
  setWriteDbgLevel(DebugOff);
  snprintf( chTestTitle, elCount(chTestTitle), "test_case_to_verify_the_functionality_of_interface_GetHWIO_Pct_CPU_Utilization_to_check_percentage_of_CPU_utilization_for_core4" );
  snprintf( chTestDescription, elCount(chTestDescription), "Purpose: test_case_to_verify_the_functionality_of_interface_GetHWIO_Pct_CPU_Utilization_to_check_percentage_of_CPU_utilization_for_core4.");
  TestCaseAddInfo( chTestTitle, "TC_L30SW_QT_36832681", chTestDescription );

  /***************************************************************************************************************/    
                                              // Start of Test Case
  /***************************************************************************************************************/
  
  /***************************************************************************************************************/    
                                              // Test Step 1 PRECONDITIONS
  /***************************************************************************************************************/
  
  snprintf( chActionText, elCount(chActionText), "Flash the Software and ECU is running"); 
  snprintf( chExpectedText, elCount(chExpectedText), "ECU should be in running state"); 
  TestStepAddActionExpected( chActionText, chExpectedText );

  A_DBGR_BreakpointDeleteAll();
  A_DBGR_RnGo();
  E_DBGR_CheckState(T32_State_Running);
  

   /***************************************************************************************************************/    
            // Test Step 2: Check all cores are in running state                                   
  /***************************************************************************************************************/
  
  //Check Core0 is running
  snprintf( chActionText, elCount(chActionText), "Check 1000ms Task Counter from Core0 "); 
  snprintf( chExpectedText, elCount(chExpectedText), "1000ms Counter from Core0 is incrementing"); 
  TestStepAddActionExpected( chActionText, chExpectedText );
  A_DBGR_VariableRead( "Task_Core0_1000ms_Count", taskvalue);
  E_DBGR_VariableCheck("Task_Core0_1000ms_Count", taskvalue, Greater);
  
  //Check Core1 is running
  snprintf( chActionText, elCount(chActionText), "Check 1000ms Task Counter from Core1 "); 
  snprintf( chExpectedText, elCount(chExpectedText), "1000ms Counter from Core1 is incrementing"); 
  TestStepAddActionExpected( chActionText, chExpectedText );
  A_DBGR_VariableRead( "Task_Core1_1000ms_Count", taskvalue);
  E_DBGR_VariableCheck("Task_Core1_1000ms_Count", taskvalue, Greater);
  
  //Check Core2 is running
  snprintf( chActionText, elCount(chActionText), "Check 1000ms Task Counter from Core2 "); 
  snprintf( chExpectedText, elCount(chExpectedText), "1000ms Counter from Core2 is incrementing"); 
  TestStepAddActionExpected( chActionText, chExpectedText );
  A_DBGR_VariableRead( "Task_Core2_1000ms_Count", taskvalue);
  E_DBGR_VariableCheck("Task_Core2_1000ms_Count", taskvalue, Greater);
    
  //Check Core3 is running
  snprintf( chActionText, elCount(chActionText), "Check 1000ms Task Counter from Core3 "); 
  snprintf( chExpectedText, elCount(chExpectedText), "1000ms Counter from Core3 is incrementing"); 
  TestStepAddActionExpected( chActionText, chExpectedText );
  A_DBGR_VariableRead( "Task_Core3_1000ms_Count", taskvalue);
  E_DBGR_VariableCheck("Task_Core3_1000ms_Count", taskvalue, Greater);
    
  //Check Core4 is running
  snprintf( chActionText, elCount(chActionText), "Check 1000ms Task Counter from Core4 "); 
  snprintf( chExpectedText, elCount(chExpectedText), "1000ms Counter from Core4 is incrementing"); 
  TestStepAddActionExpected( chActionText, chExpectedText );
  A_DBGR_VariableRead( "Task_Core4_1000ms_Count", taskvalue);
  E_DBGR_VariableCheck("Task_Core4_1000ms_Count", taskvalue, Greater);
    
  //Check Core5 is running
  snprintf( chActionText, elCount(chActionText), "Check 1000ms Task Counter from Core5 "); 
  snprintf( chExpectedText, elCount(chExpectedText), "1000ms Counter from Core5 is incrementing"); 
  TestStepAddActionExpected( chActionText, chExpectedText );
  A_DBGR_VariableRead( "Task_Core5_1000ms_Count", taskvalue);
  E_DBGR_VariableCheck("Task_Core5_1000ms_Count", taskvalue, Greater);
  
  
  /*******************************************************************************************************************************************************/    
    // Test Step 3: Set CpuUtilization for Core4
  /*******************************************************************************************************************************************************/ 
  
  snprintf( chActionText, elCount(chActionText), "Set CpuUtilization for Core4"); 
  snprintf( chExpectedText, elCount(chExpectedText), "Set CpuUtilization for Core4"); 
  TestStepAddActionExpected( chActionText, chExpectedText );
  A_DBGR_VariableSet("CPU_Utilization_Core4", "1");
  E_DBGR_VariableCheck("CPU_Utilization_Core4", 1, Equal);
  
  /*******************************************************************************************************************************************************/    
    // Test Step 4: Read CpuUtilization
  /*******************************************************************************************************************************************************/

  snprintf( chActionText, elCount(chActionText), "Call funtion Os_Test_GetHWIO_Pct_CPU_Utilization() "); 
  snprintf( chExpectedText, elCount(chExpectedText), "Verify CpuUtilizatio  variable in funtion Os_Test_GetHWIO_Pct_CPU_Utilization() "); 
  TestStepAddActionExpected( chActionText, chExpectedText );
  A_DBGR_VariableRead( "CpuUtilization", taskvalue);
  E_DBGR_VariableCheck("CPU_Utilization_Core4", 1, Equal);
  
  CPUUtilization_before_delay=taskvalue*(0.003051);
  write("CPUUtilization_before_delay is %f",CPUUtilization_before_delay);
    
  
    /******************************************************************************************************************************************************/ 
 // Test Step 5: Set dealy in Core4 by setting FlagCore_OS_4=1
  /*******************************************************************************************************************************************************/ 
  
  snprintf( chActionText, elCount(chActionText), "Set dealy in Core4 "); 
  snprintf( chExpectedText, elCount(chExpectedText), "check dealy in Core4"); 
  TestStepAddActionExpected( chActionText, chExpectedText );
  A_DBGR_VariableSet("FlagCore_OS_4", "1");
  E_DBGR_VariableCheck("FlagCore_OS_4", 1, Equal);
  
    /*******************************************************************************************************************************************************/    
    // Test Step 6: Read CpuUtilization
  /*******************************************************************************************************************************************************/

  snprintf( chActionText, elCount(chActionText), "Call funtion Os_Test_GetHWIO_Pct_CPU_Utilization() "); 
  snprintf( chExpectedText, elCount(chExpectedText), "Verify CpuUtilizatio  variable in funtion Os_Test_GetHWIO_Pct_CPU_Utilization() "); 
  TestStepAddActionExpected( chActionText, chExpectedText );
  A_DBGR_VariableRead( "CpuUtilization", taskvalue);
  E_DBGR_VariableCheck("FlagCore_OS_4", 1, Equal);
  
 
  CPUUtilization_after_delay=taskvalue*(0.003051);
  write("CPUUtilization_after_delay for Core4 is %f",CPUUtilization_after_delay);
  
  
  if(CPUUtilization_after_delay > CPUUtilization_before_delay)
  {
    CPUUtilization = CPUUtilization_after_delay - CPUUtilization_before_delay;
    testStepPass("","CpuUtilization for Core4 is %f",CPUUtilization);
  }
  else
  {
    CPUUtilization = CPUUtilization_after_delay - CPUUtilization_before_delay;
    testStepFail("","CpuUtilization for Core4 is %f",CPUUtilization);
  }
  
  /*******************************************************************************************************************************************************/    
    // Test Step 7: Remove dealy in Core4 by setting FlagCore_OS_4=0
  /*******************************************************************************************************************************************************/ 
  
  snprintf( chActionText, elCount(chActionText), "Remove dealy in Core4 "); 
  snprintf( chExpectedText, elCount(chExpectedText), "Remove dealy in Core4"); 
  TestStepAddActionExpected( chActionText, chExpectedText );
  A_DBGR_VariableSet("FlagCore_OS_4", "0");
  E_DBGR_VariableCheck("FlagCore_OS_4", 0, Equal);
    /*******************************************************************************************************************************************************/    
    // Test Step 8: Set CPU_Utilization_Core4=0 for Core4
  /*******************************************************************************************************************************************************/ 
  
  snprintf( chActionText, elCount(chActionText), "Setting back CPU_Utilization_Core4 to 0"); 
  snprintf( chExpectedText, elCount(chExpectedText), "Setting back CPU_Utilization_Core4 to 0"); 
  TestStepAddActionExpected( chActionText, chExpectedText );
  A_DBGR_VariableSet("CPU_Utilization_Core4", "0");
  E_DBGR_VariableCheck("CPU_Utilization_Core4", 0, Equal);
   


}

/***************************************************************************************************
----------------------------------------------------------------------------------------------------
Test case name:  TC_L30SW_QT_36832682: test_case_to_verify_the_functionality_of_interface_GetHWIO_Pct_CPU_Utilization_to_check_percentage_of_CPU_utilization_for_core5
----------------------------------------------------------------------------------------------------
Description:  test_case_to_verify_the_functionality_of_interface_GetHWIO_Pct_CPU_Utilization_to_check_percentage_of_CPU_utilization_for_core5

***************************************************************************************************/
testcase test_case_to_verify_the_functionality_of_interface_GetHWIO_Pct_CPU_Utilization_to_check_percentage_of_CPU_utilization_for_core5()
{
  /***************************************************************************************************************/    
                                                // Variable Definition
  /***************************************************************************************************************/ 
  
  long taskvalue;
   float CPUUtilization, CPUUtilization_before_delay, CPUUtilization_after_delay;
  
  /***************************************************************************************************************/    
                                               // Local Values
  /***************************************************************************************************************/ 
  

  
  /***************************************************************************************************************/    
                                              // Test Case Info
  /***************************************************************************************************************/
  setWriteDbgLevel(DebugOff);
  snprintf( chTestTitle, elCount(chTestTitle), "test_case_to_verify_the_functionality_of_interface_GetHWIO_Pct_CPU_Utilization_to_check_percentage_of_CPU_utilization_for_core5" );
  snprintf( chTestDescription, elCount(chTestDescription), "Purpose: test_case_to_verify_the_functionality_of_interface_GetHWIO_Pct_CPU_Utilization_to_check_percentage_of_CPU_utilization_for_core5.");
  TestCaseAddInfo( chTestTitle, "TC_L30SW_QT_36832682", chTestDescription );

  /***************************************************************************************************************/    
                                              // Start of Test Case
  /***************************************************************************************************************/
  
  /***************************************************************************************************************/    
                                              // Test Step 1 PRECONDITIONS
  /***************************************************************************************************************/
  
  snprintf( chActionText, elCount(chActionText), "Flash the Software and ECU is running"); 
  snprintf( chExpectedText, elCount(chExpectedText), "ECU should be in running state"); 
  TestStepAddActionExpected( chActionText, chExpectedText );

  A_DBGR_BreakpointDeleteAll();
  A_DBGR_RnGo();
  E_DBGR_CheckState(T32_State_Running);
  

   /***************************************************************************************************************/    
            // Test Step 2: Check all cores are in running state                                   
  /***************************************************************************************************************/
  
  //Check Core0 is running
  snprintf( chActionText, elCount(chActionText), "Check 1000ms Task Counter from Core0 "); 
  snprintf( chExpectedText, elCount(chExpectedText), "1000ms Counter from Core0 is incrementing"); 
  TestStepAddActionExpected( chActionText, chExpectedText );
  A_DBGR_VariableRead( "Task_Core0_1000ms_Count", taskvalue);
  E_DBGR_VariableCheck("Task_Core0_1000ms_Count", taskvalue, Greater);
  
  //Check Core1 is running
  snprintf( chActionText, elCount(chActionText), "Check 1000ms Task Counter from Core1 "); 
  snprintf( chExpectedText, elCount(chExpectedText), "1000ms Counter from Core1 is incrementing"); 
  TestStepAddActionExpected( chActionText, chExpectedText );
  A_DBGR_VariableRead( "Task_Core1_1000ms_Count", taskvalue);
  E_DBGR_VariableCheck("Task_Core1_1000ms_Count", taskvalue, Greater);
  
  //Check Core2 is running
  snprintf( chActionText, elCount(chActionText), "Check 1000ms Task Counter from Core2 "); 
  snprintf( chExpectedText, elCount(chExpectedText), "1000ms Counter from Core2 is incrementing"); 
  TestStepAddActionExpected( chActionText, chExpectedText );
  A_DBGR_VariableRead( "Task_Core2_1000ms_Count", taskvalue);
  E_DBGR_VariableCheck("Task_Core2_1000ms_Count", taskvalue, Greater);
    
  //Check Core3 is running
  snprintf( chActionText, elCount(chActionText), "Check 1000ms Task Counter from Core3 "); 
  snprintf( chExpectedText, elCount(chExpectedText), "1000ms Counter from Core3 is incrementing"); 
  TestStepAddActionExpected( chActionText, chExpectedText );
  A_DBGR_VariableRead( "Task_Core3_1000ms_Count", taskvalue);
  E_DBGR_VariableCheck("Task_Core3_1000ms_Count", taskvalue, Greater);
    
  //Check Core4 is running
  snprintf( chActionText, elCount(chActionText), "Check 1000ms Task Counter from Core4 "); 
  snprintf( chExpectedText, elCount(chExpectedText), "1000ms Counter from Core4 is incrementing"); 
  TestStepAddActionExpected( chActionText, chExpectedText );
  A_DBGR_VariableRead( "Task_Core4_1000ms_Count", taskvalue);
  E_DBGR_VariableCheck("Task_Core4_1000ms_Count", taskvalue, Greater);
    
  //Check Core5 is running
  snprintf( chActionText, elCount(chActionText), "Check 1000ms Task Counter from Core5 "); 
  snprintf( chExpectedText, elCount(chExpectedText), "1000ms Counter from Core5 is incrementing"); 
  TestStepAddActionExpected( chActionText, chExpectedText );
  A_DBGR_VariableRead( "Task_Core5_1000ms_Count", taskvalue);
  E_DBGR_VariableCheck("Task_Core5_1000ms_Count", taskvalue, Greater);
  
  
  /*******************************************************************************************************************************************************/    
    // Test Step 3: Set CpuUtilization for Core5
  /*******************************************************************************************************************************************************/ 
  
  snprintf( chActionText, elCount(chActionText), "Set CpuUtilization for Core5"); 
  snprintf( chExpectedText, elCount(chExpectedText), "Set CpuUtilization for Core5"); 
  TestStepAddActionExpected( chActionText, chExpectedText );
  A_DBGR_VariableSet("CPU_Utilization_Core5", "1");
  E_DBGR_VariableCheck("CPU_Utilization_Core5", 1, Equal);
  
  /*******************************************************************************************************************************************************/    
    // Test Step 4: Read CpuUtilization
  /*******************************************************************************************************************************************************/

  snprintf( chActionText, elCount(chActionText), "Call funtion Os_Test_GetHWIO_Pct_CPU_Utilization() "); 
  snprintf( chExpectedText, elCount(chExpectedText), "Verify CpuUtilizatio  variable in funtion Os_Test_GetHWIO_Pct_CPU_Utilization() "); 
  TestStepAddActionExpected( chActionText, chExpectedText );
  A_DBGR_VariableRead( "CpuUtilization", taskvalue);
  E_DBGR_VariableCheck("CPU_Utilization_Core5", 1, Equal);
  
  CPUUtilization_before_delay=taskvalue*(0.003051);
  write("CPUUtilization_before_delay for Core 5 is %f",CPUUtilization_before_delay);
  
    /******************************************************************************************************************************************************/ 
 // Test Step 5: Set dealy in Core5 by setting FlagCore_OS_5=1
  /*******************************************************************************************************************************************************/ 
  
  snprintf( chActionText, elCount(chActionText), "Set dealy in Core5 "); 
  snprintf( chExpectedText, elCount(chExpectedText), "check dealy in Core5"); 
  TestStepAddActionExpected( chActionText, chExpectedText );
  A_DBGR_VariableSet("FlagCore_OS_5", "1");
  E_DBGR_VariableCheck("FlagCore_OS_5", 1, Equal);
  
      // Test Step 6: Read CpuUtilization
  /*******************************************************************************************************************************************************/

  snprintf( chActionText, elCount(chActionText), "Call funtion Os_Test_GetHWIO_Pct_CPU_Utilization() "); 
  snprintf( chExpectedText, elCount(chExpectedText), "Verify CpuUtilizatio  variable in funtion Os_Test_GetHWIO_Pct_CPU_Utilization() "); 
  TestStepAddActionExpected( chActionText, chExpectedText );
  A_DBGR_VariableRead( "CpuUtilization", taskvalue);
  E_DBGR_VariableCheck("FlagCore_OS_5", 1, Equal);
  
  
  CPUUtilization_after_delay=taskvalue*(0.003051);
  write("CPUUtilization_after_delay is %f",CPUUtilization_after_delay);
  
  
  if(CPUUtilization_after_delay > CPUUtilization_before_delay)
  {
    CPUUtilization = CPUUtilization_after_delay - CPUUtilization_before_delay;
    testStepPass("","CpuUtilization is %f",CPUUtilization);
  }
  else
  {
    CPUUtilization = CPUUtilization_after_delay - CPUUtilization_before_delay;
    testStepFail("","CpuUtilization is %f",CPUUtilization);
  }

  
  
  /*******************************************************************************************************************************************************/    
    // Test Step 7: Remove dealy in Core5 by setting FlagCore_OS_5=0
  /*******************************************************************************************************************************************************/ 
  
  snprintf( chActionText, elCount(chActionText), "Remove dealy in Core5 "); 
  snprintf( chExpectedText, elCount(chExpectedText), "Remove dealy in Core5"); 
  TestStepAddActionExpected( chActionText, chExpectedText );
  A_DBGR_VariableSet("FlagCore_OS_5", "0");
  E_DBGR_VariableCheck("FlagCore_OS_5", 0, Equal);
  
  /*******************************************************************************************************************************************************/    
    // Test Step 8: Set CPU_Utilization_Core5=0 for Core5
  /*******************************************************************************************************************************************************/ 
  
  snprintf( chActionText, elCount(chActionText), "Setting back CPU_Utilization_Core5 to 0"); 
  snprintf( chExpectedText, elCount(chExpectedText), "Setting back CPU_Utilization_Core5 to 0"); 
  TestStepAddActionExpected( chActionText, chExpectedText );
  A_DBGR_VariableSet("CPU_Utilization_Core5", "0");
  E_DBGR_VariableCheck("CPU_Utilization_Core5", 0, Equal);
   


}


/***************************************************************************************************
----------------------------------------------------------------------------------------------------
Test case name:  TC_L30SW_QT_36832660: TC_to_verify_interface_GetHWIO_Cnt_OS_TaskOverrun_to_check_overun_count_after_give_the_delay_in_particulat_task_CPU0_2_5ms_task
----------------------------------------------------------------------------------------------------
Description:  TC_to_verify_interface_GetHWIO_Cnt_OS_TaskOverrun_to_check_overun_count_after_give_the_delay_in_particulat_task_CPU0_2_5ms_task

***************************************************************************************************/
testcase TC_to_verify_interface_GetHWIO_Cnt_OS_TaskOverrun_to_check_overun_count_after_give_the_delay_in_particulat_task_CPU0_2_5ms_task()
{
  /***************************************************************************************************************/    
                                                // Variable Definition
  /***************************************************************************************************************/ 
  
  long taskvalue;
  
  /***************************************************************************************************************/    
                                               // Local Values
  /***************************************************************************************************************/ 
  

  
  /***************************************************************************************************************/    
                                              // Test Case Info
  /***************************************************************************************************************/
  setWriteDbgLevel(DebugOff);
  snprintf( chTestTitle, elCount(chTestTitle), "TC_to_verify_interface_GetHWIO_Cnt_OS_TaskOverrun_to_check_overun_count_after_give_the_delay_in_particulat_task_CPU0_2_5ms_task" );
  snprintf( chTestDescription, elCount(chTestDescription), "Purpose: TC_to_verify_interface_GetHWIO_Cnt_OS_TaskOverrun_to_check_overun_count_after_give_the_delay_in_particulat_task_CPU0_2_5ms_task.");
  TestCaseAddInfo( chTestTitle, "TC_L30SW_QT_36832660", chTestDescription );

  /***************************************************************************************************************/    
                                              // Start of Test Case
  /***************************************************************************************************************/
  
  /***************************************************************************************************************/    
                                              // Test Step 1 PRECONDITIONS
  /***************************************************************************************************************/
  
  snprintf( chActionText, elCount(chActionText), "Flash the Software and ECU is running"); 
  snprintf( chExpectedText, elCount(chExpectedText), "ECU should be in running state"); 
  TestStepAddActionExpected( chActionText, chExpectedText );

  A_DBGR_BreakpointDeleteAll();
  A_DBGR_RnGo();
  E_DBGR_CheckState(T32_State_Running);
  

   /***************************************************************************************************************/    
            // Test Step 2: Check all cores are in running state                                   
  /***************************************************************************************************************/
  
  //Check Core0 is running
  snprintf( chActionText, elCount(chActionText), "Check 1000ms Task Counter from Core0 "); 
  snprintf( chExpectedText, elCount(chExpectedText), "1000ms Counter from Core0 is incrementing"); 
  TestStepAddActionExpected( chActionText, chExpectedText );
  A_DBGR_VariableRead( "Task_Core0_1000ms_Count", taskvalue);
  E_DBGR_VariableCheck("Task_Core0_1000ms_Count", taskvalue, Greater);
  
  //Check Core1 is running
  snprintf( chActionText, elCount(chActionText), "Check 1000ms Task Counter from Core1 "); 
  snprintf( chExpectedText, elCount(chExpectedText), "1000ms Counter from Core1 is incrementing"); 
  TestStepAddActionExpected( chActionText, chExpectedText );
  A_DBGR_VariableRead( "Task_Core1_1000ms_Count", taskvalue);
  E_DBGR_VariableCheck("Task_Core1_1000ms_Count", taskvalue, Greater);
  
  //Check Core2 is running
  snprintf( chActionText, elCount(chActionText), "Check 1000ms Task Counter from Core2 "); 
  snprintf( chExpectedText, elCount(chExpectedText), "1000ms Counter from Core2 is incrementing"); 
  TestStepAddActionExpected( chActionText, chExpectedText );
  A_DBGR_VariableRead( "Task_Core2_1000ms_Count", taskvalue);
  E_DBGR_VariableCheck("Task_Core2_1000ms_Count", taskvalue, Greater);
    
  //Check Core3 is running
  snprintf( chActionText, elCount(chActionText), "Check 1000ms Task Counter from Core3 "); 
  snprintf( chExpectedText, elCount(chExpectedText), "1000ms Counter from Core3 is incrementing"); 
  TestStepAddActionExpected( chActionText, chExpectedText );
  A_DBGR_VariableRead( "Task_Core3_1000ms_Count", taskvalue);
  E_DBGR_VariableCheck("Task_Core3_1000ms_Count", taskvalue, Greater);
    
  //Check Core4 is running
  snprintf( chActionText, elCount(chActionText), "Check 1000ms Task Counter from Core4 "); 
  snprintf( chExpectedText, elCount(chExpectedText), "1000ms Counter from Core4 is incrementing"); 
  TestStepAddActionExpected( chActionText, chExpectedText );
  A_DBGR_VariableRead( "Task_Core4_1000ms_Count", taskvalue);
  E_DBGR_VariableCheck("Task_Core4_1000ms_Count", taskvalue, Greater);
    
  //Check Core5 is running
  snprintf( chActionText, elCount(chActionText), "Check 1000ms Task Counter from Core5 "); 
  snprintf( chExpectedText, elCount(chExpectedText), "1000ms Counter from Core5 is incrementing"); 
  TestStepAddActionExpected( chActionText, chExpectedText );
  A_DBGR_VariableRead( "Task_Core5_1000ms_Count", taskvalue);
  E_DBGR_VariableCheck("Task_Core5_1000ms_Count", taskvalue, Greater);
  
  /*******************************************************************************************************************************************************/    
    // Test Step 3: Set dealy in Core0 by setting FlagCore_OS_0=1 
  /*******************************************************************************************************************************************************/ 
  
  snprintf( chActionText, elCount(chActionText), "Set dealy in Core0 "); 
  snprintf( chExpectedText, elCount(chExpectedText), "check dealy in Core0"); 
  TestStepAddActionExpected( chActionText, chExpectedText );
  A_DBGR_VariableSet("FlagCore_OS_0", "1");
  E_DBGR_VariableCheck("FlagCore_OS_0", 1, Equal);
  
  
  /*******************************************************************************************************************************************************/    
    // Test Step 4: Read TaskOverrunCnt[0][8]
  /*******************************************************************************************************************************************************/ 
  
  snprintf( chActionText, elCount(chActionText), "Check TaskOverrunCnt[0][8] from Core0 "); 
  snprintf( chExpectedText, elCount(chExpectedText), "TaskOverrunCnt[0][8] for Core0 is incrementing"); 
  TestStepAddActionExpected( chActionText, chExpectedText );
  A_DBGR_VariableRead( "TaskOverrunCnt[0][8]", taskvalue);
  E_DBGR_VariableCheck("TaskOverrunCnt[0][8]", taskvalue, Greater);
  
    /*******************************************************************************************************************************************************/    
    // Test Step 5: Remove dealy in Core0 by setting FlagCore_OS_0=1 
  /*******************************************************************************************************************************************************/ 
  
  snprintf( chActionText, elCount(chActionText), "Remove dealy in Core0 "); 
  snprintf( chExpectedText, elCount(chExpectedText), "Remove dealy in Core0"); 
  TestStepAddActionExpected( chActionText, chExpectedText );
  A_DBGR_VariableSet("FlagCore_OS_0", "0");
  E_DBGR_VariableCheck("FlagCore_OS_0", 0, Equal);
  
   
}

/***************************************************************************************************
----------------------------------------------------------------------------------------------------
Test case name:  TC_L30SW_QT_36832661: TC_to_verify_interface_GetHWIO_Cnt_OS_TaskOverrun_to_check_overun_count_after_give_the_delay_in_particulat_task_CPU1_1000ms_task
----------------------------------------------------------------------------------------------------
Description:  TC_to_verify_interface_GetHWIO_Cnt_OS_TaskOverrun_to_check_overun_count_after_give_the_delay_in_particulat_task_CPU1_1000ms_task

***************************************************************************************************/
testcase TC_to_verify_interface_GetHWIO_Cnt_OS_TaskOverrun_to_check_overun_count_after_give_the_delay_in_particulat_task_CPU1_1000ms_task()
{
  /***************************************************************************************************************/    
                                                // Variable Definition
  /***************************************************************************************************************/ 
  
  long taskvalue;
  
  /***************************************************************************************************************/    
                                               // Local Values
  /***************************************************************************************************************/ 
  

  
  /***************************************************************************************************************/    
                                              // Test Case Info
  /***************************************************************************************************************/
  setWriteDbgLevel(DebugOff);
  snprintf( chTestTitle, elCount(chTestTitle), "TC_to_verify_interface_GetHWIO_Cnt_OS_TaskOverrun_to_check_overun_count_after_give_the_delay_in_particulat_task_CPU1_1000ms_task" );
  snprintf( chTestDescription, elCount(chTestDescription), "Purpose: TC_to_verify_interface_GetHWIO_Cnt_OS_TaskOverrun_to_check_overun_count_after_give_the_delay_in_particulat_task_CPU1_1000ms_task.");
  TestCaseAddInfo( chTestTitle, "TC_L30SW_QT_36832661", chTestDescription );

  /***************************************************************************************************************/    
                                              // Start of Test Case
  /***************************************************************************************************************/
  
  /***************************************************************************************************************/    
                                              // Test Step 1 PRECONDITIONS
  /***************************************************************************************************************/
  
  snprintf( chActionText, elCount(chActionText), "Flash the Software and ECU is running"); 
  snprintf( chExpectedText, elCount(chExpectedText), "ECU should be in running state"); 
  TestStepAddActionExpected( chActionText, chExpectedText );

  A_DBGR_BreakpointDeleteAll();
  A_DBGR_RnGo();
  E_DBGR_CheckState(T32_State_Running);
  

   /***************************************************************************************************************/    
            // Test Step 2: Check all cores are in running state                                   
  /***************************************************************************************************************/
  
  //Check Core0 is running
  snprintf( chActionText, elCount(chActionText), "Check 1000ms Task Counter from Core0 "); 
  snprintf( chExpectedText, elCount(chExpectedText), "1000ms Counter from Core0 is incrementing"); 
  TestStepAddActionExpected( chActionText, chExpectedText );
  A_DBGR_VariableRead( "Task_Core0_1000ms_Count", taskvalue);
  E_DBGR_VariableCheck("Task_Core0_1000ms_Count", taskvalue, Greater);
  
  //Check Core1 is running
  snprintf( chActionText, elCount(chActionText), "Check 1000ms Task Counter from Core1 "); 
  snprintf( chExpectedText, elCount(chExpectedText), "1000ms Counter from Core1 is incrementing"); 
  TestStepAddActionExpected( chActionText, chExpectedText );
  A_DBGR_VariableRead( "Task_Core1_1000ms_Count", taskvalue);
  E_DBGR_VariableCheck("Task_Core1_1000ms_Count", taskvalue, Greater);
  
  //Check Core2 is running
  snprintf( chActionText, elCount(chActionText), "Check 1000ms Task Counter from Core2 "); 
  snprintf( chExpectedText, elCount(chExpectedText), "1000ms Counter from Core2 is incrementing"); 
  TestStepAddActionExpected( chActionText, chExpectedText );
  A_DBGR_VariableRead( "Task_Core2_1000ms_Count", taskvalue);
  E_DBGR_VariableCheck("Task_Core2_1000ms_Count", taskvalue, Greater);
    
  //Check Core3 is running
  snprintf( chActionText, elCount(chActionText), "Check 1000ms Task Counter from Core3 "); 
  snprintf( chExpectedText, elCount(chExpectedText), "1000ms Counter from Core3 is incrementing"); 
  TestStepAddActionExpected( chActionText, chExpectedText );
  A_DBGR_VariableRead( "Task_Core3_1000ms_Count", taskvalue);
  E_DBGR_VariableCheck("Task_Core3_1000ms_Count", taskvalue, Greater);
    
  //Check Core4 is running
  snprintf( chActionText, elCount(chActionText), "Check 1000ms Task Counter from Core4 "); 
  snprintf( chExpectedText, elCount(chExpectedText), "1000ms Counter from Core4 is incrementing"); 
  TestStepAddActionExpected( chActionText, chExpectedText );
  A_DBGR_VariableRead( "Task_Core4_1000ms_Count", taskvalue);
  E_DBGR_VariableCheck("Task_Core4_1000ms_Count", taskvalue, Greater);
    
  //Check Core5 is running
  snprintf( chActionText, elCount(chActionText), "Check 1000ms Task Counter from Core5 "); 
  snprintf( chExpectedText, elCount(chExpectedText), "1000ms Counter from Core5 is incrementing"); 
  TestStepAddActionExpected( chActionText, chExpectedText );
  A_DBGR_VariableRead( "Task_Core5_1000ms_Count", taskvalue);
  E_DBGR_VariableCheck("Task_Core5_1000ms_Count", taskvalue, Greater);
  
      // Test Step 3: Set dealy in Core1 by setting FlagCore_OS_1=1 
  /*******************************************************************************************************************************************************/ 
  
  snprintf( chActionText, elCount(chActionText), "Set dealy in Core1 "); 
  snprintf( chExpectedText, elCount(chExpectedText), "check dealy in Core1"); 
  TestStepAddActionExpected( chActionText, chExpectedText );
  A_DBGR_VariableSet("FlagCore_OS_1", "1");
  E_DBGR_VariableCheck("FlagCore_OS_1", 1, Equal);

  
  /*******************************************************************************************************************************************************/    
    // Test Step 4: Read TaskOverrunCnt[1][8]
  /*******************************************************************************************************************************************************/ 
  
  snprintf( chActionText, elCount(chActionText), "Check TaskOverrunCnt[1][8] for Core1 "); 
  snprintf( chExpectedText, elCount(chExpectedText), "TaskOverrunCnt[1][8] for Core1 is incrementing"); 
  TestStepAddActionExpected( chActionText, chExpectedText );
  A_DBGR_VariableRead( "TaskOverrunCnt[1][8]", taskvalue);
  E_DBGR_VariableCheck("TaskOverrunCnt[1][8]", taskvalue, Greater);
    
   /*******************************************************************************************************************************************************/    
    // Test Step 5: Remove dealy in Core1 by setting FlagCore_OS_1=1 
  /*******************************************************************************************************************************************************/ 
  
  snprintf( chActionText, elCount(chActionText), "Remove dealy in Core1 "); 
  snprintf( chExpectedText, elCount(chExpectedText), "Remove dealy in Core1"); 
  TestStepAddActionExpected( chActionText, chExpectedText );
  A_DBGR_VariableSet("FlagCore_OS_1", "0");
  E_DBGR_VariableCheck("FlagCore_OS_1", 0, Equal);
  
   
}

/***************************************************************************************************
----------------------------------------------------------------------------------------------------
Test case name:  TC_L30SW_QT_36832662: TC_to_verify_interface_GetHWIO_Cnt_OS_TaskOverrun_to_check_overun_count_after_give_the_delay_in_particulat_task_CPU2_2_5ms_task
----------------------------------------------------------------------------------------------------
Description:  TC_to_verify_interface_GetHWIO_Cnt_OS_TaskOverrun_to_check_overun_count_after_give_the_delay_in_particulat_task_CPU2_2_5ms_task

***************************************************************************************************/
testcase TC_to_verify_interface_GetHWIO_Cnt_OS_TaskOverrun_to_check_overun_count_after_give_the_delay_in_particulat_task_CPU2_2_5ms_task()
{
  /***************************************************************************************************************/    
                                                // Variable Definition
  /***************************************************************************************************************/ 
  
  long taskvalue;
  
  /***************************************************************************************************************/    
                                               // Local Values
  /***************************************************************************************************************/ 
  

  
  /***************************************************************************************************************/    
                                              // Test Case Info
  /***************************************************************************************************************/
  setWriteDbgLevel(DebugOff);
  snprintf( chTestTitle, elCount(chTestTitle), "TC_to_verify_interface_GetHWIO_Cnt_OS_TaskOverrun_to_check_overun_count_after_give_the_delay_in_particulat_task_CPU2_2_5ms_task" );
  snprintf( chTestDescription, elCount(chTestDescription), "Purpose: TC_to_verify_interface_GetHWIO_Cnt_OS_TaskOverrun_to_check_overun_count_after_give_the_delay_in_particulat_task_CPU2_2_5ms_task.");
  TestCaseAddInfo( chTestTitle, "TC_L30SW_QT_36832662", chTestDescription );

  /***************************************************************************************************************/    
                                              // Start of Test Case
  /***************************************************************************************************************/
  
  /***************************************************************************************************************/    
                                              // Test Step 1 PRECONDITIONS
  /***************************************************************************************************************/
  
  snprintf( chActionText, elCount(chActionText), "Flash the Software and ECU is running"); 
  snprintf( chExpectedText, elCount(chExpectedText), "ECU should be in running state"); 
  TestStepAddActionExpected( chActionText, chExpectedText );

  A_DBGR_BreakpointDeleteAll();
  A_DBGR_RnGo();
  E_DBGR_CheckState(T32_State_Running);
  

   /***************************************************************************************************************/    
            // Test Step 2: Check all cores are in running state                                   
  /***************************************************************************************************************/
  
  //Check Core0 is running
  snprintf( chActionText, elCount(chActionText), "Check 1000ms Task Counter from Core0 "); 
  snprintf( chExpectedText, elCount(chExpectedText), "1000ms Counter from Core0 is incrementing"); 
  TestStepAddActionExpected( chActionText, chExpectedText );
  A_DBGR_VariableRead( "Task_Core0_1000ms_Count", taskvalue);
  E_DBGR_VariableCheck("Task_Core0_1000ms_Count", taskvalue, Greater);
  
  //Check Core1 is running
  snprintf( chActionText, elCount(chActionText), "Check 1000ms Task Counter from Core1 "); 
  snprintf( chExpectedText, elCount(chExpectedText), "1000ms Counter from Core1 is incrementing"); 
  TestStepAddActionExpected( chActionText, chExpectedText );
  A_DBGR_VariableRead( "Task_Core1_1000ms_Count", taskvalue);
  E_DBGR_VariableCheck("Task_Core1_1000ms_Count", taskvalue, Greater);
  
  //Check Core2 is running
  snprintf( chActionText, elCount(chActionText), "Check 1000ms Task Counter from Core2 "); 
  snprintf( chExpectedText, elCount(chExpectedText), "1000ms Counter from Core2 is incrementing"); 
  TestStepAddActionExpected( chActionText, chExpectedText );
  A_DBGR_VariableRead( "Task_Core2_1000ms_Count", taskvalue);
  E_DBGR_VariableCheck("Task_Core2_1000ms_Count", taskvalue, Greater);
    
  //Check Core3 is running
  snprintf( chActionText, elCount(chActionText), "Check 1000ms Task Counter from Core3 "); 
  snprintf( chExpectedText, elCount(chExpectedText), "1000ms Counter from Core3 is incrementing"); 
  TestStepAddActionExpected( chActionText, chExpectedText );
  A_DBGR_VariableRead( "Task_Core3_1000ms_Count", taskvalue);
  E_DBGR_VariableCheck("Task_Core3_1000ms_Count", taskvalue, Greater);
    
  //Check Core4 is running
  snprintf( chActionText, elCount(chActionText), "Check 1000ms Task Counter from Core4 "); 
  snprintf( chExpectedText, elCount(chExpectedText), "1000ms Counter from Core4 is incrementing"); 
  TestStepAddActionExpected( chActionText, chExpectedText );
  A_DBGR_VariableRead( "Task_Core4_1000ms_Count", taskvalue);
  E_DBGR_VariableCheck("Task_Core4_1000ms_Count", taskvalue, Greater);
    
  //Check Core5 is running
  snprintf( chActionText, elCount(chActionText), "Check 1000ms Task Counter from Core5 "); 
  snprintf( chExpectedText, elCount(chExpectedText), "1000ms Counter from Core5 is incrementing"); 
  TestStepAddActionExpected( chActionText, chExpectedText );
  A_DBGR_VariableRead( "Task_Core5_1000ms_Count", taskvalue);
  E_DBGR_VariableCheck("Task_Core5_1000ms_Count", taskvalue, Greater);
  
    // Test Step 3: Set dealy in Core2 by setting FlagCore_OS_2=1
  /*******************************************************************************************************************************************************/ 
  
  snprintf( chActionText, elCount(chActionText), "Set dealy in Core2 "); 
  snprintf( chExpectedText, elCount(chExpectedText), "check dealy in Core2"); 
  TestStepAddActionExpected( chActionText, chExpectedText );
  A_DBGR_VariableSet("FlagCore_OS_2", "1");
  E_DBGR_VariableCheck("FlagCore_OS_2", 1, Equal);
  
  
  /*******************************************************************************************************************************************************/    
    // Test Step 3: Read TaskOverrunCnt[2][8]
  /*******************************************************************************************************************************************************/ 
  
  snprintf( chActionText, elCount(chActionText), "Check TaskOverrunCnt[2][8] for Core2 "); 
  snprintf( chExpectedText, elCount(chExpectedText), "TaskOverrunCnt[2][8] for Core2 is incrementing"); 
  TestStepAddActionExpected( chActionText, chExpectedText );
  A_DBGR_VariableRead( "TaskOverrunCnt[2][8]", taskvalue);
  E_DBGR_VariableCheck("TaskOverrunCnt[2][8]", taskvalue, Greater);
  
  /*******************************************************************************************************************************************************/    
    // Test Step 5: Remove dealy in Core2 by setting FlagCore_OS_2=0
  /*******************************************************************************************************************************************************/ 
  
  snprintf( chActionText, elCount(chActionText), "Remove dealy in Core2 "); 
  snprintf( chExpectedText, elCount(chExpectedText), "Remove dealy in Core2"); 
  TestStepAddActionExpected( chActionText, chExpectedText );
  A_DBGR_VariableSet("FlagCore_OS_2", "0");
  E_DBGR_VariableCheck("FlagCore_OS_2", 0, Equal);
  
   
}

/***************************************************************************************************
----------------------------------------------------------------------------------------------------
Test case name:  TC_L30SW_QT_36832663: TC_to_verify_interface_GetHWIO_Cnt_OS_TaskOverrun_to_check_overun_count_after_give_the_delay_in_particulat_task_CPU2_2_5ms_task
----------------------------------------------------------------------------------------------------
Description:  TC_to_verify_interface_GetHWIO_Cnt_OS_TaskOverrun_to_check_overun_count_after_give_the_delay_in_particulat_task_CPU2_2_5ms_task

***************************************************************************************************/
testcase TC_to_verify_interface_GetHWIO_Cnt_OS_TaskOverrun_to_check_overun_count_after_give_the_delay_in_particulat_task_CPU3_2_5ms_task()
{
  /***************************************************************************************************************/    
                                                // Variable Definition
  /***************************************************************************************************************/ 
  
  long taskvalue;
  
  /***************************************************************************************************************/    
                                               // Local Values
  /***************************************************************************************************************/ 
  

  
  /***************************************************************************************************************/    
                                              // Test Case Info
  /***************************************************************************************************************/
  setWriteDbgLevel(DebugOff);
  snprintf( chTestTitle, elCount(chTestTitle), "TC_to_verify_interface_GetHWIO_Cnt_OS_TaskOverrun_to_check_overun_count_after_give_the_delay_in_particulat_task_CPU3_2_5ms_task" );
  snprintf( chTestDescription, elCount(chTestDescription), "Purpose: TC_to_verify_interface_GetHWIO_Cnt_OS_TaskOverrun_to_check_overun_count_after_give_the_delay_in_particulat_task_CPU3_2_5ms_task.");
  TestCaseAddInfo( chTestTitle, "TC_L30SW_QT_36832663", chTestDescription );

  /***************************************************************************************************************/    
                                              // Start of Test Case
  /***************************************************************************************************************/
  
  /***************************************************************************************************************/    
                                              // Test Step 1 PRECONDITIONS
  /***************************************************************************************************************/
  
  snprintf( chActionText, elCount(chActionText), "Flash the Software and ECU is running"); 
  snprintf( chExpectedText, elCount(chExpectedText), "ECU should be in running state"); 
  TestStepAddActionExpected( chActionText, chExpectedText );

  A_DBGR_BreakpointDeleteAll();
  A_DBGR_RnGo();
  E_DBGR_CheckState(T32_State_Running);
  

   /***************************************************************************************************************/    
            // Test Step 2: Check all cores are in running state                                   
  /***************************************************************************************************************/
  
  //Check Core0 is running
  snprintf( chActionText, elCount(chActionText), "Check 1000ms Task Counter from Core0 "); 
  snprintf( chExpectedText, elCount(chExpectedText), "1000ms Counter from Core0 is incrementing"); 
  TestStepAddActionExpected( chActionText, chExpectedText );
  A_DBGR_VariableRead( "Task_Core0_1000ms_Count", taskvalue);
  E_DBGR_VariableCheck("Task_Core0_1000ms_Count", taskvalue, Greater);
  
  //Check Core1 is running
  snprintf( chActionText, elCount(chActionText), "Check 1000ms Task Counter from Core1 "); 
  snprintf( chExpectedText, elCount(chExpectedText), "1000ms Counter from Core1 is incrementing"); 
  TestStepAddActionExpected( chActionText, chExpectedText );
  A_DBGR_VariableRead( "Task_Core1_1000ms_Count", taskvalue);
  E_DBGR_VariableCheck("Task_Core1_1000ms_Count", taskvalue, Greater);
  
  //Check Core2 is running
  snprintf( chActionText, elCount(chActionText), "Check 1000ms Task Counter from Core2 "); 
  snprintf( chExpectedText, elCount(chExpectedText), "1000ms Counter from Core2 is incrementing"); 
  TestStepAddActionExpected( chActionText, chExpectedText );
  A_DBGR_VariableRead( "Task_Core2_1000ms_Count", taskvalue);
  E_DBGR_VariableCheck("Task_Core2_1000ms_Count", taskvalue, Greater);
    
  //Check Core3 is running
  snprintf( chActionText, elCount(chActionText), "Check 1000ms Task Counter from Core3 "); 
  snprintf( chExpectedText, elCount(chExpectedText), "1000ms Counter from Core3 is incrementing"); 
  TestStepAddActionExpected( chActionText, chExpectedText );
  A_DBGR_VariableRead( "Task_Core3_1000ms_Count", taskvalue);
  E_DBGR_VariableCheck("Task_Core3_1000ms_Count", taskvalue, Greater);
    
  //Check Core4 is running
  snprintf( chActionText, elCount(chActionText), "Check 1000ms Task Counter from Core4 "); 
  snprintf( chExpectedText, elCount(chExpectedText), "1000ms Counter from Core4 is incrementing"); 
  TestStepAddActionExpected( chActionText, chExpectedText );
  A_DBGR_VariableRead( "Task_Core4_1000ms_Count", taskvalue);
  E_DBGR_VariableCheck("Task_Core4_1000ms_Count", taskvalue, Greater);
    
  //Check Core5 is running
  snprintf( chActionText, elCount(chActionText), "Check 1000ms Task Counter from Core5 "); 
  snprintf( chExpectedText, elCount(chExpectedText), "1000ms Counter from Core5 is incrementing"); 
  TestStepAddActionExpected( chActionText, chExpectedText );
  A_DBGR_VariableRead( "Task_Core5_1000ms_Count", taskvalue);
  E_DBGR_VariableCheck("Task_Core5_1000ms_Count", taskvalue, Greater);
  
    // Test Step 3: Set dealy in Core3 by setting FlagCore_OS_3=1
  /*******************************************************************************************************************************************************/ 
  
  snprintf( chActionText, elCount(chActionText), "Set dealy in Core3 "); 
  snprintf( chExpectedText, elCount(chExpectedText), "check dealy in Core3"); 
  TestStepAddActionExpected( chActionText, chExpectedText );
  A_DBGR_VariableSet("FlagCore_OS_3", "1");
  E_DBGR_VariableCheck("FlagCore_OS_3", 1, Equal);
    
  
  /*******************************************************************************************************************************************************/    
    // Test Step 4: Read TaskOverrunCnt[3][8]
  /*******************************************************************************************************************************************************/ 
  
  snprintf( chActionText, elCount(chActionText), "Check TaskOverrunCnt[3][8] for Core3 "); 
  snprintf( chExpectedText, elCount(chExpectedText), "TaskOverrunCnt[3][8] for Core3 is incrementing"); 
  TestStepAddActionExpected( chActionText, chExpectedText );
  A_DBGR_VariableRead( "TaskOverrunCnt[3][8]", taskvalue);
  E_DBGR_VariableCheck("TaskOverrunCnt[3][8]", taskvalue, Greater);
  
  /*******************************************************************************************************************************************************/    
    // Test Step 5: Remove dealy in Core3 by setting FlagCore_OS_3=0
  /*******************************************************************************************************************************************************/ 
  
  snprintf( chActionText, elCount(chActionText), "Remove dealy in Core3 "); 
  snprintf( chExpectedText, elCount(chExpectedText), "Remove dealy in Core3"); 
  TestStepAddActionExpected( chActionText, chExpectedText );
  A_DBGR_VariableSet("FlagCore_OS_3", "0");
  E_DBGR_VariableCheck("FlagCore_OS_3", 0, Equal);
  
   
}

/***************************************************************************************************
----------------------------------------------------------------------------------------------------
Test case name:  TC_L30SW_QT_36832664: TC_to_verify_interface_GetHWIO_Cnt_OS_TaskOverrun_to_check_overun_count_after_give_the_delay_in_particulat_task_CPU4_1000ms_task
----------------------------------------------------------------------------------------------------
Description:  TC_to_verify_interface_GetHWIO_Cnt_OS_TaskOverrun_to_check_overun_count_after_give_the_delay_in_particulat_task_CPU4_1000ms_task

***************************************************************************************************/
testcase TC_to_verify_interface_GetHWIO_Cnt_OS_TaskOverrun_to_check_overun_count_after_give_the_delay_in_particulat_task_CPU4_1000ms_task()
{
  /***************************************************************************************************************/    
                                                // Variable Definition
  /***************************************************************************************************************/ 
  
  long taskvalue;
  
  /***************************************************************************************************************/    
                                               // Local Values
  /***************************************************************************************************************/ 
  

  
  /***************************************************************************************************************/    
                                              // Test Case Info
  /***************************************************************************************************************/
  setWriteDbgLevel(DebugOff);
  snprintf( chTestTitle, elCount(chTestTitle), "TC_to_verify_interface_GetHWIO_Cnt_OS_TaskOverrun_to_check_overun_count_after_give_the_delay_in_particulat_task_CPU4_1000ms_task" );
  snprintf( chTestDescription, elCount(chTestDescription), "Purpose: TC_to_verify_interface_GetHWIO_Cnt_OS_TaskOverrun_to_check_overun_count_after_give_the_delay_in_particulat_task_CPU4_1000ms_task.");
  TestCaseAddInfo( chTestTitle, "TC_L30SW_QT_36832664", chTestDescription );

  /***************************************************************************************************************/    
                                              // Start of Test Case
  /***************************************************************************************************************/
  
  /***************************************************************************************************************/    
                                              // Test Step 1 PRECONDITIONS
  /***************************************************************************************************************/
  
  snprintf( chActionText, elCount(chActionText), "Flash the Software and ECU is running"); 
  snprintf( chExpectedText, elCount(chExpectedText), "ECU should be in running state"); 
  TestStepAddActionExpected( chActionText, chExpectedText );

  A_DBGR_BreakpointDeleteAll();
  A_DBGR_RnGo();
  E_DBGR_CheckState(T32_State_Running);
  

   /***************************************************************************************************************/    
            // Test Step 2: Check all cores are in running state                                   
  /***************************************************************************************************************/
  
  //Check Core0 is running
  snprintf( chActionText, elCount(chActionText), "Check 1000ms Task Counter from Core0 "); 
  snprintf( chExpectedText, elCount(chExpectedText), "1000ms Counter from Core0 is incrementing"); 
  TestStepAddActionExpected( chActionText, chExpectedText );
  A_DBGR_VariableRead( "Task_Core0_1000ms_Count", taskvalue);
  E_DBGR_VariableCheck("Task_Core0_1000ms_Count", taskvalue, Greater);
  
  //Check Core1 is running
  snprintf( chActionText, elCount(chActionText), "Check 1000ms Task Counter from Core1 "); 
  snprintf( chExpectedText, elCount(chExpectedText), "1000ms Counter from Core1 is incrementing"); 
  TestStepAddActionExpected( chActionText, chExpectedText );
  A_DBGR_VariableRead( "Task_Core1_1000ms_Count", taskvalue);
  E_DBGR_VariableCheck("Task_Core1_1000ms_Count", taskvalue, Greater);
  
  //Check Core2 is running
  snprintf( chActionText, elCount(chActionText), "Check 1000ms Task Counter from Core2 "); 
  snprintf( chExpectedText, elCount(chExpectedText), "1000ms Counter from Core2 is incrementing"); 
  TestStepAddActionExpected( chActionText, chExpectedText );
  A_DBGR_VariableRead( "Task_Core2_1000ms_Count", taskvalue);
  E_DBGR_VariableCheck("Task_Core2_1000ms_Count", taskvalue, Greater);
    
  //Check Core3 is running
  snprintf( chActionText, elCount(chActionText), "Check 1000ms Task Counter from Core3 "); 
  snprintf( chExpectedText, elCount(chExpectedText), "1000ms Counter from Core3 is incrementing"); 
  TestStepAddActionExpected( chActionText, chExpectedText );
  A_DBGR_VariableRead( "Task_Core3_1000ms_Count", taskvalue);
  E_DBGR_VariableCheck("Task_Core3_1000ms_Count", taskvalue, Greater);
    
  //Check Core4 is running
  snprintf( chActionText, elCount(chActionText), "Check 1000ms Task Counter from Core4 "); 
  snprintf( chExpectedText, elCount(chExpectedText), "1000ms Counter from Core4 is incrementing"); 
  TestStepAddActionExpected( chActionText, chExpectedText );
  A_DBGR_VariableRead( "Task_Core4_1000ms_Count", taskvalue);
  E_DBGR_VariableCheck("Task_Core4_1000ms_Count", taskvalue, Greater);
    
  //Check Core5 is running
  snprintf( chActionText, elCount(chActionText), "Check 1000ms Task Counter from Core5 "); 
  snprintf( chExpectedText, elCount(chExpectedText), "1000ms Counter from Core5 is incrementing"); 
  TestStepAddActionExpected( chActionText, chExpectedText );
  A_DBGR_VariableRead( "Task_Core5_1000ms_Count", taskvalue);
  E_DBGR_VariableCheck("Task_Core5_1000ms_Count", taskvalue, Greater);
  
    // Test Step 3: Set dealy in Core4 by setting FlagCore_OS_4=1
  /*******************************************************************************************************************************************************/ 
  
  snprintf( chActionText, elCount(chActionText), "Set dealy in Core4 "); 
  snprintf( chExpectedText, elCount(chExpectedText), "check dealy in Core4"); 
  TestStepAddActionExpected( chActionText, chExpectedText );
  A_DBGR_VariableSet("FlagCore_OS_4", "1");
  E_DBGR_VariableCheck("FlagCore_OS_4", 1, Equal);
  

  /*******************************************************************************************************************************************************/    
    // Test Step 4: Read TaskOverrunCnt[4][0]
  /*******************************************************************************************************************************************************/ 
  
  snprintf( chActionText, elCount(chActionText), "Check TaskOverrunCnt[4][0] for Core4 "); 
  snprintf( chExpectedText, elCount(chExpectedText), "TaskOverrunCnt[4][0]for Core4 is incrementing"); 
  TestStepAddActionExpected( chActionText, chExpectedText );
  A_DBGR_VariableRead( "TaskOverrunCnt[4][0]", taskvalue);
  E_DBGR_VariableCheck("TaskOverrunCnt[4][0]", taskvalue, Greater);
  
     /*******************************************************************************************************************************************************/    
    // Test Step 5: Remove dealy in Core4 by setting FlagCore_OS_4=0
  /*******************************************************************************************************************************************************/ 
  
  snprintf( chActionText, elCount(chActionText), "Remove dealy in Core4 "); 
  snprintf( chExpectedText, elCount(chExpectedText), "Remove dealy in Core4"); 
  TestStepAddActionExpected( chActionText, chExpectedText );
  A_DBGR_VariableSet("FlagCore_OS_4", "0");
  E_DBGR_VariableCheck("FlagCore_OS_4", 0, Equal);
  
   
}

/***************************************************************************************************
----------------------------------------------------------------------------------------------------
Test case name:  TC_L30SW_QT_36832665: TC_to_verify_interface_GetHWIO_Cnt_OS_TaskOverrun_to_check_overun_count_after_give_the_delay_in_particulat_task_CPU5_1000ms_task
----------------------------------------------------------------------------------------------------
Description:  TC_to_verify_interface_GetHWIO_Cnt_OS_TaskOverrun_to_check_overun_count_after_give_the_delay_in_particulat_task_CPU5_1000ms_task

***************************************************************************************************/
testcase TC_to_verify_interface_GetHWIO_Cnt_OS_TaskOverrun_to_check_overun_count_after_give_the_delay_in_particulat_task_CPU5_1000ms_task()
{
  /***************************************************************************************************************/    
                                                // Variable Definition
  /***************************************************************************************************************/ 
  
  long taskvalue;
  
  /***************************************************************************************************************/    
                                               // Local Values
  /***************************************************************************************************************/ 
  

  
  /***************************************************************************************************************/    
                                              // Test Case Info
  /***************************************************************************************************************/
  setWriteDbgLevel(DebugOff);
  snprintf( chTestTitle, elCount(chTestTitle), "TC_to_verify_interface_GetHWIO_Cnt_OS_TaskOverrun_to_check_overun_count_after_give_the_delay_in_particulat_task_CPU5_1000ms_task" );
  snprintf( chTestDescription, elCount(chTestDescription), "Purpose: TC_to_verify_interface_GetHWIO_Cnt_OS_TaskOverrun_to_check_overun_count_after_give_the_delay_in_particulat_task_CPU5_1000ms_task.");
  TestCaseAddInfo( chTestTitle, "TC_L30SW_QT_36832665", chTestDescription );

  /***************************************************************************************************************/    
                                              // Start of Test Case
  /***************************************************************************************************************/
  
  /***************************************************************************************************************/    
                                              // Test Step 1 PRECONDITIONS
  /***************************************************************************************************************/
  
  snprintf( chActionText, elCount(chActionText), "Flash the Software and ECU is running"); 
  snprintf( chExpectedText, elCount(chExpectedText), "ECU should be in running state"); 
  TestStepAddActionExpected( chActionText, chExpectedText );

  A_DBGR_BreakpointDeleteAll();
  A_DBGR_RnGo();
  E_DBGR_CheckState(T32_State_Running);
  

   /***************************************************************************************************************/    
            // Test Step 2: Check all cores are in running state                                   
  /***************************************************************************************************************/
  
  //Check Core0 is running
  snprintf( chActionText, elCount(chActionText), "Check 1000ms Task Counter from Core0 "); 
  snprintf( chExpectedText, elCount(chExpectedText), "1000ms Counter from Core0 is incrementing"); 
  TestStepAddActionExpected( chActionText, chExpectedText );
  A_DBGR_VariableRead( "Task_Core0_1000ms_Count", taskvalue);
  E_DBGR_VariableCheck("Task_Core0_1000ms_Count", taskvalue, Greater);
  
  //Check Core1 is running
  snprintf( chActionText, elCount(chActionText), "Check 1000ms Task Counter from Core1 "); 
  snprintf( chExpectedText, elCount(chExpectedText), "1000ms Counter from Core1 is incrementing"); 
  TestStepAddActionExpected( chActionText, chExpectedText );
  A_DBGR_VariableRead( "Task_Core1_1000ms_Count", taskvalue);
  E_DBGR_VariableCheck("Task_Core1_1000ms_Count", taskvalue, Greater);
  
  //Check Core2 is running
  snprintf( chActionText, elCount(chActionText), "Check 1000ms Task Counter from Core2 "); 
  snprintf( chExpectedText, elCount(chExpectedText), "1000ms Counter from Core2 is incrementing"); 
  TestStepAddActionExpected( chActionText, chExpectedText );
  A_DBGR_VariableRead( "Task_Core2_1000ms_Count", taskvalue);
  E_DBGR_VariableCheck("Task_Core2_1000ms_Count", taskvalue, Greater);
    
  //Check Core3 is running
  snprintf( chActionText, elCount(chActionText), "Check 1000ms Task Counter from Core3 "); 
  snprintf( chExpectedText, elCount(chExpectedText), "1000ms Counter from Core3 is incrementing"); 
  TestStepAddActionExpected( chActionText, chExpectedText );
  A_DBGR_VariableRead( "Task_Core3_1000ms_Count", taskvalue);
  E_DBGR_VariableCheck("Task_Core3_1000ms_Count", taskvalue, Greater);
    
  //Check Core4 is running
  snprintf( chActionText, elCount(chActionText), "Check 1000ms Task Counter from Core4 "); 
  snprintf( chExpectedText, elCount(chExpectedText), "1000ms Counter from Core4 is incrementing"); 
  TestStepAddActionExpected( chActionText, chExpectedText );
  A_DBGR_VariableRead( "Task_Core4_1000ms_Count", taskvalue);
  E_DBGR_VariableCheck("Task_Core4_1000ms_Count", taskvalue, Greater);
    
  //Check Core5 is running
  snprintf( chActionText, elCount(chActionText), "Check 1000ms Task Counter from Core5 "); 
  snprintf( chExpectedText, elCount(chExpectedText), "1000ms Counter from Core5 is incrementing"); 
  TestStepAddActionExpected( chActionText, chExpectedText );
  A_DBGR_VariableRead( "Task_Core5_1000ms_Count", taskvalue);
  E_DBGR_VariableCheck("Task_Core5_1000ms_Count", taskvalue, Greater);
  
    // Test Step 3: Set dealy in Core5 by setting FlagCore_OS_5=1
  /*******************************************************************************************************************************************************/ 
  
  snprintf( chActionText, elCount(chActionText), "Set dealy in Core5 "); 
  snprintf( chExpectedText, elCount(chExpectedText), "check dealy in Core5"); 
  TestStepAddActionExpected( chActionText, chExpectedText );
  A_DBGR_VariableSet("FlagCore_OS_5", "1");
  E_DBGR_VariableCheck("FlagCore_OS_5", 1, Equal);
    
  
  /*******************************************************************************************************************************************************/    
    // Test Step 3: Read TaskOverrunCnt[5][0]
  /*******************************************************************************************************************************************************/ 
  
  snprintf( chActionText, elCount(chActionText), "Check TaskOverrunCnt[5][0] for Core5 "); 
  snprintf( chExpectedText, elCount(chExpectedText), "TaskOverrunCnt[5][0] for Core5 is incrementing"); 
  TestStepAddActionExpected( chActionText, chExpectedText );
  A_DBGR_VariableRead( "TaskOverrunCnt[5][0]", taskvalue);
  E_DBGR_VariableCheck("TaskOverrunCnt[5][0]", taskvalue, Greater);
  
     /*******************************************************************************************************************************************************/    
    // Test Step 5: Remove dealy in Core5 by setting FlagCore_OS_5=0
  /*******************************************************************************************************************************************************/ 
  
  snprintf( chActionText, elCount(chActionText), "Remove dealy in Core5 "); 
  snprintf( chExpectedText, elCount(chExpectedText), "Remove dealy in Core5"); 
  TestStepAddActionExpected( chActionText, chExpectedText );
  A_DBGR_VariableSet("FlagCore_OS_5", "0");
  E_DBGR_VariableCheck("FlagCore_OS_5", 0, Equal);
  
   
}

/***************************************************************************************************
----------------------------------------------------------------------------------------------------
Test case name:  TC_L30SW_QT_36542142: TC_to_verify_functionality_of_interface_GetHWIO_t_OS_TaskExecution_to_check_execution_time_for_core0_1000ms_task_scaled_value
----------------------------------------------------------------------------------------------------
Description:  TC_to_verify_functionality_of_interface_GetHWIO_t_OS_TaskExecution_to_check_execution_time_for_core0_1000ms_task_scaled_value
***************************************************************************************************/
testcase TC_to_verify_functionality_of_interface_GetHWIO_t_OS_TaskExecution_to_check_execution_time_for_core0_1000ms_task_scaled_value()
{
  /***************************************************************************************************************/    
                                                // Variable Definition
  /***************************************************************************************************************/ 
  
  long taskvalue;
  float execution_time, execution_time_before_delay, execution_time_after_delay;
  
  /***************************************************************************************************************/    
                                               // Local Values
  /***************************************************************************************************************/ 
  

  
  /***************************************************************************************************************/    
                                              // Test Case Info
  /***************************************************************************************************************/
  setWriteDbgLevel(DebugOff);
  snprintf( chTestTitle, elCount(chTestTitle), "TC_to_verify_functionality_of_interface_GetHWIO_t_OS_TaskExecution_to_check_execution_time_for_core0_1000ms_task_scaled_value" );
  snprintf( chTestDescription, elCount(chTestDescription), "Purpose: TC_to_verify_functionality_of_interface_GetHWIO_t_OS_TaskExecution_to_check_execution_time_for_core0_1000ms_task_scaled_value.");
  TestCaseAddInfo( chTestTitle, "TC_L30SW_QT_36542142", chTestDescription );

  /***************************************************************************************************************/    
                                              // Start of Test Case
  /***************************************************************************************************************/
  
  /***************************************************************************************************************/    
                                              // Test Step 1 PRECONDITIONS
  /***************************************************************************************************************/
  
  snprintf( chActionText, elCount(chActionText), "Flash the Software and ECU is running"); 
  snprintf( chExpectedText, elCount(chExpectedText), "ECU should be in running state"); 
  TestStepAddActionExpected( chActionText, chExpectedText );

  A_DBGR_BreakpointDeleteAll();
  A_DBGR_RnGo();
  E_DBGR_CheckState(T32_State_Running);
  

   /***************************************************************************************************************/    
            // Test Step 2: Check all cores are in running state                                   
  /***************************************************************************************************************/
  
  //Check Core0 is running
  snprintf( chActionText, elCount(chActionText), "Check 1000ms Task Counter from Core0 "); 
  snprintf( chExpectedText, elCount(chExpectedText), "1000ms Counter from Core0 is incrementing"); 
  TestStepAddActionExpected( chActionText, chExpectedText );
  A_DBGR_VariableRead( "Task_Core0_1000ms_Count", taskvalue);
  E_DBGR_VariableCheck("Task_Core0_1000ms_Count", taskvalue, Greater);
  
  //Check Core1 is running
  snprintf( chActionText, elCount(chActionText), "Check 1000ms Task Counter from Core1 "); 
  snprintf( chExpectedText, elCount(chExpectedText), "1000ms Counter from Core1 is incrementing"); 
  TestStepAddActionExpected( chActionText, chExpectedText );
  A_DBGR_VariableRead( "Task_Core1_1000ms_Count", taskvalue);
  E_DBGR_VariableCheck("Task_Core1_1000ms_Count", taskvalue, Greater);
  
  //Check Core2 is running
  snprintf( chActionText, elCount(chActionText), "Check 1000ms Task Counter from Core2 "); 
  snprintf( chExpectedText, elCount(chExpectedText), "1000ms Counter from Core2 is incrementing"); 
  TestStepAddActionExpected( chActionText, chExpectedText );
  A_DBGR_VariableRead( "Task_Core2_1000ms_Count", taskvalue);
  E_DBGR_VariableCheck("Task_Core2_1000ms_Count", taskvalue, Greater);
    
  //Check Core3 is running
  snprintf( chActionText, elCount(chActionText), "Check 1000ms Task Counter from Core3 "); 
  snprintf( chExpectedText, elCount(chExpectedText), "1000ms Counter from Core3 is incrementing"); 
  TestStepAddActionExpected( chActionText, chExpectedText );
  A_DBGR_VariableRead( "Task_Core3_1000ms_Count", taskvalue);
  E_DBGR_VariableCheck("Task_Core3_1000ms_Count", taskvalue, Greater);
    
  //Check Core4 is running
  snprintf( chActionText, elCount(chActionText), "Check 1000ms Task Counter from Core4 "); 
  snprintf( chExpectedText, elCount(chExpectedText), "1000ms Counter from Core4 is incrementing"); 
  TestStepAddActionExpected( chActionText, chExpectedText );
  A_DBGR_VariableRead( "Task_Core4_1000ms_Count", taskvalue);
  E_DBGR_VariableCheck("Task_Core4_1000ms_Count", taskvalue, Greater);
    
  //Check Core5 is running
  snprintf( chActionText, elCount(chActionText), "Check 1000ms Task Counter from Core5 "); 
  snprintf( chExpectedText, elCount(chExpectedText), "1000ms Counter from Core5 is incrementing"); 
  TestStepAddActionExpected( chActionText, chExpectedText );
  A_DBGR_VariableRead( "Task_Core5_1000ms_Count", taskvalue);
  E_DBGR_VariableCheck("Task_Core5_1000ms_Count", taskvalue, Greater);
  
   /*******************************************************************************************************************************************************/    
    // Test Step 3: Set TaskExecution_Core0 for Core0
  /*******************************************************************************************************************************************************/ 
  
  snprintf( chActionText, elCount(chActionText), "Set TaskExecution_Core0 for Core0"); 
  snprintf( chExpectedText, elCount(chExpectedText), "Set TaskExecution_Core0 for Core0"); 
  TestStepAddActionExpected( chActionText, chExpectedText );
  A_DBGR_VariableSet("TaskExecution_Core0", "1");
  E_DBGR_VariableCheck("TaskExecution_Core0", 1, Equal);
  
  /******************************************************************************************************************************************************/    
    // Test Step 4: Read exectiontime for Core 0
  /*******************************************************************************************************************************************************/

  snprintf( chActionText, elCount(chActionText), "Call funtion Os_Test_GetHWIO_t_OS_TaskExecution() "); 
  snprintf( chExpectedText, elCount(chExpectedText), "Verify exectiontime  variable in funtion Os_Test_GetHWIO_t_OS_TaskExecution() "); 
  TestStepAddActionExpected( chActionText, chExpectedText );
   A_DBGR_VariableRead( "exectiontime", taskvalue);
   E_DBGR_VariableCheck("TaskExecution_Core0", 1, Equal);
  
  execution_time_before_delay=taskvalue*(0.007812);
  write("execution_time_before_delay for Core 0 is %f",execution_time_before_delay);
  
    /******************************************************************************************************************************************************/ 
 // Test Step 5: Set dealy in Core0 by setting FlagCore0_Task__1000ms=1
  /*******************************************************************************************************************************************************/ 
  
  snprintf( chActionText, elCount(chActionText), "Set dealy in Core0 "); 
  snprintf( chExpectedText, elCount(chExpectedText), "check dealy in Core0"); 
  TestStepAddActionExpected( chActionText, chExpectedText );
  A_DBGR_VariableSet("FlagCore0_Task__1000ms", "1");
  E_DBGR_VariableCheck("FlagCore0_Task__1000ms", 1, Equal);
  testWaitForTimeout(1000);
  
  /******************************************************************************************************************************************************/    
    // Test Step 6: Read exectiontime for Core 0
  /*******************************************************************************************************************************************************/

  snprintf( chActionText, elCount(chActionText), "Call funtion Os_Test_GetHWIO_t_OS_TaskExecution() "); 
  snprintf( chExpectedText, elCount(chExpectedText), "Verify exectiontime  variable in funtion Os_Test_GetHWIO_t_OS_TaskExecution() "); 
  TestStepAddActionExpected( chActionText, chExpectedText );
  A_DBGR_VariableRead( "exectiontime", taskvalue);
  E_DBGR_VariableCheck("FlagCore0_Task__1000ms", 1, Equal);
  
  execution_time_after_delay=taskvalue*(0.007812);
  write("execution_time_after_delay for Core0 is %f",execution_time_after_delay);
  
  
   if(execution_time_after_delay > execution_time_before_delay)
  {
    execution_time = execution_time_after_delay - execution_time_before_delay;
    testStepPass("","execution_time for Core0 is %f",execution_time);
  }
  else
  {
    execution_time = execution_time_after_delay - execution_time_before_delay;
    testStepFail("","execution_time for Core0 is %f",execution_time);
  }
  
  /*******************************************************************************************************************************************************/    
    // Test Step 7: Remove dealy in Core0 by setting FlagCore0_Task__1000ms=0
  /*******************************************************************************************************************************************************/ 
  
  snprintf( chActionText, elCount(chActionText), "Remove dealy in Core0 "); 
  snprintf( chExpectedText, elCount(chExpectedText), "Remove dealy in Core0"); 
  TestStepAddActionExpected( chActionText, chExpectedText );
  A_DBGR_VariableSet("FlagCore0_Task__1000ms", "0");
  E_DBGR_VariableCheck("FlagCore0_Task__1000ms", 0, Equal);
  
  /*******************************************************************************************************************************************************/    
    // Test Step 8: Set CPU_Utilization_Core0=0 for Core0
  /*******************************************************************************************************************************************************/ 
  
  snprintf( chActionText, elCount(chActionText), "Set TaskExecution_Core0=0 for Core0"); 
  snprintf( chExpectedText, elCount(chExpectedText), "Set TaskExecution_Core0=0 for Core0"); 
  TestStepAddActionExpected( chActionText, chExpectedText );
  A_DBGR_VariableSet("TaskExecution_Core0", "0");
  E_DBGR_VariableCheck("TaskExecution_Core0", 0, Equal);

}

/***************************************************************************************************
----------------------------------------------------------------------------------------------------
Test case name:  TC_L30SW_QT_36542143: TC_to_verify_functionality_of_interface_GetHWIO_t_OS_TaskExecution_to_check_execution_time_for_core1_1000ms_task_scaled_value
----------------------------------------------------------------------------------------------------
Description:  TC_to_verify_functionality_of_interface_GetHWIO_t_OS_TaskExecution_to_check_execution_time_for_core1_1000ms_task_scaled_value
***************************************************************************************************/
testcase TC_to_verify_functionality_of_interface_GetHWIO_t_OS_TaskExecution_to_check_execution_time_for_core1_1000ms_task_scaled_value()
{
  /***************************************************************************************************************/    
                                                // Variable Definition
  /***************************************************************************************************************/ 
  
  long taskvalue;
  float execution_time, execution_time_before_delay, execution_time_after_delay;;
  
  /***************************************************************************************************************/    
                                               // Local Values
  /***************************************************************************************************************/ 
  

  
  /***************************************************************************************************************/    
                                              // Test Case Info
  /***************************************************************************************************************/
  setWriteDbgLevel(DebugOff);
  snprintf( chTestTitle, elCount(chTestTitle), "TC_to_verify_functionality_of_interface_GetHWIO_t_OS_TaskExecution_to_check_execution_time_for_core1_1000ms_task_scaled_value" );
  snprintf( chTestDescription, elCount(chTestDescription), "Purpose: TC_to_verify_functionality_of_interface_GetHWIO_t_OS_TaskExecution_to_check_execution_time_for_core1_1000ms_task_scaled_value.");
  TestCaseAddInfo( chTestTitle, "TC_L30SW_QT_36542143", chTestDescription );

  /***************************************************************************************************************/    
                                              // Start of Test Case
  /***************************************************************************************************************/
  
  /***************************************************************************************************************/    
                                              // Test Step 1 PRECONDITIONS
  /***************************************************************************************************************/
  
  snprintf( chActionText, elCount(chActionText), "Flash the Software and ECU is running"); 
  snprintf( chExpectedText, elCount(chExpectedText), "ECU should be in running state"); 
  TestStepAddActionExpected( chActionText, chExpectedText );

  A_DBGR_BreakpointDeleteAll();
  A_DBGR_RnGo();
  E_DBGR_CheckState(T32_State_Running);
  

   /***************************************************************************************************************/    
            // Test Step 2: Check all cores are in running state                                   
  /***************************************************************************************************************/
  
  //Check Core0 is running
  snprintf( chActionText, elCount(chActionText), "Check 1000ms Task Counter from Core0 "); 
  snprintf( chExpectedText, elCount(chExpectedText), "1000ms Counter from Core0 is incrementing"); 
  TestStepAddActionExpected( chActionText, chExpectedText );
  A_DBGR_VariableRead( "Task_Core0_1000ms_Count", taskvalue);
  E_DBGR_VariableCheck("Task_Core0_1000ms_Count", taskvalue, Greater);
  
  //Check Core1 is running
  snprintf( chActionText, elCount(chActionText), "Check 1000ms Task Counter from Core1 "); 
  snprintf( chExpectedText, elCount(chExpectedText), "1000ms Counter from Core1 is incrementing"); 
  TestStepAddActionExpected( chActionText, chExpectedText );
  A_DBGR_VariableRead( "Task_Core1_1000ms_Count", taskvalue);
  E_DBGR_VariableCheck("Task_Core1_1000ms_Count", taskvalue, Greater);
  
  //Check Core2 is running
  snprintf( chActionText, elCount(chActionText), "Check 1000ms Task Counter from Core2 "); 
  snprintf( chExpectedText, elCount(chExpectedText), "1000ms Counter from Core2 is incrementing"); 
  TestStepAddActionExpected( chActionText, chExpectedText );
  A_DBGR_VariableRead( "Task_Core2_1000ms_Count", taskvalue);
  E_DBGR_VariableCheck("Task_Core2_1000ms_Count", taskvalue, Greater);
    
  //Check Core3 is running
  snprintf( chActionText, elCount(chActionText), "Check 1000ms Task Counter from Core3 "); 
  snprintf( chExpectedText, elCount(chExpectedText), "1000ms Counter from Core3 is incrementing"); 
  TestStepAddActionExpected( chActionText, chExpectedText );
  A_DBGR_VariableRead( "Task_Core3_1000ms_Count", taskvalue);
  E_DBGR_VariableCheck("Task_Core3_1000ms_Count", taskvalue, Greater);
    
  //Check Core4 is running
  snprintf( chActionText, elCount(chActionText), "Check 1000ms Task Counter from Core4 "); 
  snprintf( chExpectedText, elCount(chExpectedText), "1000ms Counter from Core4 is incrementing"); 
  TestStepAddActionExpected( chActionText, chExpectedText );
  A_DBGR_VariableRead( "Task_Core4_1000ms_Count", taskvalue);
  E_DBGR_VariableCheck("Task_Core4_1000ms_Count", taskvalue, Greater);
    
  //Check Core5 is running
  snprintf( chActionText, elCount(chActionText), "Check 1000ms Task Counter from Core5 "); 
  snprintf( chExpectedText, elCount(chExpectedText), "1000ms Counter from Core5 is incrementing"); 
  TestStepAddActionExpected( chActionText, chExpectedText );
  A_DBGR_VariableRead( "Task_Core5_1000ms_Count", taskvalue);
  E_DBGR_VariableCheck("Task_Core5_1000ms_Count", taskvalue, Greater);
  
 /*******************************************************************************************************************************************************/    
    // Test Step 3: Set TaskExecution_Core1 for Core1
  /*******************************************************************************************************************************************************/ 
  
  snprintf( chActionText, elCount(chActionText), "Set TaskExecution_Core1 for Core1"); 
  snprintf( chExpectedText, elCount(chExpectedText), "Set TaskExecution_Core1 for Core1"); 
  TestStepAddActionExpected( chActionText, chExpectedText );
  A_DBGR_VariableSet("TaskExecution_Core1", "1");
  E_DBGR_VariableCheck("TaskExecution_Core1", 1, Equal);
  
  /******************************************************************************************************************************************************/    
    // Test Step 4: Read exectiontime for Core1
  /*******************************************************************************************************************************************************/

  snprintf( chActionText, elCount(chActionText), "Call funtion Os_Test_GetHWIO_t_OS_TaskExecution() "); 
  snprintf( chExpectedText, elCount(chExpectedText), "Verify exectiontime  variable in funtion Os_Test_GetHWIO_t_OS_TaskExecution() "); 
  TestStepAddActionExpected( chActionText, chExpectedText );
  A_DBGR_VariableRead( "exectiontime", taskvalue);
  E_DBGR_VariableCheck("TaskExecution_Core1", 1, Equal);
  
  execution_time_before_delay=taskvalue*(0.007812);
  write("execution_time_before_delay for Core 1 is %f",execution_time_before_delay);

  
    /******************************************************************************************************************************************************/ 
 // Test Step 5: Set dealy in Core1 by setting FlagCore1_Task__1000ms=1
  /*******************************************************************************************************************************************************/ 
  
  snprintf( chActionText, elCount(chActionText), "Set dealy in Core1 "); 
  snprintf( chExpectedText, elCount(chExpectedText), "check dealy in Core1"); 
  TestStepAddActionExpected( chActionText, chExpectedText );
  A_DBGR_VariableSet("FlagCore1_Task__1000ms", "1");
  E_DBGR_VariableCheck("FlagCore1_Task__1000ms", 1, Equal);
  testWaitForTimeout(1000);
  
  /******************************************************************************************************************************************************/    
    // Test Step 6: Read exectiontime for Core1
  /*******************************************************************************************************************************************************/

  snprintf( chActionText, elCount(chActionText), "Call funtion Os_Test_GetHWIO_t_OS_TaskExecution() "); 
  snprintf( chExpectedText, elCount(chExpectedText), "Verify exectiontime  variable in funtion Os_Test_GetHWIO_t_OS_TaskExecution() "); 
  TestStepAddActionExpected( chActionText, chExpectedText );
  A_DBGR_VariableRead( "exectiontime", taskvalue);
  E_DBGR_VariableCheck("FlagCore1_Task__1000ms", 1, Equal);
  
  execution_time_after_delay=taskvalue*(0.007812);
  write("execution_time_after_delay for Core1 is %f",execution_time_after_delay);
  
  
   if(execution_time_after_delay > execution_time_before_delay)
  {
    execution_time = execution_time_after_delay - execution_time_before_delay;
    testStepPass("","execution_time for Core1 is %f",execution_time);
  }
  else
  {
    execution_time = execution_time_after_delay - execution_time_before_delay;
    testStepFail("","execution_time for Core1 is %f",execution_time);
  }
  
  /*******************************************************************************************************************************************************/    
    // Test Step 7: Remove dealy in Core1 by setting FlagCore1_Task__1000ms=0
  /*******************************************************************************************************************************************************/ 
  
  snprintf( chActionText, elCount(chActionText), "Remove dealy in Core1 "); 
  snprintf( chExpectedText, elCount(chExpectedText), "Remove dealy in Core1"); 
  TestStepAddActionExpected( chActionText, chExpectedText );
  A_DBGR_VariableSet("FlagCore1_Task__1000ms", "0");
  E_DBGR_VariableCheck("FlagCore1_Task__1000ms", 0, Equal);
  
  /*******************************************************************************************************************************************************/    
    // Test Step 8: Set TaskExecution_Core1=0 for Core1
  /*******************************************************************************************************************************************************/ 
  
  snprintf( chActionText, elCount(chActionText), "Set TaskExecution_Core1=0 for Core1"); 
  snprintf( chExpectedText, elCount(chExpectedText), "Set TaskExecution_Core1=0 for Core1"); 
  TestStepAddActionExpected( chActionText, chExpectedText );
  A_DBGR_VariableSet("TaskExecution_Core1", "0");
  E_DBGR_VariableCheck("TaskExecution_Core1", 0, Equal);

}

/***************************************************************************************************
----------------------------------------------------------------------------------------------------
Test case name:  TC_L30SW_QT_36542144: TC_to_verify_functionality_of_interface_GetHWIO_t_OS_TaskExecution_to_check_execution_time_for_core2_1000ms_task_scaled_value
----------------------------------------------------------------------------------------------------
Description:  TC_to_verify_functionality_of_interface_GetHWIO_t_OS_TaskExecution_to_check_execution_time_for_core2_1000ms_task_scaled_value
***************************************************************************************************/
testcase TC_to_verify_functionality_of_interface_GetHWIO_t_OS_TaskExecution_to_check_execution_time_for_core2_1000ms_task_scaled_value()
{
  /***************************************************************************************************************/    
                                                // Variable Definition
  /***************************************************************************************************************/ 
  
  long taskvalue;
  float execution_time, execution_time_before_delay, execution_time_after_delay;;
  
  /***************************************************************************************************************/    
                                               // Local Values
  /***************************************************************************************************************/ 
  

  
  /***************************************************************************************************************/    
                                              // Test Case Info
  /***************************************************************************************************************/
  setWriteDbgLevel(DebugOff);
  snprintf( chTestTitle, elCount(chTestTitle), "TC_to_verify_functionality_of_interface_GetHWIO_t_OS_TaskExecution_to_check_execution_time_for_core2_1000ms_task_scaled_value" );
  snprintf( chTestDescription, elCount(chTestDescription), "Purpose: TC_to_verify_functionality_of_interface_GetHWIO_t_OS_TaskExecution_to_check_execution_time_for_core2_1000ms_task_scaled_value.");
  TestCaseAddInfo( chTestTitle, "TC_L30SW_QT_36542144", chTestDescription );

  /***************************************************************************************************************/    
                                              // Start of Test Case
  /***************************************************************************************************************/
  
  /***************************************************************************************************************/    
                                              // Test Step 1 PRECONDITIONS
  /***************************************************************************************************************/
  
  snprintf( chActionText, elCount(chActionText), "Flash the Software and ECU is running"); 
  snprintf( chExpectedText, elCount(chExpectedText), "ECU should be in running state"); 
  TestStepAddActionExpected( chActionText, chExpectedText );

  A_DBGR_BreakpointDeleteAll();
  A_DBGR_RnGo();
  E_DBGR_CheckState(T32_State_Running);
  

   /***************************************************************************************************************/    
            // Test Step 2: Check all cores are in running state                                   
  /***************************************************************************************************************/
  
  //Check Core0 is running
  snprintf( chActionText, elCount(chActionText), "Check 1000ms Task Counter from Core0 "); 
  snprintf( chExpectedText, elCount(chExpectedText), "1000ms Counter from Core0 is incrementing"); 
  TestStepAddActionExpected( chActionText, chExpectedText );
  A_DBGR_VariableRead( "Task_Core0_1000ms_Count", taskvalue);
  E_DBGR_VariableCheck("Task_Core0_1000ms_Count", taskvalue, Greater);
  
  //Check Core1 is running
  snprintf( chActionText, elCount(chActionText), "Check 1000ms Task Counter from Core1 "); 
  snprintf( chExpectedText, elCount(chExpectedText), "1000ms Counter from Core1 is incrementing"); 
  TestStepAddActionExpected( chActionText, chExpectedText );
  A_DBGR_VariableRead( "Task_Core1_1000ms_Count", taskvalue);
  E_DBGR_VariableCheck("Task_Core1_1000ms_Count", taskvalue, Greater);
  
  //Check Core2 is running
  snprintf( chActionText, elCount(chActionText), "Check 1000ms Task Counter from Core2 "); 
  snprintf( chExpectedText, elCount(chExpectedText), "1000ms Counter from Core2 is incrementing"); 
  TestStepAddActionExpected( chActionText, chExpectedText );
  A_DBGR_VariableRead( "Task_Core2_1000ms_Count", taskvalue);
  E_DBGR_VariableCheck("Task_Core2_1000ms_Count", taskvalue, Greater);
    
  //Check Core3 is running
  snprintf( chActionText, elCount(chActionText), "Check 1000ms Task Counter from Core3 "); 
  snprintf( chExpectedText, elCount(chExpectedText), "1000ms Counter from Core3 is incrementing"); 
  TestStepAddActionExpected( chActionText, chExpectedText );
  A_DBGR_VariableRead( "Task_Core3_1000ms_Count", taskvalue);
  E_DBGR_VariableCheck("Task_Core3_1000ms_Count", taskvalue, Greater);
    
  //Check Core4 is running
  snprintf( chActionText, elCount(chActionText), "Check 1000ms Task Counter from Core4 "); 
  snprintf( chExpectedText, elCount(chExpectedText), "1000ms Counter from Core4 is incrementing"); 
  TestStepAddActionExpected( chActionText, chExpectedText );
  A_DBGR_VariableRead( "Task_Core4_1000ms_Count", taskvalue);
  E_DBGR_VariableCheck("Task_Core4_1000ms_Count", taskvalue, Greater);
    
  //Check Core5 is running
  snprintf( chActionText, elCount(chActionText), "Check 1000ms Task Counter from Core5 "); 
  snprintf( chExpectedText, elCount(chExpectedText), "1000ms Counter from Core5 is incrementing"); 
  TestStepAddActionExpected( chActionText, chExpectedText );
  A_DBGR_VariableRead( "Task_Core5_1000ms_Count", taskvalue);
  E_DBGR_VariableCheck("Task_Core5_1000ms_Count", taskvalue, Greater);
  
/*******************************************************************************************************************************************************/    
    // Test Step 3: Set TaskExecution_Core2 for Core2
  /*******************************************************************************************************************************************************/ 
  
  snprintf( chActionText, elCount(chActionText), "Set TaskExecution_Core2 for Core2"); 
  snprintf( chExpectedText, elCount(chExpectedText), "Set TaskExecution_Core2 for Core2"); 
  TestStepAddActionExpected( chActionText, chExpectedText );
  A_DBGR_VariableSet("TaskExecution_Core2", "1");
  E_DBGR_VariableCheck("TaskExecution_Core2", 1, Equal);
  
  /******************************************************************************************************************************************************/    
    // Test Step 4: Read exectiontime for Core2
  /*******************************************************************************************************************************************************/

  snprintf( chActionText, elCount(chActionText), "Call funtion Os_Test_GetHWIO_t_OS_TaskExecution() "); 
  snprintf( chExpectedText, elCount(chExpectedText), "Verify exectiontime  variable in funtion Os_Test_GetHWIO_t_OS_TaskExecution() "); 
  TestStepAddActionExpected( chActionText, chExpectedText );
  A_DBGR_VariableRead( "exectiontime", taskvalue);
  E_DBGR_VariableCheck("TaskExecution_Core2", 1, Equal);
  
  execution_time_before_delay=taskvalue*(0.007812);
  write("execution_time_before_delay for Core 2 is %f",execution_time_before_delay);

  
    /******************************************************************************************************************************************************/ 
 // Test Step 5: Set dealy in Core2 by setting FlagCore2_Task__1000ms=1
  /*******************************************************************************************************************************************************/ 
  
  snprintf( chActionText, elCount(chActionText), "Set dealy in Core2 "); 
  snprintf( chExpectedText, elCount(chExpectedText), "check dealy in Core2"); 
  TestStepAddActionExpected( chActionText, chExpectedText );
  A_DBGR_VariableSet("FlagCore2_Task__1000ms", "1");
  E_DBGR_VariableCheck("FlagCore2_Task__1000ms", 1, Equal);
  testWaitForTimeout(1000);
  
  /******************************************************************************************************************************************************/    
    // Test Step 6: Read exectiontime for Core2
  /*******************************************************************************************************************************************************/

  snprintf( chActionText, elCount(chActionText), "Call funtion Os_Test_GetHWIO_t_OS_TaskExecution() "); 
  snprintf( chExpectedText, elCount(chExpectedText), "Verify exectiontime  variable in funtion Os_Test_GetHWIO_t_OS_TaskExecution() "); 
  TestStepAddActionExpected( chActionText, chExpectedText );
  E_DBGR_VariableCheck("FlagCore2_Task__1000ms", 1, Equal);
  
  execution_time_after_delay=taskvalue*(0.007812);
  write("execution_time_after_delay for Core 2 is %f",execution_time_after_delay);
  
  
   if(execution_time_after_delay > execution_time_before_delay)
  {
    execution_time = execution_time_after_delay - execution_time_before_delay;
    testStepPass("","execution_time for Core 2 is %f",execution_time);
  }
  else
  {
    execution_time = execution_time_after_delay - execution_time_before_delay;
    testStepFail("","execution_time for Core 2 is %f",execution_time);
  }
  
  /*******************************************************************************************************************************************************/    
    // Test Step 7: Remove dealy in Core2 by setting FlagCore2_Task__1000ms=0
  /*******************************************************************************************************************************************************/ 
  
  snprintf( chActionText, elCount(chActionText), "Remove dealy in Core2 "); 
  snprintf( chExpectedText, elCount(chExpectedText), "Remove dealy in Core2"); 
  TestStepAddActionExpected( chActionText, chExpectedText );
  A_DBGR_VariableSet("FlagCore2_Task__1000ms", "0");
  E_DBGR_VariableCheck("FlagCore2_Task__1000ms", 0, Equal);
  
  /*******************************************************************************************************************************************************/    
    // Test Step 8: Set TaskExecution_Core2=0 for Core2
  /*******************************************************************************************************************************************************/ 
  
  snprintf( chActionText, elCount(chActionText), "Set TaskExecution_Core2=0 for Core2"); 
  snprintf( chExpectedText, elCount(chExpectedText), "Set TaskExecution_Core2=0 for Core2"); 
  TestStepAddActionExpected( chActionText, chExpectedText );
  A_DBGR_VariableSet("TaskExecution_Core2", "0");
  E_DBGR_VariableCheck("TaskExecution_Core2", 0, Equal);

}

/***************************************************************************************************
----------------------------------------------------------------------------------------------------
Test case name:  TC_L30SW_QT_36542145: TC_to_verify_functionality_of_interface_GetHWIO_t_OS_TaskExecution_to_check_execution_time_for_core3_1000ms_task_scaled_value
----------------------------------------------------------------------------------------------------
Description:  TC_to_verify_functionality_of_interface_GetHWIO_t_OS_TaskExecution_to_check_execution_time_for_core3_1000ms_task_scaled_value
***************************************************************************************************/
testcase TC_to_verify_functionality_of_interface_GetHWIO_t_OS_TaskExecution_to_check_execution_time_for_core3_1000ms_task_scaled_value()
{
  /***************************************************************************************************************/    
                                                // Variable Definition
  /***************************************************************************************************************/ 
  
  long taskvalue;
  float execution_time, execution_time_before_delay, execution_time_after_delay;
  
  /***************************************************************************************************************/    
                                               // Local Values
  /***************************************************************************************************************/ 
  

  
  /***************************************************************************************************************/    
                                              // Test Case Info
  /***************************************************************************************************************/
  setWriteDbgLevel(DebugOff);
  snprintf( chTestTitle, elCount(chTestTitle), "TC_to_verify_functionality_of_interface_GetHWIO_t_OS_TaskExecution_to_check_execution_time_for_core3_1000ms_task_scaled_value" );
  snprintf( chTestDescription, elCount(chTestDescription), "Purpose: TC_to_verify_functionality_of_interface_GetHWIO_t_OS_TaskExecution_to_check_execution_time_for_core3_1000ms_task_scaled_value.");
  TestCaseAddInfo( chTestTitle, "TC_L30SW_QT_36542145", chTestDescription );

  /***************************************************************************************************************/    
                                              // Start of Test Case
  /***************************************************************************************************************/
  
  /***************************************************************************************************************/    
                                              // Test Step 1 PRECONDITIONS
  /***************************************************************************************************************/
  
  snprintf( chActionText, elCount(chActionText), "Flash the Software and ECU is running"); 
  snprintf( chExpectedText, elCount(chExpectedText), "ECU should be in running state"); 
  TestStepAddActionExpected( chActionText, chExpectedText );

  A_DBGR_BreakpointDeleteAll();
  A_DBGR_RnGo();
  E_DBGR_CheckState(T32_State_Running);
  

   /***************************************************************************************************************/    
            // Test Step 2: Check all cores are in running state                                   
  /***************************************************************************************************************/
  
  //Check Core0 is running
  snprintf( chActionText, elCount(chActionText), "Check 1000ms Task Counter from Core0 "); 
  snprintf( chExpectedText, elCount(chExpectedText), "1000ms Counter from Core0 is incrementing"); 
  TestStepAddActionExpected( chActionText, chExpectedText );
  A_DBGR_VariableRead( "Task_Core0_1000ms_Count", taskvalue);
  E_DBGR_VariableCheck("Task_Core0_1000ms_Count", taskvalue, Greater);
  
  //Check Core1 is running
  snprintf( chActionText, elCount(chActionText), "Check 1000ms Task Counter from Core1 "); 
  snprintf( chExpectedText, elCount(chExpectedText), "1000ms Counter from Core1 is incrementing"); 
  TestStepAddActionExpected( chActionText, chExpectedText );
  A_DBGR_VariableRead( "Task_Core1_1000ms_Count", taskvalue);
  E_DBGR_VariableCheck("Task_Core1_1000ms_Count", taskvalue, Greater);
  
  //Check Core2 is running
  snprintf( chActionText, elCount(chActionText), "Check 1000ms Task Counter from Core2 "); 
  snprintf( chExpectedText, elCount(chExpectedText), "1000ms Counter from Core2 is incrementing"); 
  TestStepAddActionExpected( chActionText, chExpectedText );
  A_DBGR_VariableRead( "Task_Core2_1000ms_Count", taskvalue);
  E_DBGR_VariableCheck("Task_Core2_1000ms_Count", taskvalue, Greater);
    
  //Check Core3 is running
  snprintf( chActionText, elCount(chActionText), "Check 1000ms Task Counter from Core3 "); 
  snprintf( chExpectedText, elCount(chExpectedText), "1000ms Counter from Core3 is incrementing"); 
  TestStepAddActionExpected( chActionText, chExpectedText );
  A_DBGR_VariableRead( "Task_Core3_1000ms_Count", taskvalue);
  E_DBGR_VariableCheck("Task_Core3_1000ms_Count", taskvalue, Greater);
    
  //Check Core4 is running
  snprintf( chActionText, elCount(chActionText), "Check 1000ms Task Counter from Core4 "); 
  snprintf( chExpectedText, elCount(chExpectedText), "1000ms Counter from Core4 is incrementing"); 
  TestStepAddActionExpected( chActionText, chExpectedText );
  A_DBGR_VariableRead( "Task_Core4_1000ms_Count", taskvalue);
  E_DBGR_VariableCheck("Task_Core4_1000ms_Count", taskvalue, Greater);
    
  //Check Core5 is running
  snprintf( chActionText, elCount(chActionText), "Check 1000ms Task Counter from Core5 "); 
  snprintf( chExpectedText, elCount(chExpectedText), "1000ms Counter from Core5 is incrementing"); 
  TestStepAddActionExpected( chActionText, chExpectedText );
  A_DBGR_VariableRead( "Task_Core5_1000ms_Count", taskvalue);
  E_DBGR_VariableCheck("Task_Core5_1000ms_Count", taskvalue, Greater);
  
/*******************************************************************************************************************************************************/    
    // Test Step 3: Set TaskExecution_Core3 for Core3
  /*******************************************************************************************************************************************************/ 
  
  snprintf( chActionText, elCount(chActionText), "Set TaskExecution_Core3 for Core3"); 
  snprintf( chExpectedText, elCount(chExpectedText), "Set TaskExecution_Core3 for Core3"); 
  TestStepAddActionExpected( chActionText, chExpectedText );
  A_DBGR_VariableSet("TaskExecution_Core3", "1");
  E_DBGR_VariableCheck("TaskExecution_Core3", 1, Equal);
  
  /******************************************************************************************************************************************************/    
    // Test Step 4: Read exectiontime for Core3
  /*******************************************************************************************************************************************************/

  snprintf( chActionText, elCount(chActionText), "Call funtion Os_Test_GetHWIO_t_OS_TaskExecution() "); 
  snprintf( chExpectedText, elCount(chExpectedText), "Verify exectiontime  variable in funtion Os_Test_GetHWIO_t_OS_TaskExecution() "); 
  TestStepAddActionExpected( chActionText, chExpectedText );
  A_DBGR_VariableRead( "exectiontime", taskvalue);
   E_DBGR_VariableCheck("TaskExecution_Core3", 1, Equal);
  
  execution_time_before_delay=taskvalue*(0.007812);
  write("execution_time_before_delay for Core 3 is %f",execution_time_before_delay);

  
    /******************************************************************************************************************************************************/ 
 // Test Step 5: Set dealy in Core3 by setting FlagCore3_Task__1000ms=1
  /*******************************************************************************************************************************************************/ 
  
  snprintf( chActionText, elCount(chActionText), "Set dealy in Core3 "); 
  snprintf( chExpectedText, elCount(chExpectedText), "check dealy in Core3"); 
  TestStepAddActionExpected( chActionText, chExpectedText );
  A_DBGR_VariableSet("FlagCore3_Task__1000ms", "1");
  E_DBGR_VariableCheck("FlagCore3_Task__1000ms", 1, Equal);
  testWaitForTimeout(1000);
  
  /******************************************************************************************************************************************************/    
    // Test Step 4: Read exectiontime for Core3
  /*******************************************************************************************************************************************************/

  snprintf( chActionText, elCount(chActionText), "Call funtion Os_Test_GetHWIO_t_OS_TaskExecution() "); 
  snprintf( chExpectedText, elCount(chExpectedText), "Verify exectiontime  variable in funtion Os_Test_GetHWIO_t_OS_TaskExecution() "); 
  TestStepAddActionExpected( chActionText, chExpectedText );
  A_DBGR_VariableRead( "exectiontime", taskvalue);
  E_DBGR_VariableCheck("FlagCore3_Task__1000ms", 1, Equal);
  
  execution_time_after_delay=taskvalue*(0.007812);
  write("execution_time_after_delay for Core 3 is %f",execution_time_after_delay);
  
  
   if(execution_time_after_delay > execution_time_before_delay)
  {
    execution_time = execution_time_after_delay - execution_time_before_delay;
    testStepPass("","execution_time for Core 3 is %f",execution_time);
  }
  else
  {
    execution_time = execution_time_after_delay - execution_time_before_delay;
    testStepFail("","execution_time for Core 3 is %f",execution_time);
  }
  
  /*******************************************************************************************************************************************************/    
    // Test Step 7: Remove dealy in Core3 by setting FlagCore3_Task__1000ms=0
  /*******************************************************************************************************************************************************/ 
  
  snprintf( chActionText, elCount(chActionText), "Remove dealy in Core3 "); 
  snprintf( chExpectedText, elCount(chExpectedText), "Remove dealy in Core3"); 
  TestStepAddActionExpected( chActionText, chExpectedText );
  A_DBGR_VariableSet("FlagCore3_Task__1000ms", "0");
  E_DBGR_VariableCheck("FlagCore3_Task__1000ms", 0, Equal);
  
  /*******************************************************************************************************************************************************/    
    // Test Step 8: Set TaskExecution_Core3=0 for Core3
  /*******************************************************************************************************************************************************/ 
  
  snprintf( chActionText, elCount(chActionText), "Set TaskExecution_Core3=0 for Core3"); 
  snprintf( chExpectedText, elCount(chExpectedText), "Set TaskExecution_Core3=0 for Core3"); 
  TestStepAddActionExpected( chActionText, chExpectedText );
  A_DBGR_VariableSet("TaskExecution_Core3", "0");
  E_DBGR_VariableCheck("TaskExecution_Core3", 0, Equal);

}

/***************************************************************************************************
----------------------------------------------------------------------------------------------------
Test case name:  TC_L30SW_QT_36542146: TC_to_verify_functionality_of_interface_GetHWIO_t_OS_TaskExecution_to_check_execution_time_for_core4_1000ms_task_scaled_value
----------------------------------------------------------------------------------------------------
Description:  TC_to_verify_functionality_of_interface_GetHWIO_t_OS_TaskExecution_to_check_execution_time_for_core4_1000ms_task_scaled_value
***************************************************************************************************/
testcase TC_to_verify_functionality_of_interface_GetHWIO_t_OS_TaskExecution_to_check_execution_time_for_core4_1000ms_task_scaled_value()
{
  /***************************************************************************************************************/    
                                                // Variable Definition
  /***************************************************************************************************************/ 
  
  long taskvalue;
  float execution_time, execution_time_before_delay, execution_time_after_delay;;
  
  /***************************************************************************************************************/    
                                               // Local Values
  /***************************************************************************************************************/ 
  

  
  /***************************************************************************************************************/    
                                              // Test Case Info
  /***************************************************************************************************************/
  setWriteDbgLevel(DebugOff);
  snprintf( chTestTitle, elCount(chTestTitle), "TC_to_verify_functionality_of_interface_GetHWIO_t_OS_TaskExecution_to_check_execution_time_for_core4_1000ms_task_scaled_value" );
  snprintf( chTestDescription, elCount(chTestDescription), "Purpose: TC_to_verify_functionality_of_interface_GetHWIO_t_OS_TaskExecution_to_check_execution_time_for_core4_1000ms_task_scaled_value.");
  TestCaseAddInfo( chTestTitle, "TC_L30SW_QT_36542146", chTestDescription );

  /***************************************************************************************************************/    
                                              // Start of Test Case
  /***************************************************************************************************************/
  
  /***************************************************************************************************************/    
                                              // Test Step 1 PRECONDITIONS
  /***************************************************************************************************************/
  
  snprintf( chActionText, elCount(chActionText), "Flash the Software and ECU is running"); 
  snprintf( chExpectedText, elCount(chExpectedText), "ECU should be in running state"); 
  TestStepAddActionExpected( chActionText, chExpectedText );

  A_DBGR_BreakpointDeleteAll();
  A_DBGR_RnGo();
  E_DBGR_CheckState(T32_State_Running);
  

   /***************************************************************************************************************/    
            // Test Step 2: Check all cores are in running state                                   
  /***************************************************************************************************************/
  
  //Check Core0 is running
  snprintf( chActionText, elCount(chActionText), "Check 1000ms Task Counter from Core0 "); 
  snprintf( chExpectedText, elCount(chExpectedText), "1000ms Counter from Core0 is incrementing"); 
  TestStepAddActionExpected( chActionText, chExpectedText );
  A_DBGR_VariableRead( "Task_Core0_1000ms_Count", taskvalue);
  E_DBGR_VariableCheck("Task_Core0_1000ms_Count", taskvalue, Greater);
  
  //Check Core1 is running
  snprintf( chActionText, elCount(chActionText), "Check 1000ms Task Counter from Core1 "); 
  snprintf( chExpectedText, elCount(chExpectedText), "1000ms Counter from Core1 is incrementing"); 
  TestStepAddActionExpected( chActionText, chExpectedText );
  A_DBGR_VariableRead( "Task_Core1_1000ms_Count", taskvalue);
  E_DBGR_VariableCheck("Task_Core1_1000ms_Count", taskvalue, Greater);
  
  //Check Core2 is running
  snprintf( chActionText, elCount(chActionText), "Check 1000ms Task Counter from Core2 "); 
  snprintf( chExpectedText, elCount(chExpectedText), "1000ms Counter from Core2 is incrementing"); 
  TestStepAddActionExpected( chActionText, chExpectedText );
  A_DBGR_VariableRead( "Task_Core2_1000ms_Count", taskvalue);
  E_DBGR_VariableCheck("Task_Core2_1000ms_Count", taskvalue, Greater);
    
  //Check Core3 is running
  snprintf( chActionText, elCount(chActionText), "Check 1000ms Task Counter from Core3 "); 
  snprintf( chExpectedText, elCount(chExpectedText), "1000ms Counter from Core3 is incrementing"); 
  TestStepAddActionExpected( chActionText, chExpectedText );
  A_DBGR_VariableRead( "Task_Core3_1000ms_Count", taskvalue);
  E_DBGR_VariableCheck("Task_Core3_1000ms_Count", taskvalue, Greater);
    
  //Check Core4 is running
  snprintf( chActionText, elCount(chActionText), "Check 1000ms Task Counter from Core4 "); 
  snprintf( chExpectedText, elCount(chExpectedText), "1000ms Counter from Core4 is incrementing"); 
  TestStepAddActionExpected( chActionText, chExpectedText );
  A_DBGR_VariableRead( "Task_Core4_1000ms_Count", taskvalue);
  E_DBGR_VariableCheck("Task_Core4_1000ms_Count", taskvalue, Greater);
    
  //Check Core5 is running
  snprintf( chActionText, elCount(chActionText), "Check 1000ms Task Counter from Core5 "); 
  snprintf( chExpectedText, elCount(chExpectedText), "1000ms Counter from Core5 is incrementing"); 
  TestStepAddActionExpected( chActionText, chExpectedText );
  A_DBGR_VariableRead( "Task_Core5_1000ms_Count", taskvalue);
  E_DBGR_VariableCheck("Task_Core5_1000ms_Count", taskvalue, Greater);
  
  /*******************************************************************************************************************************************************/    
    // Test Step 3: Set TaskExecution_Core4 for Core4
  /*******************************************************************************************************************************************************/ 
  
  snprintf( chActionText, elCount(chActionText), "Set TaskExecution_Core4 for Core4"); 
  snprintf( chExpectedText, elCount(chExpectedText), "Set TaskExecution_Core4 for Core4"); 
  TestStepAddActionExpected( chActionText, chExpectedText );
  A_DBGR_VariableSet("TaskExecution_Core4", "1");
  E_DBGR_VariableCheck("TaskExecution_Core4", 1, Equal);
  
  /******************************************************************************************************************************************************/    
    // Test Step 4: Read exectiontime for Core4
  /*******************************************************************************************************************************************************/

  snprintf( chActionText, elCount(chActionText), "Call funtion Os_Test_GetHWIO_t_OS_TaskExecution() "); 
  snprintf( chExpectedText, elCount(chExpectedText), "Verify exectiontime  variable in funtion Os_Test_GetHWIO_t_OS_TaskExecution() "); 
  TestStepAddActionExpected( chActionText, chExpectedText );
  A_DBGR_VariableRead( "exectiontime", taskvalue);
   E_DBGR_VariableCheck("TaskExecution_Core4", 1, Equal);
  
  execution_time_before_delay=taskvalue*(0.007812);
  write("execution_time_before_delay for Core 4 is %f",execution_time_before_delay);

  
    /******************************************************************************************************************************************************/ 
 // Test Step 5: Set dealy in Core4 by setting FlagCore4_Task__1000ms=1
  /*******************************************************************************************************************************************************/ 
  
  snprintf( chActionText, elCount(chActionText), "Set dealy in Core4 "); 
  snprintf( chExpectedText, elCount(chExpectedText), "check dealy in Core4"); 
  TestStepAddActionExpected( chActionText, chExpectedText );
  A_DBGR_VariableSet("FlagCore4_Task__1000ms", "1");
  E_DBGR_VariableCheck("FlagCore4_Task__1000ms", 1, Equal);
  testWaitForTimeout(1000);
  
  /******************************************************************************************************************************************************/    
    // Test Step 6: Read exectiontime for Core4
  /*******************************************************************************************************************************************************/

  snprintf( chActionText, elCount(chActionText), "Call funtion Os_Test_GetHWIO_t_OS_TaskExecution() "); 
  snprintf( chExpectedText, elCount(chExpectedText), "Verify exectiontime  variable in funtion Os_Test_GetHWIO_t_OS_TaskExecution() "); 
  TestStepAddActionExpected( chActionText, chExpectedText );
  A_DBGR_VariableRead( "exectiontime", taskvalue);
  E_DBGR_VariableCheck("FlagCore4_Task__1000ms", 1, Equal);
  
  execution_time_after_delay=taskvalue*(0.007812);
  write("execution_time_after_delay for Core 4 is %f",execution_time_after_delay);
  
  
   if(execution_time_after_delay > execution_time_before_delay)
  {
    execution_time = execution_time_after_delay - execution_time_before_delay;
    testStepPass("","execution_time for Core 4 is %f",execution_time);
  }
  else
  {
    execution_time = execution_time_after_delay - execution_time_before_delay;
    testStepFail("","execution_time for Core 4 is %f",execution_time);
  }
  
  /*******************************************************************************************************************************************************/    
    // Test Step 7: Remove dealy in Core4 by setting FlagCore4_Task__1000ms=0
  /*******************************************************************************************************************************************************/ 
  
  snprintf( chActionText, elCount(chActionText), "Remove dealy in Core4 "); 
  snprintf( chExpectedText, elCount(chExpectedText), "Remove dealy in Core4"); 
  TestStepAddActionExpected( chActionText, chExpectedText );
  A_DBGR_VariableSet("FlagCore4_Task__1000ms", "0");
  E_DBGR_VariableCheck("FlagCore4_Task__1000ms", 0, Equal);
  
  /*******************************************************************************************************************************************************/    
    // Test Step 8: Set TaskExecution_Core4=0 for Core4
  /*******************************************************************************************************************************************************/ 
  
  snprintf( chActionText, elCount(chActionText), "Set TaskExecution_Core4=0 for Core4"); 
  snprintf( chExpectedText, elCount(chExpectedText), "Set TaskExecution_Core4=0 for Core4"); 
  TestStepAddActionExpected( chActionText, chExpectedText );
  A_DBGR_VariableSet("TaskExecution_Core4", "0");
  E_DBGR_VariableCheck("TaskExecution_Core4", 0, Equal);

}

/***************************************************************************************************
----------------------------------------------------------------------------------------------------
Test case name:  TC_L30SW_QT_36542147: TC_to_verify_functionality_of_interface_GetHWIO_t_OS_TaskExecution_to_check_execution_time_for_core5_1000ms_task_scaled_value
----------------------------------------------------------------------------------------------------
Description:  TC_to_verify_functionality_of_interface_GetHWIO_t_OS_TaskExecution_to_check_execution_time_for_core5_1000ms_task_scaled_value
***************************************************************************************************/
testcase TC_to_verify_functionality_of_interface_GetHWIO_t_OS_TaskExecution_to_check_execution_time_for_core5_1000ms_task_scaled_value()
{
  /***************************************************************************************************************/    
                                                // Variable Definition
  /***************************************************************************************************************/ 
  
  long taskvalue;
  float execution_time, execution_time_before_delay, execution_time_after_delay;
  
  /***************************************************************************************************************/    
                                               // Local Values
  /***************************************************************************************************************/ 
  

  
  /***************************************************************************************************************/    
                                              // Test Case Info
  /***************************************************************************************************************/
  setWriteDbgLevel(DebugOff);
  snprintf( chTestTitle, elCount(chTestTitle), "TC_to_verify_functionality_of_interface_GetHWIO_t_OS_TaskExecution_to_check_execution_time_for_core5_1000ms_task_scaled_value" );
  snprintf( chTestDescription, elCount(chTestDescription), "Purpose: TC_to_verify_functionality_of_interface_GetHWIO_t_OS_TaskExecution_to_check_execution_time_for_core5_1000ms_task_scaled_value.");
  TestCaseAddInfo( chTestTitle, "TC_L30SW_QT_36542147", chTestDescription );

  /***************************************************************************************************************/    
                                              // Start of Test Case
  /***************************************************************************************************************/
  
  /***************************************************************************************************************/    
                                              // Test Step 1 PRECONDITIONS
  /***************************************************************************************************************/
  
  snprintf( chActionText, elCount(chActionText), "Flash the Software and ECU is running"); 
  snprintf( chExpectedText, elCount(chExpectedText), "ECU should be in running state"); 
  TestStepAddActionExpected( chActionText, chExpectedText );

  A_DBGR_BreakpointDeleteAll();
  A_DBGR_RnGo();
  E_DBGR_CheckState(T32_State_Running);
  

   /***************************************************************************************************************/    
            // Test Step 2: Check all cores are in running state                                   
  /***************************************************************************************************************/
  
  //Check Core0 is running
  snprintf( chActionText, elCount(chActionText), "Check 1000ms Task Counter from Core0 "); 
  snprintf( chExpectedText, elCount(chExpectedText), "1000ms Counter from Core0 is incrementing"); 
  TestStepAddActionExpected( chActionText, chExpectedText );
  A_DBGR_VariableRead( "Task_Core0_1000ms_Count", taskvalue);
  E_DBGR_VariableCheck("Task_Core0_1000ms_Count", taskvalue, Greater);
  
  //Check Core1 is running
  snprintf( chActionText, elCount(chActionText), "Check 1000ms Task Counter from Core1 "); 
  snprintf( chExpectedText, elCount(chExpectedText), "1000ms Counter from Core1 is incrementing"); 
  TestStepAddActionExpected( chActionText, chExpectedText );
  A_DBGR_VariableRead( "Task_Core1_1000ms_Count", taskvalue);
  E_DBGR_VariableCheck("Task_Core1_1000ms_Count", taskvalue, Greater);
  
  //Check Core2 is running
  snprintf( chActionText, elCount(chActionText), "Check 1000ms Task Counter from Core2 "); 
  snprintf( chExpectedText, elCount(chExpectedText), "1000ms Counter from Core2 is incrementing"); 
  TestStepAddActionExpected( chActionText, chExpectedText );
  A_DBGR_VariableRead( "Task_Core2_1000ms_Count", taskvalue);
  E_DBGR_VariableCheck("Task_Core2_1000ms_Count", taskvalue, Greater);
    
  //Check Core3 is running
  snprintf( chActionText, elCount(chActionText), "Check 1000ms Task Counter from Core3 "); 
  snprintf( chExpectedText, elCount(chExpectedText), "1000ms Counter from Core3 is incrementing"); 
  TestStepAddActionExpected( chActionText, chExpectedText );
  A_DBGR_VariableRead( "Task_Core3_1000ms_Count", taskvalue);
  E_DBGR_VariableCheck("Task_Core3_1000ms_Count", taskvalue, Greater);
    
  //Check Core4 is running
  snprintf( chActionText, elCount(chActionText), "Check 1000ms Task Counter from Core4 "); 
  snprintf( chExpectedText, elCount(chExpectedText), "1000ms Counter from Core4 is incrementing"); 
  TestStepAddActionExpected( chActionText, chExpectedText );
  A_DBGR_VariableRead( "Task_Core4_1000ms_Count", taskvalue);
  E_DBGR_VariableCheck("Task_Core4_1000ms_Count", taskvalue, Greater);
    
  //Check Core5 is running
  snprintf( chActionText, elCount(chActionText), "Check 1000ms Task Counter from Core5 "); 
  snprintf( chExpectedText, elCount(chExpectedText), "1000ms Counter from Core5 is incrementing"); 
  TestStepAddActionExpected( chActionText, chExpectedText );
  A_DBGR_VariableRead( "Task_Core5_1000ms_Count", taskvalue);
  E_DBGR_VariableCheck("Task_Core5_1000ms_Count", taskvalue, Greater);
  
   /*******************************************************************************************************************************************************/    
    // Test Step 3: Set TaskExecution_Core5 for Core5
  /*******************************************************************************************************************************************************/ 
  
  snprintf( chActionText, elCount(chActionText), "Set TaskExecution_Core5 for Core5"); 
  snprintf( chExpectedText, elCount(chExpectedText), "Set TaskExecution_Core5 for Core5"); 
  TestStepAddActionExpected( chActionText, chExpectedText );
  A_DBGR_VariableSet("TaskExecution_Core5", "1");
  E_DBGR_VariableCheck("TaskExecution_Core5", 1, Equal);
  
  /******************************************************************************************************************************************************/    
    // Test Step 4: Read exectiontime for Core5
  /*******************************************************************************************************************************************************/

  snprintf( chActionText, elCount(chActionText), "Call funtion Os_Test_GetHWIO_t_OS_TaskExecution() "); 
  snprintf( chExpectedText, elCount(chExpectedText), "Verify exectiontime  variable in funtion Os_Test_GetHWIO_t_OS_TaskExecution() "); 
  TestStepAddActionExpected( chActionText, chExpectedText );
  A_DBGR_VariableRead( "exectiontime", taskvalue);
   E_DBGR_VariableCheck("TaskExecution_Core5", 1, Equal);
  
  execution_time_before_delay=taskvalue*(0.007812);
  write("execution_time_before_delay for Core 5 is %f",execution_time_before_delay);

  
    /******************************************************************************************************************************************************/ 
 // Test Step 5: Set dealy in Core5 by setting FlagCore5_Task__1000ms=1
  /*******************************************************************************************************************************************************/ 
  
  snprintf( chActionText, elCount(chActionText), "Set dealy in Core5 "); 
  snprintf( chExpectedText, elCount(chExpectedText), "check dealy in Core5"); 
  TestStepAddActionExpected( chActionText, chExpectedText );
  A_DBGR_VariableSet("FlagCore5_Task__1000ms", "1");
  E_DBGR_VariableCheck("FlagCore5_Task__1000ms", 1, Equal);
  testWaitForTimeout(1000);
  
  /******************************************************************************************************************************************************/    
    // Test Step 4: Read exectiontime for Core5
  /*******************************************************************************************************************************************************/

  snprintf( chActionText, elCount(chActionText), "Call funtion Os_Test_GetHWIO_t_OS_TaskExecution() "); 
  snprintf( chExpectedText, elCount(chExpectedText), "Verify exectiontime  variable in funtion Os_Test_GetHWIO_t_OS_TaskExecution() "); 
  TestStepAddActionExpected( chActionText, chExpectedText );
  A_DBGR_VariableRead( "exectiontime", taskvalue);
  E_DBGR_VariableCheck("FlagCore5_Task__1000ms", 1, Equal);
  
  execution_time_after_delay=taskvalue*(0.007812);
  write("execution_time_after_delay for Core 5 is %f",execution_time_after_delay);
  
  
   if(execution_time_after_delay > execution_time_before_delay)
  {
    execution_time = execution_time_after_delay - execution_time_before_delay;
    testStepPass("","execution_time for Core 5 is %f",execution_time);
  }
  else
  {
    execution_time = execution_time_after_delay - execution_time_before_delay;
    testStepFail("","execution_time for Core 5 is %f",execution_time);
  }
  
  /*******************************************************************************************************************************************************/    
    // Test Step 7: Remove dealy in Core5 by setting FlagCore5_Task__1000ms=0
  /*******************************************************************************************************************************************************/ 
  
  snprintf( chActionText, elCount(chActionText), "Remove dealy in Core5 "); 
  snprintf( chExpectedText, elCount(chExpectedText), "Remove dealy in Core5"); 
  TestStepAddActionExpected( chActionText, chExpectedText );
  A_DBGR_VariableSet("FlagCore5_Task__1000ms", "0");
  E_DBGR_VariableCheck("FlagCore5_Task__1000ms", 0, Equal);
  
  /*******************************************************************************************************************************************************/    
    // Test Step 8: Set TaskExecution_Core5=0 for Core5
  /*******************************************************************************************************************************************************/ 
  
  snprintf( chActionText, elCount(chActionText), "Set TaskExecution_Core5=0 for Core5"); 
  snprintf( chExpectedText, elCount(chExpectedText), "Set TaskExecution_Core5=0 for Core5"); 
  TestStepAddActionExpected( chActionText, chExpectedText );
  A_DBGR_VariableSet("TaskExecution_Core5", "0");
  E_DBGR_VariableCheck("TaskExecution_Core5", 0, Equal);

}

/***************************************************************************************************
----------------------------------------------------------------------------------------------------
Test case name:  TC_L30SW_QT_36832667: TC_to_verify_the_functionality_of_interface_GetHWIO_t_OS_TaskExecution_and_execution_time_for_specified_core0_2p5ms_task
----------------------------------------------------------------------------------------------------
Description:  TC_to_verify_the_functionality_of_interface_GetHWIO_t_OS_TaskExecution_and_execution_time_for_specified_core0_2p5ms_task
***************************************************************************************************/
testcase TC_to_verify_the_functionality_of_interface_GetHWIO_t_OS_TaskExecution_and_execution_time_for_specified_core0_2p5ms_task()
{
  /***************************************************************************************************************/    
                                                // Variable Definition
  /***************************************************************************************************************/ 
  
  long taskvalue;
  float execution_time, execution_time_before_delay, execution_time_after_delay;
  
  /***************************************************************************************************************/    
                                               // Local Values
  /***************************************************************************************************************/ 
  

  
  /***************************************************************************************************************/    
                                              // Test Case Info
  /***************************************************************************************************************/
  setWriteDbgLevel(DebugOff);
  snprintf( chTestTitle, elCount(chTestTitle), "TC_to_verify_the_functionality_of_interface_GetHWIO_t_OS_TaskExecution_and_execution_time_for_specified_core0_2p5ms_task" );
  snprintf( chTestDescription, elCount(chTestDescription), "Purpose: TC_to_verify_the_functionality_of_interface_GetHWIO_t_OS_TaskExecution_and_execution_time_for_specified_core0_2p5ms_task.");
  TestCaseAddInfo( chTestTitle, "TC_L30SW_QT_36832667", chTestDescription );

  /***************************************************************************************************************/    
                                              // Start of Test Case
  /***************************************************************************************************************/
  
  /***************************************************************************************************************/    
                                              // Test Step 1 PRECONDITIONS
  /***************************************************************************************************************/
  
  snprintf( chActionText, elCount(chActionText), "Flash the Software and ECU is running"); 
  snprintf( chExpectedText, elCount(chExpectedText), "ECU should be in running state"); 
  TestStepAddActionExpected( chActionText, chExpectedText );

  A_DBGR_BreakpointDeleteAll();
  A_DBGR_RnGo();
  E_DBGR_CheckState(T32_State_Running);
  

   /***************************************************************************************************************/    
            // Test Step 2: Check all cores are in running state                                   
  /***************************************************************************************************************/
  
  //Check Core0 is running
  snprintf( chActionText, elCount(chActionText), "Check 1000ms Task Counter from Core0 "); 
  snprintf( chExpectedText, elCount(chExpectedText), "1000ms Counter from Core0 is incrementing"); 
  TestStepAddActionExpected( chActionText, chExpectedText );
  A_DBGR_VariableRead( "Task_Core0_1000ms_Count", taskvalue);
  E_DBGR_VariableCheck("Task_Core0_1000ms_Count", taskvalue, Greater);
  
  //Check Core1 is running
  snprintf( chActionText, elCount(chActionText), "Check 1000ms Task Counter from Core1 "); 
  snprintf( chExpectedText, elCount(chExpectedText), "1000ms Counter from Core1 is incrementing"); 
  TestStepAddActionExpected( chActionText, chExpectedText );
  A_DBGR_VariableRead( "Task_Core1_1000ms_Count", taskvalue);
  E_DBGR_VariableCheck("Task_Core1_1000ms_Count", taskvalue, Greater);
  
  //Check Core2 is running
  snprintf( chActionText, elCount(chActionText), "Check 1000ms Task Counter from Core2 "); 
  snprintf( chExpectedText, elCount(chExpectedText), "1000ms Counter from Core2 is incrementing"); 
  TestStepAddActionExpected( chActionText, chExpectedText );
  A_DBGR_VariableRead( "Task_Core2_1000ms_Count", taskvalue);
  E_DBGR_VariableCheck("Task_Core2_1000ms_Count", taskvalue, Greater);
    
  //Check Core3 is running
  snprintf( chActionText, elCount(chActionText), "Check 1000ms Task Counter from Core3 "); 
  snprintf( chExpectedText, elCount(chExpectedText), "1000ms Counter from Core3 is incrementing"); 
  TestStepAddActionExpected( chActionText, chExpectedText );
  A_DBGR_VariableRead( "Task_Core3_1000ms_Count", taskvalue);
  E_DBGR_VariableCheck("Task_Core3_1000ms_Count", taskvalue, Greater);
    
  //Check Core4 is running
  snprintf( chActionText, elCount(chActionText), "Check 1000ms Task Counter from Core4 "); 
  snprintf( chExpectedText, elCount(chExpectedText), "1000ms Counter from Core4 is incrementing"); 
  TestStepAddActionExpected( chActionText, chExpectedText );
  A_DBGR_VariableRead( "Task_Core4_1000ms_Count", taskvalue);
  E_DBGR_VariableCheck("Task_Core4_1000ms_Count", taskvalue, Greater);
    
  //Check Core5 is running
  snprintf( chActionText, elCount(chActionText), "Check 1000ms Task Counter from Core5 "); 
  snprintf( chExpectedText, elCount(chExpectedText), "1000ms Counter from Core5 is incrementing"); 
  TestStepAddActionExpected( chActionText, chExpectedText );
  A_DBGR_VariableRead( "Task_Core5_1000ms_Count", taskvalue);
  E_DBGR_VariableCheck("Task_Core5_1000ms_Count", taskvalue, Greater);
  
   /*******************************************************************************************************************************************************/    
    // Test Step 3: Set TaskExecution_Core0 for Core0
  /*******************************************************************************************************************************************************/ 
  
  snprintf( chActionText, elCount(chActionText), "Set TaskExecution_Core0 for Core0"); 
  snprintf( chExpectedText, elCount(chExpectedText), "Set TaskExecution_Core0 for Core0"); 
  TestStepAddActionExpected( chActionText, chExpectedText );
  A_DBGR_VariableSet("TaskExecution_Core0", "1");
  E_DBGR_VariableCheck("TaskExecution_Core0", 1, Equal);
  
  /******************************************************************************************************************************************************/    
    // Test Step 4: Read exectiontime for Core 0
  /*******************************************************************************************************************************************************/

  snprintf( chActionText, elCount(chActionText), "Call funtion Os_Test_GetHWIO_t_OS_TaskExecution() "); 
  snprintf( chExpectedText, elCount(chExpectedText), "Verify exectiontime  variable in funtion Os_Test_GetHWIO_t_OS_TaskExecution() "); 
  TestStepAddActionExpected( chActionText, chExpectedText );
  A_DBGR_VariableRead( "exectiontime", taskvalue);
   E_DBGR_VariableCheck("TaskExecution_Core0", 1, Equal);
  
  execution_time_before_delay=taskvalue*(0.007812);
  write("execution_time_before_delay for Core 0 is %f",execution_time_before_delay);

  
    /******************************************************************************************************************************************************/ 
 // Test Step 5: Set dealy in Core0 by setting FlagCore_OS_0=1
  /*******************************************************************************************************************************************************/ 
  
  snprintf( chActionText, elCount(chActionText), "Set dealy in Core0 "); 
  snprintf( chExpectedText, elCount(chExpectedText), "check dealy in Core0"); 
  TestStepAddActionExpected( chActionText, chExpectedText );
  A_DBGR_VariableSet("FlagCore_OS_0", "1");
  E_DBGR_VariableCheck("FlagCore_OS_0", 1, Equal);
  testWaitForTimeout(1000);
  
  /******************************************************************************************************************************************************/    
    // Test Step 6: Read exectiontime for Core 0
  /*******************************************************************************************************************************************************/

  snprintf( chActionText, elCount(chActionText), "Call funtion Os_Test_GetHWIO_t_OS_TaskExecution() "); 
  snprintf( chExpectedText, elCount(chExpectedText), "Verify exectiontime  variable in funtion Os_Test_GetHWIO_t_OS_TaskExecution() "); 
  TestStepAddActionExpected( chActionText, chExpectedText );
  A_DBGR_VariableRead( "exectiontime", taskvalue);
  E_DBGR_VariableCheck("FlagCore_OS_0", 1, Equal);
  
  execution_time_after_delay=taskvalue*(0.007812);
  write("execution_time_after_delay for Core 0 is %f",execution_time_after_delay);
  
  
   if(execution_time_after_delay > execution_time_before_delay)
  {
    execution_time = execution_time_after_delay - execution_time_before_delay;
    testStepPass("","execution_time for Core 0 is %f",execution_time);
  }
  else
  {
    execution_time = execution_time_after_delay - execution_time_before_delay;
    testStepFail("","execution_time for Core 0 is %f",execution_time);
  }
  
  /*******************************************************************************************************************************************************/    
    // Test Step 7: Remove dealy in Core0 by setting FlagCore_OS_0=0
  /*******************************************************************************************************************************************************/ 
  
  snprintf( chActionText, elCount(chActionText), "Remove dealy in Core0 "); 
  snprintf( chExpectedText, elCount(chExpectedText), "Remove dealy in Core0"); 
  TestStepAddActionExpected( chActionText, chExpectedText );
  A_DBGR_VariableSet("FlagCore_OS_0", "0");
  E_DBGR_VariableCheck("FlagCore_OS_0", 0, Equal);
  
  /*******************************************************************************************************************************************************/    
    // Test Step 8: Set CPU_Utilization_Core0=0 for Core0
  /*******************************************************************************************************************************************************/ 
  
  snprintf( chActionText, elCount(chActionText), "Set TaskExecution_Core0=0 for Core0"); 
  snprintf( chExpectedText, elCount(chExpectedText), "Set TaskExecution_Core0=0 for Core0"); 
  TestStepAddActionExpected( chActionText, chExpectedText );
  A_DBGR_VariableSet("TaskExecution_Core0", "0");
  E_DBGR_VariableCheck("TaskExecution_Core0", 0, Equal);

}

/***************************************************************************************************
----------------------------------------------------------------------------------------------------
Test case name:  TC_L30SW_QT_36832668:TC_to_verify_the_functionality_of_interface_GetHWIO_t_OS_TaskExecution_and_execution_time_for_specified_core1_1000ms_task----------------------------------------------------------------------------------------------------
Description:  TC_to_verify_the_functionality_of_interface_GetHWIO_t_OS_TaskExecution_and_execution_time_for_specified_core1_1000ms_task
***************************************************************************************************/
testcase TC_to_verify_the_functionality_of_interface_GetHWIO_t_OS_TaskExecution_and_execution_time_for_specified_core1_1000ms_task()
{
  /***************************************************************************************************************/    
                                                // Variable Definition
  /***************************************************************************************************************/ 
  
  long taskvalue;
  float execution_time, execution_time_before_delay, execution_time_after_delay;
  
  /***************************************************************************************************************/    
                                               // Local Values
  /***************************************************************************************************************/ 
  

  
  /***************************************************************************************************************/    
                                              // Test Case Info
  /***************************************************************************************************************/
  setWriteDbgLevel(DebugOff);
  snprintf( chTestTitle, elCount(chTestTitle), "TC_to_verify_the_functionality_of_interface_GetHWIO_t_OS_TaskExecution_and_execution_time_for_specified_core1_1000ms_task" );
  snprintf( chTestDescription, elCount(chTestDescription), "Purpose: TC_to_verify_the_functionality_of_interface_GetHWIO_t_OS_TaskExecution_and_execution_time_for_specified_core1_1000ms_task.");
  TestCaseAddInfo( chTestTitle, "TC_L30SW_QT_36832668", chTestDescription );

  /***************************************************************************************************************/    
                                              // Start of Test Case
  /***************************************************************************************************************/
  
  /***************************************************************************************************************/    
                                              // Test Step 1 PRECONDITIONS
  /***************************************************************************************************************/
  
  snprintf( chActionText, elCount(chActionText), "Flash the Software and ECU is running"); 
  snprintf( chExpectedText, elCount(chExpectedText), "ECU should be in running state"); 
  TestStepAddActionExpected( chActionText, chExpectedText );

  A_DBGR_BreakpointDeleteAll();
  A_DBGR_RnGo();
  E_DBGR_CheckState(T32_State_Running);
  

   /***************************************************************************************************************/    
            // Test Step 2: Check all cores are in running state                                   
  /***************************************************************************************************************/
  
  //Check Core0 is running
  snprintf( chActionText, elCount(chActionText), "Check 1000ms Task Counter from Core0 "); 
  snprintf( chExpectedText, elCount(chExpectedText), "1000ms Counter from Core0 is incrementing"); 
  TestStepAddActionExpected( chActionText, chExpectedText );
  A_DBGR_VariableRead( "Task_Core0_1000ms_Count", taskvalue);
  E_DBGR_VariableCheck("Task_Core0_1000ms_Count", taskvalue, Greater);
  
  //Check Core1 is running
  snprintf( chActionText, elCount(chActionText), "Check 1000ms Task Counter from Core1 "); 
  snprintf( chExpectedText, elCount(chExpectedText), "1000ms Counter from Core1 is incrementing"); 
  TestStepAddActionExpected( chActionText, chExpectedText );
  A_DBGR_VariableRead( "Task_Core1_1000ms_Count", taskvalue);
  E_DBGR_VariableCheck("Task_Core1_1000ms_Count", taskvalue, Greater);
  
  //Check Core2 is running
  snprintf( chActionText, elCount(chActionText), "Check 1000ms Task Counter from Core2 "); 
  snprintf( chExpectedText, elCount(chExpectedText), "1000ms Counter from Core2 is incrementing"); 
  TestStepAddActionExpected( chActionText, chExpectedText );
  A_DBGR_VariableRead( "Task_Core2_1000ms_Count", taskvalue);
  E_DBGR_VariableCheck("Task_Core2_1000ms_Count", taskvalue, Greater);
    
  //Check Core3 is running
  snprintf( chActionText, elCount(chActionText), "Check 1000ms Task Counter from Core3 "); 
  snprintf( chExpectedText, elCount(chExpectedText), "1000ms Counter from Core3 is incrementing"); 
  TestStepAddActionExpected( chActionText, chExpectedText );
  A_DBGR_VariableRead( "Task_Core3_1000ms_Count", taskvalue);
  E_DBGR_VariableCheck("Task_Core3_1000ms_Count", taskvalue, Greater);
    
  //Check Core4 is running
  snprintf( chActionText, elCount(chActionText), "Check 1000ms Task Counter from Core4 "); 
  snprintf( chExpectedText, elCount(chExpectedText), "1000ms Counter from Core4 is incrementing"); 
  TestStepAddActionExpected( chActionText, chExpectedText );
  A_DBGR_VariableRead( "Task_Core4_1000ms_Count", taskvalue);
  E_DBGR_VariableCheck("Task_Core4_1000ms_Count", taskvalue, Greater);
    
  //Check Core5 is running
  snprintf( chActionText, elCount(chActionText), "Check 1000ms Task Counter from Core5 "); 
  snprintf( chExpectedText, elCount(chExpectedText), "1000ms Counter from Core5 is incrementing"); 
  TestStepAddActionExpected( chActionText, chExpectedText );
  A_DBGR_VariableRead( "Task_Core5_1000ms_Count", taskvalue);
  E_DBGR_VariableCheck("Task_Core5_1000ms_Count", taskvalue, Greater);
  
 /*******************************************************************************************************************************************************/    
    // Test Step 3: Set TaskExecution_Core1 for Core1
  /*******************************************************************************************************************************************************/ 
  
  snprintf( chActionText, elCount(chActionText), "Set TaskExecution_Core1 for Core1"); 
  snprintf( chExpectedText, elCount(chExpectedText), "Set TaskExecution_Core1 for Core1"); 
  TestStepAddActionExpected( chActionText, chExpectedText );
  A_DBGR_VariableSet("TaskExecution_Core1", "1");
  E_DBGR_VariableCheck("TaskExecution_Core1", 1, Equal);
  
  /******************************************************************************************************************************************************/    
    // Test Step 4: Read exectiontime for Core1
  /*******************************************************************************************************************************************************/

  snprintf( chActionText, elCount(chActionText), "Call funtion Os_Test_GetHWIO_t_OS_TaskExecution() "); 
  snprintf( chExpectedText, elCount(chExpectedText), "Verify exectiontime  variable in funtion Os_Test_GetHWIO_t_OS_TaskExecution() "); 
  TestStepAddActionExpected( chActionText, chExpectedText );
  A_DBGR_VariableRead( "exectiontime", taskvalue);
   E_DBGR_VariableCheck("TaskExecution_Core1", 1, Equal);
  
  execution_time_before_delay=taskvalue*(0.007812);
  write("execution_time_before_delay for Core 1 is %f",execution_time_before_delay);

  
    /******************************************************************************************************************************************************/ 
 // Test Step 5: Set dealy in Core1 by setting FlagCore1_Task__1000ms=1
  /*******************************************************************************************************************************************************/ 
  
  snprintf( chActionText, elCount(chActionText), "Set dealy in Core1 "); 
  snprintf( chExpectedText, elCount(chExpectedText), "check dealy in Core1"); 
  TestStepAddActionExpected( chActionText, chExpectedText );
  A_DBGR_VariableSet("FlagCore1_Task__1000ms", "1");
  E_DBGR_VariableCheck("FlagCore1_Task__1000ms", 1, Equal);
  testWaitForTimeout(1000);
  
  /******************************************************************************************************************************************************/    
    // Test Step 6: Read exectiontime for Core1
  /*******************************************************************************************************************************************************/

  snprintf( chActionText, elCount(chActionText), "Call funtion Os_Test_GetHWIO_t_OS_TaskExecution() "); 
  snprintf( chExpectedText, elCount(chExpectedText), "Verify exectiontime  variable in funtion Os_Test_GetHWIO_t_OS_TaskExecution() "); 
  TestStepAddActionExpected( chActionText, chExpectedText );
  A_DBGR_VariableRead( "exectiontime", taskvalue);
  E_DBGR_VariableCheck("FlagCore1_Task__1000ms", 1, Equal);
  
  execution_time_after_delay=taskvalue*(0.007812);
  write("execution_time_after_delay for Core 1 is %f",execution_time_after_delay);
  
  
   if(execution_time_after_delay > execution_time_before_delay)
  {
    execution_time = execution_time_after_delay - execution_time_before_delay;
    testStepPass("","execution_time for Core 1 is %f",execution_time);
  }
  else
  {
    execution_time = execution_time_after_delay - execution_time_before_delay;
    testStepFail("","execution_time for Core 1 is %f",execution_time);
  }
  
  /*******************************************************************************************************************************************************/    
    // Test Step 7: Remove dealy in Core1 by setting FlagCore1_Task__1000ms=0
  /*******************************************************************************************************************************************************/ 
  
  snprintf( chActionText, elCount(chActionText), "Remove dealy in Core1 "); 
  snprintf( chExpectedText, elCount(chExpectedText), "Remove dealy in Core1"); 
  TestStepAddActionExpected( chActionText, chExpectedText );
  A_DBGR_VariableSet("FlagCore1_Task__1000ms", "0");
  E_DBGR_VariableCheck("FlagCore1_Task__1000ms", 0, Equal);
  
  /*******************************************************************************************************************************************************/    
    // Test Step 8: Set TaskExecution_Core1=0 for Core1
  /*******************************************************************************************************************************************************/ 
  
  snprintf( chActionText, elCount(chActionText), "Set TaskExecution_Core1=0 for Core1"); 
  snprintf( chExpectedText, elCount(chExpectedText), "Set TaskExecution_Core1=0 for Core1"); 
  TestStepAddActionExpected( chActionText, chExpectedText );
  A_DBGR_VariableSet("TaskExecution_Core1", "0");
  E_DBGR_VariableCheck("TaskExecution_Core1", 0, Equal);

}

/***************************************************************************************************
----------------------------------------------------------------------------------------------------
Test case name:  TC_L30SW_QT_36832669: TC_to_verify_the_functionality_of_interface_GetHWIO_t_OS_TaskExecution_and_execution_time_for_specified_core2_1000ms_task
----------------------------------------------------------------------------------------------------
Description:  TC_to_verify_the_functionality_of_interface_GetHWIO_t_OS_TaskExecution_and_execution_time_for_specified_core2_1000ms_task
***************************************************************************************************/
testcase TC_to_verify_the_functionality_of_interface_GetHWIO_t_OS_TaskExecution_and_execution_time_for_specified_core2_1000ms_task()
{
  /***************************************************************************************************************/    
                                                // Variable Definition
  /***************************************************************************************************************/ 
  
  long taskvalue;
  float execution_time, execution_time_before_delay, execution_time_after_delay;
  
  /***************************************************************************************************************/    
                                               // Local Values
  /***************************************************************************************************************/ 
  

  
  /***************************************************************************************************************/    
                                              // Test Case Info
  /***************************************************************************************************************/
  setWriteDbgLevel(DebugOff);
  snprintf( chTestTitle, elCount(chTestTitle), "TC_to_verify_the_functionality_of_interface_GetHWIO_t_OS_TaskExecution_and_execution_time_for_specified_core2_1000ms_task" );
  snprintf( chTestDescription, elCount(chTestDescription), "Purpose: TC_to_verify_the_functionality_of_interface_GetHWIO_t_OS_TaskExecution_and_execution_time_for_specified_core2_1000ms_task.");
  TestCaseAddInfo( chTestTitle, "TC_L30SW_QT_36832669", chTestDescription );

  /***************************************************************************************************************/    
                                              // Start of Test Case
  /***************************************************************************************************************/
  
  /***************************************************************************************************************/    
                                              // Test Step 1 PRECONDITIONS
  /***************************************************************************************************************/
  
  snprintf( chActionText, elCount(chActionText), "Flash the Software and ECU is running"); 
  snprintf( chExpectedText, elCount(chExpectedText), "ECU should be in running state"); 
  TestStepAddActionExpected( chActionText, chExpectedText );

  A_DBGR_BreakpointDeleteAll();
  A_DBGR_RnGo();
  E_DBGR_CheckState(T32_State_Running);
  

   /***************************************************************************************************************/    
            // Test Step 2: Check all cores are in running state                                   
  /***************************************************************************************************************/
  
  //Check Core0 is running
  snprintf( chActionText, elCount(chActionText), "Check 1000ms Task Counter from Core0 "); 
  snprintf( chExpectedText, elCount(chExpectedText), "1000ms Counter from Core0 is incrementing"); 
  TestStepAddActionExpected( chActionText, chExpectedText );
  A_DBGR_VariableRead( "Task_Core0_1000ms_Count", taskvalue);
  E_DBGR_VariableCheck("Task_Core0_1000ms_Count", taskvalue, Greater);
  
  //Check Core1 is running
  snprintf( chActionText, elCount(chActionText), "Check 1000ms Task Counter from Core1 "); 
  snprintf( chExpectedText, elCount(chExpectedText), "1000ms Counter from Core1 is incrementing"); 
  TestStepAddActionExpected( chActionText, chExpectedText );
  A_DBGR_VariableRead( "Task_Core1_1000ms_Count", taskvalue);
  E_DBGR_VariableCheck("Task_Core1_1000ms_Count", taskvalue, Greater);
  
  //Check Core2 is running
  snprintf( chActionText, elCount(chActionText), "Check 1000ms Task Counter from Core2 "); 
  snprintf( chExpectedText, elCount(chExpectedText), "1000ms Counter from Core2 is incrementing"); 
  TestStepAddActionExpected( chActionText, chExpectedText );
  A_DBGR_VariableRead( "Task_Core2_1000ms_Count", taskvalue);
  E_DBGR_VariableCheck("Task_Core2_1000ms_Count", taskvalue, Greater);
    
  //Check Core3 is running
  snprintf( chActionText, elCount(chActionText), "Check 1000ms Task Counter from Core3 "); 
  snprintf( chExpectedText, elCount(chExpectedText), "1000ms Counter from Core3 is incrementing"); 
  TestStepAddActionExpected( chActionText, chExpectedText );
  A_DBGR_VariableRead( "Task_Core3_1000ms_Count", taskvalue);
  E_DBGR_VariableCheck("Task_Core3_1000ms_Count", taskvalue, Greater);
    
  //Check Core4 is running
  snprintf( chActionText, elCount(chActionText), "Check 1000ms Task Counter from Core4 "); 
  snprintf( chExpectedText, elCount(chExpectedText), "1000ms Counter from Core4 is incrementing"); 
  TestStepAddActionExpected( chActionText, chExpectedText );
  A_DBGR_VariableRead( "Task_Core4_1000ms_Count", taskvalue);
  E_DBGR_VariableCheck("Task_Core4_1000ms_Count", taskvalue, Greater);
    
  //Check Core5 is running
  snprintf( chActionText, elCount(chActionText), "Check 1000ms Task Counter from Core5 "); 
  snprintf( chExpectedText, elCount(chExpectedText), "1000ms Counter from Core5 is incrementing"); 
  TestStepAddActionExpected( chActionText, chExpectedText );
  A_DBGR_VariableRead( "Task_Core5_1000ms_Count", taskvalue);
  E_DBGR_VariableCheck("Task_Core5_1000ms_Count", taskvalue, Greater);
  
/*******************************************************************************************************************************************************/    
    // Test Step 3: Set TaskExecution_Core2 for Core2
  /*******************************************************************************************************************************************************/ 
  
  snprintf( chActionText, elCount(chActionText), "Set TaskExecution_Core2 for Core2"); 
  snprintf( chExpectedText, elCount(chExpectedText), "Set TaskExecution_Core2 for Core2"); 
  TestStepAddActionExpected( chActionText, chExpectedText );
  A_DBGR_VariableSet("TaskExecution_Core2", "1");
  E_DBGR_VariableCheck("TaskExecution_Core2", 1, Equal);
  
  /******************************************************************************************************************************************************/    
    // Test Step 4: Read exectiontime for Core2
  /*******************************************************************************************************************************************************/

  snprintf( chActionText, elCount(chActionText), "Call funtion Os_Test_GetHWIO_t_OS_TaskExecution() "); 
  snprintf( chExpectedText, elCount(chExpectedText), "Verify exectiontime  variable in funtion Os_Test_GetHWIO_t_OS_TaskExecution() "); 
  TestStepAddActionExpected( chActionText, chExpectedText );
  A_DBGR_VariableRead( "exectiontime", taskvalue);
  E_DBGR_VariableCheck("TaskExecution_Core2", 1, Equal);
  
  execution_time_before_delay=taskvalue*(0.007812);
  write("execution_time_before_delay for Core 2 is %f",execution_time_before_delay);

  
    /******************************************************************************************************************************************************/ 
 // Test Step 5: Set dealy in Core2 by setting FlagCore2_Task__1000ms=1
  /*******************************************************************************************************************************************************/ 
  
  snprintf( chActionText, elCount(chActionText), "Set dealy in Core2 "); 
  snprintf( chExpectedText, elCount(chExpectedText), "check dealy in Core2"); 
  TestStepAddActionExpected( chActionText, chExpectedText );
  A_DBGR_VariableSet("FlagCore2_Task__1000ms", "1");
  E_DBGR_VariableCheck("FlagCore2_Task__1000ms", 1, Equal);
  testWaitForTimeout(1000);
  
  /******************************************************************************************************************************************************/    
    // Test Step 4: Read exectiontime for Core2
  /*******************************************************************************************************************************************************/

  snprintf( chActionText, elCount(chActionText), "Call funtion Os_Test_GetHWIO_t_OS_TaskExecution() "); 
  snprintf( chExpectedText, elCount(chExpectedText), "Verify exectiontime  variable in funtion Os_Test_GetHWIO_t_OS_TaskExecution() "); 
  TestStepAddActionExpected( chActionText, chExpectedText );
  A_DBGR_VariableRead( "exectiontime", taskvalue);
  E_DBGR_VariableCheck("FlagCore2_Task__1000ms", 1, Equal);
  
  execution_time_after_delay=taskvalue*(0.007812);
  write("execution_time_after_delay for Core 2 is %f",execution_time_after_delay);
  
  
   if(execution_time_after_delay > execution_time_before_delay)
  {
    execution_time = execution_time_after_delay - execution_time_before_delay;
    testStepPass("","execution_time for Core 2 is %f",execution_time);
  }
  else
  {
    execution_time = execution_time_after_delay - execution_time_before_delay;
    testStepFail("","execution_time for Core 2 is %f",execution_time);
  }
  
  /*******************************************************************************************************************************************************/    
    // Test Step 7: Remove dealy in Core2 by setting FlagCore2_Task__1000ms=0
  /*******************************************************************************************************************************************************/ 
  
  snprintf( chActionText, elCount(chActionText), "Remove dealy in Core2 "); 
  snprintf( chExpectedText, elCount(chExpectedText), "Remove dealy in Core2"); 
  TestStepAddActionExpected( chActionText, chExpectedText );
  A_DBGR_VariableSet("FlagCore2_Task__1000ms", "0");
  E_DBGR_VariableCheck("FlagCore2_Task__1000ms", 0, Equal);
  
  /*******************************************************************************************************************************************************/    
    // Test Step 8: Set TaskExecution_Core2=0 for Core2
  /*******************************************************************************************************************************************************/ 
  
  snprintf( chActionText, elCount(chActionText), "Set TaskExecution_Core2=0 for Core2"); 
  snprintf( chExpectedText, elCount(chExpectedText), "Set TaskExecution_Core2=0 for Core2"); 
  TestStepAddActionExpected( chActionText, chExpectedText );
  A_DBGR_VariableSet("TaskExecution_Core2", "0");
  E_DBGR_VariableCheck("TaskExecution_Core2", 0, Equal);

}

/***************************************************************************************************
----------------------------------------------------------------------------------------------------
Test case name:  TC_L30SW_QT_36832670: TC_to_verify_the_functionality_of_interface_GetHWIO_t_OS_TaskExecution_and_execution_time_for_specified_core3_1000ms_task
----------------------------------------------------------------------------------------------------
Description:  TC_to_verify_the_functionality_of_interface_GetHWIO_t_OS_TaskExecution_and_execution_time_for_specified_core3_1000ms_task
***************************************************************************************************/
testcase TC_to_verify_the_functionality_of_interface_GetHWIO_t_OS_TaskExecution_and_execution_time_for_specified_core3_1000ms_task()
{
  /***************************************************************************************************************/    
                                                // Variable Definition
  /***************************************************************************************************************/ 
  
  long taskvalue;
  float execution_time, execution_time_before_delay, execution_time_after_delay;
  
  /***************************************************************************************************************/    
                                               // Local Values
  /***************************************************************************************************************/ 
  

  
  /***************************************************************************************************************/    
                                              // Test Case Info
  /***************************************************************************************************************/
  setWriteDbgLevel(DebugOff);
  snprintf( chTestTitle, elCount(chTestTitle), "TC_to_verify_the_functionality_of_interface_GetHWIO_t_OS_TaskExecution_and_execution_time_for_specified_core3_1000ms_task" );
  snprintf( chTestDescription, elCount(chTestDescription), "Purpose: TC_to_verify_the_functionality_of_interface_GetHWIO_t_OS_TaskExecution_and_execution_time_for_specified_core3_1000ms_task.");
  TestCaseAddInfo( chTestTitle, "TC_L30SW_QT_36832670", chTestDescription );

  /***************************************************************************************************************/    
                                              // Start of Test Case
  /***************************************************************************************************************/
  
  /***************************************************************************************************************/    
                                              // Test Step 1 PRECONDITIONS
  /***************************************************************************************************************/
  
  snprintf( chActionText, elCount(chActionText), "Flash the Software and ECU is running"); 
  snprintf( chExpectedText, elCount(chExpectedText), "ECU should be in running state"); 
  TestStepAddActionExpected( chActionText, chExpectedText );

  A_DBGR_BreakpointDeleteAll();
  A_DBGR_RnGo();
  E_DBGR_CheckState(T32_State_Running);
  

   /***************************************************************************************************************/    
            // Test Step 2: Check all cores are in running state                                   
  /***************************************************************************************************************/
  
  //Check Core0 is running
  snprintf( chActionText, elCount(chActionText), "Check 1000ms Task Counter from Core0 "); 
  snprintf( chExpectedText, elCount(chExpectedText), "1000ms Counter from Core0 is incrementing"); 
  TestStepAddActionExpected( chActionText, chExpectedText );
  A_DBGR_VariableRead( "Task_Core0_1000ms_Count", taskvalue);
  E_DBGR_VariableCheck("Task_Core0_1000ms_Count", taskvalue, Greater);
  
  //Check Core1 is running
  snprintf( chActionText, elCount(chActionText), "Check 1000ms Task Counter from Core1 "); 
  snprintf( chExpectedText, elCount(chExpectedText), "1000ms Counter from Core1 is incrementing"); 
  TestStepAddActionExpected( chActionText, chExpectedText );
  A_DBGR_VariableRead( "Task_Core1_1000ms_Count", taskvalue);
  E_DBGR_VariableCheck("Task_Core1_1000ms_Count", taskvalue, Greater);
  
  //Check Core2 is running
  snprintf( chActionText, elCount(chActionText), "Check 1000ms Task Counter from Core2 "); 
  snprintf( chExpectedText, elCount(chExpectedText), "1000ms Counter from Core2 is incrementing"); 
  TestStepAddActionExpected( chActionText, chExpectedText );
  A_DBGR_VariableRead( "Task_Core2_1000ms_Count", taskvalue);
  E_DBGR_VariableCheck("Task_Core2_1000ms_Count", taskvalue, Greater);
    
  //Check Core3 is running
  snprintf( chActionText, elCount(chActionText), "Check 1000ms Task Counter from Core3 "); 
  snprintf( chExpectedText, elCount(chExpectedText), "1000ms Counter from Core3 is incrementing"); 
  TestStepAddActionExpected( chActionText, chExpectedText );
  A_DBGR_VariableRead( "Task_Core3_1000ms_Count", taskvalue);
  E_DBGR_VariableCheck("Task_Core3_1000ms_Count", taskvalue, Greater);
    
  //Check Core4 is running
  snprintf( chActionText, elCount(chActionText), "Check 1000ms Task Counter from Core4 "); 
  snprintf( chExpectedText, elCount(chExpectedText), "1000ms Counter from Core4 is incrementing"); 
  TestStepAddActionExpected( chActionText, chExpectedText );
  A_DBGR_VariableRead( "Task_Core4_1000ms_Count", taskvalue);
  E_DBGR_VariableCheck("Task_Core4_1000ms_Count", taskvalue, Greater);
    
  //Check Core5 is running
  snprintf( chActionText, elCount(chActionText), "Check 1000ms Task Counter from Core5 "); 
  snprintf( chExpectedText, elCount(chExpectedText), "1000ms Counter from Core5 is incrementing"); 
  TestStepAddActionExpected( chActionText, chExpectedText );
  A_DBGR_VariableRead( "Task_Core5_1000ms_Count", taskvalue);
  E_DBGR_VariableCheck("Task_Core5_1000ms_Count", taskvalue, Greater);
  
/*******************************************************************************************************************************************************/    
    // Test Step 3: Set TaskExecution_Core3 for Core3
  /*******************************************************************************************************************************************************/ 
  
  snprintf( chActionText, elCount(chActionText), "Set TaskExecution_Core3 for Core3"); 
  snprintf( chExpectedText, elCount(chExpectedText), "Set TaskExecution_Core3 for Core3"); 
  TestStepAddActionExpected( chActionText, chExpectedText );
  A_DBGR_VariableSet("TaskExecution_Core3", "1");
  E_DBGR_VariableCheck("TaskExecution_Core3", 1, Equal);
  
  /******************************************************************************************************************************************************/    
    // Test Step 4: Read exectiontime for Core3
  /*******************************************************************************************************************************************************/

  snprintf( chActionText, elCount(chActionText), "Call funtion Os_Test_GetHWIO_t_OS_TaskExecution() "); 
  snprintf( chExpectedText, elCount(chExpectedText), "Verify exectiontime  variable in funtion Os_Test_GetHWIO_t_OS_TaskExecution() "); 
  TestStepAddActionExpected( chActionText, chExpectedText );
  A_DBGR_VariableRead( "exectiontime", taskvalue);
   E_DBGR_VariableCheck("TaskExecution_Core3", 1, Equal);
  
  execution_time_before_delay=taskvalue*(0.007812);
  write("execution_time_before_delay for Core 3 is %f",execution_time_before_delay);

  
    /******************************************************************************************************************************************************/ 
 // Test Step 5: Set dealy in Core3 by setting FlagCore3_Task__1000ms=1
  /*******************************************************************************************************************************************************/ 
  
  snprintf( chActionText, elCount(chActionText), "Set dealy in Core3 "); 
  snprintf( chExpectedText, elCount(chExpectedText), "check dealy in Core3"); 
  TestStepAddActionExpected( chActionText, chExpectedText );
  A_DBGR_VariableSet("FlagCore3_Task__1000ms", "1");
  E_DBGR_VariableCheck("FlagCore3_Task__1000ms", 1, Equal);
  testWaitForTimeout(1000);
  
  /******************************************************************************************************************************************************/    
    // Test Step 4: Read exectiontime for Core3
  /*******************************************************************************************************************************************************/

  snprintf( chActionText, elCount(chActionText), "Call funtion Os_Test_GetHWIO_t_OS_TaskExecution() "); 
  snprintf( chExpectedText, elCount(chExpectedText), "Verify exectiontime  variable in funtion Os_Test_GetHWIO_t_OS_TaskExecution() "); 
  TestStepAddActionExpected( chActionText, chExpectedText );
  A_DBGR_VariableRead( "exectiontime", taskvalue);
  E_DBGR_VariableCheck("FlagCore3_Task__1000ms", 1, Equal);
  
  execution_time_after_delay=taskvalue*(0.007812);
  write("execution_time_after_delay for Core 3 is %f",execution_time_after_delay);
  
  
   if(execution_time_after_delay > execution_time_before_delay)
  {
    execution_time = execution_time_after_delay - execution_time_before_delay;
    testStepPass("","execution_time for Core 3 is %f",execution_time);
  }
  else
  {
    execution_time = execution_time_after_delay - execution_time_before_delay;
    testStepFail("","execution_time for Core 3 is %f",execution_time);
  }
  
  /*******************************************************************************************************************************************************/    
    // Test Step 7: Remove dealy in Core3 by setting FlagCore3_Task__1000ms=0
  /*******************************************************************************************************************************************************/ 
  
  snprintf( chActionText, elCount(chActionText), "Remove dealy in Core3 "); 
  snprintf( chExpectedText, elCount(chExpectedText), "Remove dealy in Core3"); 
  TestStepAddActionExpected( chActionText, chExpectedText );
  A_DBGR_VariableSet("FlagCore3_Task__1000ms", "0");
  E_DBGR_VariableCheck("FlagCore3_Task__1000ms", 0, Equal);
  
  /*******************************************************************************************************************************************************/    
    // Test Step 8: Set TaskExecution_Core3=0 for Core3
  /*******************************************************************************************************************************************************/ 
  
  snprintf( chActionText, elCount(chActionText), "Set TaskExecution_Core3=0 for Core3"); 
  snprintf( chExpectedText, elCount(chExpectedText), "Set TaskExecution_Core3=0 for Core3"); 
  TestStepAddActionExpected( chActionText, chExpectedText );
  A_DBGR_VariableSet("TaskExecution_Core3", "0");
  E_DBGR_VariableCheck("TaskExecution_Core3", 0, Equal);

}

/***************************************************************************************************
----------------------------------------------------------------------------------------------------
Test case name:  TC_L30SW_QT_36832671: TC_to_verify_the_functionality_of_interface_GetHWIO_t_OS_TaskExecution_and_execution_time_for_specified_core4_1000ms_task
----------------------------------------------------------------------------------------------------
Description:  TC_to_verify_the_functionality_of_interface_GetHWIO_t_OS_TaskExecution_and_execution_time_for_specified_core4_1000ms_task
***************************************************************************************************/
testcase TC_to_verify_the_functionality_of_interface_GetHWIO_t_OS_TaskExecution_and_execution_time_for_specified_core4_1000ms_task()
{
  /***************************************************************************************************************/    
                                                // Variable Definition
  /***************************************************************************************************************/ 
  
  long taskvalue;
  float execution_time, execution_time_before_delay, execution_time_after_delay;
  
  /***************************************************************************************************************/    
                                               // Local Values
  /***************************************************************************************************************/ 
  

  
  /***************************************************************************************************************/    
                                              // Test Case Info
  /***************************************************************************************************************/
  setWriteDbgLevel(DebugOff);
  snprintf( chTestTitle, elCount(chTestTitle), "TC_to_verify_the_functionality_of_interface_GetHWIO_t_OS_TaskExecution_and_execution_time_for_specified_core4_1000ms_task" );
  snprintf( chTestDescription, elCount(chTestDescription), "Purpose: TC_to_verify_the_functionality_of_interface_GetHWIO_t_OS_TaskExecution_and_execution_time_for_specified_core4_1000ms_task.");
  TestCaseAddInfo( chTestTitle, "TC_L30SW_QT_36832671", chTestDescription );

  /***************************************************************************************************************/    
                                              // Start of Test Case
  /***************************************************************************************************************/
  
  /***************************************************************************************************************/    
                                              // Test Step 1 PRECONDITIONS
  /***************************************************************************************************************/
  
  snprintf( chActionText, elCount(chActionText), "Flash the Software and ECU is running"); 
  snprintf( chExpectedText, elCount(chExpectedText), "ECU should be in running state"); 
  TestStepAddActionExpected( chActionText, chExpectedText );

  A_DBGR_BreakpointDeleteAll();
  A_DBGR_RnGo();
  E_DBGR_CheckState(T32_State_Running);
  

   /***************************************************************************************************************/    
            // Test Step 2: Check all cores are in running state                                   
  /***************************************************************************************************************/
  
  //Check Core0 is running
  snprintf( chActionText, elCount(chActionText), "Check 1000ms Task Counter from Core0 "); 
  snprintf( chExpectedText, elCount(chExpectedText), "1000ms Counter from Core0 is incrementing"); 
  TestStepAddActionExpected( chActionText, chExpectedText );
  A_DBGR_VariableRead( "Task_Core0_1000ms_Count", taskvalue);
  E_DBGR_VariableCheck("Task_Core0_1000ms_Count", taskvalue, Greater);
  
  //Check Core1 is running
  snprintf( chActionText, elCount(chActionText), "Check 1000ms Task Counter from Core1 "); 
  snprintf( chExpectedText, elCount(chExpectedText), "1000ms Counter from Core1 is incrementing"); 
  TestStepAddActionExpected( chActionText, chExpectedText );
  A_DBGR_VariableRead( "Task_Core1_1000ms_Count", taskvalue);
  E_DBGR_VariableCheck("Task_Core1_1000ms_Count", taskvalue, Greater);
  
  //Check Core2 is running
  snprintf( chActionText, elCount(chActionText), "Check 1000ms Task Counter from Core2 "); 
  snprintf( chExpectedText, elCount(chExpectedText), "1000ms Counter from Core2 is incrementing"); 
  TestStepAddActionExpected( chActionText, chExpectedText );
  A_DBGR_VariableRead( "Task_Core2_1000ms_Count", taskvalue);
  E_DBGR_VariableCheck("Task_Core2_1000ms_Count", taskvalue, Greater);
    
  //Check Core3 is running
  snprintf( chActionText, elCount(chActionText), "Check 1000ms Task Counter from Core3 "); 
  snprintf( chExpectedText, elCount(chExpectedText), "1000ms Counter from Core3 is incrementing"); 
  TestStepAddActionExpected( chActionText, chExpectedText );
  A_DBGR_VariableRead( "Task_Core3_1000ms_Count", taskvalue);
  E_DBGR_VariableCheck("Task_Core3_1000ms_Count", taskvalue, Greater);
    
  //Check Core4 is running
  snprintf( chActionText, elCount(chActionText), "Check 1000ms Task Counter from Core4 "); 
  snprintf( chExpectedText, elCount(chExpectedText), "1000ms Counter from Core4 is incrementing"); 
  TestStepAddActionExpected( chActionText, chExpectedText );
  A_DBGR_VariableRead( "Task_Core4_1000ms_Count", taskvalue);
  E_DBGR_VariableCheck("Task_Core4_1000ms_Count", taskvalue, Greater);
    
  //Check Core5 is running
  snprintf( chActionText, elCount(chActionText), "Check 1000ms Task Counter from Core5 "); 
  snprintf( chExpectedText, elCount(chExpectedText), "1000ms Counter from Core5 is incrementing"); 
  TestStepAddActionExpected( chActionText, chExpectedText );
  A_DBGR_VariableRead( "Task_Core5_1000ms_Count", taskvalue);
  E_DBGR_VariableCheck("Task_Core5_1000ms_Count", taskvalue, Greater);
  
  /*******************************************************************************************************************************************************/    
    // Test Step 3: Set TaskExecution_Core4 for Core4
  /*******************************************************************************************************************************************************/ 
  
  snprintf( chActionText, elCount(chActionText), "Set TaskExecution_Core4 for Core4"); 
  snprintf( chExpectedText, elCount(chExpectedText), "Set TaskExecution_Core4 for Core4"); 
  TestStepAddActionExpected( chActionText, chExpectedText );
  A_DBGR_VariableSet("TaskExecution_Core4", "1");
  E_DBGR_VariableCheck("TaskExecution_Core4", 1, Equal);
  
  /******************************************************************************************************************************************************/    
    // Test Step 4: Read exectiontime for Core4
  /*******************************************************************************************************************************************************/

  snprintf( chActionText, elCount(chActionText), "Call funtion Os_Test_GetHWIO_t_OS_TaskExecution() "); 
  snprintf( chExpectedText, elCount(chExpectedText), "Verify exectiontime  variable in funtion Os_Test_GetHWIO_t_OS_TaskExecution() "); 
  TestStepAddActionExpected( chActionText, chExpectedText );
  A_DBGR_VariableRead( "exectiontime", taskvalue);
   E_DBGR_VariableCheck("TaskExecution_Core4", 1, Equal);
  
  execution_time_before_delay=taskvalue*(0.007812);
  write("execution_time_before_delay for Core 4 is %f",execution_time_before_delay);

  
    /******************************************************************************************************************************************************/ 
 // Test Step 5: Set dealy in Core4 by setting FlagCore4_Task__1000ms=1
  /*******************************************************************************************************************************************************/ 
  
  snprintf( chActionText, elCount(chActionText), "Set dealy in Core4 "); 
  snprintf( chExpectedText, elCount(chExpectedText), "check dealy in Core4"); 
  TestStepAddActionExpected( chActionText, chExpectedText );
  A_DBGR_VariableSet("FlagCore4_Task__1000ms", "1");
  E_DBGR_VariableCheck("FlagCore4_Task__1000ms", 1, Equal);
  testWaitForTimeout(1000);
  
  /******************************************************************************************************************************************************/    
    // Test Step 6: Read exectiontime for Core4
  /*******************************************************************************************************************************************************/

  snprintf( chActionText, elCount(chActionText), "Call funtion Os_Test_GetHWIO_t_OS_TaskExecution() "); 
  snprintf( chExpectedText, elCount(chExpectedText), "Verify exectiontime  variable in funtion Os_Test_GetHWIO_t_OS_TaskExecution() "); 
  TestStepAddActionExpected( chActionText, chExpectedText );
  A_DBGR_VariableRead( "exectiontime", taskvalue);
  E_DBGR_VariableCheck("FlagCore4_Task__1000ms", 1, Equal);
  
  execution_time_after_delay=taskvalue*(0.007812);
  write("execution_time_after_delay for Core 4 is %f",execution_time_after_delay);
  
  
   if(execution_time_after_delay > execution_time_before_delay)
  {
    execution_time = execution_time_after_delay - execution_time_before_delay;
    testStepPass("","execution_time for Core 4 is %f",execution_time);
  }
  else
  {
    execution_time = execution_time_after_delay - execution_time_before_delay;
    testStepFail("","execution_time for Core 4 is %f",execution_time);
  }
  
  /*******************************************************************************************************************************************************/    
    // Test Step 7: Remove dealy in Core4 by setting FlagCore4_Task__1000ms=0
  /*******************************************************************************************************************************************************/ 
  
  snprintf( chActionText, elCount(chActionText), "Remove dealy in Core4 "); 
  snprintf( chExpectedText, elCount(chExpectedText), "Remove dealy in Core4"); 
  TestStepAddActionExpected( chActionText, chExpectedText );
  A_DBGR_VariableSet("FlagCore4_Task__1000ms", "0");
  E_DBGR_VariableCheck("FlagCore4_Task__1000ms", 0, Equal);
  
  /*******************************************************************************************************************************************************/    
    // Test Step 8: Set TaskExecution_Core4=0 for Core4
  /*******************************************************************************************************************************************************/ 
  
  snprintf( chActionText, elCount(chActionText), "Set TaskExecution_Core4=0 for Core4"); 
  snprintf( chExpectedText, elCount(chExpectedText), "Set TaskExecution_Core4=0 for Core4"); 
  TestStepAddActionExpected( chActionText, chExpectedText );
  A_DBGR_VariableSet("TaskExecution_Core4", "0");
  E_DBGR_VariableCheck("TaskExecution_Core4", 0, Equal);

}

/***************************************************************************************************
----------------------------------------------------------------------------------------------------
Test case name:  TC_L30SW_QT_36832672: TC_to_verify_the_functionality_of_interface_GetHWIO_t_OS_TaskExecution_and_execution_time_for_specified_core5_1000ms_task
----------------------------------------------------------------------------------------------------
Description:  TC_to_verify_the_functionality_of_interface_GetHWIO_t_OS_TaskExecution_and_execution_time_for_specified_core5_1000ms_task
***************************************************************************************************/
testcase TC_to_verify_the_functionality_of_interface_GetHWIO_t_OS_TaskExecution_and_execution_time_for_specified_core5_1000ms_task()
{
  /***************************************************************************************************************/    
                                                // Variable Definition
  /***************************************************************************************************************/ 
  
  long taskvalue;
  float execution_time, execution_time_before_delay, execution_time_after_delay;
  
  /***************************************************************************************************************/    
                                               // Local Values
  /***************************************************************************************************************/ 
  

  
  /***************************************************************************************************************/    
                                              // Test Case Info
  /***************************************************************************************************************/
  setWriteDbgLevel(DebugOff);
  snprintf( chTestTitle, elCount(chTestTitle), "TC_to_verify_the_functionality_of_interface_GetHWIO_t_OS_TaskExecution_and_execution_time_for_specified_core5_1000ms_task" );
  snprintf( chTestDescription, elCount(chTestDescription), "Purpose: TC_to_verify_the_functionality_of_interface_GetHWIO_t_OS_TaskExecution_and_execution_time_for_specified_core5_1000ms_task.");
  TestCaseAddInfo( chTestTitle, "TC_L30SW_QT_36832672", chTestDescription );

  /***************************************************************************************************************/    
                                              // Start of Test Case
  /***************************************************************************************************************/
  
  /***************************************************************************************************************/    
                                              // Test Step 1 PRECONDITIONS
  /***************************************************************************************************************/
  
  snprintf( chActionText, elCount(chActionText), "Flash the Software and ECU is running"); 
  snprintf( chExpectedText, elCount(chExpectedText), "ECU should be in running state"); 
  TestStepAddActionExpected( chActionText, chExpectedText );

  A_DBGR_BreakpointDeleteAll();
  A_DBGR_RnGo();
  E_DBGR_CheckState(T32_State_Running);
  

   /***************************************************************************************************************/    
            // Test Step 2: Check all cores are in running state                                   
  /***************************************************************************************************************/
  
  //Check Core0 is running
  snprintf( chActionText, elCount(chActionText), "Check 1000ms Task Counter from Core0 "); 
  snprintf( chExpectedText, elCount(chExpectedText), "1000ms Counter from Core0 is incrementing"); 
  TestStepAddActionExpected( chActionText, chExpectedText );
  A_DBGR_VariableRead( "Task_Core0_1000ms_Count", taskvalue);
  E_DBGR_VariableCheck("Task_Core0_1000ms_Count", taskvalue, Greater);
  
  //Check Core1 is running
  snprintf( chActionText, elCount(chActionText), "Check 1000ms Task Counter from Core1 "); 
  snprintf( chExpectedText, elCount(chExpectedText), "1000ms Counter from Core1 is incrementing"); 
  TestStepAddActionExpected( chActionText, chExpectedText );
  A_DBGR_VariableRead( "Task_Core1_1000ms_Count", taskvalue);
  E_DBGR_VariableCheck("Task_Core1_1000ms_Count", taskvalue, Greater);
  
  //Check Core2 is running
  snprintf( chActionText, elCount(chActionText), "Check 1000ms Task Counter from Core2 "); 
  snprintf( chExpectedText, elCount(chExpectedText), "1000ms Counter from Core2 is incrementing"); 
  TestStepAddActionExpected( chActionText, chExpectedText );
  A_DBGR_VariableRead( "Task_Core2_1000ms_Count", taskvalue);
  E_DBGR_VariableCheck("Task_Core2_1000ms_Count", taskvalue, Greater);
    
  //Check Core3 is running
  snprintf( chActionText, elCount(chActionText), "Check 1000ms Task Counter from Core3 "); 
  snprintf( chExpectedText, elCount(chExpectedText), "1000ms Counter from Core3 is incrementing"); 
  TestStepAddActionExpected( chActionText, chExpectedText );
  A_DBGR_VariableRead( "Task_Core3_1000ms_Count", taskvalue);
  E_DBGR_VariableCheck("Task_Core3_1000ms_Count", taskvalue, Greater);
    
  //Check Core4 is running
  snprintf( chActionText, elCount(chActionText), "Check 1000ms Task Counter from Core4 "); 
  snprintf( chExpectedText, elCount(chExpectedText), "1000ms Counter from Core4 is incrementing"); 
  TestStepAddActionExpected( chActionText, chExpectedText );
  A_DBGR_VariableRead( "Task_Core4_1000ms_Count", taskvalue);
  E_DBGR_VariableCheck("Task_Core4_1000ms_Count", taskvalue, Greater);
    
  //Check Core5 is running
  snprintf( chActionText, elCount(chActionText), "Check 1000ms Task Counter from Core5 "); 
  snprintf( chExpectedText, elCount(chExpectedText), "1000ms Counter from Core5 is incrementing"); 
  TestStepAddActionExpected( chActionText, chExpectedText );
  A_DBGR_VariableRead( "Task_Core5_1000ms_Count", taskvalue);
  E_DBGR_VariableCheck("Task_Core5_1000ms_Count", taskvalue, Greater);
  
   /*******************************************************************************************************************************************************/    
    // Test Step 3: Set TaskExecution_Core5 for Core5
  /*******************************************************************************************************************************************************/ 
  
  snprintf( chActionText, elCount(chActionText), "Set TaskExecution_Core5 for Core5"); 
  snprintf( chExpectedText, elCount(chExpectedText), "Set TaskExecution_Core5 for Core5"); 
  TestStepAddActionExpected( chActionText, chExpectedText );
  A_DBGR_VariableSet("TaskExecution_Core5", "1");
  E_DBGR_VariableCheck("TaskExecution_Core5", 1, Equal);
  
  /******************************************************************************************************************************************************/    
    // Test Step 4: Read exectiontime for Core5
  /*******************************************************************************************************************************************************/

  snprintf( chActionText, elCount(chActionText), "Call funtion Os_Test_GetHWIO_t_OS_TaskExecution() "); 
  snprintf( chExpectedText, elCount(chExpectedText), "Verify exectiontime  variable in funtion Os_Test_GetHWIO_t_OS_TaskExecution() "); 
  TestStepAddActionExpected( chActionText, chExpectedText );
  A_DBGR_VariableRead( "exectiontime", taskvalue);
   E_DBGR_VariableCheck("TaskExecution_Core5", 1, Equal);
  
  execution_time_before_delay=taskvalue*(0.007812);
  write("execution_time_before_delay for Core 5 is %f",execution_time_before_delay);

  
    /******************************************************************************************************************************************************/ 
 // Test Step 5: Set dealy in Core5 by setting FlagCore5_Task__1000ms=1
  /*******************************************************************************************************************************************************/ 
  
  snprintf( chActionText, elCount(chActionText), "Set dealy in Core5 "); 
  snprintf( chExpectedText, elCount(chExpectedText), "check dealy in Core5"); 
  TestStepAddActionExpected( chActionText, chExpectedText );
  A_DBGR_VariableSet("FlagCore5_Task__1000ms", "1");
  E_DBGR_VariableCheck("FlagCore5_Task__1000ms", 1, Equal);
  testWaitForTimeout(1000);
  
  /******************************************************************************************************************************************************/    
    // Test Step 6: Read exectiontime for Core5
  /*******************************************************************************************************************************************************/

  snprintf( chActionText, elCount(chActionText), "Call funtion Os_Test_GetHWIO_t_OS_TaskExecution() "); 
  snprintf( chExpectedText, elCount(chExpectedText), "Verify exectiontime  variable in funtion Os_Test_GetHWIO_t_OS_TaskExecution() "); 
  TestStepAddActionExpected( chActionText, chExpectedText );
  A_DBGR_VariableRead( "exectiontime", taskvalue);
  E_DBGR_VariableCheck("FlagCore5_Task__1000ms", 1, Equal);
  
  execution_time_after_delay=taskvalue*(0.007812);
  write("execution_time_after_delay for Core 5 is %f",execution_time_after_delay);
  
  
   if(execution_time_after_delay > execution_time_before_delay)
  {
    execution_time = execution_time_after_delay - execution_time_before_delay;
    testStepPass("","execution_time for Core 5 is %f",execution_time);
  }
  else
  {
    execution_time = execution_time_after_delay - execution_time_before_delay;
    testStepFail("","execution_time for Core 5 is %f",execution_time);
  }
  
  /*******************************************************************************************************************************************************/    
    // Test Step 7: Remove dealy in Core5 by setting FlagCore5_Task__1000ms=0
  /*******************************************************************************************************************************************************/ 
  
  snprintf( chActionText, elCount(chActionText), "Remove dealy in Core5 "); 
  snprintf( chExpectedText, elCount(chExpectedText), "Remove dealy in Core5"); 
  TestStepAddActionExpected( chActionText, chExpectedText );
  A_DBGR_VariableSet("FlagCore5_Task__1000ms", "0");
  E_DBGR_VariableCheck("FlagCore5_Task__1000ms", 0, Equal);
  
  /*******************************************************************************************************************************************************/    
    // Test Step 8: Set TaskExecution_Core5=0 for Core5
  /*******************************************************************************************************************************************************/ 
  
  snprintf( chActionText, elCount(chActionText), "Set TaskExecution_Core5=0 for Core5"); 
  snprintf( chExpectedText, elCount(chExpectedText), "Set TaskExecution_Core5=0 for Core5"); 
  TestStepAddActionExpected( chActionText, chExpectedText );
  A_DBGR_VariableSet("TaskExecution_Core5", "0");
  E_DBGR_VariableCheck("TaskExecution_Core5", 0, Equal);
  
  

}
/***************************************************************************************************
----------------------------------------------------------------------------------------------------
Test case name:  TC_L30SW_QT_36651193: Verify_functionality_of_interface_LockHWIO_Scheduler_ReleaseHWIO_Scheduler_to_prohibit_task_for_CPU0_schedular_to_release_task
----------------------------------------------------------------------------------------------------
Description:  test_case_to_verify_the_functionality_of_interface_LockHWIO_Scheduler()_and_ReleaseHWIO_Scheduler_to_prohibit_the_current_task_for_CPU0_and_allow_schedular_to_release_the_task.

***************************************************************************************************/
testcase Verify_functionality_of_interface_LockHWIO_Scheduler_ReleaseHWIO_Scheduler_to_prohibit_task_for_CPU0_schedular_to_release_task()
{
  /***************************************************************************************************************/    
                                                // Variable Definition
  /***************************************************************************************************************/ 
  
  long taskvalue;
  
  /***************************************************************************************************************/    
                                               // Local Values
  /***************************************************************************************************************/ 
  

  
  /***************************************************************************************************************/    
                                              // Test Case Info
  /***************************************************************************************************************/
  setWriteDbgLevel(DebugOff);
  snprintf( chTestTitle, elCount(chTestTitle), "test_case_to_verify_the_functionality_of_interface_DsblHWIO_Interrupt_to_prohibits_all_interrupts_from_pre_empting_the_core0_task_and_interrupt__for_CPU0" );
  snprintf( chTestDescription, elCount(chTestDescription), "Purpose: test_case_to_verify_the_functionality_of_interface_DsblHWIO_Interrupt_to_prohibits_all_interrupts_from_pre_empting_the_core0_task_and_interrupt__for_CPU0.");
  TestCaseAddInfo( chTestTitle, "TC_L30SW_QT_36651193", chTestDescription );

  /***************************************************************************************************************/    
                                              // Start of Test Case
  /***************************************************************************************************************/
  
  /***************************************************************************************************************/    
                                              // Test Step 1 PRECONDITIONS
  /***************************************************************************************************************/
  
  snprintf( chActionText, elCount(chActionText), "Flash the Software and ECU is running"); 
  snprintf( chExpectedText, elCount(chExpectedText), "ECU should be in running state"); 
  TestStepAddActionExpected( chActionText, chExpectedText );

  A_DBGR_BreakpointDeleteAll();
  A_DBGR_RnGo();
  E_DBGR_CheckState(T32_State_Running);
  

   /***************************************************************************************************************/    
            // Test Step 2: Check all cores are in running state                                   
  /***************************************************************************************************************/
  
  //Check Core0 is running
  snprintf( chActionText, elCount(chActionText), "Check 1000ms Task Counter from Core0 "); 
  snprintf( chExpectedText, elCount(chExpectedText), "1000ms Counter from Core0 is incrementing"); 
  TestStepAddActionExpected( chActionText, chExpectedText );
  A_DBGR_VariableRead( "Task_Core0_1000ms_Count", taskvalue);
  E_DBGR_VariableCheck("Task_Core0_1000ms_Count", taskvalue, Greater);
  
  //Check Core1 is running
  snprintf( chActionText, elCount(chActionText), "Check 1000ms Task Counter from Core1 "); 
  snprintf( chExpectedText, elCount(chExpectedText), "1000ms Counter from Core1 is incrementing"); 
  TestStepAddActionExpected( chActionText, chExpectedText );
  A_DBGR_VariableRead( "Task_Core1_1000ms_Count", taskvalue);
  E_DBGR_VariableCheck("Task_Core1_1000ms_Count", taskvalue, Greater);
  
  //Check Core2 is running
  snprintf( chActionText, elCount(chActionText), "Check 1000ms Task Counter from Core2 "); 
  snprintf( chExpectedText, elCount(chExpectedText), "1000ms Counter from Core2 is incrementing"); 
  TestStepAddActionExpected( chActionText, chExpectedText );
  A_DBGR_VariableRead( "Task_Core2_1000ms_Count", taskvalue);
  E_DBGR_VariableCheck("Task_Core2_1000ms_Count", taskvalue, Greater);
    
  //Check Core3 is running
  snprintf( chActionText, elCount(chActionText), "Check 1000ms Task Counter from Core3 "); 
  snprintf( chExpectedText, elCount(chExpectedText), "1000ms Counter from Core3 is incrementing"); 
  TestStepAddActionExpected( chActionText, chExpectedText );
  A_DBGR_VariableRead( "Task_Core3_1000ms_Count", taskvalue);
  E_DBGR_VariableCheck("Task_Core3_1000ms_Count", taskvalue, Greater);
    
  //Check Core4 is running
  snprintf( chActionText, elCount(chActionText), "Check 1000ms Task Counter from Core4 "); 
  snprintf( chExpectedText, elCount(chExpectedText), "1000ms Counter from Core4 is incrementing"); 
  TestStepAddActionExpected( chActionText, chExpectedText );
  A_DBGR_VariableRead( "Task_Core4_1000ms_Count", taskvalue);
  E_DBGR_VariableCheck("Task_Core4_1000ms_Count", taskvalue, Greater);
    
  //Check Core5 is running
  snprintf( chActionText, elCount(chActionText), "Check 1000ms Task Counter from Core5 "); 
  snprintf( chExpectedText, elCount(chExpectedText), "1000ms Counter from Core5 is incrementing"); 
  TestStepAddActionExpected( chActionText, chExpectedText );
  A_DBGR_VariableRead( "Task_Core5_1000ms_Count", taskvalue);
  E_DBGR_VariableCheck("Task_Core5_1000ms_Count", taskvalue, Greater);
  
  /*******************************************************************************************************************************************************/    
    // Test Step 3: Set lockReleaseSchedulerTestEnable[0]=1 to LockHWIO_Scheduler in funtion Os_Test_GetHWIO_LockReleaseScheduler
  /*******************************************************************************************************************************************************/

  snprintf( chActionText, elCount(chActionText), "Set lockReleaseSchedulerTestEnable[0]=1 in funtion Os_Test_GetHWIO_LockReleaseScheduler "); 
  snprintf( chExpectedText, elCount(chExpectedText), "Verify lockReleaseSchedulerTestEnable[0]=1 funtion Os_Test_GetHWIO_LockReleaseScheduler "); 
  TestStepAddActionExpected( chActionText, chExpectedText );
  A_DBGR_VariableSet("lockReleaseSchedulerTestEnable[0]", "1");
  E_DBGR_VariableCheck("lockReleaseSchedulerTestEnable[0]", 1, Equal);


  /***************************************************************************************************************/    
        // Test Step 4 check the task counters for  the core0 stopped.
  /***************************************************************************************************************/

  //Check All tasks of Core0 are stopped
  snprintf( chActionText, elCount(chActionText), "Check 2pt5ms Task Counter from Core0 "); 
  snprintf( chExpectedText, elCount(chExpectedText), "2pt5ms Counter from Core0 is stop incrementing"); 
  TestStepAddActionExpected( chActionText, chExpectedText );
  A_DBGR_VariableRead( "Task_Core0_2pt5ms_Count", taskvalue);
  E_DBGR_VariableCheck("Task_Core0_2pt5ms_Count", taskvalue, Equal);
  
  snprintf( chActionText, elCount(chActionText), "Check 5ms Task Counter from Core0 "); 
  snprintf( chExpectedText, elCount(chExpectedText), "5ms Counter from Core0 is stop incrementing"); 
  TestStepAddActionExpected( chActionText, chExpectedText );
  A_DBGR_VariableRead( "Task_Core0_5ms_Count", taskvalue);
  E_DBGR_VariableCheck("Task_Core0_5ms_Count", taskvalue, Equal);
  
  snprintf( chActionText, elCount(chActionText), "Check 10ms Task Counter from Core0 "); 
  snprintf( chExpectedText, elCount(chExpectedText), "10ms Counter from Core0 is stop incrementing"); 
  TestStepAddActionExpected( chActionText, chExpectedText );
  A_DBGR_VariableRead( "Task_Core0_10ms_Count", taskvalue);
  E_DBGR_VariableCheck("Task_Core0_10ms_Count", taskvalue, Equal);  
  
  snprintf( chActionText, elCount(chActionText), "Check 25ms Task Counter from Core0 "); 
  snprintf( chExpectedText, elCount(chExpectedText), "25ms Counter from Core0 is stop incrementing"); 
  TestStepAddActionExpected( chActionText, chExpectedText );
  A_DBGR_VariableRead( "Task_Core0_25ms_Count", taskvalue);
  E_DBGR_VariableCheck("Task_Core0_25ms_Count", taskvalue, Equal);  

  snprintf( chActionText, elCount(chActionText), "Check 50ms Task Counter from Core0 "); 
  snprintf( chExpectedText, elCount(chExpectedText), "50ms Counter from Core0 is stop incrementing"); 
  TestStepAddActionExpected( chActionText, chExpectedText );
  A_DBGR_VariableRead( "Task_Core0_50ms_Count", taskvalue);
  E_DBGR_VariableCheck("Task_Core0_50ms_Count", taskvalue, Equal);
  
  snprintf( chActionText, elCount(chActionText), "Check 250ms Task Counter from Core0 "); 
  snprintf( chExpectedText, elCount(chExpectedText), "250ms Counter from Core0 is stop incrementing"); 
  TestStepAddActionExpected( chActionText, chExpectedText );
  A_DBGR_VariableRead( "Task_Core0_250ms_Count", taskvalue);
  E_DBGR_VariableCheck("Task_Core0_250ms_Count", taskvalue, Equal);
  
  snprintf( chActionText, elCount(chActionText), "Check 100ms Task Counter from Core0 "); 
  snprintf( chExpectedText, elCount(chExpectedText), "100ms Counter from Core0 is stop incrementing"); 
  TestStepAddActionExpected( chActionText, chExpectedText );
  A_DBGR_VariableRead( "Task_Core0_100ms_Count", taskvalue);
  E_DBGR_VariableCheck("Task_Core0_100ms_Count", taskvalue, Equal); 

  snprintf( chActionText, elCount(chActionText), "Check 500ms Task Counter from Core0 "); 
  snprintf( chExpectedText, elCount(chExpectedText), "500ms Counter from Core0 is stop incrementing"); 
  TestStepAddActionExpected( chActionText, chExpectedText );
  A_DBGR_VariableRead( "Task_Core0_500ms_Count", taskvalue);
  E_DBGR_VariableCheck("Task_Core0_500ms_Count", taskvalue, Equal);
  
  snprintf( chActionText, elCount(chActionText), "Check 1000ms Task Counter from Core0 "); 
  snprintf( chExpectedText, elCount(chExpectedText), "1000ms Counter from Core0 is stop incrementing"); 
  TestStepAddActionExpected( chActionText, chExpectedText );
  A_DBGR_VariableRead( "Task_Core0_1000ms_Count", taskvalue);
  E_DBGR_VariableCheck("Task_Core0_1000ms_Count", taskvalue, Equal);
  
   //Check Core1 is running
  snprintf( chActionText, elCount(chActionText), "Check 1000ms Task Counter from Core1 "); 
  snprintf( chExpectedText, elCount(chExpectedText), "1000ms Counter from Core1 is incrementing"); 
  TestStepAddActionExpected( chActionText, chExpectedText );
  A_DBGR_VariableRead( "Task_Core1_1000ms_Count", taskvalue);
  E_DBGR_VariableCheck("Task_Core1_1000ms_Count", taskvalue, Greater);
  
  //Check Core2 is running
  snprintf( chActionText, elCount(chActionText), "Check 1000ms Task Counter from Core2 "); 
  snprintf( chExpectedText, elCount(chExpectedText), "1000ms Counter from Core2 is incrementing"); 
  TestStepAddActionExpected( chActionText, chExpectedText );
  A_DBGR_VariableRead( "Task_Core2_1000ms_Count", taskvalue);
  E_DBGR_VariableCheck("Task_Core2_1000ms_Count", taskvalue, Greater);
    
  //Check Core3 is running
  snprintf( chActionText, elCount(chActionText), "Check 1000ms Task Counter from Core3 "); 
  snprintf( chExpectedText, elCount(chExpectedText), "1000ms Counter from Core3 is incrementing"); 
  TestStepAddActionExpected( chActionText, chExpectedText );
  A_DBGR_VariableRead( "Task_Core3_1000ms_Count", taskvalue);
  E_DBGR_VariableCheck("Task_Core3_1000ms_Count", taskvalue, Greater);
    
  //Check Core4 is running
  snprintf( chActionText, elCount(chActionText), "Check 1000ms Task Counter from Core4 "); 
  snprintf( chExpectedText, elCount(chExpectedText), "1000ms Counter from Core4 is incrementing"); 
  TestStepAddActionExpected( chActionText, chExpectedText );
  A_DBGR_VariableRead( "Task_Core4_1000ms_Count", taskvalue);
  E_DBGR_VariableCheck("Task_Core4_1000ms_Count", taskvalue, Greater);
    
  //Check Core5 is running
  snprintf( chActionText, elCount(chActionText), "Check 1000ms Task Counter from Core5 "); 
  snprintf( chExpectedText, elCount(chExpectedText), "1000ms Counter from Core5 is incrementing"); 
  TestStepAddActionExpected( chActionText, chExpectedText );
  A_DBGR_VariableRead( "Task_Core5_1000ms_Count", taskvalue);
  E_DBGR_VariableCheck("Task_Core5_1000ms_Count", taskvalue, Greater);
  
  /*******************************************************************************************************************************************************/    
    // Test Step 5: set lockScheduler[0]=1 to ReleaseHWIO_Scheduler in  funtion Os_Test_GetHWIO_LockReleaseScheduler
  /*******************************************************************************************************************************************************/
  snprintf( chActionText, elCount(chActionText), "Set lockReleaseSchedulerTestEnable[0]=1 in funtion Os_Test_GetHWIO_LockReleaseScheduler "); 
  snprintf( chExpectedText, elCount(chExpectedText), "Verify lockReleaseSchedulerTestEnable[0]=1 funtion Os_Test_GetHWIO_LockReleaseScheduler "); 
  TestStepAddActionExpected( chActionText, chExpectedText );
  A_DBGR_VariableSet("lockScheduler[0]", "1");
  E_DBGR_VariableCheck("lockScheduler[0]", 1, Equal);
  
  /***************************************************************************************************************/    
            // Test Step 6: Check all cores are in running state                                   
  /***************************************************************************************************************/
  
  //Check Core0 is running
  snprintf( chActionText, elCount(chActionText), "Check 1000ms Task Counter from Core0 "); 
  snprintf( chExpectedText, elCount(chExpectedText), "1000ms Counter from Core0 is incrementing"); 
  TestStepAddActionExpected( chActionText, chExpectedText );
  A_DBGR_VariableRead( "Task_Core0_1000ms_Count", taskvalue);
  E_DBGR_VariableCheck("Task_Core0_1000ms_Count", taskvalue, Greater);
  
  //Check Core1 is running
  snprintf( chActionText, elCount(chActionText), "Check 1000ms Task Counter from Core1 "); 
  snprintf( chExpectedText, elCount(chExpectedText), "1000ms Counter from Core1 is incrementing"); 
  TestStepAddActionExpected( chActionText, chExpectedText );
  A_DBGR_VariableRead( "Task_Core1_1000ms_Count", taskvalue);
  E_DBGR_VariableCheck("Task_Core1_1000ms_Count", taskvalue, Greater);
  
  //Check Core2 is running
  snprintf( chActionText, elCount(chActionText), "Check 1000ms Task Counter from Core2 "); 
  snprintf( chExpectedText, elCount(chExpectedText), "1000ms Counter from Core2 is incrementing"); 
  TestStepAddActionExpected( chActionText, chExpectedText );
  A_DBGR_VariableRead( "Task_Core2_1000ms_Count", taskvalue);
  E_DBGR_VariableCheck("Task_Core2_1000ms_Count", taskvalue, Greater);
    
  //Check Core3 is running
  snprintf( chActionText, elCount(chActionText), "Check 1000ms Task Counter from Core3 "); 
  snprintf( chExpectedText, elCount(chExpectedText), "1000ms Counter from Core3 is incrementing"); 
  TestStepAddActionExpected( chActionText, chExpectedText );
  A_DBGR_VariableRead( "Task_Core3_1000ms_Count", taskvalue);
  E_DBGR_VariableCheck("Task_Core3_1000ms_Count", taskvalue, Greater);
    
  //Check Core4 is running
  snprintf( chActionText, elCount(chActionText), "Check 1000ms Task Counter from Core4 "); 
  snprintf( chExpectedText, elCount(chExpectedText), "1000ms Counter from Core4 is incrementing"); 
  TestStepAddActionExpected( chActionText, chExpectedText );
  A_DBGR_VariableRead( "Task_Core4_1000ms_Count", taskvalue);
  E_DBGR_VariableCheck("Task_Core4_1000ms_Count", taskvalue, Greater);
    
  //Check Core5 is running
  snprintf( chActionText, elCount(chActionText), "Check 1000ms Task Counter from Core5 "); 
  snprintf( chExpectedText, elCount(chExpectedText), "1000ms Counter from Core5 is incrementing"); 
  TestStepAddActionExpected( chActionText, chExpectedText );
  A_DBGR_VariableRead( "Task_Core5_1000ms_Count", taskvalue);
  E_DBGR_VariableCheck("Task_Core5_1000ms_Count", taskvalue, Greater);
  
  
  snprintf( chActionText, elCount(chActionText), "Set lockReleaseSchedulerTestEnable[0]=0 in funtion Os_Test_GetHWIO_LockReleaseScheduler "); 
  snprintf( chExpectedText, elCount(chExpectedText), "Verify lockReleaseSchedulerTestEnable[0]=0 funtion Os_Test_GetHWIO_LockReleaseScheduler "); 
  TestStepAddActionExpected( chActionText, chExpectedText );
  A_DBGR_VariableSet("lockReleaseSchedulerTestEnable[0]", "0");
  E_DBGR_VariableCheck("lockReleaseSchedulerTestEnable[0]", 0, Equal);
  
  snprintf( chActionText, elCount(chActionText), "Set lockScheduler[0]=0 in funtion Os_Test_GetHWIO_LockReleaseScheduler "); 
  snprintf( chExpectedText, elCount(chExpectedText), "Verify lockScheduler[0]=0 funtion Os_Test_GetHWIO_LockReleaseScheduler "); 
  TestStepAddActionExpected( chActionText, chExpectedText );
  A_DBGR_VariableSet("lockScheduler[0]", "0");
  E_DBGR_VariableCheck("lockScheduler[0]", 0, Equal);
  
}

/***************************************************************************************************
----------------------------------------------------------------------------------------------------
Test case name:  TC_L30SW_QT_36651194: Verify_functionality_of_interface_LockHWIO_Scheduler_ReleaseHWIO_Scheduler_to_prohibit_task_for_CPU1_schedular_to_release_task
----------------------------------------------------------------------------------------------------
Description:  test_case_to_verify_the_functionality_of_interface_LockHWIO_Scheduler()_and_ReleaseHWIO_Scheduler_to_prohibit_the_current_task_for_CPU1_and_allow_schedular_to_release_the_task.

***************************************************************************************************/
testcase Verify_functionality_of_interface_LockHWIO_Scheduler_ReleaseHWIO_Scheduler_to_prohibit_task_for_CPU1_schedular_to_release_task()
{
  /***************************************************************************************************************/    
                                                // Variable Definition
  /***************************************************************************************************************/ 
  
  long taskvalue;
  
  /***************************************************************************************************************/    
                                               // Local Values
  /***************************************************************************************************************/ 
  

  
  /***************************************************************************************************************/    
                                              // Test Case Info
  /***************************************************************************************************************/
  setWriteDbgLevel(DebugOff);
  snprintf( chTestTitle, elCount(chTestTitle), "test_case_to_verify_the_functionality_of_interface_DsblHWIO_Interrupt_to_prohibits_all_interrupts_from_pre_empting_the_core1_task_and_interrupt__for_CPU1" );
  snprintf( chTestDescription, elCount(chTestDescription), "Purpose: test_case_to_verify_the_functionality_of_interface_DsblHWIO_Interrupt_to_prohibits_all_interrupts_from_pre_empting_the_core1_task_and_interrupt__for_CPU1.");
  TestCaseAddInfo( chTestTitle, "TC_L30SW_QT_36651194", chTestDescription );

  /***************************************************************************************************************/    
                                              // Start of Test Case
  /***************************************************************************************************************/
  
  /***************************************************************************************************************/    
                                              // Test Step 1 PRECONDITIONS
  /***************************************************************************************************************/
  
  snprintf( chActionText, elCount(chActionText), "Flash the Software and ECU is running"); 
  snprintf( chExpectedText, elCount(chExpectedText), "ECU should be in running state"); 
  TestStepAddActionExpected( chActionText, chExpectedText );

  A_DBGR_BreakpointDeleteAll();
  A_DBGR_RnGo();
  E_DBGR_CheckState(T32_State_Running);
  

   /***************************************************************************************************************/    
            // Test Step 2: Check all cores are in running state                                   
  /***************************************************************************************************************/
  
  //Check Core0 is running
  snprintf( chActionText, elCount(chActionText), "Check 1000ms Task Counter from Core0 "); 
  snprintf( chExpectedText, elCount(chExpectedText), "1000ms Counter from Core0 is incrementing"); 
  TestStepAddActionExpected( chActionText, chExpectedText );
  A_DBGR_VariableRead( "Task_Core0_1000ms_Count", taskvalue);
  E_DBGR_VariableCheck("Task_Core0_1000ms_Count", taskvalue, Greater);
  
  //Check Core1 is running
  snprintf( chActionText, elCount(chActionText), "Check 1000ms Task Counter from Core1 "); 
  snprintf( chExpectedText, elCount(chExpectedText), "1000ms Counter from Core1 is incrementing"); 
  TestStepAddActionExpected( chActionText, chExpectedText );
  A_DBGR_VariableRead( "Task_Core1_1000ms_Count", taskvalue);
  E_DBGR_VariableCheck("Task_Core1_1000ms_Count", taskvalue, Greater);
  
  //Check Core2 is running
  snprintf( chActionText, elCount(chActionText), "Check 1000ms Task Counter from Core2 "); 
  snprintf( chExpectedText, elCount(chExpectedText), "1000ms Counter from Core2 is incrementing"); 
  TestStepAddActionExpected( chActionText, chExpectedText );
  A_DBGR_VariableRead( "Task_Core2_1000ms_Count", taskvalue);
  E_DBGR_VariableCheck("Task_Core2_1000ms_Count", taskvalue, Greater);
    
  //Check Core3 is running
  snprintf( chActionText, elCount(chActionText), "Check 1000ms Task Counter from Core3 "); 
  snprintf( chExpectedText, elCount(chExpectedText), "1000ms Counter from Core3 is incrementing"); 
  TestStepAddActionExpected( chActionText, chExpectedText );
  A_DBGR_VariableRead( "Task_Core3_1000ms_Count", taskvalue);
  E_DBGR_VariableCheck("Task_Core3_1000ms_Count", taskvalue, Greater);
    
  //Check Core4 is running
  snprintf( chActionText, elCount(chActionText), "Check 1000ms Task Counter from Core4 "); 
  snprintf( chExpectedText, elCount(chExpectedText), "1000ms Counter from Core4 is incrementing"); 
  TestStepAddActionExpected( chActionText, chExpectedText );
  A_DBGR_VariableRead( "Task_Core4_1000ms_Count", taskvalue);
  E_DBGR_VariableCheck("Task_Core4_1000ms_Count", taskvalue, Greater);
    
  //Check Core5 is running
  snprintf( chActionText, elCount(chActionText), "Check 1000ms Task Counter from Core5 "); 
  snprintf( chExpectedText, elCount(chExpectedText), "1000ms Counter from Core5 is incrementing"); 
  TestStepAddActionExpected( chActionText, chExpectedText );
  A_DBGR_VariableRead( "Task_Core5_1000ms_Count", taskvalue);
  E_DBGR_VariableCheck("Task_Core5_1000ms_Count", taskvalue, Greater);
  
  /*******************************************************************************************************************************************************/    
    // Test Step 3: Set lockReleaseSchedulerTestEnable[1]=1 to LockHWIO_Scheduler in funtion Os_Test_GetHWIO_LockReleaseScheduler
  /*******************************************************************************************************************************************************/

  snprintf( chActionText, elCount(chActionText), "Set lockReleaseSchedulerTestEnable[0]=1 in funtion Os_Test_GetHWIO_LockReleaseScheduler "); 
  snprintf( chExpectedText, elCount(chExpectedText), "Verify lockReleaseSchedulerTestEnable[0]=1 funtion Os_Test_GetHWIO_LockReleaseScheduler "); 
  TestStepAddActionExpected( chActionText, chExpectedText );
  A_DBGR_VariableSet("lockReleaseSchedulerTestEnable[1]", "1");
  E_DBGR_VariableCheck("lockReleaseSchedulerTestEnable[1]", 1, Equal);


  /***************************************************************************************************************/    
        // Test Step 4 check the task counters for  the core1 stopped.
  /***************************************************************************************************************/

  //Check All tasks of Core1 are stopped
  snprintf( chActionText, elCount(chActionText), "Check 2pt5ms Task Counter from Core1 "); 
  snprintf( chExpectedText, elCount(chExpectedText), "2pt5ms Counter from Core1 is stop incrementing"); 
  TestStepAddActionExpected( chActionText, chExpectedText );
  A_DBGR_VariableRead( "Task_Core1_2pt5ms_Count", taskvalue);
  E_DBGR_VariableCheck("Task_Core1_2pt5ms_Count", taskvalue, Equal);
  
  snprintf( chActionText, elCount(chActionText), "Check 5ms Task Counter from Core1 "); 
  snprintf( chExpectedText, elCount(chExpectedText), "5ms Counter from Core1 is stop incrementing"); 
  TestStepAddActionExpected( chActionText, chExpectedText );
  A_DBGR_VariableRead( "Task_Core1_5ms_Count", taskvalue);
  E_DBGR_VariableCheck("Task_Core1_5ms_Count", taskvalue, Equal);
  
  snprintf( chActionText, elCount(chActionText), "Check 10ms Task Counter from Core1 "); 
  snprintf( chExpectedText, elCount(chExpectedText), "10ms Counter from Core1 is stop incrementing"); 
  TestStepAddActionExpected( chActionText, chExpectedText );
  A_DBGR_VariableRead( "Task_Core1_10ms_Count", taskvalue);
  E_DBGR_VariableCheck("Task_Core1_10ms_Count", taskvalue, Equal);  
  
  snprintf( chActionText, elCount(chActionText), "Check 25ms Task Counter from Core1 "); 
  snprintf( chExpectedText, elCount(chExpectedText), "25ms Counter from Core1 is stop incrementing"); 
  TestStepAddActionExpected( chActionText, chExpectedText );
  A_DBGR_VariableRead( "Task_Core1_25ms_Count", taskvalue);
  E_DBGR_VariableCheck("Task_Core1_25ms_Count", taskvalue, Equal);  

  snprintf( chActionText, elCount(chActionText), "Check 50ms Task Counter from Core1 "); 
  snprintf( chExpectedText, elCount(chExpectedText), "50ms Counter from Core1 is stop incrementing"); 
  TestStepAddActionExpected( chActionText, chExpectedText );
  A_DBGR_VariableRead( "Task_Core1_50ms_Count", taskvalue);
  E_DBGR_VariableCheck("Task_Core1_50ms_Count", taskvalue, Equal);
  
  snprintf( chActionText, elCount(chActionText), "Check 250ms Task Counter from Core1 "); 
  snprintf( chExpectedText, elCount(chExpectedText), "250ms Counter from Core1 is stop incrementing"); 
  TestStepAddActionExpected( chActionText, chExpectedText );
  A_DBGR_VariableRead( "Task_Core1_250ms_Count", taskvalue);
  E_DBGR_VariableCheck("Task_Core1_250ms_Count", taskvalue, Equal);
  
  snprintf( chActionText, elCount(chActionText), "Check 100ms Task Counter from Core1 "); 
  snprintf( chExpectedText, elCount(chExpectedText), "100ms Counter from Core1 is stop incrementing"); 
  TestStepAddActionExpected( chActionText, chExpectedText );
  A_DBGR_VariableRead( "Task_Core1_100ms_Count", taskvalue);
  E_DBGR_VariableCheck("Task_Core1_100ms_Count", taskvalue, Equal); 

  snprintf( chActionText, elCount(chActionText), "Check 500ms Task Counter from Core1 "); 
  snprintf( chExpectedText, elCount(chExpectedText), "500ms Counter from Core1 is stop incrementing"); 
  TestStepAddActionExpected( chActionText, chExpectedText );
  A_DBGR_VariableRead( "Task_Core1_500ms_Count", taskvalue);
  E_DBGR_VariableCheck("Task_Core1_500ms_Count", taskvalue, Equal);
  
  snprintf( chActionText, elCount(chActionText), "Check 1000ms Task Counter from Core1 "); 
  snprintf( chExpectedText, elCount(chExpectedText), "1000ms Counter from Core1 is stop incrementing"); 
  TestStepAddActionExpected( chActionText, chExpectedText );
  A_DBGR_VariableRead( "Task_Core1_1000ms_Count", taskvalue);
  E_DBGR_VariableCheck("Task_Core1_1000ms_Count", taskvalue, Equal);
  
   //Check Core0 is running
  snprintf( chActionText, elCount(chActionText), "Check 1000ms Task Counter from Core0 "); 
  snprintf( chExpectedText, elCount(chExpectedText), "1000ms Counter from Core0 is incrementing"); 
  TestStepAddActionExpected( chActionText, chExpectedText );
  A_DBGR_VariableRead( "Task_Core0_1000ms_Count", taskvalue);
  E_DBGR_VariableCheck("Task_Core0_1000ms_Count", taskvalue, Greater);
  
  //Check Core2 is running
  snprintf( chActionText, elCount(chActionText), "Check 1000ms Task Counter from Core2 "); 
  snprintf( chExpectedText, elCount(chExpectedText), "1000ms Counter from Core2 is incrementing"); 
  TestStepAddActionExpected( chActionText, chExpectedText );
  A_DBGR_VariableRead( "Task_Core2_1000ms_Count", taskvalue);
  E_DBGR_VariableCheck("Task_Core2_1000ms_Count", taskvalue, Greater);
    
  //Check Core3 is running
  snprintf( chActionText, elCount(chActionText), "Check 1000ms Task Counter from Core3 "); 
  snprintf( chExpectedText, elCount(chExpectedText), "1000ms Counter from Core3 is incrementing"); 
  TestStepAddActionExpected( chActionText, chExpectedText );
  A_DBGR_VariableRead( "Task_Core3_1000ms_Count", taskvalue);
  E_DBGR_VariableCheck("Task_Core3_1000ms_Count", taskvalue, Greater);
    
  //Check Core4 is running
  snprintf( chActionText, elCount(chActionText), "Check 1000ms Task Counter from Core4 "); 
  snprintf( chExpectedText, elCount(chExpectedText), "1000ms Counter from Core4 is incrementing"); 
  TestStepAddActionExpected( chActionText, chExpectedText );
  A_DBGR_VariableRead( "Task_Core4_1000ms_Count", taskvalue);
  E_DBGR_VariableCheck("Task_Core4_1000ms_Count", taskvalue, Greater);
    
  //Check Core5 is running
  snprintf( chActionText, elCount(chActionText), "Check 1000ms Task Counter from Core5 "); 
  snprintf( chExpectedText, elCount(chExpectedText), "1000ms Counter from Core5 is incrementing"); 
  TestStepAddActionExpected( chActionText, chExpectedText );
  A_DBGR_VariableRead( "Task_Core5_1000ms_Count", taskvalue);
  E_DBGR_VariableCheck("Task_Core5_1000ms_Count", taskvalue, Greater);
  
  /*******************************************************************************************************************************************************/    
    // Test Step 5: set lockScheduler[1]=1 to ReleaseHWIO_Scheduler in  funtion Os_Test_GetHWIO_LockReleaseScheduler
  /*******************************************************************************************************************************************************/
  snprintf( chActionText, elCount(chActionText), "Set lockReleaseSchedulerTestEnable[1]=1 in funtion Os_Test_GetHWIO_LockReleaseScheduler "); 
  snprintf( chExpectedText, elCount(chExpectedText), "Verify lockReleaseSchedulerTestEnable[1]=1 funtion Os_Test_GetHWIO_LockReleaseScheduler "); 
  TestStepAddActionExpected( chActionText, chExpectedText );
  A_DBGR_VariableSet("lockScheduler[1]", "1");
  E_DBGR_VariableCheck("lockScheduler[1]", 1, Equal);
  
  /***************************************************************************************************************/    
            // Test Step 6: Check all cores are in running state                                   
  /***************************************************************************************************************/
  
  //Check Core0 is running
  snprintf( chActionText, elCount(chActionText), "Check 1000ms Task Counter from Core0 "); 
  snprintf( chExpectedText, elCount(chExpectedText), "1000ms Counter from Core0 is incrementing"); 
  TestStepAddActionExpected( chActionText, chExpectedText );
  A_DBGR_VariableRead( "Task_Core0_1000ms_Count", taskvalue);
  E_DBGR_VariableCheck("Task_Core0_1000ms_Count", taskvalue, Greater);
  
  //Check Core1 is running
  snprintf( chActionText, elCount(chActionText), "Check 1000ms Task Counter from Core1 "); 
  snprintf( chExpectedText, elCount(chExpectedText), "1000ms Counter from Core1 is incrementing"); 
  TestStepAddActionExpected( chActionText, chExpectedText );
  A_DBGR_VariableRead( "Task_Core1_1000ms_Count", taskvalue);
  E_DBGR_VariableCheck("Task_Core1_1000ms_Count", taskvalue, Greater);
  
  //Check Core2 is running
  snprintf( chActionText, elCount(chActionText), "Check 1000ms Task Counter from Core2 "); 
  snprintf( chExpectedText, elCount(chExpectedText), "1000ms Counter from Core2 is incrementing"); 
  TestStepAddActionExpected( chActionText, chExpectedText );
  A_DBGR_VariableRead( "Task_Core2_1000ms_Count", taskvalue);
  E_DBGR_VariableCheck("Task_Core2_1000ms_Count", taskvalue, Greater);
    
  //Check Core3 is running
  snprintf( chActionText, elCount(chActionText), "Check 1000ms Task Counter from Core3 "); 
  snprintf( chExpectedText, elCount(chExpectedText), "1000ms Counter from Core3 is incrementing"); 
  TestStepAddActionExpected( chActionText, chExpectedText );
  A_DBGR_VariableRead( "Task_Core3_1000ms_Count", taskvalue);
  E_DBGR_VariableCheck("Task_Core3_1000ms_Count", taskvalue, Greater);
    
  //Check Core4 is running
  snprintf( chActionText, elCount(chActionText), "Check 1000ms Task Counter from Core4 "); 
  snprintf( chExpectedText, elCount(chExpectedText), "1000ms Counter from Core4 is incrementing"); 
  TestStepAddActionExpected( chActionText, chExpectedText );
  A_DBGR_VariableRead( "Task_Core4_1000ms_Count", taskvalue);
  E_DBGR_VariableCheck("Task_Core4_1000ms_Count", taskvalue, Greater);
    
  //Check Core5 is running
  snprintf( chActionText, elCount(chActionText), "Check 1000ms Task Counter from Core5 "); 
  snprintf( chExpectedText, elCount(chExpectedText), "1000ms Counter from Core5 is incrementing"); 
  TestStepAddActionExpected( chActionText, chExpectedText );
  A_DBGR_VariableRead( "Task_Core5_1000ms_Count", taskvalue);
  E_DBGR_VariableCheck("Task_Core5_1000ms_Count", taskvalue, Greater);
  
  
  snprintf( chActionText, elCount(chActionText), "Set lockReleaseSchedulerTestEnable[1]=0 in funtion Os_Test_GetHWIO_LockReleaseScheduler "); 
  snprintf( chExpectedText, elCount(chExpectedText), "Verify lockReleaseSchedulerTestEnable[1]=0 funtion Os_Test_GetHWIO_LockReleaseScheduler "); 
  TestStepAddActionExpected( chActionText, chExpectedText );
  A_DBGR_VariableSet("lockReleaseSchedulerTestEnable[1]", "0");
  E_DBGR_VariableCheck("lockReleaseSchedulerTestEnable[1]", 0, Equal);
  
  snprintf( chActionText, elCount(chActionText), "Set lockScheduler[1]=0 in funtion Os_Test_GetHWIO_LockReleaseScheduler "); 
  snprintf( chExpectedText, elCount(chExpectedText), "Verify lockScheduler[1]=0 funtion Os_Test_GetHWIO_LockReleaseScheduler "); 
  TestStepAddActionExpected( chActionText, chExpectedText );
  A_DBGR_VariableSet("lockScheduler[1]", "0");
  E_DBGR_VariableCheck("lockScheduler[1]", 0, Equal);
  
}

/***************************************************************************************************
----------------------------------------------------------------------------------------------------
Test case name:  TC_L30SW_QT_36651195: Verify_functionality_of_interface_LockHWIO_Scheduler_ReleaseHWIO_Scheduler_to_prohibit_task_for_CPU2_schedular_to_release_task
----------------------------------------------------------------------------------------------------
Description:  test_case_to_verify_the_functionality_of_interface_LockHWIO_Scheduler()_and_ReleaseHWIO_Scheduler_to_prohibit_the_current_task_for_CPU2_and_allow_schedular_to_release_the_task.

***************************************************************************************************/
testcase Verify_functionality_of_interface_LockHWIO_Scheduler_ReleaseHWIO_Scheduler_to_prohibit_task_for_CPU2_schedular_to_release_task()
{
  /***************************************************************************************************************/    
                                                // Variable Definition
  /***************************************************************************************************************/ 
  
  long taskvalue;
  
  /***************************************************************************************************************/    
                                               // Local Values
  /***************************************************************************************************************/ 
  

  
  /***************************************************************************************************************/    
                                              // Test Case Info
  /***************************************************************************************************************/
  setWriteDbgLevel(DebugOff);
  snprintf( chTestTitle, elCount(chTestTitle), "test_case_to_verify_the_functionality_of_interface_DsblHWIO_Interrupt_to_prohibits_all_interrupts_from_pre_empting_the_core2_task_and_interrupt__for_CPU2" );
  snprintf( chTestDescription, elCount(chTestDescription), "Purpose: test_case_to_verify_the_functionality_of_interface_DsblHWIO_Interrupt_to_prohibits_all_interrupts_from_pre_empting_the_core2_task_and_interrupt__for_CPU2.");
  TestCaseAddInfo( chTestTitle, "TC_L30SW_QT_36651195", chTestDescription );

  /***************************************************************************************************************/    
                                              // Start of Test Case
  /***************************************************************************************************************/
  
  /***************************************************************************************************************/    
                                              // Test Step 1 PRECONDITIONS
  /***************************************************************************************************************/
  
  snprintf( chActionText, elCount(chActionText), "Flash the Software and ECU is running"); 
  snprintf( chExpectedText, elCount(chExpectedText), "ECU should be in running state"); 
  TestStepAddActionExpected( chActionText, chExpectedText );

  A_DBGR_BreakpointDeleteAll();
  A_DBGR_RnGo();
  E_DBGR_CheckState(T32_State_Running);
  

   /***************************************************************************************************************/    
            // Test Step 2: Check all cores are in running state                                   
  /***************************************************************************************************************/
  
  //Check Core0 is running
  snprintf( chActionText, elCount(chActionText), "Check 1000ms Task Counter from Core0 "); 
  snprintf( chExpectedText, elCount(chExpectedText), "1000ms Counter from Core0 is incrementing"); 
  TestStepAddActionExpected( chActionText, chExpectedText );
  A_DBGR_VariableRead( "Task_Core0_1000ms_Count", taskvalue);
  E_DBGR_VariableCheck("Task_Core0_1000ms_Count", taskvalue, Greater);
  
  //Check Core1 is running
  snprintf( chActionText, elCount(chActionText), "Check 1000ms Task Counter from Core1 "); 
  snprintf( chExpectedText, elCount(chExpectedText), "1000ms Counter from Core1 is incrementing"); 
  TestStepAddActionExpected( chActionText, chExpectedText );
  A_DBGR_VariableRead( "Task_Core1_1000ms_Count", taskvalue);
  E_DBGR_VariableCheck("Task_Core1_1000ms_Count", taskvalue, Greater);
  
  //Check Core2 is running
  snprintf( chActionText, elCount(chActionText), "Check 1000ms Task Counter from Core2 "); 
  snprintf( chExpectedText, elCount(chExpectedText), "1000ms Counter from Core2 is incrementing"); 
  TestStepAddActionExpected( chActionText, chExpectedText );
  A_DBGR_VariableRead( "Task_Core2_1000ms_Count", taskvalue);
  E_DBGR_VariableCheck("Task_Core2_1000ms_Count", taskvalue, Greater);
    
  //Check Core3 is running
  snprintf( chActionText, elCount(chActionText), "Check 1000ms Task Counter from Core3 "); 
  snprintf( chExpectedText, elCount(chExpectedText), "1000ms Counter from Core3 is incrementing"); 
  TestStepAddActionExpected( chActionText, chExpectedText );
  A_DBGR_VariableRead( "Task_Core3_1000ms_Count", taskvalue);
  E_DBGR_VariableCheck("Task_Core3_1000ms_Count", taskvalue, Greater);
    
  //Check Core4 is running
  snprintf( chActionText, elCount(chActionText), "Check 1000ms Task Counter from Core4 "); 
  snprintf( chExpectedText, elCount(chExpectedText), "1000ms Counter from Core4 is incrementing"); 
  TestStepAddActionExpected( chActionText, chExpectedText );
  A_DBGR_VariableRead( "Task_Core4_1000ms_Count", taskvalue);
  E_DBGR_VariableCheck("Task_Core4_1000ms_Count", taskvalue, Greater);
    
  //Check Core5 is running
  snprintf( chActionText, elCount(chActionText), "Check 1000ms Task Counter from Core5 "); 
  snprintf( chExpectedText, elCount(chExpectedText), "1000ms Counter from Core5 is incrementing"); 
  TestStepAddActionExpected( chActionText, chExpectedText );
  A_DBGR_VariableRead( "Task_Core5_1000ms_Count", taskvalue);
  E_DBGR_VariableCheck("Task_Core5_1000ms_Count", taskvalue, Greater);
  
  /*******************************************************************************************************************************************************/    
    // Test Step 3: Set lockReleaseSchedulerTestEnable[2]=1 to LockHWIO_Scheduler in funtion Os_Test_GetHWIO_LockReleaseScheduler
  /*******************************************************************************************************************************************************/

  snprintf( chActionText, elCount(chActionText), "Set lockReleaseSchedulerTestEnable[2]=1 in funtion Os_Test_GetHWIO_LockReleaseScheduler "); 
  snprintf( chExpectedText, elCount(chExpectedText), "Verify lockReleaseSchedulerTestEnable[2]=1 funtion Os_Test_GetHWIO_LockReleaseScheduler "); 
  TestStepAddActionExpected( chActionText, chExpectedText );
  A_DBGR_VariableSet("lockReleaseSchedulerTestEnable[2]", "1");
  E_DBGR_VariableCheck("lockReleaseSchedulerTestEnable[2]", 1, Equal);


  /***************************************************************************************************************/    
        // Test Step 4 check the task counters for  the core2 stopped.
  /***************************************************************************************************************/

  //Check All tasks of Core2 are stopped
  snprintf( chActionText, elCount(chActionText), "Check 2pt5ms Task Counter from Core2 "); 
  snprintf( chExpectedText, elCount(chExpectedText), "2pt5ms Counter from Core2 is stop incrementing"); 
  TestStepAddActionExpected( chActionText, chExpectedText );
  A_DBGR_VariableRead( "Task_Core2_2pt5ms_Count", taskvalue);
  E_DBGR_VariableCheck("Task_Core2_2pt5ms_Count", taskvalue, Equal);
  
  snprintf( chActionText, elCount(chActionText), "Check 5ms Task Counter from Core2 "); 
  snprintf( chExpectedText, elCount(chExpectedText), "5ms Counter from Core2 is stop incrementing"); 
  TestStepAddActionExpected( chActionText, chExpectedText );
  A_DBGR_VariableRead( "Task_Core2_5ms_Count", taskvalue);
  E_DBGR_VariableCheck("Task_Core2_5ms_Count", taskvalue, Equal);
  
  snprintf( chActionText, elCount(chActionText), "Check 10ms Task Counter from Core2 "); 
  snprintf( chExpectedText, elCount(chExpectedText), "10ms Counter from Core2 is stop incrementing"); 
  TestStepAddActionExpected( chActionText, chExpectedText );
  A_DBGR_VariableRead( "Task_Core2_10ms_Count", taskvalue);
  E_DBGR_VariableCheck("Task_Core2_10ms_Count", taskvalue, Equal);  
  
  snprintf( chActionText, elCount(chActionText), "Check 25ms Task Counter from Core2 "); 
  snprintf( chExpectedText, elCount(chExpectedText), "25ms Counter from Core2 is stop incrementing"); 
  TestStepAddActionExpected( chActionText, chExpectedText );
  A_DBGR_VariableRead( "Task_Core2_25ms_Count", taskvalue);
  E_DBGR_VariableCheck("Task_Core2_25ms_Count", taskvalue, Equal);  

  snprintf( chActionText, elCount(chActionText), "Check 50ms Task Counter from Core2 "); 
  snprintf( chExpectedText, elCount(chExpectedText), "50ms Counter from Core2 is stop incrementing"); 
  TestStepAddActionExpected( chActionText, chExpectedText );
  A_DBGR_VariableRead( "Task_Core2_50ms_Count", taskvalue);
  E_DBGR_VariableCheck("Task_Core2_50ms_Count", taskvalue, Equal);
  
  snprintf( chActionText, elCount(chActionText), "Check 250ms Task Counter from Core2 "); 
  snprintf( chExpectedText, elCount(chExpectedText), "250ms Counter from Core2 is stop incrementing"); 
  TestStepAddActionExpected( chActionText, chExpectedText );
  A_DBGR_VariableRead( "Task_Core2_250ms_Count", taskvalue);
  E_DBGR_VariableCheck("Task_Core2_250ms_Count", taskvalue, Equal);
  
  snprintf( chActionText, elCount(chActionText), "Check 100ms Task Counter from Core2 "); 
  snprintf( chExpectedText, elCount(chExpectedText), "100ms Counter from Core2 is stop incrementing"); 
  TestStepAddActionExpected( chActionText, chExpectedText );
  A_DBGR_VariableRead( "Task_Core2_100ms_Count", taskvalue);
  E_DBGR_VariableCheck("Task_Core2_100ms_Count", taskvalue, Equal); 

  snprintf( chActionText, elCount(chActionText), "Check 500ms Task Counter from Core2 "); 
  snprintf( chExpectedText, elCount(chExpectedText), "500ms Counter from Core2 is stop incrementing"); 
  TestStepAddActionExpected( chActionText, chExpectedText );
  A_DBGR_VariableRead( "Task_Core2_500ms_Count", taskvalue);
  E_DBGR_VariableCheck("Task_Core2_500ms_Count", taskvalue, Equal);
  
  snprintf( chActionText, elCount(chActionText), "Check 1000ms Task Counter from Core2 "); 
  snprintf( chExpectedText, elCount(chExpectedText), "1000ms Counter from Core2 is stop incrementing"); 
  TestStepAddActionExpected( chActionText, chExpectedText );
  A_DBGR_VariableRead( "Task_Core2_1000ms_Count", taskvalue);
  E_DBGR_VariableCheck("Task_Core2_1000ms_Count", taskvalue, Equal);
  
   //Check Core0 is running
  snprintf( chActionText, elCount(chActionText), "Check 1000ms Task Counter from Core0 "); 
  snprintf( chExpectedText, elCount(chExpectedText), "1000ms Counter from Core0 is incrementing"); 
  TestStepAddActionExpected( chActionText, chExpectedText );
  A_DBGR_VariableRead( "Task_Core0_1000ms_Count", taskvalue);
  E_DBGR_VariableCheck("Task_Core0_1000ms_Count", taskvalue, Greater);
  
  //Check Core1 is running
  snprintf( chActionText, elCount(chActionText), "Check 1000ms Task Counter from Core1 "); 
  snprintf( chExpectedText, elCount(chExpectedText), "1000ms Counter from Core1 is incrementing"); 
  TestStepAddActionExpected( chActionText, chExpectedText );
  A_DBGR_VariableRead( "Task_Core1_1000ms_Count", taskvalue);
  E_DBGR_VariableCheck("Task_Core1_1000ms_Count", taskvalue, Greater);
    
  //Check Core3 is running
  snprintf( chActionText, elCount(chActionText), "Check 1000ms Task Counter from Core3 "); 
  snprintf( chExpectedText, elCount(chExpectedText), "1000ms Counter from Core3 is incrementing"); 
  TestStepAddActionExpected( chActionText, chExpectedText );
  A_DBGR_VariableRead( "Task_Core3_1000ms_Count", taskvalue);
  E_DBGR_VariableCheck("Task_Core3_1000ms_Count", taskvalue, Greater);
    
  //Check Core4 is running
  snprintf( chActionText, elCount(chActionText), "Check 1000ms Task Counter from Core4 "); 
  snprintf( chExpectedText, elCount(chExpectedText), "1000ms Counter from Core4 is incrementing"); 
  TestStepAddActionExpected( chActionText, chExpectedText );
  A_DBGR_VariableRead( "Task_Core4_1000ms_Count", taskvalue);
  E_DBGR_VariableCheck("Task_Core4_1000ms_Count", taskvalue, Greater);
    
  //Check Core5 is running
  snprintf( chActionText, elCount(chActionText), "Check 1000ms Task Counter from Core5 "); 
  snprintf( chExpectedText, elCount(chExpectedText), "1000ms Counter from Core5 is incrementing"); 
  TestStepAddActionExpected( chActionText, chExpectedText );
  A_DBGR_VariableRead( "Task_Core5_1000ms_Count", taskvalue);
  E_DBGR_VariableCheck("Task_Core5_1000ms_Count", taskvalue, Greater);
  
  /*******************************************************************************************************************************************************/    
    // Test Step 5: set lockScheduler[2]=1 to ReleaseHWIO_Scheduler in  funtion Os_Test_GetHWIO_LockReleaseScheduler
  /*******************************************************************************************************************************************************/
  snprintf( chActionText, elCount(chActionText), "Set lockReleaseSchedulerTestEnable[2]=1 in funtion Os_Test_GetHWIO_LockReleaseScheduler "); 
  snprintf( chExpectedText, elCount(chExpectedText), "Verify lockReleaseSchedulerTestEnable[2]=1 funtion Os_Test_GetHWIO_LockReleaseScheduler "); 
  TestStepAddActionExpected( chActionText, chExpectedText );
  A_DBGR_VariableSet("lockScheduler[2]", "1");
  E_DBGR_VariableCheck("lockScheduler[2]", 1, Equal);
  
  /***************************************************************************************************************/    
            // Test Step 6: Check all cores are in running state                                   
  /***************************************************************************************************************/
  
  //Check Core0 is running
  snprintf( chActionText, elCount(chActionText), "Check 1000ms Task Counter from Core0 "); 
  snprintf( chExpectedText, elCount(chExpectedText), "1000ms Counter from Core0 is incrementing"); 
  TestStepAddActionExpected( chActionText, chExpectedText );
  A_DBGR_VariableRead( "Task_Core0_1000ms_Count", taskvalue);
  E_DBGR_VariableCheck("Task_Core0_1000ms_Count", taskvalue, Greater);
  
  //Check Core1 is running
  snprintf( chActionText, elCount(chActionText), "Check 1000ms Task Counter from Core1 "); 
  snprintf( chExpectedText, elCount(chExpectedText), "1000ms Counter from Core1 is incrementing"); 
  TestStepAddActionExpected( chActionText, chExpectedText );
  A_DBGR_VariableRead( "Task_Core1_1000ms_Count", taskvalue);
  E_DBGR_VariableCheck("Task_Core1_1000ms_Count", taskvalue, Greater);
  
  //Check Core2 is running
  snprintf( chActionText, elCount(chActionText), "Check 1000ms Task Counter from Core2 "); 
  snprintf( chExpectedText, elCount(chExpectedText), "1000ms Counter from Core2 is incrementing"); 
  TestStepAddActionExpected( chActionText, chExpectedText );
  A_DBGR_VariableRead( "Task_Core2_1000ms_Count", taskvalue);
  E_DBGR_VariableCheck("Task_Core2_1000ms_Count", taskvalue, Greater);
    
  //Check Core3 is running
  snprintf( chActionText, elCount(chActionText), "Check 1000ms Task Counter from Core3 "); 
  snprintf( chExpectedText, elCount(chExpectedText), "1000ms Counter from Core3 is incrementing"); 
  TestStepAddActionExpected( chActionText, chExpectedText );
  A_DBGR_VariableRead( "Task_Core3_1000ms_Count", taskvalue);
  E_DBGR_VariableCheck("Task_Core3_1000ms_Count", taskvalue, Greater);
    
  //Check Core4 is running
  snprintf( chActionText, elCount(chActionText), "Check 1000ms Task Counter from Core4 "); 
  snprintf( chExpectedText, elCount(chExpectedText), "1000ms Counter from Core4 is incrementing"); 
  TestStepAddActionExpected( chActionText, chExpectedText );
  A_DBGR_VariableRead( "Task_Core4_1000ms_Count", taskvalue);
  E_DBGR_VariableCheck("Task_Core4_1000ms_Count", taskvalue, Greater);
    
  //Check Core5 is running
  snprintf( chActionText, elCount(chActionText), "Check 1000ms Task Counter from Core5 "); 
  snprintf( chExpectedText, elCount(chExpectedText), "1000ms Counter from Core5 is incrementing"); 
  TestStepAddActionExpected( chActionText, chExpectedText );
  A_DBGR_VariableRead( "Task_Core5_1000ms_Count", taskvalue);
  E_DBGR_VariableCheck("Task_Core5_1000ms_Count", taskvalue, Greater);
  
  
  snprintf( chActionText, elCount(chActionText), "Set lockReleaseSchedulerTestEnable[2]=0 in funtion Os_Test_GetHWIO_LockReleaseScheduler "); 
  snprintf( chExpectedText, elCount(chExpectedText), "Verify lockReleaseSchedulerTestEnable[2]=0 funtion Os_Test_GetHWIO_LockReleaseScheduler "); 
  TestStepAddActionExpected( chActionText, chExpectedText );
  A_DBGR_VariableSet("lockReleaseSchedulerTestEnable[2]", "0");
  E_DBGR_VariableCheck("lockReleaseSchedulerTestEnable[2]", 0, Equal);
  
  snprintf( chActionText, elCount(chActionText), "Set lockScheduler[2]=0 in funtion Os_Test_GetHWIO_LockReleaseScheduler "); 
  snprintf( chExpectedText, elCount(chExpectedText), "Verify lockScheduler[2]=0 funtion Os_Test_GetHWIO_LockReleaseScheduler "); 
  TestStepAddActionExpected( chActionText, chExpectedText );
  A_DBGR_VariableSet("lockScheduler[2]", "0");
  E_DBGR_VariableCheck("lockScheduler[2]", 0, Equal);
  
}

/***************************************************************************************************
----------------------------------------------------------------------------------------------------
Test case name:  TC_L30SW_QT_36651196: Verify_functionality_of_interface_LockHWIO_Scheduler_ReleaseHWIO_Scheduler_to_prohibit_task_for_CPU3_schedular_to_release_task
----------------------------------------------------------------------------------------------------
Description:  test_case_to_verify_the_functionality_of_interface_LockHWIO_Scheduler()_and_ReleaseHWIO_Scheduler_to_prohibit_the_current_task_for_CPU3_and_allow_schedular_to_release_the_task.

***************************************************************************************************/
testcase Verify_functionality_of_interface_LockHWIO_Scheduler_ReleaseHWIO_Scheduler_to_prohibit_task_for_CPU3_schedular_to_release_task()
{
  /***************************************************************************************************************/    
                                                // Variable Definition
  /***************************************************************************************************************/ 
  
  long taskvalue;
  
  /***************************************************************************************************************/    
                                               // Local Values
  /***************************************************************************************************************/ 
  

  
  /***************************************************************************************************************/    
                                              // Test Case Info
  /***************************************************************************************************************/
  setWriteDbgLevel(DebugOff);
  snprintf( chTestTitle, elCount(chTestTitle), "test_case_to_verify_the_functionality_of_interface_DsblHWIO_Interrupt_to_prohibits_all_interrupts_from_pre_empting_the_core3_task_and_interrupt__for_CPU3" );
  snprintf( chTestDescription, elCount(chTestDescription), "Purpose: test_case_to_verify_the_functionality_of_interface_DsblHWIO_Interrupt_to_prohibits_all_interrupts_from_pre_empting_the_core3_task_and_interrupt__for_CPU3.");
  TestCaseAddInfo( chTestTitle, "TC_L30SW_QT_36651196", chTestDescription );

  /***************************************************************************************************************/    
                                              // Start of Test Case
  /***************************************************************************************************************/
  
  /***************************************************************************************************************/    
                                              // Test Step 1 PRECONDITIONS
  /***************************************************************************************************************/
  
  snprintf( chActionText, elCount(chActionText), "Flash the Software and ECU is running"); 
  snprintf( chExpectedText, elCount(chExpectedText), "ECU should be in running state"); 
  TestStepAddActionExpected( chActionText, chExpectedText );

  A_DBGR_BreakpointDeleteAll();
  A_DBGR_RnGo();
  E_DBGR_CheckState(T32_State_Running);
  

   /***************************************************************************************************************/    
            // Test Step 2: Check all cores are in running state                                   
  /***************************************************************************************************************/
  
  //Check Core0 is running
  snprintf( chActionText, elCount(chActionText), "Check 1000ms Task Counter from Core0 "); 
  snprintf( chExpectedText, elCount(chExpectedText), "1000ms Counter from Core0 is incrementing"); 
  TestStepAddActionExpected( chActionText, chExpectedText );
  A_DBGR_VariableRead( "Task_Core0_1000ms_Count", taskvalue);
  E_DBGR_VariableCheck("Task_Core0_1000ms_Count", taskvalue, Greater);
  
  //Check Core1 is running
  snprintf( chActionText, elCount(chActionText), "Check 1000ms Task Counter from Core1 "); 
  snprintf( chExpectedText, elCount(chExpectedText), "1000ms Counter from Core1 is incrementing"); 
  TestStepAddActionExpected( chActionText, chExpectedText );
  A_DBGR_VariableRead( "Task_Core1_1000ms_Count", taskvalue);
  E_DBGR_VariableCheck("Task_Core1_1000ms_Count", taskvalue, Greater);
  
  //Check Core2 is running
  snprintf( chActionText, elCount(chActionText), "Check 1000ms Task Counter from Core2 "); 
  snprintf( chExpectedText, elCount(chExpectedText), "1000ms Counter from Core2 is incrementing"); 
  TestStepAddActionExpected( chActionText, chExpectedText );
  A_DBGR_VariableRead( "Task_Core2_1000ms_Count", taskvalue);
  E_DBGR_VariableCheck("Task_Core2_1000ms_Count", taskvalue, Greater);
    
  //Check Core3 is running
  snprintf( chActionText, elCount(chActionText), "Check 1000ms Task Counter from Core3 "); 
  snprintf( chExpectedText, elCount(chExpectedText), "1000ms Counter from Core3 is incrementing"); 
  TestStepAddActionExpected( chActionText, chExpectedText );
  A_DBGR_VariableRead( "Task_Core3_1000ms_Count", taskvalue);
  E_DBGR_VariableCheck("Task_Core3_1000ms_Count", taskvalue, Greater);
    
  //Check Core4 is running
  snprintf( chActionText, elCount(chActionText), "Check 1000ms Task Counter from Core4 "); 
  snprintf( chExpectedText, elCount(chExpectedText), "1000ms Counter from Core4 is incrementing"); 
  TestStepAddActionExpected( chActionText, chExpectedText );
  A_DBGR_VariableRead( "Task_Core4_1000ms_Count", taskvalue);
  E_DBGR_VariableCheck("Task_Core4_1000ms_Count", taskvalue, Greater);
    
  //Check Core5 is running
  snprintf( chActionText, elCount(chActionText), "Check 1000ms Task Counter from Core5 "); 
  snprintf( chExpectedText, elCount(chExpectedText), "1000ms Counter from Core5 is incrementing"); 
  TestStepAddActionExpected( chActionText, chExpectedText );
  A_DBGR_VariableRead( "Task_Core5_1000ms_Count", taskvalue);
  E_DBGR_VariableCheck("Task_Core5_1000ms_Count", taskvalue, Greater);
  
  /*******************************************************************************************************************************************************/    
    // Test Step 3: Set lockReleaseSchedulerTestEnable[3]=1 to LockHWIO_Scheduler in funtion Os_Test_GetHWIO_LockReleaseScheduler
  /*******************************************************************************************************************************************************/

  snprintf( chActionText, elCount(chActionText), "Set lockReleaseSchedulerTestEnable[3]=1 in funtion Os_Test_GetHWIO_LockReleaseScheduler "); 
  snprintf( chExpectedText, elCount(chExpectedText), "Verify lockReleaseSchedulerTestEnable[3]=1 funtion Os_Test_GetHWIO_LockReleaseScheduler "); 
  TestStepAddActionExpected( chActionText, chExpectedText );
  A_DBGR_VariableSet("lockReleaseSchedulerTestEnable[3]", "1");
  E_DBGR_VariableCheck("lockReleaseSchedulerTestEnable[3]", 1, Equal);


  /***************************************************************************************************************/    
        // Test Step 4 check the task counters for  the core3 stopped.
  /***************************************************************************************************************/

  //Check All tasks of Core3 are stopped
  snprintf( chActionText, elCount(chActionText), "Check 2pt5ms Task Counter from Core3 "); 
  snprintf( chExpectedText, elCount(chExpectedText), "2pt5ms Counter from Core3 is stop incrementing"); 
  TestStepAddActionExpected( chActionText, chExpectedText );
  A_DBGR_VariableRead( "Task_Core3_2pt5ms_Count", taskvalue);
  E_DBGR_VariableCheck("Task_Core3_2pt5ms_Count", taskvalue, Equal);
  
  snprintf( chActionText, elCount(chActionText), "Check 5ms Task Counter from Core3 "); 
  snprintf( chExpectedText, elCount(chExpectedText), "5ms Counter from Core3 is stop incrementing"); 
  TestStepAddActionExpected( chActionText, chExpectedText );
  A_DBGR_VariableRead( "Task_Core3_5ms_Count", taskvalue);
  E_DBGR_VariableCheck("Task_Core3_5ms_Count", taskvalue, Equal);
  
  snprintf( chActionText, elCount(chActionText), "Check 10ms Task Counter from Core3 "); 
  snprintf( chExpectedText, elCount(chExpectedText), "10ms Counter from Core3 is stop incrementing"); 
  TestStepAddActionExpected( chActionText, chExpectedText );
  A_DBGR_VariableRead( "Task_Core3_10ms_Count", taskvalue);
  E_DBGR_VariableCheck("Task_Core3_10ms_Count", taskvalue, Equal);  
  
  snprintf( chActionText, elCount(chActionText), "Check 25ms Task Counter from Core3 "); 
  snprintf( chExpectedText, elCount(chExpectedText), "25ms Counter from Core3 is stop incrementing"); 
  TestStepAddActionExpected( chActionText, chExpectedText );
  A_DBGR_VariableRead( "Task_Core3_25ms_Count", taskvalue);
  E_DBGR_VariableCheck("Task_Core3_25ms_Count", taskvalue, Equal);  

  snprintf( chActionText, elCount(chActionText), "Check 50ms Task Counter from Core3 "); 
  snprintf( chExpectedText, elCount(chExpectedText), "50ms Counter from Core3 is stop incrementing"); 
  TestStepAddActionExpected( chActionText, chExpectedText );
  A_DBGR_VariableRead( "Task_Core3_50ms_Count", taskvalue);
  E_DBGR_VariableCheck("Task_Core3_50ms_Count", taskvalue, Equal);
  
  snprintf( chActionText, elCount(chActionText), "Check 250ms Task Counter from Core3 "); 
  snprintf( chExpectedText, elCount(chExpectedText), "250ms Counter from Core3 is stop incrementing"); 
  TestStepAddActionExpected( chActionText, chExpectedText );
  A_DBGR_VariableRead( "Task_Core3_250ms_Count", taskvalue);
  E_DBGR_VariableCheck("Task_Core3_250ms_Count", taskvalue, Equal);
  
  snprintf( chActionText, elCount(chActionText), "Check 100ms Task Counter from Core3 "); 
  snprintf( chExpectedText, elCount(chExpectedText), "100ms Counter from Core3 is stop incrementing"); 
  TestStepAddActionExpected( chActionText, chExpectedText );
  A_DBGR_VariableRead( "Task_Core3_100ms_Count", taskvalue);
  E_DBGR_VariableCheck("Task_Core3_100ms_Count", taskvalue, Equal); 

  snprintf( chActionText, elCount(chActionText), "Check 500ms Task Counter from Core3 "); 
  snprintf( chExpectedText, elCount(chExpectedText), "500ms Counter from Core3 is stop incrementing"); 
  TestStepAddActionExpected( chActionText, chExpectedText );
  A_DBGR_VariableRead( "Task_Core3_500ms_Count", taskvalue);
  E_DBGR_VariableCheck("Task_Core3_500ms_Count", taskvalue, Equal);
  
  snprintf( chActionText, elCount(chActionText), "Check 1000ms Task Counter from Core3 "); 
  snprintf( chExpectedText, elCount(chExpectedText), "1000ms Counter from Core3 is stop incrementing"); 
  TestStepAddActionExpected( chActionText, chExpectedText );
  A_DBGR_VariableRead( "Task_Core3_1000ms_Count", taskvalue);
  E_DBGR_VariableCheck("Task_Core3_1000ms_Count", taskvalue, Equal);
  
   //Check Core0 is running
  snprintf( chActionText, elCount(chActionText), "Check 1000ms Task Counter from Core0 "); 
  snprintf( chExpectedText, elCount(chExpectedText), "1000ms Counter from Core0 is incrementing"); 
  TestStepAddActionExpected( chActionText, chExpectedText );
  A_DBGR_VariableRead( "Task_Core0_1000ms_Count", taskvalue);
  E_DBGR_VariableCheck("Task_Core0_1000ms_Count", taskvalue, Greater);
  
  //Check Core1 is running
  snprintf( chActionText, elCount(chActionText), "Check 1000ms Task Counter from Core1 "); 
  snprintf( chExpectedText, elCount(chExpectedText), "1000ms Counter from Core1 is incrementing"); 
  TestStepAddActionExpected( chActionText, chExpectedText );
  A_DBGR_VariableRead( "Task_Core1_1000ms_Count", taskvalue);
  E_DBGR_VariableCheck("Task_Core1_1000ms_Count", taskvalue, Greater);
    
  //Check Core2 is running
  snprintf( chActionText, elCount(chActionText), "Check 1000ms Task Counter from Core2 "); 
  snprintf( chExpectedText, elCount(chExpectedText), "1000ms Counter from Core2 is incrementing"); 
  TestStepAddActionExpected( chActionText, chExpectedText );
  A_DBGR_VariableRead( "Task_Core2_1000ms_Count", taskvalue);
  E_DBGR_VariableCheck("Task_Core2_1000ms_Count", taskvalue, Greater);
    
  //Check Core4 is running
  snprintf( chActionText, elCount(chActionText), "Check 1000ms Task Counter from Core4 "); 
  snprintf( chExpectedText, elCount(chExpectedText), "1000ms Counter from Core4 is incrementing"); 
  TestStepAddActionExpected( chActionText, chExpectedText );
  A_DBGR_VariableRead( "Task_Core4_1000ms_Count", taskvalue);
  E_DBGR_VariableCheck("Task_Core4_1000ms_Count", taskvalue, Greater);
    
  //Check Core5 is running
  snprintf( chActionText, elCount(chActionText), "Check 1000ms Task Counter from Core5 "); 
  snprintf( chExpectedText, elCount(chExpectedText), "1000ms Counter from Core5 is incrementing"); 
  TestStepAddActionExpected( chActionText, chExpectedText );
  A_DBGR_VariableRead( "Task_Core5_1000ms_Count", taskvalue);
  E_DBGR_VariableCheck("Task_Core5_1000ms_Count", taskvalue, Greater);
  
  /*******************************************************************************************************************************************************/    
    // Test Step 5: set lockScheduler[3]=1 to ReleaseHWIO_Scheduler in  funtion Os_Test_GetHWIO_LockReleaseScheduler
  /*******************************************************************************************************************************************************/
  snprintf( chActionText, elCount(chActionText), "Set lockReleaseSchedulerTestEnable[3]=1 in funtion Os_Test_GetHWIO_LockReleaseScheduler "); 
  snprintf( chExpectedText, elCount(chExpectedText), "Verify lockReleaseSchedulerTestEnable[3]=1 funtion Os_Test_GetHWIO_LockReleaseScheduler "); 
  TestStepAddActionExpected( chActionText, chExpectedText );
  A_DBGR_VariableSet("lockScheduler[3]", "1");
  E_DBGR_VariableCheck("lockScheduler[3]", 1, Equal);
  
  /***************************************************************************************************************/    
            // Test Step 6: Check all cores are in running state                                   
  /***************************************************************************************************************/
  
  //Check Core0 is running
  snprintf( chActionText, elCount(chActionText), "Check 1000ms Task Counter from Core0 "); 
  snprintf( chExpectedText, elCount(chExpectedText), "1000ms Counter from Core0 is incrementing"); 
  TestStepAddActionExpected( chActionText, chExpectedText );
  A_DBGR_VariableRead( "Task_Core0_1000ms_Count", taskvalue);
  E_DBGR_VariableCheck("Task_Core0_1000ms_Count", taskvalue, Greater);
  
  //Check Core1 is running
  snprintf( chActionText, elCount(chActionText), "Check 1000ms Task Counter from Core1 "); 
  snprintf( chExpectedText, elCount(chExpectedText), "1000ms Counter from Core1 is incrementing"); 
  TestStepAddActionExpected( chActionText, chExpectedText );
  A_DBGR_VariableRead( "Task_Core1_1000ms_Count", taskvalue);
  E_DBGR_VariableCheck("Task_Core1_1000ms_Count", taskvalue, Greater);
  
  //Check Core2 is running
  snprintf( chActionText, elCount(chActionText), "Check 1000ms Task Counter from Core2 "); 
  snprintf( chExpectedText, elCount(chExpectedText), "1000ms Counter from Core2 is incrementing"); 
  TestStepAddActionExpected( chActionText, chExpectedText );
  A_DBGR_VariableRead( "Task_Core2_1000ms_Count", taskvalue);
  E_DBGR_VariableCheck("Task_Core2_1000ms_Count", taskvalue, Greater);
    
  //Check Core3 is running
  snprintf( chActionText, elCount(chActionText), "Check 1000ms Task Counter from Core3 "); 
  snprintf( chExpectedText, elCount(chExpectedText), "1000ms Counter from Core3 is incrementing"); 
  TestStepAddActionExpected( chActionText, chExpectedText );
  A_DBGR_VariableRead( "Task_Core3_1000ms_Count", taskvalue);
  E_DBGR_VariableCheck("Task_Core3_1000ms_Count", taskvalue, Greater);
    
  //Check Core4 is running
  snprintf( chActionText, elCount(chActionText), "Check 1000ms Task Counter from Core4 "); 
  snprintf( chExpectedText, elCount(chExpectedText), "1000ms Counter from Core4 is incrementing"); 
  TestStepAddActionExpected( chActionText, chExpectedText );
  A_DBGR_VariableRead( "Task_Core4_1000ms_Count", taskvalue);
  E_DBGR_VariableCheck("Task_Core4_1000ms_Count", taskvalue, Greater);
    
  //Check Core5 is running
  snprintf( chActionText, elCount(chActionText), "Check 1000ms Task Counter from Core5 "); 
  snprintf( chExpectedText, elCount(chExpectedText), "1000ms Counter from Core5 is incrementing"); 
  TestStepAddActionExpected( chActionText, chExpectedText );
  A_DBGR_VariableRead( "Task_Core5_1000ms_Count", taskvalue);
  E_DBGR_VariableCheck("Task_Core5_1000ms_Count", taskvalue, Greater);
  
  
  snprintf( chActionText, elCount(chActionText), "Set lockReleaseSchedulerTestEnable[3]=0 in funtion Os_Test_GetHWIO_LockReleaseScheduler "); 
  snprintf( chExpectedText, elCount(chExpectedText), "Verify lockReleaseSchedulerTestEnable[3]=0 funtion Os_Test_GetHWIO_LockReleaseScheduler "); 
  TestStepAddActionExpected( chActionText, chExpectedText );
  A_DBGR_VariableSet("lockReleaseSchedulerTestEnable[3]", "0");
  E_DBGR_VariableCheck("lockReleaseSchedulerTestEnable[3]", 0, Equal);
  
  snprintf( chActionText, elCount(chActionText), "Set lockScheduler[3]=0 in funtion Os_Test_GetHWIO_LockReleaseScheduler "); 
  snprintf( chExpectedText, elCount(chExpectedText), "Verify lockScheduler[3]=0 funtion Os_Test_GetHWIO_LockReleaseScheduler "); 
  TestStepAddActionExpected( chActionText, chExpectedText );
  A_DBGR_VariableSet("lockScheduler[3]", "0");
  E_DBGR_VariableCheck("lockScheduler[3]", 0, Equal);
  
}

/***************************************************************************************************
----------------------------------------------------------------------------------------------------
Test case name:  TC_L30SW_QT_36651197: Verify_functionality_of_interface_LockHWIO_Scheduler_ReleaseHWIO_Scheduler_to_prohibit_task_for_CPU4_schedular_to_release_task
----------------------------------------------------------------------------------------------------
Description:  test_case_to_verify_the_functionality_of_interface_LockHWIO_Scheduler()_and_ReleaseHWIO_Scheduler_to_prohibit_the_current_task_for_CPU4_and_allow_schedular_to_release_the_task.

***************************************************************************************************/
testcase Verify_functionality_of_interface_LockHWIO_Scheduler_ReleaseHWIO_Scheduler_to_prohibit_task_for_CPU4_schedular_to_release_task()
{
  /***************************************************************************************************************/    
                                                // Variable Definition
  /***************************************************************************************************************/ 
  
  long taskvalue;
  
  /***************************************************************************************************************/    
                                               // Local Values
  /***************************************************************************************************************/ 
  

  
  /***************************************************************************************************************/    
                                              // Test Case Info
  /***************************************************************************************************************/
  setWriteDbgLevel(DebugOff);
  snprintf( chTestTitle, elCount(chTestTitle), "test_case_to_verify_the_functionality_of_interface_DsblHWIO_Interrupt_to_prohibits_all_interrupts_from_pre_empting_the_core4_task_and_interrupt__for_CPU4" );
  snprintf( chTestDescription, elCount(chTestDescription), "Purpose: test_case_to_verify_the_functionality_of_interface_DsblHWIO_Interrupt_to_prohibits_all_interrupts_from_pre_empting_the_core3_task_and_interrupt__for_CPU4.");
  TestCaseAddInfo( chTestTitle, "TC_L30SW_QT_36651197", chTestDescription );

  /***************************************************************************************************************/    
                                              // Start of Test Case
  /***************************************************************************************************************/
  
  /***************************************************************************************************************/    
                                              // Test Step 1 PRECONDITIONS
  /***************************************************************************************************************/
  
  snprintf( chActionText, elCount(chActionText), "Flash the Software and ECU is running"); 
  snprintf( chExpectedText, elCount(chExpectedText), "ECU should be in running state"); 
  TestStepAddActionExpected( chActionText, chExpectedText );

  A_DBGR_BreakpointDeleteAll();
  A_DBGR_RnGo();
  E_DBGR_CheckState(T32_State_Running);
  

   /***************************************************************************************************************/    
            // Test Step 2: Check all cores are in running state                                   
  /***************************************************************************************************************/
  
  //Check Core0 is running
  snprintf( chActionText, elCount(chActionText), "Check 1000ms Task Counter from Core0 "); 
  snprintf( chExpectedText, elCount(chExpectedText), "1000ms Counter from Core0 is incrementing"); 
  TestStepAddActionExpected( chActionText, chExpectedText );
  A_DBGR_VariableRead( "Task_Core0_1000ms_Count", taskvalue);
  E_DBGR_VariableCheck("Task_Core0_1000ms_Count", taskvalue, Greater);
  
  //Check Core1 is running
  snprintf( chActionText, elCount(chActionText), "Check 1000ms Task Counter from Core1 "); 
  snprintf( chExpectedText, elCount(chExpectedText), "1000ms Counter from Core1 is incrementing"); 
  TestStepAddActionExpected( chActionText, chExpectedText );
  A_DBGR_VariableRead( "Task_Core1_1000ms_Count", taskvalue);
  E_DBGR_VariableCheck("Task_Core1_1000ms_Count", taskvalue, Greater);
  
  //Check Core2 is running
  snprintf( chActionText, elCount(chActionText), "Check 1000ms Task Counter from Core2 "); 
  snprintf( chExpectedText, elCount(chExpectedText), "1000ms Counter from Core2 is incrementing"); 
  TestStepAddActionExpected( chActionText, chExpectedText );
  A_DBGR_VariableRead( "Task_Core2_1000ms_Count", taskvalue);
  E_DBGR_VariableCheck("Task_Core2_1000ms_Count", taskvalue, Greater);
    
  //Check Core3 is running
  snprintf( chActionText, elCount(chActionText), "Check 1000ms Task Counter from Core3 "); 
  snprintf( chExpectedText, elCount(chExpectedText), "1000ms Counter from Core3 is incrementing"); 
  TestStepAddActionExpected( chActionText, chExpectedText );
  A_DBGR_VariableRead( "Task_Core3_1000ms_Count", taskvalue);
  E_DBGR_VariableCheck("Task_Core3_1000ms_Count", taskvalue, Greater);
    
  //Check Core4 is running
  snprintf( chActionText, elCount(chActionText), "Check 1000ms Task Counter from Core4 "); 
  snprintf( chExpectedText, elCount(chExpectedText), "1000ms Counter from Core4 is incrementing"); 
  TestStepAddActionExpected( chActionText, chExpectedText );
  A_DBGR_VariableRead( "Task_Core4_1000ms_Count", taskvalue);
  E_DBGR_VariableCheck("Task_Core4_1000ms_Count", taskvalue, Greater);
    
  //Check Core5 is running
  snprintf( chActionText, elCount(chActionText), "Check 1000ms Task Counter from Core5 "); 
  snprintf( chExpectedText, elCount(chExpectedText), "1000ms Counter from Core5 is incrementing"); 
  TestStepAddActionExpected( chActionText, chExpectedText );
  A_DBGR_VariableRead( "Task_Core5_1000ms_Count", taskvalue);
  E_DBGR_VariableCheck("Task_Core5_1000ms_Count", taskvalue, Greater);
  
  /*******************************************************************************************************************************************************/    
    // Test Step 3: Set lockReleaseSchedulerTestEnable[4]=1 to LockHWIO_Scheduler in funtion Os_Test_GetHWIO_LockReleaseScheduler
  /*******************************************************************************************************************************************************/

  snprintf( chActionText, elCount(chActionText), "Set lockReleaseSchedulerTestEnable[4]=1 in funtion Os_Test_GetHWIO_LockReleaseScheduler "); 
  snprintf( chExpectedText, elCount(chExpectedText), "Verify lockReleaseSchedulerTestEnable[4]=1 funtion Os_Test_GetHWIO_LockReleaseScheduler "); 
  TestStepAddActionExpected( chActionText, chExpectedText );
  A_DBGR_VariableSet("lockReleaseSchedulerTestEnable[4]", "1");
  E_DBGR_VariableCheck("lockReleaseSchedulerTestEnable[4]", 1, Equal);


  /***************************************************************************************************************/    
        // Test Step 4 check the task counters for  the core4 stopped.
  /***************************************************************************************************************/

  //Check All tasks of Core4 are stopped
  
  snprintf( chActionText, elCount(chActionText), "Check 1000ms Task Counter from Core4 "); 
  snprintf( chExpectedText, elCount(chExpectedText), "1000ms Counter from Core4 is stop incrementing"); 
  TestStepAddActionExpected( chActionText, chExpectedText );
  A_DBGR_VariableRead( "Task_Core4_1000ms_Count", taskvalue);
  E_DBGR_VariableCheck("Task_Core4_1000ms_Count", taskvalue, Equal);
  
   //Check Core0 is running
  snprintf( chActionText, elCount(chActionText), "Check 1000ms Task Counter from Core0 "); 
  snprintf( chExpectedText, elCount(chExpectedText), "1000ms Counter from Core0 is incrementing"); 
  TestStepAddActionExpected( chActionText, chExpectedText );
  A_DBGR_VariableRead( "Task_Core0_1000ms_Count", taskvalue);
  E_DBGR_VariableCheck("Task_Core0_1000ms_Count", taskvalue, Greater);
  
  //Check Core1 is running
  snprintf( chActionText, elCount(chActionText), "Check 1000ms Task Counter from Core1 "); 
  snprintf( chExpectedText, elCount(chExpectedText), "1000ms Counter from Core1 is incrementing"); 
  TestStepAddActionExpected( chActionText, chExpectedText );
  A_DBGR_VariableRead( "Task_Core1_1000ms_Count", taskvalue);
  E_DBGR_VariableCheck("Task_Core1_1000ms_Count", taskvalue, Greater);
    
  //Check Core2 is running
  snprintf( chActionText, elCount(chActionText), "Check 1000ms Task Counter from Core2 "); 
  snprintf( chExpectedText, elCount(chExpectedText), "1000ms Counter from Core2 is incrementing"); 
  TestStepAddActionExpected( chActionText, chExpectedText );
  A_DBGR_VariableRead( "Task_Core2_1000ms_Count", taskvalue);
  E_DBGR_VariableCheck("Task_Core2_1000ms_Count", taskvalue, Greater);
    
  //Check Core3 is running
  snprintf( chActionText, elCount(chActionText), "Check 1000ms Task Counter from Core3 "); 
  snprintf( chExpectedText, elCount(chExpectedText), "1000ms Counter from Core3 is incrementing"); 
  TestStepAddActionExpected( chActionText, chExpectedText );
  A_DBGR_VariableRead( "Task_Core3_1000ms_Count", taskvalue);
  E_DBGR_VariableCheck("Task_Core3_1000ms_Count", taskvalue, Greater);
    
  //Check Core5 is running
  snprintf( chActionText, elCount(chActionText), "Check 1000ms Task Counter from Core5 "); 
  snprintf( chExpectedText, elCount(chExpectedText), "1000ms Counter from Core5 is incrementing"); 
  TestStepAddActionExpected( chActionText, chExpectedText );
  A_DBGR_VariableRead( "Task_Core5_1000ms_Count", taskvalue);
  E_DBGR_VariableCheck("Task_Core5_1000ms_Count", taskvalue, Greater);
  
  /*******************************************************************************************************************************************************/    
    // Test Step 5: set lockScheduler[4]=1 to ReleaseHWIO_Scheduler in  funtion Os_Test_GetHWIO_LockReleaseScheduler
  /*******************************************************************************************************************************************************/
  snprintf( chActionText, elCount(chActionText), "Set lockReleaseSchedulerTestEnable[4]=1 in funtion Os_Test_GetHWIO_LockReleaseScheduler "); 
  snprintf( chExpectedText, elCount(chExpectedText), "Verify lockReleaseSchedulerTestEnable[4]=1 funtion Os_Test_GetHWIO_LockReleaseScheduler "); 
  TestStepAddActionExpected( chActionText, chExpectedText );
  A_DBGR_VariableSet("lockScheduler[4]", "1");
  E_DBGR_VariableCheck("lockScheduler[4]", 1, Equal);
  
  /***************************************************************************************************************/    
            // Test Step 6: Check all cores are in running state                                   
  /***************************************************************************************************************/
  
  //Check Core0 is running
  snprintf( chActionText, elCount(chActionText), "Check 1000ms Task Counter from Core0 "); 
  snprintf( chExpectedText, elCount(chExpectedText), "1000ms Counter from Core0 is incrementing"); 
  TestStepAddActionExpected( chActionText, chExpectedText );
  A_DBGR_VariableRead( "Task_Core0_1000ms_Count", taskvalue);
  E_DBGR_VariableCheck("Task_Core0_1000ms_Count", taskvalue, Greater);
  
  //Check Core1 is running
  snprintf( chActionText, elCount(chActionText), "Check 1000ms Task Counter from Core1 "); 
  snprintf( chExpectedText, elCount(chExpectedText), "1000ms Counter from Core1 is incrementing"); 
  TestStepAddActionExpected( chActionText, chExpectedText );
  A_DBGR_VariableRead( "Task_Core1_1000ms_Count", taskvalue);
  E_DBGR_VariableCheck("Task_Core1_1000ms_Count", taskvalue, Greater);
  
  //Check Core2 is running
  snprintf( chActionText, elCount(chActionText), "Check 1000ms Task Counter from Core2 "); 
  snprintf( chExpectedText, elCount(chExpectedText), "1000ms Counter from Core2 is incrementing"); 
  TestStepAddActionExpected( chActionText, chExpectedText );
  A_DBGR_VariableRead( "Task_Core2_1000ms_Count", taskvalue);
  E_DBGR_VariableCheck("Task_Core2_1000ms_Count", taskvalue, Greater);
    
  //Check Core3 is running
  snprintf( chActionText, elCount(chActionText), "Check 1000ms Task Counter from Core3 "); 
  snprintf( chExpectedText, elCount(chExpectedText), "1000ms Counter from Core3 is incrementing"); 
  TestStepAddActionExpected( chActionText, chExpectedText );
  A_DBGR_VariableRead( "Task_Core3_1000ms_Count", taskvalue);
  E_DBGR_VariableCheck("Task_Core3_1000ms_Count", taskvalue, Greater);
    
  //Check Core4 is running
  snprintf( chActionText, elCount(chActionText), "Check 1000ms Task Counter from Core4 "); 
  snprintf( chExpectedText, elCount(chExpectedText), "1000ms Counter from Core4 is incrementing"); 
  TestStepAddActionExpected( chActionText, chExpectedText );
  A_DBGR_VariableRead( "Task_Core4_1000ms_Count", taskvalue);
  E_DBGR_VariableCheck("Task_Core4_1000ms_Count", taskvalue, Greater);
    
  //Check Core5 is running
  snprintf( chActionText, elCount(chActionText), "Check 1000ms Task Counter from Core5 "); 
  snprintf( chExpectedText, elCount(chExpectedText), "1000ms Counter from Core5 is incrementing"); 
  TestStepAddActionExpected( chActionText, chExpectedText );
  A_DBGR_VariableRead( "Task_Core5_1000ms_Count", taskvalue);
  E_DBGR_VariableCheck("Task_Core5_1000ms_Count", taskvalue, Greater);
  
  
  snprintf( chActionText, elCount(chActionText), "Set lockReleaseSchedulerTestEnable[4]=0 in funtion Os_Test_GetHWIO_LockReleaseScheduler "); 
  snprintf( chExpectedText, elCount(chExpectedText), "Verify lockReleaseSchedulerTestEnable[4]=0 funtion Os_Test_GetHWIO_LockReleaseScheduler "); 
  TestStepAddActionExpected( chActionText, chExpectedText );
  A_DBGR_VariableSet("lockReleaseSchedulerTestEnable[4]", "0");
  E_DBGR_VariableCheck("lockReleaseSchedulerTestEnable[4]", 0, Equal);
  
  snprintf( chActionText, elCount(chActionText), "Set lockScheduler[4]=0 in funtion Os_Test_GetHWIO_LockReleaseScheduler "); 
  snprintf( chExpectedText, elCount(chExpectedText), "Verify lockScheduler[4]=0 funtion Os_Test_GetHWIO_LockReleaseScheduler "); 
  TestStepAddActionExpected( chActionText, chExpectedText );
  A_DBGR_VariableSet("lockScheduler[4]", "0");
  E_DBGR_VariableCheck("lockScheduler[4]", 0, Equal);
  
}

/***************************************************************************************************
----------------------------------------------------------------------------------------------------
Test case name:  TC_L30SW_QT_36651197: Verify_functionality_of_interface_LockHWIO_Scheduler_ReleaseHWIO_Scheduler_to_prohibit_task_for_CPU5_schedular_to_release_task
----------------------------------------------------------------------------------------------------
Description:  test_case_to_verify_the_functionality_of_interface_LockHWIO_Scheduler()_and_ReleaseHWIO_Scheduler_to_prohibit_the_current_task_for_CPU5_and_allow_schedular_to_release_the_task.

***************************************************************************************************/
testcase Verify_functionality_of_interface_LockHWIO_Scheduler_ReleaseHWIO_Scheduler_to_prohibit_task_for_CPU5_schedular_to_release_task()
{
  /***************************************************************************************************************/    
                                                // Variable Definition
  /***************************************************************************************************************/ 
  
  long taskvalue;
  
  /***************************************************************************************************************/    
                                               // Local Values
  /***************************************************************************************************************/ 
  

  
  /***************************************************************************************************************/    
                                              // Test Case Info
  /***************************************************************************************************************/
  setWriteDbgLevel(DebugOff);
  snprintf( chTestTitle, elCount(chTestTitle), "test_case_to_verify_the_functionality_of_interface_DsblHWIO_Interrupt_to_prohibits_all_interrupts_from_pre_empting_the_core4_task_and_interrupt__for_CPU5" );
  snprintf( chTestDescription, elCount(chTestDescription), "Purpose: test_case_to_verify_the_functionality_of_interface_DsblHWIO_Interrupt_to_prohibits_all_interrupts_from_pre_empting_the_core3_task_and_interrupt__for_CPU5.");
  TestCaseAddInfo( chTestTitle, "TC_L30SW_QT_36651197", chTestDescription );

  /***************************************************************************************************************/    
                                              // Start of Test Case
  /***************************************************************************************************************/
  
  /***************************************************************************************************************/    
                                              // Test Step 1 PRECONDITIONS
  /***************************************************************************************************************/
  
  snprintf( chActionText, elCount(chActionText), "Flash the Software and ECU is running"); 
  snprintf( chExpectedText, elCount(chExpectedText), "ECU should be in running state"); 
  TestStepAddActionExpected( chActionText, chExpectedText );

  A_DBGR_BreakpointDeleteAll();
  A_DBGR_RnGo();
  E_DBGR_CheckState(T32_State_Running);
  

   /***************************************************************************************************************/    
            // Test Step 2: Check all cores are in running state                                   
  /***************************************************************************************************************/
  
  //Check Core0 is running
  snprintf( chActionText, elCount(chActionText), "Check 1000ms Task Counter from Core0 "); 
  snprintf( chExpectedText, elCount(chExpectedText), "1000ms Counter from Core0 is incrementing"); 
  TestStepAddActionExpected( chActionText, chExpectedText );
  A_DBGR_VariableRead( "Task_Core0_1000ms_Count", taskvalue);
  E_DBGR_VariableCheck("Task_Core0_1000ms_Count", taskvalue, Greater);
  
  //Check Core1 is running
  snprintf( chActionText, elCount(chActionText), "Check 1000ms Task Counter from Core1 "); 
  snprintf( chExpectedText, elCount(chExpectedText), "1000ms Counter from Core1 is incrementing"); 
  TestStepAddActionExpected( chActionText, chExpectedText );
  A_DBGR_VariableRead( "Task_Core1_1000ms_Count", taskvalue);
  E_DBGR_VariableCheck("Task_Core1_1000ms_Count", taskvalue, Greater);
  
  //Check Core2 is running
  snprintf( chActionText, elCount(chActionText), "Check 1000ms Task Counter from Core2 "); 
  snprintf( chExpectedText, elCount(chExpectedText), "1000ms Counter from Core2 is incrementing"); 
  TestStepAddActionExpected( chActionText, chExpectedText );
  A_DBGR_VariableRead( "Task_Core2_1000ms_Count", taskvalue);
  E_DBGR_VariableCheck("Task_Core2_1000ms_Count", taskvalue, Greater);
    
  //Check Core3 is running
  snprintf( chActionText, elCount(chActionText), "Check 1000ms Task Counter from Core3 "); 
  snprintf( chExpectedText, elCount(chExpectedText), "1000ms Counter from Core3 is incrementing"); 
  TestStepAddActionExpected( chActionText, chExpectedText );
  A_DBGR_VariableRead( "Task_Core3_1000ms_Count", taskvalue);
  E_DBGR_VariableCheck("Task_Core3_1000ms_Count", taskvalue, Greater);
    
  //Check Core4 is running
  snprintf( chActionText, elCount(chActionText), "Check 1000ms Task Counter from Core4 "); 
  snprintf( chExpectedText, elCount(chExpectedText), "1000ms Counter from Core4 is incrementing"); 
  TestStepAddActionExpected( chActionText, chExpectedText );
  A_DBGR_VariableRead( "Task_Core4_1000ms_Count", taskvalue);
  E_DBGR_VariableCheck("Task_Core4_1000ms_Count", taskvalue, Greater);
    
  //Check Core5 is running
  snprintf( chActionText, elCount(chActionText), "Check 1000ms Task Counter from Core5 "); 
  snprintf( chExpectedText, elCount(chExpectedText), "1000ms Counter from Core5 is incrementing"); 
  TestStepAddActionExpected( chActionText, chExpectedText );
  A_DBGR_VariableRead( "Task_Core5_1000ms_Count", taskvalue);
  E_DBGR_VariableCheck("Task_Core5_1000ms_Count", taskvalue, Greater);
  
  /*******************************************************************************************************************************************************/    
    // Test Step 3: Set lockReleaseSchedulerTestEnable[5]=1 to LockHWIO_Scheduler in funtion Os_Test_GetHWIO_LockReleaseScheduler
  /*******************************************************************************************************************************************************/

  snprintf( chActionText, elCount(chActionText), "Set lockReleaseSchedulerTestEnable[5]=1 in funtion Os_Test_GetHWIO_LockReleaseScheduler "); 
  snprintf( chExpectedText, elCount(chExpectedText), "Verify lockReleaseSchedulerTestEnable[5]=1 funtion Os_Test_GetHWIO_LockReleaseScheduler "); 
  TestStepAddActionExpected( chActionText, chExpectedText );
  A_DBGR_VariableSet("lockReleaseSchedulerTestEnable[5]", "1");
  E_DBGR_VariableCheck("lockReleaseSchedulerTestEnable[5]", 1, Equal);


  /***************************************************************************************************************/    
        // Test Step 4 check the task counters for  the core5 stopped.
  /***************************************************************************************************************/

  //Check All tasks of Core5 are stopped
  snprintf( chActionText, elCount(chActionText), "Check 1000ms Task Counter from Core5 "); 
  snprintf( chExpectedText, elCount(chExpectedText), "1000ms Counter from Core5 is incrementing"); 
  TestStepAddActionExpected( chActionText, chExpectedText );
  A_DBGR_VariableRead( "Task_Core5_1000ms_Count", taskvalue);
  E_DBGR_VariableCheck("Task_Core5_1000ms_Count", taskvalue, Equal);

  
   //Check Core0 is running
  snprintf( chActionText, elCount(chActionText), "Check 1000ms Task Counter from Core0 "); 
  snprintf( chExpectedText, elCount(chExpectedText), "1000ms Counter from Core0 is incrementing"); 
  TestStepAddActionExpected( chActionText, chExpectedText );
  A_DBGR_VariableRead( "Task_Core0_1000ms_Count", taskvalue);
  E_DBGR_VariableCheck("Task_Core0_1000ms_Count", taskvalue, Greater);
  
  //Check Core1 is running
  snprintf( chActionText, elCount(chActionText), "Check 1000ms Task Counter from Core1 "); 
  snprintf( chExpectedText, elCount(chExpectedText), "1000ms Counter from Core1 is incrementing"); 
  TestStepAddActionExpected( chActionText, chExpectedText );
  A_DBGR_VariableRead( "Task_Core1_1000ms_Count", taskvalue);
  E_DBGR_VariableCheck("Task_Core1_1000ms_Count", taskvalue, Greater);
    
  //Check Core2 is running
  snprintf( chActionText, elCount(chActionText), "Check 1000ms Task Counter from Core2 "); 
  snprintf( chExpectedText, elCount(chExpectedText), "1000ms Counter from Core2 is incrementing"); 
  TestStepAddActionExpected( chActionText, chExpectedText );
  A_DBGR_VariableRead( "Task_Core2_1000ms_Count", taskvalue);
  E_DBGR_VariableCheck("Task_Core2_1000ms_Count", taskvalue, Greater);
    
  //Check Core3 is running
  snprintf( chActionText, elCount(chActionText), "Check 1000ms Task Counter from Core3 "); 
  snprintf( chExpectedText, elCount(chExpectedText), "1000ms Counter from Core3 is incrementing"); 
  TestStepAddActionExpected( chActionText, chExpectedText );
  A_DBGR_VariableRead( "Task_Core3_1000ms_Count", taskvalue);
  E_DBGR_VariableCheck("Task_Core3_1000ms_Count", taskvalue, Greater);
    
  //Check Core4 is running
  snprintf( chActionText, elCount(chActionText), "Check 1000ms Task Counter from Core4 "); 
  snprintf( chExpectedText, elCount(chExpectedText), "1000ms Counter from Core4 is stop incrementing"); 
  TestStepAddActionExpected( chActionText, chExpectedText );
  A_DBGR_VariableRead( "Task_Core4_1000ms_Count", taskvalue);
  E_DBGR_VariableCheck("Task_Core4_1000ms_Count", taskvalue, Greater);
  
  /*******************************************************************************************************************************************************/    
    // Test Step 5: set lockScheduler[4]=1 to ReleaseHWIO_Scheduler in  funtion Os_Test_GetHWIO_LockReleaseScheduler
  /*******************************************************************************************************************************************************/
  snprintf( chActionText, elCount(chActionText), "Set lockReleaseSchedulerTestEnable[5]=1 in funtion Os_Test_GetHWIO_LockReleaseScheduler "); 
  snprintf( chExpectedText, elCount(chExpectedText), "Verify lockReleaseSchedulerTestEnable[5]=1 funtion Os_Test_GetHWIO_LockReleaseScheduler "); 
  TestStepAddActionExpected( chActionText, chExpectedText );
  A_DBGR_VariableSet("lockScheduler[5]", "1");
  E_DBGR_VariableCheck("lockScheduler[5]", 1, Equal);
  
  /***************************************************************************************************************/    
            // Test Step 6: Check all cores are in running state                                   
  /***************************************************************************************************************/
  
  //Check Core0 is running
  snprintf( chActionText, elCount(chActionText), "Check 1000ms Task Counter from Core0 "); 
  snprintf( chExpectedText, elCount(chExpectedText), "1000ms Counter from Core0 is incrementing"); 
  TestStepAddActionExpected( chActionText, chExpectedText );
  A_DBGR_VariableRead( "Task_Core0_1000ms_Count", taskvalue);
  E_DBGR_VariableCheck("Task_Core0_1000ms_Count", taskvalue, Greater);
  
  //Check Core1 is running
  snprintf( chActionText, elCount(chActionText), "Check 1000ms Task Counter from Core1 "); 
  snprintf( chExpectedText, elCount(chExpectedText), "1000ms Counter from Core1 is incrementing"); 
  TestStepAddActionExpected( chActionText, chExpectedText );
  A_DBGR_VariableRead( "Task_Core1_1000ms_Count", taskvalue);
  E_DBGR_VariableCheck("Task_Core1_1000ms_Count", taskvalue, Greater);
  
  //Check Core2 is running
  snprintf( chActionText, elCount(chActionText), "Check 1000ms Task Counter from Core2 "); 
  snprintf( chExpectedText, elCount(chExpectedText), "1000ms Counter from Core2 is incrementing"); 
  TestStepAddActionExpected( chActionText, chExpectedText );
  A_DBGR_VariableRead( "Task_Core2_1000ms_Count", taskvalue);
  E_DBGR_VariableCheck("Task_Core2_1000ms_Count", taskvalue, Greater);
    
  //Check Core3 is running
  snprintf( chActionText, elCount(chActionText), "Check 1000ms Task Counter from Core3 "); 
  snprintf( chExpectedText, elCount(chExpectedText), "1000ms Counter from Core3 is incrementing"); 
  TestStepAddActionExpected( chActionText, chExpectedText );
  A_DBGR_VariableRead( "Task_Core3_1000ms_Count", taskvalue);
  E_DBGR_VariableCheck("Task_Core3_1000ms_Count", taskvalue, Greater);
    
  //Check Core4 is running
  snprintf( chActionText, elCount(chActionText), "Check 1000ms Task Counter from Core4 "); 
  snprintf( chExpectedText, elCount(chExpectedText), "1000ms Counter from Core4 is incrementing"); 
  TestStepAddActionExpected( chActionText, chExpectedText );
  A_DBGR_VariableRead( "Task_Core4_1000ms_Count", taskvalue);
  E_DBGR_VariableCheck("Task_Core4_1000ms_Count", taskvalue, Greater);
    
  //Check Core5 is running
  snprintf( chActionText, elCount(chActionText), "Check 1000ms Task Counter from Core5 "); 
  snprintf( chExpectedText, elCount(chExpectedText), "1000ms Counter from Core5 is incrementing"); 
  TestStepAddActionExpected( chActionText, chExpectedText );
  A_DBGR_VariableRead( "Task_Core5_1000ms_Count", taskvalue);
  E_DBGR_VariableCheck("Task_Core5_1000ms_Count", taskvalue, Greater);
  
  
  snprintf( chActionText, elCount(chActionText), "Set lockReleaseSchedulerTestEnable[5]=0 in funtion Os_Test_GetHWIO_LockReleaseScheduler "); 
  snprintf( chExpectedText, elCount(chExpectedText), "Verify lockReleaseSchedulerTestEnable[5]=0 funtion Os_Test_GetHWIO_LockReleaseScheduler "); 
  TestStepAddActionExpected( chActionText, chExpectedText );
  A_DBGR_VariableSet("lockReleaseSchedulerTestEnable[5]", "0");
  E_DBGR_VariableCheck("lockReleaseSchedulerTestEnable[5]", 0, Equal);
  
  snprintf( chActionText, elCount(chActionText), "Set lockScheduler[5]=0 in funtion Os_Test_GetHWIO_LockReleaseScheduler "); 
  snprintf( chExpectedText, elCount(chExpectedText), "Verify lockScheduler[5]=0 funtion Os_Test_GetHWIO_LockReleaseScheduler "); 
  TestStepAddActionExpected( chActionText, chExpectedText );
  A_DBGR_VariableSet("lockScheduler[5]", "0");
  E_DBGR_VariableCheck("lockScheduler[5]", 0, Equal);
  
}


/***************************************************************************************************
----------------------------------------------------------------------------------------------------
Test case name:  TC_L30SW_QT_36651207: verify_the_functionality_of_interface_to_check_lock_unlock_status_for_all_31_Semaphore_IDS_for_CPU0
----------------------------------------------------------------------------------------------------
Description:  Test_case_to_verify_the_functionality_of_interface_to_check_lock_unlock_status_for_all_31_Semaphore_IDS_for_CPU0

***************************************************************************************************/

testcase verify_the_functionality_of_interface_to_check_lock_unlock_status_for_all_31_Semaphore_IDS_for_CPU0()
{
  /***************************************************************************************************************/    
                                                // Variable Definition
  /***************************************************************************************************************/ 
  
  long taskvalue;
  
  /***************************************************************************************************************/    
                                               // Local Values
  /***************************************************************************************************************/ 
  

  
  /***************************************************************************************************************/    
                                              // Test Case Info
  /***************************************************************************************************************/
  setWriteDbgLevel(DebugOff);
  snprintf( chTestTitle, elCount(chTestTitle), "Test_case_to_verify_the_functionality_of_interface_to_check_lock_unlock_status_for_all_31_Semaphore_IDS_for_CPU0" );
  snprintf( chTestDescription, elCount(chTestDescription), "Purpose:Test_case_to_verify_the_functionality_of_interface_to_check_lock_unlock_status_for_all_31_Semaphore_IDS_for_CPU0.");
  TestCaseAddInfo( chTestTitle, "TC_L30SW_QT_36651207", chTestDescription );

  /***************************************************************************************************************/    
                                              // Start of Test Case
  /***************************************************************************************************************/
  
  /***************************************************************************************************************/    
                                              // Test Step 1 PRECONDITIONS
  /***************************************************************************************************************/
  
  snprintf( chActionText, elCount(chActionText), "Flash the Software and ECU is running"); 
  snprintf( chExpectedText, elCount(chExpectedText), "ECU should be in running state"); 
  TestStepAddActionExpected( chActionText, chExpectedText );

  A_DBGR_BreakpointDeleteAll();
  A_DBGR_RnGo();
  E_DBGR_CheckState(T32_State_Running);
  

   /***************************************************************************************************************/    
            // Test Step 2: Check all cores are in running state                                   
  /***************************************************************************************************************/
  
  //Check Core0 is running
  snprintf( chActionText, elCount(chActionText), "Check 1000ms Task Counter from Core0 "); 
  snprintf( chExpectedText, elCount(chExpectedText), "1000ms Counter from Core0 is incrementing"); 
  TestStepAddActionExpected( chActionText, chExpectedText );
  A_DBGR_VariableRead( "Task_Core0_1000ms_Count", taskvalue);
  E_DBGR_VariableCheck("Task_Core0_1000ms_Count", taskvalue, Greater);
  
  //Check Core1 is running
  snprintf( chActionText, elCount(chActionText), "Check 1000ms Task Counter from Core1 "); 
  snprintf( chExpectedText, elCount(chExpectedText), "1000ms Counter from Core1 is incrementing"); 
  TestStepAddActionExpected( chActionText, chExpectedText );
  A_DBGR_VariableRead( "Task_Core1_1000ms_Count", taskvalue);
  E_DBGR_VariableCheck("Task_Core1_1000ms_Count", taskvalue, Greater);
  
  //Check Core2 is running
  snprintf( chActionText, elCount(chActionText), "Check 1000ms Task Counter from Core2 "); 
  snprintf( chExpectedText, elCount(chExpectedText), "1000ms Counter from Core2 is incrementing"); 
  TestStepAddActionExpected( chActionText, chExpectedText );
  A_DBGR_VariableRead( "Task_Core2_1000ms_Count", taskvalue);
  E_DBGR_VariableCheck("Task_Core2_1000ms_Count", taskvalue, Greater);
    
  //Check Core3 is running
  snprintf( chActionText, elCount(chActionText), "Check 1000ms Task Counter from Core3 "); 
  snprintf( chExpectedText, elCount(chExpectedText), "1000ms Counter from Core3 is incrementing"); 
  TestStepAddActionExpected( chActionText, chExpectedText );
  A_DBGR_VariableRead( "Task_Core3_1000ms_Count", taskvalue);
  E_DBGR_VariableCheck("Task_Core3_1000ms_Count", taskvalue, Greater);
    
  //Check Core4 is running
  snprintf( chActionText, elCount(chActionText), "Check 1000ms Task Counter from Core4 "); 
  snprintf( chExpectedText, elCount(chExpectedText), "1000ms Counter from Core4 is incrementing"); 
  TestStepAddActionExpected( chActionText, chExpectedText );
  A_DBGR_VariableRead( "Task_Core4_1000ms_Count", taskvalue);
  E_DBGR_VariableCheck("Task_Core4_1000ms_Count", taskvalue, Greater);
    
  //Check Core5 is running
  snprintf( chActionText, elCount(chActionText), "Check 1000ms Task Counter from Core5 "); 
  snprintf( chExpectedText, elCount(chExpectedText), "1000ms Counter from Core5 is incrementing"); 
  TestStepAddActionExpected( chActionText, chExpectedText );
  A_DBGR_VariableRead( "Task_Core5_1000ms_Count", taskvalue);
  E_DBGR_VariableCheck("Task_Core5_1000ms_Count", taskvalue, Greater);
  
  /*******************************************************************************************************************************************************/    
    // Test Step 3: Set flag lock_unlock_status_flag_core0=1 to check semaphore lock for core0 in function TestApp_Core0_1000ms_MainFunction
  /*******************************************************************************************************************************************************/

  snprintf( chActionText, elCount(chActionText), "Set flag lock_unlock_status_flag_core0=1 to check semaphore lock for core0 in function TestApp_Core0_1000ms_MainFunction "); 
  snprintf( chExpectedText, elCount(chExpectedText), "Verify flag lock_unlock_status_flag_core0=1 to check semaphore lock for core0 in function TestApp_Core0_1000ms_MainFunction "); 
  TestStepAddActionExpected( chActionText, chExpectedText );
  A_DBGR_RnGo();
  A_DBGR_VariableSet("lock_unlock_status_flag_core0", "1");
  E_DBGR_VariableCheck("lock_unlock_status_flag_core0", 1, Equal);


  
  
  
  
  /*******************************************************************************************************************************************************/    
    // Test Step 4: check var Smsts_lock[semaphore]=1 for 32 index in function Os_Test_GetHWIO_e_LockSemaphore_test() in test_os_hwio.c file
  /*******************************************************************************************************************************************************/
  snprintf( chActionText, elCount(chActionText), "check var Smsts_lock[0]=1  in function Os_Test_GetHWIO_e_LockSemaphore_test() in test_os_hwio.c file "); 
  snprintf( chExpectedText, elCount(chExpectedText), "Verify var Smsts_lock[0]=1  in function Os_Test_GetHWIO_e_LockSemaphore_test() in test_os_hwio.c file "); 
  TestStepAddActionExpected( chActionText, chExpectedText );
  E_DBGR_VariableCheck("Smsts_lock[0]", 1, Equal);
  
  snprintf( chActionText, elCount(chActionText), "check var Smsts_lock[1]=1  in function Os_Test_GetHWIO_e_LockSemaphore_test() in test_os_hwio.c file "); 
  snprintf( chExpectedText, elCount(chExpectedText), "Verify var Smsts_lock[1]=1  in function Os_Test_GetHWIO_e_LockSemaphore_test() in test_os_hwio.c file "); 
  TestStepAddActionExpected( chActionText, chExpectedText );
  E_DBGR_VariableCheck("Smsts_lock[1]", 1, Equal);
  
  snprintf( chActionText, elCount(chActionText), "check var Smsts_lock[2]=1  in function Os_Test_GetHWIO_e_LockSemaphore_test() in test_os_hwio.c file "); 
  snprintf( chExpectedText, elCount(chExpectedText), "Verify var Smsts_lock[2]=1  in function Os_Test_GetHWIO_e_LockSemaphore_test() in test_os_hwio.c file "); 
  TestStepAddActionExpected( chActionText, chExpectedText );
  E_DBGR_VariableCheck("Smsts_lock[2]", 1, Equal);
  
  snprintf( chActionText, elCount(chActionText), "check var Smsts_lock[3]=1  in function Os_Test_GetHWIO_e_LockSemaphore_test() in test_os_hwio.c file "); 
  snprintf( chExpectedText, elCount(chExpectedText), "Verify var Smsts_lock[3]=1  in function Os_Test_GetHWIO_e_LockSemaphore_test() in test_os_hwio.c file "); 
  TestStepAddActionExpected( chActionText, chExpectedText );
  E_DBGR_VariableCheck("Smsts_lock[3]", 1, Equal);
  
  snprintf( chActionText, elCount(chActionText), "check var Smsts_lock[4]=1  in function Os_Test_GetHWIO_e_LockSemaphore_test() in test_os_hwio.c file "); 
  snprintf( chExpectedText, elCount(chExpectedText), "Verify var Smsts_lock[4]=1  in function Os_Test_GetHWIO_e_LockSemaphore_test() in test_os_hwio.c file "); 
  TestStepAddActionExpected( chActionText, chExpectedText );
  E_DBGR_VariableCheck("Smsts_lock[4]", 1, Equal);
  
  snprintf( chActionText, elCount(chActionText), "check var Smsts_lock[5]=1  in function Os_Test_GetHWIO_e_LockSemaphore_test() in test_os_hwio.c file "); 
  snprintf( chExpectedText, elCount(chExpectedText), "Verify var Smsts_lock[5]=1  in function Os_Test_GetHWIO_e_LockSemaphore_test() in test_os_hwio.c file "); 
  TestStepAddActionExpected( chActionText, chExpectedText );
  E_DBGR_VariableCheck("Smsts_lock[5]", 1, Equal);
  
  snprintf( chActionText, elCount(chActionText), "check var Smsts_lock[6]=1  in function Os_Test_GetHWIO_e_LockSemaphore_test() in test_os_hwio.c file "); 
  snprintf( chExpectedText, elCount(chExpectedText), "Verify var Smsts_lock[6]=1  in function Os_Test_GetHWIO_e_LockSemaphore_test() in test_os_hwio.c file "); 
  TestStepAddActionExpected( chActionText, chExpectedText );
  E_DBGR_VariableCheck("Smsts_lock[6]", 1, Equal);
  
  snprintf( chActionText, elCount(chActionText), "check var Smsts_lock[7]=1  in function Os_Test_GetHWIO_e_LockSemaphore_test() in test_os_hwio.c file "); 
  snprintf( chExpectedText, elCount(chExpectedText), "Verify var Smsts_lock[7]=1  in function Os_Test_GetHWIO_e_LockSemaphore_test() in test_os_hwio.c file "); 
  TestStepAddActionExpected( chActionText, chExpectedText );
  E_DBGR_VariableCheck("Smsts_lock[7]", 1, Equal);
  
  snprintf( chActionText, elCount(chActionText), "check var Smsts_lock[8]=1  in function Os_Test_GetHWIO_e_LockSemaphore_test() in test_os_hwio.c file "); 
  snprintf( chExpectedText, elCount(chExpectedText), "Verify var Smsts_lock[8]=1  in function Os_Test_GetHWIO_e_LockSemaphore_test() in test_os_hwio.c file "); 
  TestStepAddActionExpected( chActionText, chExpectedText );
  E_DBGR_VariableCheck("Smsts_lock[8]", 1, Equal);
  
  snprintf( chActionText, elCount(chActionText), "check var Smsts_lock[9]=1  in function Os_Test_GetHWIO_e_LockSemaphore_test() in test_os_hwio.c file "); 
  snprintf( chExpectedText, elCount(chExpectedText), "Verify var Smsts_lock[9]=1  in function Os_Test_GetHWIO_e_LockSemaphore_test() in test_os_hwio.c file "); 
  TestStepAddActionExpected( chActionText, chExpectedText );
  E_DBGR_VariableCheck("Smsts_lock[9]", 1, Equal);
  
  snprintf( chActionText, elCount(chActionText), "check var Smsts_lock[10]=1  in function Os_Test_GetHWIO_e_LockSemaphore_test() in test_os_hwio.c file "); 
  snprintf( chExpectedText, elCount(chExpectedText), "Verify var Smsts_lock[10]=1  in function Os_Test_GetHWIO_e_LockSemaphore_test() in test_os_hwio.c file "); 
  TestStepAddActionExpected( chActionText, chExpectedText );
  E_DBGR_VariableCheck("Smsts_lock[10]", 1, Equal);
  
  snprintf( chActionText, elCount(chActionText), "check var Smsts_lock[11]=1  in function Os_Test_GetHWIO_e_LockSemaphore_test() in test_os_hwio.c file "); 
  snprintf( chExpectedText, elCount(chExpectedText), "Verify var Smsts_lock[11]=1  in function Os_Test_GetHWIO_e_LockSemaphore_test() in test_os_hwio.c file "); 
  TestStepAddActionExpected( chActionText, chExpectedText );
  E_DBGR_VariableCheck("Smsts_lock[11]", 1, Equal);
  
  snprintf( chActionText, elCount(chActionText), "check var Smsts_lock[12]=1  in function Os_Test_GetHWIO_e_LockSemaphore_test() in test_os_hwio.c file "); 
  snprintf( chExpectedText, elCount(chExpectedText), "Verify var Smsts_lock[12]=1  in function Os_Test_GetHWIO_e_LockSemaphore_test() in test_os_hwio.c file "); 
  TestStepAddActionExpected( chActionText, chExpectedText );
  E_DBGR_VariableCheck("Smsts_lock[12]", 1, Equal);
  
  snprintf( chActionText, elCount(chActionText), "check var Smsts_lock[13]=1  in function Os_Test_GetHWIO_e_LockSemaphore_test() in test_os_hwio.c file "); 
  snprintf( chExpectedText, elCount(chExpectedText), "Verify var Smsts_lock[13]=1  in function Os_Test_GetHWIO_e_LockSemaphore_test() in test_os_hwio.c file "); 
  TestStepAddActionExpected( chActionText, chExpectedText );
  E_DBGR_VariableCheck("Smsts_lock[13]", 1, Equal);
  
  snprintf( chActionText, elCount(chActionText), "check var Smsts_lock[14]=1  in function Os_Test_GetHWIO_e_LockSemaphore_test() in test_os_hwio.c file "); 
  snprintf( chExpectedText, elCount(chExpectedText), "Verify var Smsts_lock[14]=1  in function Os_Test_GetHWIO_e_LockSemaphore_test() in test_os_hwio.c file "); 
  TestStepAddActionExpected( chActionText, chExpectedText );
  E_DBGR_VariableCheck("Smsts_lock[14]", 1, Equal);
  
  snprintf( chActionText, elCount(chActionText), "check var Smsts_lock[15]=1  in function Os_Test_GetHWIO_e_LockSemaphore_test() in test_os_hwio.c file "); 
  snprintf( chExpectedText, elCount(chExpectedText), "Verify var Smsts_lock[15]=1  in function Os_Test_GetHWIO_e_LockSemaphore_test() in test_os_hwio.c file "); 
  TestStepAddActionExpected( chActionText, chExpectedText );
  E_DBGR_VariableCheck("Smsts_lock[15]", 1, Equal);
  
  snprintf( chActionText, elCount(chActionText), "check var Smsts_lock[16]=1  in function Os_Test_GetHWIO_e_LockSemaphore_test() in test_os_hwio.c file "); 
  snprintf( chExpectedText, elCount(chExpectedText), "Verify var Smsts_lock[16]=1  in function Os_Test_GetHWIO_e_LockSemaphore_test() in test_os_hwio.c file "); 
  TestStepAddActionExpected( chActionText, chExpectedText );
  E_DBGR_VariableCheck("Smsts_lock[16]", 1, Equal);
  
  snprintf( chActionText, elCount(chActionText), "check var Smsts_lock[17]=1  in function Os_Test_GetHWIO_e_LockSemaphore_test() in test_os_hwio.c file "); 
  snprintf( chExpectedText, elCount(chExpectedText), "Verify var Smsts_lock[17]=1  in function Os_Test_GetHWIO_e_LockSemaphore_test() in test_os_hwio.c file "); 
  TestStepAddActionExpected( chActionText, chExpectedText );
  E_DBGR_VariableCheck("Smsts_lock[17]", 1, Equal);
  
  snprintf( chActionText, elCount(chActionText), "check var Smsts_lock[18]=1  in function Os_Test_GetHWIO_e_LockSemaphore_test() in test_os_hwio.c file "); 
  snprintf( chExpectedText, elCount(chExpectedText), "Verify var Smsts_lock[18]=1  in function Os_Test_GetHWIO_e_LockSemaphore_test() in test_os_hwio.c file "); 
  TestStepAddActionExpected( chActionText, chExpectedText );
  E_DBGR_VariableCheck("Smsts_lock[18]", 1, Equal);
  
  snprintf( chActionText, elCount(chActionText), "check var Smsts_lock[19]=1  in function Os_Test_GetHWIO_e_LockSemaphore_test() in test_os_hwio.c file "); 
  snprintf( chExpectedText, elCount(chExpectedText), "Verify var Smsts_lock[19]=1  in function Os_Test_GetHWIO_e_LockSemaphore_test() in test_os_hwio.c file "); 
  TestStepAddActionExpected( chActionText, chExpectedText );
  E_DBGR_VariableCheck("Smsts_lock[19]", 1, Equal);
  
  
  snprintf( chActionText, elCount(chActionText), "check var Smsts_lock[20]=1  in function Os_Test_GetHWIO_e_LockSemaphore_test() in test_os_hwio.c file "); 
  snprintf( chExpectedText, elCount(chExpectedText), "Verify var Smsts_lock[20]=1  in function Os_Test_GetHWIO_e_LockSemaphore_test() in test_os_hwio.c file "); 
  TestStepAddActionExpected( chActionText, chExpectedText );
  E_DBGR_VariableCheck("Smsts_lock[20]", 1, Equal);
  
  
  snprintf( chActionText, elCount(chActionText), "check var Smsts_lock[21]=1  in function Os_Test_GetHWIO_e_LockSemaphore_test() in test_os_hwio.c file "); 
  snprintf( chExpectedText, elCount(chExpectedText), "Verify var Smsts_lock[21]=1  in function Os_Test_GetHWIO_e_LockSemaphore_test() in test_os_hwio.c file "); 
  TestStepAddActionExpected( chActionText, chExpectedText );
  E_DBGR_VariableCheck("Smsts_lock[21]", 1, Equal);
  
  
  snprintf( chActionText, elCount(chActionText), "check var Smsts_lock[22]=1  in function Os_Test_GetHWIO_e_LockSemaphore_test() in test_os_hwio.c file "); 
  snprintf( chExpectedText, elCount(chExpectedText), "Verify var Smsts_lock[22]=1  in function Os_Test_GetHWIO_e_LockSemaphore_test() in test_os_hwio.c file "); 
  TestStepAddActionExpected( chActionText, chExpectedText );
  E_DBGR_VariableCheck("Smsts_lock[22]", 1, Equal);
  
  
  snprintf( chActionText, elCount(chActionText), "check var Smsts_lock[23]=1  in function Os_Test_GetHWIO_e_LockSemaphore_test() in test_os_hwio.c file "); 
  snprintf( chExpectedText, elCount(chExpectedText), "Verify var Smsts_lock[23]=1  in function Os_Test_GetHWIO_e_LockSemaphore_test() in test_os_hwio.c file "); 
  TestStepAddActionExpected( chActionText, chExpectedText );
  E_DBGR_VariableCheck("Smsts_lock[23]", 1, Equal);
  
  
  snprintf( chActionText, elCount(chActionText), "check var Smsts_lock[24]=1  in function Os_Test_GetHWIO_e_LockSemaphore_test() in test_os_hwio.c file "); 
  snprintf( chExpectedText, elCount(chExpectedText), "Verify var Smsts_lock[24]=1  in function Os_Test_GetHWIO_e_LockSemaphore_test() in test_os_hwio.c file "); 
  TestStepAddActionExpected( chActionText, chExpectedText );
  E_DBGR_VariableCheck("Smsts_lock[24]", 1, Equal);
  
  
  snprintf( chActionText, elCount(chActionText), "check var Smsts_lock[25]=1  in function Os_Test_GetHWIO_e_LockSemaphore_test() in test_os_hwio.c file "); 
  snprintf( chExpectedText, elCount(chExpectedText), "Verify var Smsts_lock[25]=1  in function Os_Test_GetHWIO_e_LockSemaphore_test() in test_os_hwio.c file "); 
  TestStepAddActionExpected( chActionText, chExpectedText );
  E_DBGR_VariableCheck("Smsts_lock[25]", 1, Equal);
  
  
  snprintf( chActionText, elCount(chActionText), "check var Smsts_lock[26]=1  in function Os_Test_GetHWIO_e_LockSemaphore_test() in test_os_hwio.c file "); 
  snprintf( chExpectedText, elCount(chExpectedText), "Verify var Smsts_lock[26]=1  in function Os_Test_GetHWIO_e_LockSemaphore_test() in test_os_hwio.c file "); 
  TestStepAddActionExpected( chActionText, chExpectedText );
  E_DBGR_VariableCheck("Smsts_lock[26]", 1, Equal);
  
  
  snprintf( chActionText, elCount(chActionText), "check var Smsts_lock[27]=1  in function Os_Test_GetHWIO_e_LockSemaphore_test() in test_os_hwio.c file "); 
  snprintf( chExpectedText, elCount(chExpectedText), "Verify var Smsts_lock[27]=1  in function Os_Test_GetHWIO_e_LockSemaphore_test() in test_os_hwio.c file "); 
  TestStepAddActionExpected( chActionText, chExpectedText );
  E_DBGR_VariableCheck("Smsts_lock[27]", 1, Equal);
  
  snprintf( chActionText, elCount(chActionText), "check var Smsts_lock[28]=1  in function Os_Test_GetHWIO_e_LockSemaphore_test() in test_os_hwio.c file "); 
  snprintf( chExpectedText, elCount(chExpectedText), "Verify var Smsts_lock[28]=1  in function Os_Test_GetHWIO_e_LockSemaphore_test() in test_os_hwio.c file "); 
  TestStepAddActionExpected( chActionText, chExpectedText );
  E_DBGR_VariableCheck("Smsts_lock[28]", 1, Equal);
  
  
  snprintf( chActionText, elCount(chActionText), "check var Smsts_lock[29]=1  in function Os_Test_GetHWIO_e_LockSemaphore_test() in test_os_hwio.c file "); 
  snprintf( chExpectedText, elCount(chExpectedText), "Verify var Smsts_lock[29]=1  in function Os_Test_GetHWIO_e_LockSemaphore_test() in test_os_hwio.c file "); 
  TestStepAddActionExpected( chActionText, chExpectedText );
  E_DBGR_VariableCheck("Smsts_lock[29]", 1, Equal);
  
  
  snprintf( chActionText, elCount(chActionText), "check var Smsts_lock[30]=1  in function Os_Test_GetHWIO_e_LockSemaphore_test() in test_os_hwio.c file "); 
  snprintf( chExpectedText, elCount(chExpectedText), "Verify var Smsts_lock[30]=1  in function Os_Test_GetHWIO_e_LockSemaphore_test() in test_os_hwio.c file "); 
  TestStepAddActionExpected( chActionText, chExpectedText );
  E_DBGR_VariableCheck("Smsts_lock[30]", 1, Equal);
  
  
  snprintf( chActionText, elCount(chActionText), "check var Smsts_lock[31]=1  in function Os_Test_GetHWIO_e_LockSemaphore_test() in test_os_hwio.c file "); 
  snprintf( chExpectedText, elCount(chExpectedText), "Verify var Smsts_lock[31]=1  in function Os_Test_GetHWIO_e_LockSemaphore_test() in test_os_hwio.c file "); 
  TestStepAddActionExpected( chActionText, chExpectedText );
  E_DBGR_VariableCheck("Smsts_lock[31]", 1, Equal);
  
  
  
  
  /*******************************************************************************************************************************************************/    
    // Test Step 5: check var Smsts_unlock[semaphore]=0 for 32 index in function Os_Test_GetHWIO_e_LockSemaphore_test() in test_os_hwio.c file
  /*******************************************************************************************************************************************************/
  snprintf( chActionText, elCount(chActionText), "check var Smsts_unlock[0]=0  in function Os_Test_GetHWIO_e_LockSemaphore_test() in test_os_hwio.c file "); 
  snprintf( chExpectedText, elCount(chExpectedText), "Verify var Smsts_unlock[0]=0  in function Os_Test_GetHWIO_e_LockSemaphore_test() in test_os_hwio.c file "); 
  TestStepAddActionExpected( chActionText, chExpectedText );
  E_DBGR_VariableCheck("Smsts_unlock[0]", 0, Equal);
  
  snprintf( chActionText, elCount(chActionText), "check var Smsts_unlock[1]=0  in function Os_Test_GetHWIO_e_LockSemaphore_test() in test_os_hwio.c file "); 
  snprintf( chExpectedText, elCount(chExpectedText), "Verify var Smsts_unlock[1]=0  in function Os_Test_GetHWIO_e_LockSemaphore_test() in test_os_hwio.c file "); 
  TestStepAddActionExpected( chActionText, chExpectedText );
  E_DBGR_VariableCheck("Smsts_unlock[1]", 0, Equal);
  
  snprintf( chActionText, elCount(chActionText), "check var Smsts_unlock[2]=0  in function Os_Test_GetHWIO_e_LockSemaphore_test() in test_os_hwio.c file "); 
  snprintf( chExpectedText, elCount(chExpectedText), "Verify var Smsts_unlock[2]=0  in function Os_Test_GetHWIO_e_LockSemaphore_test() in test_os_hwio.c file "); 
  TestStepAddActionExpected( chActionText, chExpectedText );
  E_DBGR_VariableCheck("Smsts_unlock[2]", 0, Equal);
  
  snprintf( chActionText, elCount(chActionText), "check var Smsts_unlock[3]=0  in function Os_Test_GetHWIO_e_LockSemaphore_test() in test_os_hwio.c file "); 
  snprintf( chExpectedText, elCount(chExpectedText), "Verify var Smsts_unlock[3]=0  in function Os_Test_GetHWIO_e_LockSemaphore_test() in test_os_hwio.c file "); 
  TestStepAddActionExpected( chActionText, chExpectedText );
  E_DBGR_VariableCheck("Smsts_unlock[3]", 0, Equal);
  
  snprintf( chActionText, elCount(chActionText), "check var Smsts_unlock[4]=0  in function Os_Test_GetHWIO_e_LockSemaphore_test() in test_os_hwio.c file "); 
  snprintf( chExpectedText, elCount(chExpectedText), "Verify var Smsts_unlock[4]=0  in function Os_Test_GetHWIO_e_LockSemaphore_test() in test_os_hwio.c file "); 
  TestStepAddActionExpected( chActionText, chExpectedText );
  E_DBGR_VariableCheck("Smsts_unlock[4]", 0, Equal);
  
  snprintf( chActionText, elCount(chActionText), "check var Smsts_unlock[5]=0  in function Os_Test_GetHWIO_e_LockSemaphore_test() in test_os_hwio.c file "); 
  snprintf( chExpectedText, elCount(chExpectedText), "Verify var Smsts_unlock[5]=0  in function Os_Test_GetHWIO_e_LockSemaphore_test() in test_os_hwio.c file "); 
  TestStepAddActionExpected( chActionText, chExpectedText );
  E_DBGR_VariableCheck("Smsts_unlock[5]", 0, Equal);
  
  snprintf( chActionText, elCount(chActionText), "check var Smsts_unlock[6]=0  in function Os_Test_GetHWIO_e_LockSemaphore_test() in test_os_hwio.c file "); 
  snprintf( chExpectedText, elCount(chExpectedText), "Verify var Smsts_lock[6]=0  in function Os_Test_GetHWIO_e_LockSemaphore_test() in test_os_hwio.c file "); 
  TestStepAddActionExpected( chActionText, chExpectedText );
  E_DBGR_VariableCheck("Smsts_unlock[6]", 0, Equal);
  
  snprintf( chActionText, elCount(chActionText), "check var Smsts_unlock[7]=0  in function Os_Test_GetHWIO_e_LockSemaphore_test() in test_os_hwio.c file "); 
  snprintf( chExpectedText, elCount(chExpectedText), "Verify var Smsts_unlock[7]=0Smsts_unlock  in function Os_Test_GetHWIO_e_LockSemaphore_test() in test_os_hwio.c file "); 
  TestStepAddActionExpected( chActionText, chExpectedText );
  E_DBGR_VariableCheck("Smsts_unlock[7]", 0, Equal);
  
  snprintf( chActionText, elCount(chActionText), "check var Smsts_unlock[8]=0  in function Os_Test_GetHWIO_e_LockSemaphore_test() in test_os_hwio.c file "); 
  snprintf( chExpectedText, elCount(chExpectedText), "Verify var Smsts_unlock[8]=0  in function Os_Test_GetHWIO_e_LockSemaphore_test() in test_os_hwio.c file "); 
  TestStepAddActionExpected( chActionText, chExpectedText );
  E_DBGR_VariableCheck("Smsts_unlock[8]", 0, Equal);
  
  snprintf( chActionText, elCount(chActionText), "check var Smsts_unlock[9]=0  in function Os_Test_GetHWIO_e_LockSemaphore_test() in test_os_hwio.c file "); 
  snprintf( chExpectedText, elCount(chExpectedText), "Verify var Smsts_unlock[9]=0  in function Os_Test_GetHWIO_e_LockSemaphore_test() in test_os_hwio.c file "); 
  TestStepAddActionExpected( chActionText, chExpectedText );
  E_DBGR_VariableCheck("Smsts_unlock[9]", 0, Equal);
  
  snprintf( chActionText, elCount(chActionText), "check var Smsts_unlock[10]=0  in function Os_Test_GetHWIO_e_LockSemaphore_test() in test_os_hwio.c file "); 
  snprintf( chExpectedText, elCount(chExpectedText), "Verify var Smsts_unlock[10]=0  in function Os_Test_GetHWIO_e_LockSemaphore_test() in test_os_hwio.c file "); 
  TestStepAddActionExpected( chActionText, chExpectedText );
  E_DBGR_VariableCheck("Smsts_unlock[10]", 0, Equal);
  
  snprintf( chActionText, elCount(chActionText), "check var Smsts_unlock[11]=0  in function Os_Test_GetHWIO_e_LockSemaphore_test() in test_os_hwio.c file "); 
  snprintf( chExpectedText, elCount(chExpectedText), "Verify var Smsts_unlock[11]=0  in function Os_Test_GetHWIO_e_LockSemaphore_test() in test_os_hwio.c file "); 
  TestStepAddActionExpected( chActionText, chExpectedText );
  E_DBGR_VariableCheck("Smsts_unlock[11]", 0, Equal);
  
  snprintf( chActionText, elCount(chActionText), "check var Smsts_unlock[12]=0  in function Os_Test_GetHWIO_e_LockSemaphore_test() in test_os_hwio.c file "); 
  snprintf( chExpectedText, elCount(chExpectedText), "Verify var Smsts_unlock[12]=0  in function Os_Test_GetHWIO_e_LockSemaphore_test() in test_os_hwio.c file "); 
  TestStepAddActionExpected( chActionText, chExpectedText );
  E_DBGR_VariableCheck("Smsts_unlock[12]", 0, Equal);
  
  snprintf( chActionText, elCount(chActionText), "check var Smsts_unlock[13]=0  in function Os_Test_GetHWIO_e_LockSemaphore_test() in test_os_hwio.c file "); 
  snprintf( chExpectedText, elCount(chExpectedText), "Verify var Smsts_unlock[13]=0  in function Os_Test_GetHWIO_e_LockSemaphore_test() in test_os_hwio.c file "); 
  TestStepAddActionExpected( chActionText, chExpectedText );
  E_DBGR_VariableCheck("Smsts_unlock[13]", 0, Equal);
  
  snprintf( chActionText, elCount(chActionText), "check var Smsts_unlock[14]=0  in function Os_Test_GetHWIO_e_LockSemaphore_test() in test_os_hwio.c file "); 
  snprintf( chExpectedText, elCount(chExpectedText), "Verify var Smsts_unlock[14]=0  in function Os_Test_GetHWIO_e_LockSemaphore_test() in test_os_hwio.c file "); 
  TestStepAddActionExpected( chActionText, chExpectedText );
  E_DBGR_VariableCheck("Smsts_unlock[14]", 0, Equal);
  
  snprintf( chActionText, elCount(chActionText), "check var Smsts_unlock[15]=0  in function Os_Test_GetHWIO_e_LockSemaphore_test() in test_os_hwio.c file "); 
  snprintf( chExpectedText, elCount(chExpectedText), "Verify var Smsts_unlock[15]=0  in function Os_Test_GetHWIO_e_LockSemaphore_test() in test_os_hwio.c file "); 
  TestStepAddActionExpected( chActionText, chExpectedText );
  E_DBGR_VariableCheck("Smsts_unlock[15]", 0, Equal);
  
  snprintf( chActionText, elCount(chActionText), "check var Smsts_unlock[16]=0  in function Os_Test_GetHWIO_e_LockSemaphore_test() in test_os_hwio.c file "); 
  snprintf( chExpectedText, elCount(chExpectedText), "Verify var Smsts_unlock[16]=0  in function Os_Test_GetHWIO_e_LockSemaphore_test() in test_os_hwio.c file "); 
  TestStepAddActionExpected( chActionText, chExpectedText );
  E_DBGR_VariableCheck("Smsts_unlock[16]", 0, Equal);
  
  snprintf( chActionText, elCount(chActionText), "check var Smsts_unlock[17]=0  in function Os_Test_GetHWIO_e_LockSemaphore_test() in test_os_hwio.c file "); 
  snprintf( chExpectedText, elCount(chExpectedText), "Verify var Smsts_unlock[17]=0  in function Os_Test_GetHWIO_e_LockSemaphore_test() in test_os_hwio.c file "); 
  TestStepAddActionExpected( chActionText, chExpectedText );
  E_DBGR_VariableCheck("Smsts_unlock[17]", 0, Equal);
  
  snprintf( chActionText, elCount(chActionText), "check var Smsts_unlock[18]=0  in function Os_Test_GetHWIO_e_LockSemaphore_test() in test_os_hwio.c file "); 
  snprintf( chExpectedText, elCount(chExpectedText), "Verify var Smsts_unlock[18]=0  in function Os_Test_GetHWIO_e_LockSemaphore_test() in test_os_hwio.c file "); 
  TestStepAddActionExpected( chActionText, chExpectedText );
  E_DBGR_VariableCheck("Smsts_unlock[18]", 0, Equal);
  
  snprintf( chActionText, elCount(chActionText), "check var Smsts_unlock[19]=0  in function Os_Test_GetHWIO_e_LockSemaphore_test() in test_os_hwio.c file "); 
  snprintf( chExpectedText, elCount(chExpectedText), "Verify var Smsts_unlock[19]=0  in function Os_Test_GetHWIO_e_LockSemaphore_test() in test_os_hwio.c file "); 
  TestStepAddActionExpected( chActionText, chExpectedText );
  E_DBGR_VariableCheck("Smsts_unlock[19]", 0, Equal);
  
  
  snprintf( chActionText, elCount(chActionText), "check var Smsts_unlock[20]=0  in function Os_Test_GetHWIO_e_LockSemaphore_test() in test_os_hwio.c file "); 
  snprintf( chExpectedText, elCount(chExpectedText), "Verify var Smsts_unlock[20]=0  in function Os_Test_GetHWIO_e_LockSemaphore_test() in test_os_hwio.c file "); 
  TestStepAddActionExpected( chActionText, chExpectedText );
  E_DBGR_VariableCheck("Smsts_unlock[20]", 0, Equal);
  
  
  snprintf( chActionText, elCount(chActionText), "check var Smsts_unlock[21]=0  in function Os_Test_GetHWIO_e_LockSemaphore_test() in test_os_hwio.c file "); 
  snprintf( chExpectedText, elCount(chExpectedText), "Verify var Smsts_unlock[21]=0  in function Os_Test_GetHWIO_e_LockSemaphore_test() in test_os_hwio.c file "); 
  TestStepAddActionExpected( chActionText, chExpectedText );
  E_DBGR_VariableCheck("Smsts_unlock[21]", 0, Equal);
  
  
  snprintf( chActionText, elCount(chActionText), "check var Smsts_unlock[22]=0  in function Os_Test_GetHWIO_e_LockSemaphore_test() in test_os_hwio.c file "); 
  snprintf( chExpectedText, elCount(chExpectedText), "Verify var Smsts_unlock[22]=0  in function Os_Test_GetHWIO_e_LockSemaphore_test() in test_os_hwio.c file "); 
  TestStepAddActionExpected( chActionText, chExpectedText );
  E_DBGR_VariableCheck("Smsts_unlock[22]", 0, Equal);
  
  
  snprintf( chActionText, elCount(chActionText), "check var Smsts_unlock[23]=0  in function Os_Test_GetHWIO_e_LockSemaphore_test() in test_os_hwio.c file "); 
  snprintf( chExpectedText, elCount(chExpectedText), "Verify var Smsts_unlock[23]=0  in function Os_Test_GetHWIO_e_LockSemaphore_test() in test_os_hwio.c file "); 
  TestStepAddActionExpected( chActionText, chExpectedText );
  E_DBGR_VariableCheck("Smsts_unlock[23]", 0, Equal);
  
  
  snprintf( chActionText, elCount(chActionText), "check var Smsts_unlock[24]=0  in function Os_Test_GetHWIO_e_LockSemaphore_test() in test_os_hwio.c file "); 
  snprintf( chExpectedText, elCount(chExpectedText), "Verify var Smsts_unlock[24]=0  in function Os_Test_GetHWIO_e_LockSemaphore_test() in test_os_hwio.c file "); 
  TestStepAddActionExpected( chActionText, chExpectedText );
  E_DBGR_VariableCheck("Smsts_unlock[24]", 0, Equal);
  
  
  snprintf( chActionText, elCount(chActionText), "check var Smsts_unlock[25]=0  in function Os_Test_GetHWIO_e_LockSemaphore_test() in test_os_hwio.c file "); 
  snprintf( chExpectedText, elCount(chExpectedText), "Verify var Smsts_unloc[25]=1 0 in function Os_Test_GetHWIO_e_LockSemaphore_test() in test_os_hwio.c file "); 
  TestStepAddActionExpected( chActionText, chExpectedText );
  E_DBGR_VariableCheck("Smsts_unlock[25]", 0, Equal);
  
  
  snprintf( chActionText, elCount(chActionText), "check var Smsts_unlock[26]=0  in function Os_Test_GetHWIO_e_LockSemaphore_test() in test_os_hwio.c file "); 
  snprintf( chExpectedText, elCount(chExpectedText), "Verify var Smsts_unlock[26]=0  in function Os_Test_GetHWIO_e_LockSemaphore_test() in test_os_hwio.c file "); 
  TestStepAddActionExpected( chActionText, chExpectedText );
  E_DBGR_VariableCheck("Smsts_unlock[26]", 0, Equal);
  
  
  snprintf( chActionText, elCount(chActionText), "check var Smsts_unlock[27]=0  in function Os_Test_GetHWIO_e_LockSemaphore_test() in test_os_hwio.c file "); 
  snprintf( chExpectedText, elCount(chExpectedText), "Verify var Smsts_unlock[27]=0  in function Os_Test_GetHWIO_e_LockSemaphore_test() in test_os_hwio.c file "); 
  TestStepAddActionExpected( chActionText, chExpectedText );
  E_DBGR_VariableCheck("Smsts_unlock[27]", 0, Equal);
  
  snprintf( chActionText, elCount(chActionText), "check var Smsts_unlock[28]=0Smsts_unlock  in function Os_Test_GetHWIO_e_LockSemaphore_test() in test_os_hwio.c file "); 
  snprintf( chExpectedText, elCount(chExpectedText), "Verify var Smsts_unlock[28]=0  in function Os_Test_GetHWIO_e_LockSemaphore_test() in test_os_hwio.c file "); 
  TestStepAddActionExpected( chActionText, chExpectedText );
  E_DBGR_VariableCheck("Smsts_unlock[28]", 0, Equal);
  
  
  snprintf( chActionText, elCount(chActionText), "check var Smsts_unlock[29]=0  in function Os_Test_GetHWIO_e_LockSemaphore_test() in test_os_hwio.c file "); 
  snprintf( chExpectedText, elCount(chExpectedText), "Verify var Smsts_unlock[29]=0  in function Os_Test_GetHWIO_e_LockSemaphore_test() in test_os_hwio.c file "); 
  TestStepAddActionExpected( chActionText, chExpectedText );
  E_DBGR_VariableCheck("Smsts_unlock[29]", 0, Equal);
  
  
  snprintf( chActionText, elCount(chActionText), "check var Smsts_unlock[30]=0  in function Os_Test_GetHWIO_e_LockSemaphore_test() in test_os_hwio.c file "); 
  snprintf( chExpectedText, elCount(chExpectedText), "Verify var Smsts_unlock[30]=0  in function Os_Test_GetHWIO_e_LockSemaphore_test() in test_os_hwio.c file "); 
  TestStepAddActionExpected( chActionText, chExpectedText );
  E_DBGR_VariableCheck("Smsts_unlock[30]", 0, Equal);
  
  
  snprintf( chActionText, elCount(chActionText), "check var Smsts_unlock[31]=0  in function Os_Test_GetHWIO_e_LockSemaphore_test() in test_os_hwio.c file "); 
  snprintf( chExpectedText, elCount(chExpectedText), "Verify var Smsts_unlock[31]=0  in function Os_Test_GetHWIO_e_LockSemaphore_test() in test_os_hwio.c file "); 
  TestStepAddActionExpected( chActionText, chExpectedText );
  E_DBGR_VariableCheck("Smsts_unlock[31]", 0, Equal);
  
  
  
  
  /*******************************************************************************************************************************************************/    
    // Test Step 6: check var Smsts_status[semaphore]=1 for 32 index in function Os_Test_GetHWIO_e_LockSemaphore_test() in test_os_hwio.c file
  /*******************************************************************************************************************************************************/
  snprintf( chActionText, elCount(chActionText), "check var Smsts_status[0]=1  in function Os_Test_GetHWIO_e_LockSemaphore_test() in test_os_hwio.c file "); 
  snprintf( chExpectedText, elCount(chExpectedText), "Verify var Smsts_status[0]=1  in function Os_Test_GetHWIO_e_LockSemaphore_test() in test_os_hwio.c file "); 
  TestStepAddActionExpected( chActionText, chExpectedText );
  E_DBGR_VariableCheck("Smsts_status[0]", 1, Equal);
  
  snprintf( chActionText, elCount(chActionText), "check var Smsts_status[1]=1  in function Os_Test_GetHWIO_e_LockSemaphore_test() in test_os_hwio.c file "); 
  snprintf( chExpectedText, elCount(chExpectedText), "Verify var Smsts_status[1]=1  in function Os_Test_GetHWIO_e_LockSemaphore_test() in test_os_hwio.c file "); 
  TestStepAddActionExpected( chActionText, chExpectedText );
  E_DBGR_VariableCheck("Smsts_status[1]", 1, Equal);
  
  snprintf( chActionText, elCount(chActionText), "check var Smsts_status[2]=1  in function Os_Test_GetHWIO_e_LockSemaphore_test() in test_os_hwio.c file "); 
  snprintf( chExpectedText, elCount(chExpectedText), "Verify var Smsts_status[2]=1  in function Os_Test_GetHWIO_e_LockSemaphore_test() in test_os_hwio.c file "); 
  TestStepAddActionExpected( chActionText, chExpectedText );
  E_DBGR_VariableCheck("Smsts_status[2]", 1, Equal);
  
  snprintf( chActionText, elCount(chActionText), "check var Smsts_status[3]=1  in function Os_Test_GetHWIO_e_LockSemaphore_test() in test_os_hwio.c file "); 
  snprintf( chExpectedText, elCount(chExpectedText), "Verify var Smsts_status[3]=1  in function Os_Test_GetHWIO_e_LockSemaphore_test() in test_os_hwio.c file "); 
  TestStepAddActionExpected( chActionText, chExpectedText );
  E_DBGR_VariableCheck("Smsts_status[3]", 1, Equal);
  
  snprintf( chActionText, elCount(chActionText), "check var Smsts_status[4]=1  in function Os_Test_GetHWIO_e_LockSemaphore_test() in test_os_hwio.c file "); 
  snprintf( chExpectedText, elCount(chExpectedText), "Verify var Smsts_status[4]=1  in function Os_Test_GetHWIO_e_LockSemaphore_test() in test_os_hwio.c file "); 
  TestStepAddActionExpected( chActionText, chExpectedText );
  E_DBGR_VariableCheck("Smsts_status[4]", 1, Equal);
  
  snprintf( chActionText, elCount(chActionText), "check var Smsts_status[5]=1  in function Os_Test_GetHWIO_e_LockSemaphore_test() in test_os_hwio.c file "); 
  snprintf( chExpectedText, elCount(chExpectedText), "Verify var Smsts_status[5]=1  in function Os_Test_GetHWIO_e_LockSemaphore_test() in test_os_hwio.c file "); 
  TestStepAddActionExpected( chActionText, chExpectedText );
  E_DBGR_VariableCheck("Smsts_status[5]", 1, Equal);
  
  snprintf( chActionText, elCount(chActionText), "check var Smsts_status[6]=1  in function Os_Test_GetHWIO_e_LockSemaphore_test() in test_os_hwio.c file "); 
  snprintf( chExpectedText, elCount(chExpectedText), "Verify var Smsts_status[6]=1  in function Os_Test_GetHWIO_e_LockSemaphore_test() in test_os_hwio.c file "); 
  TestStepAddActionExpected( chActionText, chExpectedText );
  E_DBGR_VariableCheck("Smsts_status[6]", 1, Equal);
  
  snprintf( chActionText, elCount(chActionText), "check var Smsts_status[7]=1  in function Os_Test_GetHWIO_e_LockSemaphore_test() in test_os_hwio.c file "); 
  snprintf( chExpectedText, elCount(chExpectedText), "Verify var Smsts_status[7]=1  in function Os_Test_GetHWIO_e_LockSemaphore_test() in test_os_hwio.c file "); 
  TestStepAddActionExpected( chActionText, chExpectedText );
  E_DBGR_VariableCheck("Smsts_status[7]", 1, Equal);
  
  snprintf( chActionText, elCount(chActionText), "check var Smsts_status[8]=1  in function Os_Test_GetHWIO_e_LockSemaphore_test() in test_os_hwio.c file "); 
  snprintf( chExpectedText, elCount(chExpectedText), "Verify var Smsts_status[8]=1  in function Os_Test_GetHWIO_e_LockSemaphore_test() in test_os_hwio.c file "); 
  TestStepAddActionExpected( chActionText, chExpectedText );
  E_DBGR_VariableCheck("Smsts_status[8]", 1, Equal);
  
  snprintf( chActionText, elCount(chActionText), "check var Smsts_status[9]=1  in function Os_Test_GetHWIO_e_LockSemaphore_test() in test_os_hwio.c file "); 
  snprintf( chExpectedText, elCount(chExpectedText), "Verify var Smsts_status[9]=1  in function Os_Test_GetHWIO_e_LockSemaphore_test() in test_os_hwio.c file "); 
  TestStepAddActionExpected( chActionText, chExpectedText );
  E_DBGR_VariableCheck("Smsts_status[9]", 1, Equal);
  
  snprintf( chActionText, elCount(chActionText), "check var Smsts_status[10]=1  in function Os_Test_GetHWIO_e_LockSemaphore_test() in test_os_hwio.c file "); 
  snprintf( chExpectedText, elCount(chExpectedText), "Verify var Smsts_status[10]=1  in function Os_Test_GetHWIO_e_LockSemaphore_test() in test_os_hwio.c file "); 
  TestStepAddActionExpected( chActionText, chExpectedText );
  E_DBGR_VariableCheck("Smsts_status[10]", 1, Equal);
  
  snprintf( chActionText, elCount(chActionText), "check var Smsts_status[11]=1  in function Os_Test_GetHWIO_e_LockSemaphore_test() in test_os_hwio.c file "); 
  snprintf( chExpectedText, elCount(chExpectedText), "Verify var Smsts_status[11]=1  in function Os_Test_GetHWIO_e_LockSemaphore_test() in test_os_hwio.c file "); 
  TestStepAddActionExpected( chActionText, chExpectedText );
  E_DBGR_VariableCheck("Smsts_status[11]", 1, Equal);
  
  snprintf( chActionText, elCount(chActionText), "check var Smsts_status[12]=1  in function Os_Test_GetHWIO_e_LockSemaphore_test() in test_os_hwio.c file "); 
  snprintf( chExpectedText, elCount(chExpectedText), "Verify var Smsts_status[12]=1  in function Os_Test_GetHWIO_e_LockSemaphore_test() in test_os_hwio.c file "); 
  TestStepAddActionExpected( chActionText, chExpectedText );
  E_DBGR_VariableCheck("Smsts_status[12]", 1, Equal);
  
  snprintf( chActionText, elCount(chActionText), "check var Smsts_status[13]=1  in function Os_Test_GetHWIO_e_LockSemaphore_test() in test_os_hwio.c file "); 
  snprintf( chExpectedText, elCount(chExpectedText), "Verify var Smsts_status[13]=1  in function Os_Test_GetHWIO_e_LockSemaphore_test() in test_os_hwio.c file "); 
  TestStepAddActionExpected( chActionText, chExpectedText );
  E_DBGR_VariableCheck("Smsts_status[13]", 1, Equal);
  
  snprintf( chActionText, elCount(chActionText), "check var Smsts_status[14]=1  in function Os_Test_GetHWIO_e_LockSemaphore_test() in test_os_hwio.c file "); 
  snprintf( chExpectedText, elCount(chExpectedText), "Verify var Smsts_status[14]=1  in function Os_Test_GetHWIO_e_LockSemaphore_test() in test_os_hwio.c file "); 
  TestStepAddActionExpected( chActionText, chExpectedText );
  E_DBGR_VariableCheck("Smsts_status[14]", 1, Equal);
  
  snprintf( chActionText, elCount(chActionText), "check var Smsts_status[15]=1  in function Os_Test_GetHWIO_e_LockSemaphore_test() in test_os_hwio.c file "); 
  snprintf( chExpectedText, elCount(chExpectedText), "Verify var Smsts_status[15]=1  in function Os_Test_GetHWIO_e_LockSemaphore_test() in test_os_hwio.c file "); 
  TestStepAddActionExpected( chActionText, chExpectedText );
  E_DBGR_VariableCheck("Smsts_status[15]", 1, Equal);
  
  snprintf( chActionText, elCount(chActionText), "check var Smsts_status[16]=1  in function Os_Test_GetHWIO_e_LockSemaphore_test() in test_os_hwio.c file "); 
  snprintf( chExpectedText, elCount(chExpectedText), "Verify var Smsts_status[16]=1  in function Os_Test_GetHWIO_e_LockSemaphore_test() in test_os_hwio.c file "); 
  TestStepAddActionExpected( chActionText, chExpectedText );
  E_DBGR_VariableCheck("Smsts_status[16]", 1, Equal);
  
  snprintf( chActionText, elCount(chActionText), "check var Smsts_status[17]=1  in function Os_Test_GetHWIO_e_LockSemaphore_test() in test_os_hwio.c file "); 
  snprintf( chExpectedText, elCount(chExpectedText), "Verify var Smsts_status[17]=1  in function Os_Test_GetHWIO_e_LockSemaphore_test() in test_os_hwio.c file "); 
  TestStepAddActionExpected( chActionText, chExpectedText );
  E_DBGR_VariableCheck("Smsts_status[17]", 1, Equal);
  
  snprintf( chActionText, elCount(chActionText), "check var Smsts_status[18]=1  in function Os_Test_GetHWIO_e_LockSemaphore_test() in test_os_hwio.c file "); 
  snprintf( chExpectedText, elCount(chExpectedText), "Verify var Smsts_status[18]=1  in function Os_Test_GetHWIO_e_LockSemaphore_test() in test_os_hwio.c file "); 
  TestStepAddActionExpected( chActionText, chExpectedText );
  E_DBGR_VariableCheck("Smsts_status[18]", 1, Equal);
  
  snprintf( chActionText, elCount(chActionText), "check var Smsts_status[19]=1  in function Os_Test_GetHWIO_e_LockSemaphore_test() in test_os_hwio.c file "); 
  snprintf( chExpectedText, elCount(chExpectedText), "Verify var Smsts_status[19]=1  in function Os_Test_GetHWIO_e_LockSemaphore_test() in test_os_hwio.c file "); 
  TestStepAddActionExpected( chActionText, chExpectedText );
  E_DBGR_VariableCheck("Smsts_status[19]", 1, Equal);
  
  
  snprintf( chActionText, elCount(chActionText), "check var Smsts_status[20]=1  in function Os_Test_GetHWIO_e_LockSemaphore_test() in test_os_hwio.c file "); 
  snprintf( chExpectedText, elCount(chExpectedText), "Verify var Smsts_status[20]=1  in function Os_Test_GetHWIO_e_LockSemaphore_test() in test_os_hwio.c file "); 
  TestStepAddActionExpected( chActionText, chExpectedText );
  E_DBGR_VariableCheck("Smsts_status[20]", 1, Equal);
  
  
  snprintf( chActionText, elCount(chActionText), "check var Smsts_status[21]=1  in function Os_Test_GetHWIO_e_LockSemaphore_test() in test_os_hwio.c file "); 
  snprintf( chExpectedText, elCount(chExpectedText), "Verify var Smsts_status[21]=1  in function Os_Test_GetHWIO_e_LockSemaphore_test() in test_os_hwio.c file "); 
  TestStepAddActionExpected( chActionText, chExpectedText );
  E_DBGR_VariableCheck("Smsts_status[21]", 1, Equal);
  
  
  snprintf( chActionText, elCount(chActionText), "check var Smsts_status[22]=1  in function Os_Test_GetHWIO_e_LockSemaphore_test() in test_os_hwio.c file "); 
  snprintf( chExpectedText, elCount(chExpectedText), "Verify var Smsts_status[22]=1  in function Os_Test_GetHWIO_e_LockSemaphore_test() in test_os_hwio.c file "); 
  TestStepAddActionExpected( chActionText, chExpectedText );
  E_DBGR_VariableCheck("Smsts_status[22]", 1, Equal);
  
  
  snprintf( chActionText, elCount(chActionText), "check var Smsts_status[23]=1  in function Os_Test_GetHWIO_e_LockSemaphore_test() in test_os_hwio.c file "); 
  snprintf( chExpectedText, elCount(chExpectedText), "Verify var Smsts_status[23]=1  in function Os_Test_GetHWIO_e_LockSemaphore_test() in test_os_hwio.c file "); 
  TestStepAddActionExpected( chActionText, chExpectedText );
  E_DBGR_VariableCheck("Smsts_status[23]", 1, Equal);
  
  
  snprintf( chActionText, elCount(chActionText), "check var Smsts_status[24]=1  in function Os_Test_GetHWIO_e_LockSemaphore_test() in test_os_hwio.c file "); 
  snprintf( chExpectedText, elCount(chExpectedText), "Verify var Smsts_status[24]=1  in function Os_Test_GetHWIO_e_LockSemaphore_test() in test_os_hwio.c file "); 
  TestStepAddActionExpected( chActionText, chExpectedText );
  E_DBGR_VariableCheck("Smsts_status[24]", 1, Equal);
  
  
  snprintf( chActionText, elCount(chActionText), "check var Smsts_lock[25]=1  in function Os_Test_GetHWIO_e_LockSemaphore_test() in test_os_hwio.c file "); 
  snprintf( chExpectedText, elCount(chExpectedText), "Verify var Smsts_lock[25]=1  in function Os_Test_GetHWIO_e_LockSemaphore_test() in test_os_hwio.c file "); 
  TestStepAddActionExpected( chActionText, chExpectedText );
  E_DBGR_VariableCheck("Smsts_status[25]", 1, Equal);
  
  
  snprintf( chActionText, elCount(chActionText), "check var Smsts_status[26]=1  in function Os_Test_GetHWIO_e_LockSemaphore_test() in test_os_hwio.c file "); 
  snprintf( chExpectedText, elCount(chExpectedText), "Verify var Smsts_status[26]=1  in function Os_Test_GetHWIO_e_LockSemaphore_test() in test_os_hwio.c file "); 
  TestStepAddActionExpected( chActionText, chExpectedText );
  E_DBGR_VariableCheck("Smsts_status[26]", 1, Equal);
  
  
  snprintf( chActionText, elCount(chActionText), "check var Smsts_status[27]=1  in function Os_Test_GetHWIO_e_LockSemaphore_test() in test_os_hwio.c file "); 
  snprintf( chExpectedText, elCount(chExpectedText), "Verify var Smsts_status[27]=1  in function Os_Test_GetHWIO_e_LockSemaphore_test() in test_os_hwio.c file "); 
  TestStepAddActionExpected( chActionText, chExpectedText );
  E_DBGR_VariableCheck("Smsts_status[27]", 1, Equal);
  
  snprintf( chActionText, elCount(chActionText), "check var Smsts_status[28]=1  in function Os_Test_GetHWIO_e_LockSemaphore_test() in test_os_hwio.c file "); 
  snprintf( chExpectedText, elCount(chExpectedText), "Verify var Smsts_status[28]=1  in function Os_Test_GetHWIO_e_LockSemaphore_test() in test_os_hwio.c file "); 
  TestStepAddActionExpected( chActionText, chExpectedText );
  E_DBGR_VariableCheck("Smsts_status[28]", 1, Equal);
  
  
  snprintf( chActionText, elCount(chActionText), "check var Smsts_status[29]=1  in function Os_Test_GetHWIO_e_LockSemaphore_test() in test_os_hwio.c file "); 
  snprintf( chExpectedText, elCount(chExpectedText), "Verify var Smsts_status[29]=1  in function Os_Test_GetHWIO_e_LockSemaphore_test() in test_os_hwio.c file "); 
  TestStepAddActionExpected( chActionText, chExpectedText );
  E_DBGR_VariableCheck("Smsts_status[29]", 1, Equal);
  
  
  snprintf( chActionText, elCount(chActionText), "check var Smsts_status[30]=1  in function Os_Test_GetHWIO_e_LockSemaphore_test() in test_os_hwio.c file "); 
  snprintf( chExpectedText, elCount(chExpectedText), "Verify var Smsts_status[30]=1  in function Os_Test_GetHWIO_e_LockSemaphore_test() in test_os_hwio.c file "); 
  TestStepAddActionExpected( chActionText, chExpectedText );
  E_DBGR_VariableCheck("Smsts_status[30]", 1, Equal);
  
  
  snprintf( chActionText, elCount(chActionText), "check var Smsts_status[31]=1  in function Os_Test_GetHWIO_e_LockSemaphore_test() in test_os_hwio.c file "); 
  snprintf( chExpectedText, elCount(chExpectedText), "Verify var Smsts_status[31]=1  in function Os_Test_GetHWIO_e_LockSemaphore_test() in test_os_hwio.c file "); 
  TestStepAddActionExpected( chActionText, chExpectedText );
  E_DBGR_VariableCheck("Smsts_status[31]", 1, Equal);
  
  
  
  
  
  
}





/***************************************************************************************************
----------------------------------------------------------------------------------------------------
Test case name:  TC_L30SW_QT_36651207: verify_the_functionality_of_interface_to_check_lock_unlock_status_for_all_31_Semaphore_IDS_for_CPU1
----------------------------------------------------------------------------------------------------
Description:  Test_case_to_verify_the_functionality_of_interface_to_check_lock_unlock_status_for_all_31_Semaphore_IDS_for_CPU1

***************************************************************************************************/



testcase verify_the_functionality_of_interface_to_check_lock_unlock_status_for_all_31_Semaphore_IDS_for_CPU1()
{
  /***************************************************************************************************************/    
                                                // Variable Definition
  /***************************************************************************************************************/ 
  
  long taskvalue;
  
  /***************************************************************************************************************/    
                                               // Local Values
  /***************************************************************************************************************/ 
  

  
  /***************************************************************************************************************/    
                                              // Test Case Info
  /***************************************************************************************************************/
  setWriteDbgLevel(DebugOff);
  snprintf( chTestTitle, elCount(chTestTitle), "Test_case_to_verify_the_functionality_of_interface_to_check_lock_unlock_status_for_all_31_Semaphore_IDS_for_CPU1" );
  snprintf( chTestDescription, elCount(chTestDescription), "Purpose:Test_case_to_verify_the_functionality_of_interface_to_check_lock_unlock_status_for_all_31_Semaphore_IDS_for_CPU1.");
  TestCaseAddInfo( chTestTitle, "TC_L30SW_QT_36651207", chTestDescription );

  /***************************************************************************************************************/    
                                              // Start of Test Case
  /***************************************************************************************************************/
  
  /***************************************************************************************************************/    
                                              // Test Step 1 PRECONDITIONS
  /***************************************************************************************************************/
  
  snprintf( chActionText, elCount(chActionText), "Flash the Software and ECU is running"); 
  snprintf( chExpectedText, elCount(chExpectedText), "ECU should be in running state"); 
  TestStepAddActionExpected( chActionText, chExpectedText );

  A_DBGR_BreakpointDeleteAll();
  A_DBGR_RnGo();
  E_DBGR_CheckState(T32_State_Running);
  

   /***************************************************************************************************************/    
            // Test Step 2: Check all cores are in running state                                   
  /***************************************************************************************************************/
  
  //Check Core0 is running
  snprintf( chActionText, elCount(chActionText), "Check 1000ms Task Counter from Core0 "); 
  snprintf( chExpectedText, elCount(chExpectedText), "1000ms Counter from Core0 is incrementing"); 
  TestStepAddActionExpected( chActionText, chExpectedText );
  A_DBGR_VariableRead( "Task_Core0_1000ms_Count", taskvalue);
  E_DBGR_VariableCheck("Task_Core0_1000ms_Count", taskvalue, Greater);
  
  //Check Core1 is running
  snprintf( chActionText, elCount(chActionText), "Check 1000ms Task Counter from Core1 "); 
  snprintf( chExpectedText, elCount(chExpectedText), "1000ms Counter from Core1 is incrementing"); 
  TestStepAddActionExpected( chActionText, chExpectedText );
  A_DBGR_VariableRead( "Task_Core1_1000ms_Count", taskvalue);
  E_DBGR_VariableCheck("Task_Core1_1000ms_Count", taskvalue, Greater);
  
  //Check Core2 is running
  snprintf( chActionText, elCount(chActionText), "Check 1000ms Task Counter from Core2 "); 
  snprintf( chExpectedText, elCount(chExpectedText), "1000ms Counter from Core2 is incrementing"); 
  TestStepAddActionExpected( chActionText, chExpectedText );
  A_DBGR_VariableRead( "Task_Core2_1000ms_Count", taskvalue);
  E_DBGR_VariableCheck("Task_Core2_1000ms_Count", taskvalue, Greater);
    
  //Check Core3 is running
  snprintf( chActionText, elCount(chActionText), "Check 1000ms Task Counter from Core3 "); 
  snprintf( chExpectedText, elCount(chExpectedText), "1000ms Counter from Core3 is incrementing"); 
  TestStepAddActionExpected( chActionText, chExpectedText );
  A_DBGR_VariableRead( "Task_Core3_1000ms_Count", taskvalue);
  E_DBGR_VariableCheck("Task_Core3_1000ms_Count", taskvalue, Greater);
    
  //Check Core4 is running
  snprintf( chActionText, elCount(chActionText), "Check 1000ms Task Counter from Core4 "); 
  snprintf( chExpectedText, elCount(chExpectedText), "1000ms Counter from Core4 is incrementing"); 
  TestStepAddActionExpected( chActionText, chExpectedText );
  A_DBGR_VariableRead( "Task_Core4_1000ms_Count", taskvalue);
  E_DBGR_VariableCheck("Task_Core4_1000ms_Count", taskvalue, Greater);
    
  //Check Core5 is running
  snprintf( chActionText, elCount(chActionText), "Check 1000ms Task Counter from Core5 "); 
  snprintf( chExpectedText, elCount(chExpectedText), "1000ms Counter from Core5 is incrementing"); 
  TestStepAddActionExpected( chActionText, chExpectedText );
  A_DBGR_VariableRead( "Task_Core5_1000ms_Count", taskvalue);
  E_DBGR_VariableCheck("Task_Core5_1000ms_Count", taskvalue, Greater);
  
  /*******************************************************************************************************************************************************/    
    // Test Step 3: Set flag lock_unlock_status_flag_core1=1 to check semaphore lock for core1 in function TestApp_Core1_1000ms_MainFunction
  /*******************************************************************************************************************************************************/

  snprintf( chActionText, elCount(chActionText), "Set flag lock_unlock_status_flag_core1=2 to check semaphore lock for core0 in function TestApp_Core0_1000ms_MainFunction "); 
  snprintf( chExpectedText, elCount(chExpectedText), "Verify flag lock_unlock_status_flag_core1=2 to check semaphore lock for core0 in function TestApp_Core0_1000ms_MainFunction "); 
  TestStepAddActionExpected( chActionText, chExpectedText );
  A_DBGR_RnGo();
  A_DBGR_VariableSet("lock_unlock_status_flag_core1", "1");
  E_DBGR_VariableCheck("lock_unlock_status_flag_core1", 1, Equal);
   //A_DBGR_RnGo();


  
  
  /*******************************************************************************************************************************************************/    
    // Test Step 4: check var Smsts_lock[semaphore]=2 for 32 index in function Os_Test_GetHWIO_e_LockSemaphore_test() in test_os_hwio.c file
  /*******************************************************************************************************************************************************/
  snprintf( chActionText, elCount(chActionText), "check var Smsts_lock[0]=2  in function Os_Test_GetHWIO_e_LockSemaphore_test() in test_os_hwio.c file "); 
  snprintf( chExpectedText, elCount(chExpectedText), "Verify var Smsts_lock[0]=2  in function Os_Test_GetHWIO_e_LockSemaphore_test() in test_os_hwio.c file "); 
  TestStepAddActionExpected( chActionText, chExpectedText );
  E_DBGR_VariableCheck("Smsts_lock[0]", 2, Equal);
  
  snprintf( chActionText, elCount(chActionText), "check var Smsts_lock[1]=2  in function Os_Test_GetHWIO_e_LockSemaphore_test() in test_os_hwio.c file "); 
  snprintf( chExpectedText, elCount(chExpectedText), "Verify var Smsts_lock[1]=2  in function Os_Test_GetHWIO_e_LockSemaphore_test() in test_os_hwio.c file "); 
  TestStepAddActionExpected( chActionText, chExpectedText );
  E_DBGR_VariableCheck("Smsts_lock[1]", 2, Equal);
  
  snprintf( chActionText, elCount(chActionText), "check var Smsts_lock[2]=2  in function Os_Test_GetHWIO_e_LockSemaphore_test() in test_os_hwio.c file "); 
  snprintf( chExpectedText, elCount(chExpectedText), "Verify var Smsts_lock[2]=2  in function Os_Test_GetHWIO_e_LockSemaphore_test() in test_os_hwio.c file "); 
  TestStepAddActionExpected( chActionText, chExpectedText );
  E_DBGR_VariableCheck("Smsts_lock[2]", 2, Equal);
  
  snprintf( chActionText, elCount(chActionText), "check var Smsts_lock[3]=2  in function Os_Test_GetHWIO_e_LockSemaphore_test() in test_os_hwio.c file "); 
  snprintf( chExpectedText, elCount(chExpectedText), "Verify var Smsts_lock[3]=2  in function Os_Test_GetHWIO_e_LockSemaphore_test() in test_os_hwio.c file "); 
  TestStepAddActionExpected( chActionText, chExpectedText );
  E_DBGR_VariableCheck("Smsts_lock[3]", 2, Equal);
  
  snprintf( chActionText, elCount(chActionText), "check var Smsts_lock[4]=2  in function Os_Test_GetHWIO_e_LockSemaphore_test() in test_os_hwio.c file "); 
  snprintf( chExpectedText, elCount(chExpectedText), "Verify var Smsts_lock[4]=2  in function Os_Test_GetHWIO_e_LockSemaphore_test() in test_os_hwio.c file "); 
  TestStepAddActionExpected( chActionText, chExpectedText );
  E_DBGR_VariableCheck("Smsts_lock[4]", 2, Equal);
  
  snprintf( chActionText, elCount(chActionText), "check var Smsts_lock[5]=2  in function Os_Test_GetHWIO_e_LockSemaphore_test() in test_os_hwio.c file "); 
  snprintf( chExpectedText, elCount(chExpectedText), "Verify var Smsts_lock[5]=2  in function Os_Test_GetHWIO_e_LockSemaphore_test() in test_os_hwio.c file "); 
  TestStepAddActionExpected( chActionText, chExpectedText );
  E_DBGR_VariableCheck("Smsts_lock[5]", 2, Equal);
  
  snprintf( chActionText, elCount(chActionText), "check var Smsts_lock[6]=2  in function Os_Test_GetHWIO_e_LockSemaphore_test() in test_os_hwio.c file "); 
  snprintf( chExpectedText, elCount(chExpectedText), "Verify var Smsts_lock[6]=2  in function Os_Test_GetHWIO_e_LockSemaphore_test() in test_os_hwio.c file "); 
  TestStepAddActionExpected( chActionText, chExpectedText );
  E_DBGR_VariableCheck("Smsts_lock[6]", 2, Equal);
  
  snprintf( chActionText, elCount(chActionText), "check var Smsts_lock[7]=2  in function Os_Test_GetHWIO_e_LockSemaphore_test() in test_os_hwio.c file "); 
  snprintf( chExpectedText, elCount(chExpectedText), "Verify var Smsts_lock[7]=2  in function Os_Test_GetHWIO_e_LockSemaphore_test() in test_os_hwio.c file "); 
  TestStepAddActionExpected( chActionText, chExpectedText );
  E_DBGR_VariableCheck("Smsts_lock[7]", 2, Equal);
  
  snprintf( chActionText, elCount(chActionText), "check var Smsts_lock[8]=2  in function Os_Test_GetHWIO_e_LockSemaphore_test() in test_os_hwio.c file "); 
  snprintf( chExpectedText, elCount(chExpectedText), "Verify var Smsts_lock[8]=2  in function Os_Test_GetHWIO_e_LockSemaphore_test() in test_os_hwio.c file "); 
  TestStepAddActionExpected( chActionText, chExpectedText );
  E_DBGR_VariableCheck("Smsts_lock[8]", 2, Equal);
  
  snprintf( chActionText, elCount(chActionText), "check var Smsts_lock[9]=2  in function Os_Test_GetHWIO_e_LockSemaphore_test() in test_os_hwio.c file "); 
  snprintf( chExpectedText, elCount(chExpectedText), "Verify var Smsts_lock[9]=2  in function Os_Test_GetHWIO_e_LockSemaphore_test() in test_os_hwio.c file "); 
  TestStepAddActionExpected( chActionText, chExpectedText );
  E_DBGR_VariableCheck("Smsts_lock[9]", 2, Equal);
  
  snprintf( chActionText, elCount(chActionText), "check var Smsts_lock[10]=2  in function Os_Test_GetHWIO_e_LockSemaphore_test() in test_os_hwio.c file "); 
  snprintf( chExpectedText, elCount(chExpectedText), "Verify var Smsts_lock[10]=2  in function Os_Test_GetHWIO_e_LockSemaphore_test() in test_os_hwio.c file "); 
  TestStepAddActionExpected( chActionText, chExpectedText );
  E_DBGR_VariableCheck("Smsts_lock[10]", 2, Equal);
  
  snprintf( chActionText, elCount(chActionText), "check var Smsts_lock[11]=2  in function Os_Test_GetHWIO_e_LockSemaphore_test() in test_os_hwio.c file "); 
  snprintf( chExpectedText, elCount(chExpectedText), "Verify var Smsts_lock[11]=2  in function Os_Test_GetHWIO_e_LockSemaphore_test() in test_os_hwio.c file "); 
  TestStepAddActionExpected( chActionText, chExpectedText );
  E_DBGR_VariableCheck("Smsts_lock[11]", 2, Equal);
  
  snprintf( chActionText, elCount(chActionText), "check var Smsts_lock[12]=2  in function Os_Test_GetHWIO_e_LockSemaphore_test() in test_os_hwio.c file "); 
  snprintf( chExpectedText, elCount(chExpectedText), "Verify var Smsts_lock[12]=2  in function Os_Test_GetHWIO_e_LockSemaphore_test() in test_os_hwio.c file "); 
  TestStepAddActionExpected( chActionText, chExpectedText );
  E_DBGR_VariableCheck("Smsts_lock[12]", 2, Equal);
  
  snprintf( chActionText, elCount(chActionText), "check var Smsts_lock[13]=2  in function Os_Test_GetHWIO_e_LockSemaphore_test() in test_os_hwio.c file "); 
  snprintf( chExpectedText, elCount(chExpectedText), "Verify var Smsts_lock[13]=2  in function Os_Test_GetHWIO_e_LockSemaphore_test() in test_os_hwio.c file "); 
  TestStepAddActionExpected( chActionText, chExpectedText );
  E_DBGR_VariableCheck("Smsts_lock[13]", 2, Equal);
  
  snprintf( chActionText, elCount(chActionText), "check var Smsts_lock[14]=2  in function Os_Test_GetHWIO_e_LockSemaphore_test() in test_os_hwio.c file "); 
  snprintf( chExpectedText, elCount(chExpectedText), "Verify var Smsts_lock[14]=2  in function Os_Test_GetHWIO_e_LockSemaphore_test() in test_os_hwio.c file "); 
  TestStepAddActionExpected( chActionText, chExpectedText );
  E_DBGR_VariableCheck("Smsts_lock[14]", 2, Equal);
  
  snprintf( chActionText, elCount(chActionText), "check var Smsts_lock[15]=2  in function Os_Test_GetHWIO_e_LockSemaphore_test() in test_os_hwio.c file "); 
  snprintf( chExpectedText, elCount(chExpectedText), "Verify var Smsts_lock[15]=2  in function Os_Test_GetHWIO_e_LockSemaphore_test() in test_os_hwio.c file "); 
  TestStepAddActionExpected( chActionText, chExpectedText );
  E_DBGR_VariableCheck("Smsts_lock[15]", 2, Equal);
  
  snprintf( chActionText, elCount(chActionText), "check var Smsts_lock[16]=2  in function Os_Test_GetHWIO_e_LockSemaphore_test() in test_os_hwio.c file "); 
  snprintf( chExpectedText, elCount(chExpectedText), "Verify var Smsts_lock[16]=2  in function Os_Test_GetHWIO_e_LockSemaphore_test() in test_os_hwio.c file "); 
  TestStepAddActionExpected( chActionText, chExpectedText );
  E_DBGR_VariableCheck("Smsts_lock[16]", 2, Equal);
  
  snprintf( chActionText, elCount(chActionText), "check var Smsts_lock[17]=2  in function Os_Test_GetHWIO_e_LockSemaphore_test() in test_os_hwio.c file "); 
  snprintf( chExpectedText, elCount(chExpectedText), "Verify var Smsts_lock[17]=2  in function Os_Test_GetHWIO_e_LockSemaphore_test() in test_os_hwio.c file "); 
  TestStepAddActionExpected( chActionText, chExpectedText );
  E_DBGR_VariableCheck("Smsts_lock[17]", 2, Equal);
  
  snprintf( chActionText, elCount(chActionText), "check var Smsts_lock[18]=2  in function Os_Test_GetHWIO_e_LockSemaphore_test() in test_os_hwio.c file "); 
  snprintf( chExpectedText, elCount(chExpectedText), "Verify var Smsts_lock[18]=2  in function Os_Test_GetHWIO_e_LockSemaphore_test() in test_os_hwio.c file "); 
  TestStepAddActionExpected( chActionText, chExpectedText );
  E_DBGR_VariableCheck("Smsts_lock[18]", 2, Equal);
  
  snprintf( chActionText, elCount(chActionText), "check var Smsts_lock[19]=2  in function Os_Test_GetHWIO_e_LockSemaphore_test() in test_os_hwio.c file "); 
  snprintf( chExpectedText, elCount(chExpectedText), "Verify var Smsts_lock[19]=2  in function Os_Test_GetHWIO_e_LockSemaphore_test() in test_os_hwio.c file "); 
  TestStepAddActionExpected( chActionText, chExpectedText );
  E_DBGR_VariableCheck("Smsts_lock[19]", 2, Equal);
  
  
  snprintf( chActionText, elCount(chActionText), "check var Smsts_lock[20]=2  in function Os_Test_GetHWIO_e_LockSemaphore_test() in test_os_hwio.c file "); 
  snprintf( chExpectedText, elCount(chExpectedText), "Verify var Smsts_lock[20]=2  in function Os_Test_GetHWIO_e_LockSemaphore_test() in test_os_hwio.c file "); 
  TestStepAddActionExpected( chActionText, chExpectedText );
  E_DBGR_VariableCheck("Smsts_lock[20]", 2, Equal);
  
  
  snprintf( chActionText, elCount(chActionText), "check var Smsts_lock[21]=2  in function Os_Test_GetHWIO_e_LockSemaphore_test() in test_os_hwio.c file "); 
  snprintf( chExpectedText, elCount(chExpectedText), "Verify var Smsts_lock[21]=2  in function Os_Test_GetHWIO_e_LockSemaphore_test() in test_os_hwio.c file "); 
  TestStepAddActionExpected( chActionText, chExpectedText );
  E_DBGR_VariableCheck("Smsts_lock[21]", 2, Equal);
  
  
  snprintf( chActionText, elCount(chActionText), "check var Smsts_lock[22]=2  in function Os_Test_GetHWIO_e_LockSemaphore_test() in test_os_hwio.c file "); 
  snprintf( chExpectedText, elCount(chExpectedText), "Verify var Smsts_lock[22]=2  in function Os_Test_GetHWIO_e_LockSemaphore_test() in test_os_hwio.c file "); 
  TestStepAddActionExpected( chActionText, chExpectedText );
  E_DBGR_VariableCheck("Smsts_lock[22]", 2, Equal);
  
  
  snprintf( chActionText, elCount(chActionText), "check var Smsts_lock[23]=2  in function Os_Test_GetHWIO_e_LockSemaphore_test() in test_os_hwio.c file "); 
  snprintf( chExpectedText, elCount(chExpectedText), "Verify var Smsts_lock[23]=2  in function Os_Test_GetHWIO_e_LockSemaphore_test() in test_os_hwio.c file "); 
  TestStepAddActionExpected( chActionText, chExpectedText );
  E_DBGR_VariableCheck("Smsts_lock[23]", 2, Equal);
  
  
  snprintf( chActionText, elCount(chActionText), "check var Smsts_lock[24]=2  in function Os_Test_GetHWIO_e_LockSemaphore_test() in test_os_hwio.c file "); 
  snprintf( chExpectedText, elCount(chExpectedText), "Verify var Smsts_lock[24]=2  in function Os_Test_GetHWIO_e_LockSemaphore_test() in test_os_hwio.c file "); 
  TestStepAddActionExpected( chActionText, chExpectedText );
  E_DBGR_VariableCheck("Smsts_lock[24]", 2, Equal);
  
  
  snprintf( chActionText, elCount(chActionText), "check var Smsts_lock[25]=2  in function Os_Test_GetHWIO_e_LockSemaphore_test() in test_os_hwio.c file "); 
  snprintf( chExpectedText, elCount(chExpectedText), "Verify var Smsts_lock[25]=2  in function Os_Test_GetHWIO_e_LockSemaphore_test() in test_os_hwio.c file "); 
  TestStepAddActionExpected( chActionText, chExpectedText );
  E_DBGR_VariableCheck("Smsts_lock[25]", 2, Equal);
  
  
  snprintf( chActionText, elCount(chActionText), "check var Smsts_lock[26]=2  in function Os_Test_GetHWIO_e_LockSemaphore_test() in test_os_hwio.c file "); 
  snprintf( chExpectedText, elCount(chExpectedText), "Verify var Smsts_lock[26]=2  in function Os_Test_GetHWIO_e_LockSemaphore_test() in test_os_hwio.c file "); 
  TestStepAddActionExpected( chActionText, chExpectedText );
  E_DBGR_VariableCheck("Smsts_lock[26]", 2, Equal);
  
  
  snprintf( chActionText, elCount(chActionText), "check var Smsts_lock[27]=2  in function Os_Test_GetHWIO_e_LockSemaphore_test() in test_os_hwio.c file "); 
  snprintf( chExpectedText, elCount(chExpectedText), "Verify var Smsts_lock[27]=2  in function Os_Test_GetHWIO_e_LockSemaphore_test() in test_os_hwio.c file "); 
  TestStepAddActionExpected( chActionText, chExpectedText );
  E_DBGR_VariableCheck("Smsts_lock[27]", 2, Equal);
  
  snprintf( chActionText, elCount(chActionText), "check var Smsts_lock[28]=2  in function Os_Test_GetHWIO_e_LockSemaphore_test() in test_os_hwio.c file "); 
  snprintf( chExpectedText, elCount(chExpectedText), "Verify var Smsts_lock[28]=2  in function Os_Test_GetHWIO_e_LockSemaphore_test() in test_os_hwio.c file "); 
  TestStepAddActionExpected( chActionText, chExpectedText );
  E_DBGR_VariableCheck("Smsts_lock[28]", 2, Equal);
  
  
  snprintf( chActionText, elCount(chActionText), "check var Smsts_lock[29]=2  in function Os_Test_GetHWIO_e_LockSemaphore_test() in test_os_hwio.c file "); 
  snprintf( chExpectedText, elCount(chExpectedText), "Verify var Smsts_lock[29]=2  in function Os_Test_GetHWIO_e_LockSemaphore_test() in test_os_hwio.c file "); 
  TestStepAddActionExpected( chActionText, chExpectedText );
  E_DBGR_VariableCheck("Smsts_lock[29]", 2, Equal);
  
  
  snprintf( chActionText, elCount(chActionText), "check var Smsts_lock[30]=2  in function Os_Test_GetHWIO_e_LockSemaphore_test() in test_os_hwio.c file "); 
  snprintf( chExpectedText, elCount(chExpectedText), "Verify var Smsts_lock[30]=2  in function Os_Test_GetHWIO_e_LockSemaphore_test() in test_os_hwio.c file "); 
  TestStepAddActionExpected( chActionText, chExpectedText );
  E_DBGR_VariableCheck("Smsts_lock[30]", 2, Equal);
  
  
  snprintf( chActionText, elCount(chActionText), "check var Smsts_lock[31]=2  in function Os_Test_GetHWIO_e_LockSemaphore_test() in test_os_hwio.c file "); 
  snprintf( chExpectedText, elCount(chExpectedText), "Verify var Smsts_lock[31]=2  in function Os_Test_GetHWIO_e_LockSemaphore_test() in test_os_hwio.c file "); 
  TestStepAddActionExpected( chActionText, chExpectedText );
  E_DBGR_VariableCheck("Smsts_lock[31]", 2, Equal);
  
  
  
  
  /*******************************************************************************************************************************************************/    
    // Test Step 5: check var Smsts_unlock[semaphore]=0 for 32 index in function Os_Test_GetHWIO_e_LockSemaphore_test() in test_os_hwio.c file
  /*******************************************************************************************************************************************************/
  snprintf( chActionText, elCount(chActionText), "check var Smsts_unlock[0]=0  in function Os_Test_GetHWIO_e_LockSemaphore_test() in test_os_hwio.c file "); 
  snprintf( chExpectedText, elCount(chExpectedText), "Verify var Smsts_unlock[0]=0  in function Os_Test_GetHWIO_e_LockSemaphore_test() in test_os_hwio.c file "); 
  TestStepAddActionExpected( chActionText, chExpectedText );
  E_DBGR_VariableCheck("Smsts_unlock[0]", 0, Equal);
  
  snprintf( chActionText, elCount(chActionText), "check var Smsts_unlock[1]=0  in function Os_Test_GetHWIO_e_LockSemaphore_test() in test_os_hwio.c file "); 
  snprintf( chExpectedText, elCount(chExpectedText), "Verify var Smsts_unlock[1]=0  in function Os_Test_GetHWIO_e_LockSemaphore_test() in test_os_hwio.c file "); 
  TestStepAddActionExpected( chActionText, chExpectedText );
  E_DBGR_VariableCheck("Smsts_unlock[1]", 0, Equal);
  
  snprintf( chActionText, elCount(chActionText), "check var Smsts_unlock[2]=0  in function Os_Test_GetHWIO_e_LockSemaphore_test() in test_os_hwio.c file "); 
  snprintf( chExpectedText, elCount(chExpectedText), "Verify var Smsts_unlock[2]=0  in function Os_Test_GetHWIO_e_LockSemaphore_test() in test_os_hwio.c file "); 
  TestStepAddActionExpected( chActionText, chExpectedText );
  E_DBGR_VariableCheck("Smsts_unlock[2]", 0, Equal);
  
  snprintf( chActionText, elCount(chActionText), "check var Smsts_unlock[3]=0  in function Os_Test_GetHWIO_e_LockSemaphore_test() in test_os_hwio.c file "); 
  snprintf( chExpectedText, elCount(chExpectedText), "Verify var Smsts_unlock[3]=0  in function Os_Test_GetHWIO_e_LockSemaphore_test() in test_os_hwio.c file "); 
  TestStepAddActionExpected( chActionText, chExpectedText );
  E_DBGR_VariableCheck("Smsts_unlock[3]", 0, Equal);
  
  snprintf( chActionText, elCount(chActionText), "check var Smsts_unlock[4]=0  in function Os_Test_GetHWIO_e_LockSemaphore_test() in test_os_hwio.c file "); 
  snprintf( chExpectedText, elCount(chExpectedText), "Verify var Smsts_unlock[4]=0  in function Os_Test_GetHWIO_e_LockSemaphore_test() in test_os_hwio.c file "); 
  TestStepAddActionExpected( chActionText, chExpectedText );
  E_DBGR_VariableCheck("Smsts_unlock[4]", 0, Equal);
  
  snprintf( chActionText, elCount(chActionText), "check var Smsts_unlock[5]=0  in function Os_Test_GetHWIO_e_LockSemaphore_test() in test_os_hwio.c file "); 
  snprintf( chExpectedText, elCount(chExpectedText), "Verify var Smsts_unlock[5]=0  in function Os_Test_GetHWIO_e_LockSemaphore_test() in test_os_hwio.c file "); 
  TestStepAddActionExpected( chActionText, chExpectedText );
  E_DBGR_VariableCheck("Smsts_unlock[5]", 0, Equal);
  
  snprintf( chActionText, elCount(chActionText), "check var Smsts_unlock[6]=0  in function Os_Test_GetHWIO_e_LockSemaphore_test() in test_os_hwio.c file "); 
  snprintf( chExpectedText, elCount(chExpectedText), "Verify var Smsts_lock[6]=0  in function Os_Test_GetHWIO_e_LockSemaphore_test() in test_os_hwio.c file "); 
  TestStepAddActionExpected( chActionText, chExpectedText );
  E_DBGR_VariableCheck("Smsts_unlock[6]", 0, Equal);
  
  snprintf( chActionText, elCount(chActionText), "check var Smsts_unlock[7]=0  in function Os_Test_GetHWIO_e_LockSemaphore_test() in test_os_hwio.c file "); 
  snprintf( chExpectedText, elCount(chExpectedText), "Verify var Smsts_unlock[7]=0Smsts_unlock  in function Os_Test_GetHWIO_e_LockSemaphore_test() in test_os_hwio.c file "); 
  TestStepAddActionExpected( chActionText, chExpectedText );
  E_DBGR_VariableCheck("Smsts_unlock[7]", 0, Equal);
  
  snprintf( chActionText, elCount(chActionText), "check var Smsts_unlock[8]=0  in function Os_Test_GetHWIO_e_LockSemaphore_test() in test_os_hwio.c file "); 
  snprintf( chExpectedText, elCount(chExpectedText), "Verify var Smsts_unlock[8]=0  in function Os_Test_GetHWIO_e_LockSemaphore_test() in test_os_hwio.c file "); 
  TestStepAddActionExpected( chActionText, chExpectedText );
  E_DBGR_VariableCheck("Smsts_unlock[8]", 0, Equal);
  
  snprintf( chActionText, elCount(chActionText), "check var Smsts_unlock[9]=0  in function Os_Test_GetHWIO_e_LockSemaphore_test() in test_os_hwio.c file "); 
  snprintf( chExpectedText, elCount(chExpectedText), "Verify var Smsts_unlock[9]=0  in function Os_Test_GetHWIO_e_LockSemaphore_test() in test_os_hwio.c file "); 
  TestStepAddActionExpected( chActionText, chExpectedText );
  E_DBGR_VariableCheck("Smsts_unlock[9]", 0, Equal);
  
  snprintf( chActionText, elCount(chActionText), "check var Smsts_unlock[10]=0  in function Os_Test_GetHWIO_e_LockSemaphore_test() in test_os_hwio.c file "); 
  snprintf( chExpectedText, elCount(chExpectedText), "Verify var Smsts_unlock[10]=0  in function Os_Test_GetHWIO_e_LockSemaphore_test() in test_os_hwio.c file "); 
  TestStepAddActionExpected( chActionText, chExpectedText );
  E_DBGR_VariableCheck("Smsts_unlock[10]", 0, Equal);
  
  snprintf( chActionText, elCount(chActionText), "check var Smsts_unlock[11]=0  in function Os_Test_GetHWIO_e_LockSemaphore_test() in test_os_hwio.c file "); 
  snprintf( chExpectedText, elCount(chExpectedText), "Verify var Smsts_unlock[11]=0  in function Os_Test_GetHWIO_e_LockSemaphore_test() in test_os_hwio.c file "); 
  TestStepAddActionExpected( chActionText, chExpectedText );
  E_DBGR_VariableCheck("Smsts_unlock[11]", 0, Equal);
  
  snprintf( chActionText, elCount(chActionText), "check var Smsts_unlock[12]=0  in function Os_Test_GetHWIO_e_LockSemaphore_test() in test_os_hwio.c file "); 
  snprintf( chExpectedText, elCount(chExpectedText), "Verify var Smsts_unlock[12]=0  in function Os_Test_GetHWIO_e_LockSemaphore_test() in test_os_hwio.c file "); 
  TestStepAddActionExpected( chActionText, chExpectedText );
  E_DBGR_VariableCheck("Smsts_unlock[12]", 0, Equal);
  
  snprintf( chActionText, elCount(chActionText), "check var Smsts_unlock[13]=0  in function Os_Test_GetHWIO_e_LockSemaphore_test() in test_os_hwio.c file "); 
  snprintf( chExpectedText, elCount(chExpectedText), "Verify var Smsts_unlock[13]=0  in function Os_Test_GetHWIO_e_LockSemaphore_test() in test_os_hwio.c file "); 
  TestStepAddActionExpected( chActionText, chExpectedText );
  E_DBGR_VariableCheck("Smsts_unlock[13]", 0, Equal);
  
  snprintf( chActionText, elCount(chActionText), "check var Smsts_unlock[14]=0  in function Os_Test_GetHWIO_e_LockSemaphore_test() in test_os_hwio.c file "); 
  snprintf( chExpectedText, elCount(chExpectedText), "Verify var Smsts_unlock[14]=0  in function Os_Test_GetHWIO_e_LockSemaphore_test() in test_os_hwio.c file "); 
  TestStepAddActionExpected( chActionText, chExpectedText );
  E_DBGR_VariableCheck("Smsts_unlock[14]", 0, Equal);
  
  snprintf( chActionText, elCount(chActionText), "check var Smsts_unlock[15]=0  in function Os_Test_GetHWIO_e_LockSemaphore_test() in test_os_hwio.c file "); 
  snprintf( chExpectedText, elCount(chExpectedText), "Verify var Smsts_unlock[15]=0  in function Os_Test_GetHWIO_e_LockSemaphore_test() in test_os_hwio.c file "); 
  TestStepAddActionExpected( chActionText, chExpectedText );
  E_DBGR_VariableCheck("Smsts_unlock[15]", 0, Equal);
  
  snprintf( chActionText, elCount(chActionText), "check var Smsts_unlock[16]=0  in function Os_Test_GetHWIO_e_LockSemaphore_test() in test_os_hwio.c file "); 
  snprintf( chExpectedText, elCount(chExpectedText), "Verify var Smsts_unlock[16]=0  in function Os_Test_GetHWIO_e_LockSemaphore_test() in test_os_hwio.c file "); 
  TestStepAddActionExpected( chActionText, chExpectedText );
  E_DBGR_VariableCheck("Smsts_unlock[16]", 0, Equal);
  
  snprintf( chActionText, elCount(chActionText), "check var Smsts_unlock[17]=0  in function Os_Test_GetHWIO_e_LockSemaphore_test() in test_os_hwio.c file "); 
  snprintf( chExpectedText, elCount(chExpectedText), "Verify var Smsts_unlock[17]=0  in function Os_Test_GetHWIO_e_LockSemaphore_test() in test_os_hwio.c file "); 
  TestStepAddActionExpected( chActionText, chExpectedText );
  E_DBGR_VariableCheck("Smsts_unlock[17]", 0, Equal);
  
  snprintf( chActionText, elCount(chActionText), "check var Smsts_unlock[18]=0  in function Os_Test_GetHWIO_e_LockSemaphore_test() in test_os_hwio.c file "); 
  snprintf( chExpectedText, elCount(chExpectedText), "Verify var Smsts_unlock[18]=0  in function Os_Test_GetHWIO_e_LockSemaphore_test() in test_os_hwio.c file "); 
  TestStepAddActionExpected( chActionText, chExpectedText );
  E_DBGR_VariableCheck("Smsts_unlock[18]", 0, Equal);
  
  snprintf( chActionText, elCount(chActionText), "check var Smsts_unlock[19]=0  in function Os_Test_GetHWIO_e_LockSemaphore_test() in test_os_hwio.c file "); 
  snprintf( chExpectedText, elCount(chExpectedText), "Verify var Smsts_unlock[19]=0  in function Os_Test_GetHWIO_e_LockSemaphore_test() in test_os_hwio.c file "); 
  TestStepAddActionExpected( chActionText, chExpectedText );
  E_DBGR_VariableCheck("Smsts_unlock[19]", 0, Equal);
  
  
  snprintf( chActionText, elCount(chActionText), "check var Smsts_unlock[20]=0  in function Os_Test_GetHWIO_e_LockSemaphore_test() in test_os_hwio.c file "); 
  snprintf( chExpectedText, elCount(chExpectedText), "Verify var Smsts_unlock[20]=0  in function Os_Test_GetHWIO_e_LockSemaphore_test() in test_os_hwio.c file "); 
  TestStepAddActionExpected( chActionText, chExpectedText );
  E_DBGR_VariableCheck("Smsts_unlock[20]", 0, Equal);
  
  
  snprintf( chActionText, elCount(chActionText), "check var Smsts_unlock[21]=0  in function Os_Test_GetHWIO_e_LockSemaphore_test() in test_os_hwio.c file "); 
  snprintf( chExpectedText, elCount(chExpectedText), "Verify var Smsts_unlock[21]=0  in function Os_Test_GetHWIO_e_LockSemaphore_test() in test_os_hwio.c file "); 
  TestStepAddActionExpected( chActionText, chExpectedText );
  E_DBGR_VariableCheck("Smsts_unlock[21]", 0, Equal);
  
  
  snprintf( chActionText, elCount(chActionText), "check var Smsts_unlock[22]=0  in function Os_Test_GetHWIO_e_LockSemaphore_test() in test_os_hwio.c file "); 
  snprintf( chExpectedText, elCount(chExpectedText), "Verify var Smsts_unlock[22]=0  in function Os_Test_GetHWIO_e_LockSemaphore_test() in test_os_hwio.c file "); 
  TestStepAddActionExpected( chActionText, chExpectedText );
  E_DBGR_VariableCheck("Smsts_unlock[22]", 0, Equal);
  
  
  snprintf( chActionText, elCount(chActionText), "check var Smsts_unlock[23]=0  in function Os_Test_GetHWIO_e_LockSemaphore_test() in test_os_hwio.c file "); 
  snprintf( chExpectedText, elCount(chExpectedText), "Verify var Smsts_unlock[23]=0  in function Os_Test_GetHWIO_e_LockSemaphore_test() in test_os_hwio.c file "); 
  TestStepAddActionExpected( chActionText, chExpectedText );
  E_DBGR_VariableCheck("Smsts_unlock[23]", 0, Equal);
  
  
  snprintf( chActionText, elCount(chActionText), "check var Smsts_unlock[24]=0  in function Os_Test_GetHWIO_e_LockSemaphore_test() in test_os_hwio.c file "); 
  snprintf( chExpectedText, elCount(chExpectedText), "Verify var Smsts_unlock[24]=0  in function Os_Test_GetHWIO_e_LockSemaphore_test() in test_os_hwio.c file "); 
  TestStepAddActionExpected( chActionText, chExpectedText );
  E_DBGR_VariableCheck("Smsts_unlock[24]", 0, Equal);
  
  
  snprintf( chActionText, elCount(chActionText), "check var Smsts_unlock[25]=0  in function Os_Test_GetHWIO_e_LockSemaphore_test() in test_os_hwio.c file "); 
  snprintf( chExpectedText, elCount(chExpectedText), "Verify var Smsts_unloc[25]=2 0 in function Os_Test_GetHWIO_e_LockSemaphore_test() in test_os_hwio.c file "); 
  TestStepAddActionExpected( chActionText, chExpectedText );
  E_DBGR_VariableCheck("Smsts_unlock[25]", 0, Equal);
  
  
  snprintf( chActionText, elCount(chActionText), "check var Smsts_unlock[26]=0  in function Os_Test_GetHWIO_e_LockSemaphore_test() in test_os_hwio.c file "); 
  snprintf( chExpectedText, elCount(chExpectedText), "Verify var Smsts_unlock[26]=0  in function Os_Test_GetHWIO_e_LockSemaphore_test() in test_os_hwio.c file "); 
  TestStepAddActionExpected( chActionText, chExpectedText );
  E_DBGR_VariableCheck("Smsts_unlock[26]", 0, Equal);
  
  
  snprintf( chActionText, elCount(chActionText), "check var Smsts_unlock[27]=0  in function Os_Test_GetHWIO_e_LockSemaphore_test() in test_os_hwio.c file "); 
  snprintf( chExpectedText, elCount(chExpectedText), "Verify var Smsts_unlock[27]=0  in function Os_Test_GetHWIO_e_LockSemaphore_test() in test_os_hwio.c file "); 
  TestStepAddActionExpected( chActionText, chExpectedText );
  E_DBGR_VariableCheck("Smsts_unlock[27]", 0, Equal);
  
  snprintf( chActionText, elCount(chActionText), "check var Smsts_unlock[28]=0Smsts_unlock  in function Os_Test_GetHWIO_e_LockSemaphore_test() in test_os_hwio.c file "); 
  snprintf( chExpectedText, elCount(chExpectedText), "Verify var Smsts_unlock[28]=0  in function Os_Test_GetHWIO_e_LockSemaphore_test() in test_os_hwio.c file "); 
  TestStepAddActionExpected( chActionText, chExpectedText );
  E_DBGR_VariableCheck("Smsts_unlock[28]", 0, Equal);
  
  
  snprintf( chActionText, elCount(chActionText), "check var Smsts_unlock[29]=0  in function Os_Test_GetHWIO_e_LockSemaphore_test() in test_os_hwio.c file "); 
  snprintf( chExpectedText, elCount(chExpectedText), "Verify var Smsts_unlock[29]=0  in function Os_Test_GetHWIO_e_LockSemaphore_test() in test_os_hwio.c file "); 
  TestStepAddActionExpected( chActionText, chExpectedText );
  E_DBGR_VariableCheck("Smsts_unlock[29]", 0, Equal);
  
  
  snprintf( chActionText, elCount(chActionText), "check var Smsts_unlock[30]=0  in function Os_Test_GetHWIO_e_LockSemaphore_test() in test_os_hwio.c file "); 
  snprintf( chExpectedText, elCount(chExpectedText), "Verify var Smsts_unlock[30]=0  in function Os_Test_GetHWIO_e_LockSemaphore_test() in test_os_hwio.c file "); 
  TestStepAddActionExpected( chActionText, chExpectedText );
  E_DBGR_VariableCheck("Smsts_unlock[30]", 0, Equal);
  
  
  snprintf( chActionText, elCount(chActionText), "check var Smsts_unlock[31]=0  in function Os_Test_GetHWIO_e_LockSemaphore_test() in test_os_hwio.c file "); 
  snprintf( chExpectedText, elCount(chExpectedText), "Verify var Smsts_unlock[31]=0  in function Os_Test_GetHWIO_e_LockSemaphore_test() in test_os_hwio.c file "); 
  TestStepAddActionExpected( chActionText, chExpectedText );
  E_DBGR_VariableCheck("Smsts_unlock[31]", 0, Equal);
  
  
  
  
  /*******************************************************************************************************************************************************/    
    // Test Step 6: check var Smsts_status[semaphore]=2 for 32 index in function Os_Test_GetHWIO_e_LockSemaphore_test() in test_os_hwio.c file
  /*******************************************************************************************************************************************************/
  snprintf( chActionText, elCount(chActionText), "check var Smsts_status[0]=2  in function Os_Test_GetHWIO_e_LockSemaphore_test() in test_os_hwio.c file "); 
  snprintf( chExpectedText, elCount(chExpectedText), "Verify var Smsts_status[0]=2  in function Os_Test_GetHWIO_e_LockSemaphore_test() in test_os_hwio.c file "); 
  TestStepAddActionExpected( chActionText, chExpectedText );
  E_DBGR_VariableCheck("Smsts_status[0]", 2, Equal);
  
  snprintf( chActionText, elCount(chActionText), "check var Smsts_status[1]=2  in function Os_Test_GetHWIO_e_LockSemaphore_test() in test_os_hwio.c file "); 
  snprintf( chExpectedText, elCount(chExpectedText), "Verify var Smsts_status[1]=2  in function Os_Test_GetHWIO_e_LockSemaphore_test() in test_os_hwio.c file "); 
  TestStepAddActionExpected( chActionText, chExpectedText );
  E_DBGR_VariableCheck("Smsts_status[1]", 2, Equal);
  
  snprintf( chActionText, elCount(chActionText), "check var Smsts_status[2]=2  in function Os_Test_GetHWIO_e_LockSemaphore_test() in test_os_hwio.c file "); 
  snprintf( chExpectedText, elCount(chExpectedText), "Verify var Smsts_status[2]=2  in function Os_Test_GetHWIO_e_LockSemaphore_test() in test_os_hwio.c file "); 
  TestStepAddActionExpected( chActionText, chExpectedText );
  E_DBGR_VariableCheck("Smsts_status[2]", 2, Equal);
  
  snprintf( chActionText, elCount(chActionText), "check var Smsts_status[3]=2  in function Os_Test_GetHWIO_e_LockSemaphore_test() in test_os_hwio.c file "); 
  snprintf( chExpectedText, elCount(chExpectedText), "Verify var Smsts_status[3]=2  in function Os_Test_GetHWIO_e_LockSemaphore_test() in test_os_hwio.c file "); 
  TestStepAddActionExpected( chActionText, chExpectedText );
  E_DBGR_VariableCheck("Smsts_status[3]", 2, Equal);
  
  snprintf( chActionText, elCount(chActionText), "check var Smsts_status[4]=2  in function Os_Test_GetHWIO_e_LockSemaphore_test() in test_os_hwio.c file "); 
  snprintf( chExpectedText, elCount(chExpectedText), "Verify var Smsts_status[4]=2  in function Os_Test_GetHWIO_e_LockSemaphore_test() in test_os_hwio.c file "); 
  TestStepAddActionExpected( chActionText, chExpectedText );
  E_DBGR_VariableCheck("Smsts_status[4]", 2, Equal);
  
  snprintf( chActionText, elCount(chActionText), "check var Smsts_status[5]=2  in function Os_Test_GetHWIO_e_LockSemaphore_test() in test_os_hwio.c file "); 
  snprintf( chExpectedText, elCount(chExpectedText), "Verify var Smsts_status[5]=2  in function Os_Test_GetHWIO_e_LockSemaphore_test() in test_os_hwio.c file "); 
  TestStepAddActionExpected( chActionText, chExpectedText );
  E_DBGR_VariableCheck("Smsts_status[5]", 2, Equal);
  
  snprintf( chActionText, elCount(chActionText), "check var Smsts_status[6]=2  in function Os_Test_GetHWIO_e_LockSemaphore_test() in test_os_hwio.c file "); 
  snprintf( chExpectedText, elCount(chExpectedText), "Verify var Smsts_status[6]=2  in function Os_Test_GetHWIO_e_LockSemaphore_test() in test_os_hwio.c file "); 
  TestStepAddActionExpected( chActionText, chExpectedText );
  E_DBGR_VariableCheck("Smsts_status[6]", 2, Equal);
  
  snprintf( chActionText, elCount(chActionText), "check var Smsts_status[7]=2  in function Os_Test_GetHWIO_e_LockSemaphore_test() in test_os_hwio.c file "); 
  snprintf( chExpectedText, elCount(chExpectedText), "Verify var Smsts_status[7]=2  in function Os_Test_GetHWIO_e_LockSemaphore_test() in test_os_hwio.c file "); 
  TestStepAddActionExpected( chActionText, chExpectedText );
  E_DBGR_VariableCheck("Smsts_status[7]", 2, Equal);
  
  snprintf( chActionText, elCount(chActionText), "check var Smsts_status[8]=2  in function Os_Test_GetHWIO_e_LockSemaphore_test() in test_os_hwio.c file "); 
  snprintf( chExpectedText, elCount(chExpectedText), "Verify var Smsts_status[8]=2  in function Os_Test_GetHWIO_e_LockSemaphore_test() in test_os_hwio.c file "); 
  TestStepAddActionExpected( chActionText, chExpectedText );
  E_DBGR_VariableCheck("Smsts_status[8]", 2, Equal);
  
  snprintf( chActionText, elCount(chActionText), "check var Smsts_status[9]=2  in function Os_Test_GetHWIO_e_LockSemaphore_test() in test_os_hwio.c file "); 
  snprintf( chExpectedText, elCount(chExpectedText), "Verify var Smsts_status[9]=2  in function Os_Test_GetHWIO_e_LockSemaphore_test() in test_os_hwio.c file "); 
  TestStepAddActionExpected( chActionText, chExpectedText );
  E_DBGR_VariableCheck("Smsts_status[9]", 2, Equal);
  
  snprintf( chActionText, elCount(chActionText), "check var Smsts_status[10]=2  in function Os_Test_GetHWIO_e_LockSemaphore_test() in test_os_hwio.c file "); 
  snprintf( chExpectedText, elCount(chExpectedText), "Verify var Smsts_status[10]=2  in function Os_Test_GetHWIO_e_LockSemaphore_test() in test_os_hwio.c file "); 
  TestStepAddActionExpected( chActionText, chExpectedText );
  E_DBGR_VariableCheck("Smsts_status[10]", 2, Equal);
  
  snprintf( chActionText, elCount(chActionText), "check var Smsts_status[11]=2  in function Os_Test_GetHWIO_e_LockSemaphore_test() in test_os_hwio.c file "); 
  snprintf( chExpectedText, elCount(chExpectedText), "Verify var Smsts_status[11]=2  in function Os_Test_GetHWIO_e_LockSemaphore_test() in test_os_hwio.c file "); 
  TestStepAddActionExpected( chActionText, chExpectedText );
  E_DBGR_VariableCheck("Smsts_status[11]", 2, Equal);
  
  snprintf( chActionText, elCount(chActionText), "check var Smsts_status[12]=2  in function Os_Test_GetHWIO_e_LockSemaphore_test() in test_os_hwio.c file "); 
  snprintf( chExpectedText, elCount(chExpectedText), "Verify var Smsts_status[12]=2  in function Os_Test_GetHWIO_e_LockSemaphore_test() in test_os_hwio.c file "); 
  TestStepAddActionExpected( chActionText, chExpectedText );
  E_DBGR_VariableCheck("Smsts_status[12]", 2, Equal);
  
  snprintf( chActionText, elCount(chActionText), "check var Smsts_status[13]=2  in function Os_Test_GetHWIO_e_LockSemaphore_test() in test_os_hwio.c file "); 
  snprintf( chExpectedText, elCount(chExpectedText), "Verify var Smsts_status[13]=2  in function Os_Test_GetHWIO_e_LockSemaphore_test() in test_os_hwio.c file "); 
  TestStepAddActionExpected( chActionText, chExpectedText );
  E_DBGR_VariableCheck("Smsts_status[13]", 2, Equal);
  
  snprintf( chActionText, elCount(chActionText), "check var Smsts_status[14]=2  in function Os_Test_GetHWIO_e_LockSemaphore_test() in test_os_hwio.c file "); 
  snprintf( chExpectedText, elCount(chExpectedText), "Verify var Smsts_status[14]=2  in function Os_Test_GetHWIO_e_LockSemaphore_test() in test_os_hwio.c file "); 
  TestStepAddActionExpected( chActionText, chExpectedText );
  E_DBGR_VariableCheck("Smsts_status[14]", 2, Equal);
  
  snprintf( chActionText, elCount(chActionText), "check var Smsts_status[15]=2  in function Os_Test_GetHWIO_e_LockSemaphore_test() in test_os_hwio.c file "); 
  snprintf( chExpectedText, elCount(chExpectedText), "Verify var Smsts_status[15]=2  in function Os_Test_GetHWIO_e_LockSemaphore_test() in test_os_hwio.c file "); 
  TestStepAddActionExpected( chActionText, chExpectedText );
  E_DBGR_VariableCheck("Smsts_status[15]", 2, Equal);
  
  snprintf( chActionText, elCount(chActionText), "check var Smsts_status[16]=2  in function Os_Test_GetHWIO_e_LockSemaphore_test() in test_os_hwio.c file "); 
  snprintf( chExpectedText, elCount(chExpectedText), "Verify var Smsts_status[16]=2  in function Os_Test_GetHWIO_e_LockSemaphore_test() in test_os_hwio.c file "); 
  TestStepAddActionExpected( chActionText, chExpectedText );
  E_DBGR_VariableCheck("Smsts_status[16]", 2, Equal);
  
  snprintf( chActionText, elCount(chActionText), "check var Smsts_status[17]=2  in function Os_Test_GetHWIO_e_LockSemaphore_test() in test_os_hwio.c file "); 
  snprintf( chExpectedText, elCount(chExpectedText), "Verify var Smsts_status[17]=2  in function Os_Test_GetHWIO_e_LockSemaphore_test() in test_os_hwio.c file "); 
  TestStepAddActionExpected( chActionText, chExpectedText );
  E_DBGR_VariableCheck("Smsts_status[17]", 2, Equal);
  
  snprintf( chActionText, elCount(chActionText), "check var Smsts_status[18]=2  in function Os_Test_GetHWIO_e_LockSemaphore_test() in test_os_hwio.c file "); 
  snprintf( chExpectedText, elCount(chExpectedText), "Verify var Smsts_status[18]=2  in function Os_Test_GetHWIO_e_LockSemaphore_test() in test_os_hwio.c file "); 
  TestStepAddActionExpected( chActionText, chExpectedText );
  E_DBGR_VariableCheck("Smsts_status[18]", 2, Equal);
  
  snprintf( chActionText, elCount(chActionText), "check var Smsts_status[19]=2  in function Os_Test_GetHWIO_e_LockSemaphore_test() in test_os_hwio.c file "); 
  snprintf( chExpectedText, elCount(chExpectedText), "Verify var Smsts_status[19]=2  in function Os_Test_GetHWIO_e_LockSemaphore_test() in test_os_hwio.c file "); 
  TestStepAddActionExpected( chActionText, chExpectedText );
  E_DBGR_VariableCheck("Smsts_status[19]", 2, Equal);
  
  
  snprintf( chActionText, elCount(chActionText), "check var Smsts_status[20]=2  in function Os_Test_GetHWIO_e_LockSemaphore_test() in test_os_hwio.c file "); 
  snprintf( chExpectedText, elCount(chExpectedText), "Verify var Smsts_status[20]=2  in function Os_Test_GetHWIO_e_LockSemaphore_test() in test_os_hwio.c file "); 
  TestStepAddActionExpected( chActionText, chExpectedText );
  E_DBGR_VariableCheck("Smsts_status[20]", 2, Equal);
  
  
  snprintf( chActionText, elCount(chActionText), "check var Smsts_status[21]=2  in function Os_Test_GetHWIO_e_LockSemaphore_test() in test_os_hwio.c file "); 
  snprintf( chExpectedText, elCount(chExpectedText), "Verify var Smsts_status[21]=2  in function Os_Test_GetHWIO_e_LockSemaphore_test() in test_os_hwio.c file "); 
  TestStepAddActionExpected( chActionText, chExpectedText );
  E_DBGR_VariableCheck("Smsts_status[21]", 2, Equal);
  
  
  snprintf( chActionText, elCount(chActionText), "check var Smsts_status[22]=2  in function Os_Test_GetHWIO_e_LockSemaphore_test() in test_os_hwio.c file "); 
  snprintf( chExpectedText, elCount(chExpectedText), "Verify var Smsts_status[22]=2  in function Os_Test_GetHWIO_e_LockSemaphore_test() in test_os_hwio.c file "); 
  TestStepAddActionExpected( chActionText, chExpectedText );
  E_DBGR_VariableCheck("Smsts_status[22]", 2, Equal);
  
  
  snprintf( chActionText, elCount(chActionText), "check var Smsts_status[23]=2  in function Os_Test_GetHWIO_e_LockSemaphore_test() in test_os_hwio.c file "); 
  snprintf( chExpectedText, elCount(chExpectedText), "Verify var Smsts_status[23]=2  in function Os_Test_GetHWIO_e_LockSemaphore_test() in test_os_hwio.c file "); 
  TestStepAddActionExpected( chActionText, chExpectedText );
  E_DBGR_VariableCheck("Smsts_status[23]", 2, Equal);
  
  
  snprintf( chActionText, elCount(chActionText), "check var Smsts_status[24]=2  in function Os_Test_GetHWIO_e_LockSemaphore_test() in test_os_hwio.c file "); 
  snprintf( chExpectedText, elCount(chExpectedText), "Verify var Smsts_status[24]=2  in function Os_Test_GetHWIO_e_LockSemaphore_test() in test_os_hwio.c file "); 
  TestStepAddActionExpected( chActionText, chExpectedText );
  E_DBGR_VariableCheck("Smsts_status[24]", 2, Equal);
  
  
  snprintf( chActionText, elCount(chActionText), "check var Smsts_lock[25]=2  in function Os_Test_GetHWIO_e_LockSemaphore_test() in test_os_hwio.c file "); 
  snprintf( chExpectedText, elCount(chExpectedText), "Verify var Smsts_lock[25]=2  in function Os_Test_GetHWIO_e_LockSemaphore_test() in test_os_hwio.c file "); 
  TestStepAddActionExpected( chActionText, chExpectedText );
  E_DBGR_VariableCheck("Smsts_status[25]", 2, Equal);
  
  
  snprintf( chActionText, elCount(chActionText), "check var Smsts_status[26]=2  in function Os_Test_GetHWIO_e_LockSemaphore_test() in test_os_hwio.c file "); 
  snprintf( chExpectedText, elCount(chExpectedText), "Verify var Smsts_status[26]=2  in function Os_Test_GetHWIO_e_LockSemaphore_test() in test_os_hwio.c file "); 
  TestStepAddActionExpected( chActionText, chExpectedText );
  E_DBGR_VariableCheck("Smsts_status[26]", 2, Equal);
  
  
  snprintf( chActionText, elCount(chActionText), "check var Smsts_status[27]=2  in function Os_Test_GetHWIO_e_LockSemaphore_test() in test_os_hwio.c file "); 
  snprintf( chExpectedText, elCount(chExpectedText), "Verify var Smsts_status[27]=2  in function Os_Test_GetHWIO_e_LockSemaphore_test() in test_os_hwio.c file "); 
  TestStepAddActionExpected( chActionText, chExpectedText );
  E_DBGR_VariableCheck("Smsts_status[27]", 2, Equal);
  
  snprintf( chActionText, elCount(chActionText), "check var Smsts_status[28]=2  in function Os_Test_GetHWIO_e_LockSemaphore_test() in test_os_hwio.c file "); 
  snprintf( chExpectedText, elCount(chExpectedText), "Verify var Smsts_status[28]=2  in function Os_Test_GetHWIO_e_LockSemaphore_test() in test_os_hwio.c file "); 
  TestStepAddActionExpected( chActionText, chExpectedText );
  E_DBGR_VariableCheck("Smsts_status[28]", 2, Equal);
  
  
  snprintf( chActionText, elCount(chActionText), "check var Smsts_status[29]=2  in function Os_Test_GetHWIO_e_LockSemaphore_test() in test_os_hwio.c file "); 
  snprintf( chExpectedText, elCount(chExpectedText), "Verify var Smsts_status[29]=2  in function Os_Test_GetHWIO_e_LockSemaphore_test() in test_os_hwio.c file "); 
  TestStepAddActionExpected( chActionText, chExpectedText );
  E_DBGR_VariableCheck("Smsts_status[29]", 2, Equal);
  
  
  snprintf( chActionText, elCount(chActionText), "check var Smsts_status[30]=2  in function Os_Test_GetHWIO_e_LockSemaphore_test() in test_os_hwio.c file "); 
  snprintf( chExpectedText, elCount(chExpectedText), "Verify var Smsts_status[30]=2  in function Os_Test_GetHWIO_e_LockSemaphore_test() in test_os_hwio.c file "); 
  TestStepAddActionExpected( chActionText, chExpectedText );
  E_DBGR_VariableCheck("Smsts_status[30]", 2, Equal);
  
  
  snprintf( chActionText, elCount(chActionText), "check var Smsts_status[31]=2  in function Os_Test_GetHWIO_e_LockSemaphore_test() in test_os_hwio.c file "); 
  snprintf( chExpectedText, elCount(chExpectedText), "Verify var Smsts_status[31]=2  in function Os_Test_GetHWIO_e_LockSemaphore_test() in test_os_hwio.c file "); 
  TestStepAddActionExpected( chActionText, chExpectedText );
  E_DBGR_VariableCheck("Smsts_status[31]", 2, Equal);
  
  
  
  
  
  
}



/***************************************************************************************************
----------------------------------------------------------------------------------------------------
Test case name:  TC_L30SW_QT_36651207: verify_the_functionality_of_interface_to_check_lock_unlock_status_for_all_31_Semaphore_IDS_for_CPU2
----------------------------------------------------------------------------------------------------
Description:  Test_case_to_verify_the_functionality_of_interface_to_check_lock_unlock_status_for_all_31_Semaphore_IDS_for_CPU2

***************************************************************************************************/



testcase verify_the_functionality_of_interface_to_check_lock_unlock_status_for_all_31_Semaphore_IDS_for_CPU2()
{
  /***************************************************************************************************************/    
                                                // Variable Definition
  /***************************************************************************************************************/ 
  
  long taskvalue;
  
  /***************************************************************************************************************/    
                                               // Local Values
  /***************************************************************************************************************/ 
  

  
  /***************************************************************************************************************/    
                                              // Test Case Info
  /***************************************************************************************************************/
  setWriteDbgLevel(DebugOff);
  snprintf( chTestTitle, elCount(chTestTitle), "Test_case_to_verify_the_functionality_of_interface_to_check_lock_unlock_status_for_all_31_Semaphore_IDS_for_CPU2" );
  snprintf( chTestDescription, elCount(chTestDescription), "Purpose:Test_case_to_verify_the_functionality_of_interface_to_check_lock_unlock_status_for_all_31_Semaphore_IDS_for_CPU2.");
  TestCaseAddInfo( chTestTitle, "TC_L30SW_QT_36651207", chTestDescription );

  /***************************************************************************************************************/    
                                              // Start of Test Case
  /***************************************************************************************************************/
  
  /***************************************************************************************************************/    
                                              // Test Step 1 PRECONDITIONS
  /***************************************************************************************************************/
  
  snprintf( chActionText, elCount(chActionText), "Flash the Software and ECU is running"); 
  snprintf( chExpectedText, elCount(chExpectedText), "ECU should be in running state"); 
  TestStepAddActionExpected( chActionText, chExpectedText );

  A_DBGR_BreakpointDeleteAll();
  A_DBGR_RnGo();
  E_DBGR_CheckState(T32_State_Running);
  

   /***************************************************************************************************************/    
            // Test Step 2: Check all cores are in running state                                   
  /***************************************************************************************************************/
  
  //Check Core0 is running
  snprintf( chActionText, elCount(chActionText), "Check 1000ms Task Counter from Core0 "); 
  snprintf( chExpectedText, elCount(chExpectedText), "1000ms Counter from Core0 is incrementing"); 
  TestStepAddActionExpected( chActionText, chExpectedText );
  A_DBGR_VariableRead( "Task_Core0_1000ms_Count", taskvalue);
  E_DBGR_VariableCheck("Task_Core0_1000ms_Count", taskvalue, Greater);
  
  //Check Core1 is running
  snprintf( chActionText, elCount(chActionText), "Check 1000ms Task Counter from Core1 "); 
  snprintf( chExpectedText, elCount(chExpectedText), "1000ms Counter from Core1 is incrementing"); 
  TestStepAddActionExpected( chActionText, chExpectedText );
  A_DBGR_VariableRead( "Task_Core1_1000ms_Count", taskvalue);
  E_DBGR_VariableCheck("Task_Core1_1000ms_Count", taskvalue, Greater);
  
  //Check Core2 is running
  snprintf( chActionText, elCount(chActionText), "Check 1000ms Task Counter from Core2 "); 
  snprintf( chExpectedText, elCount(chExpectedText), "1000ms Counter from Core2 is incrementing"); 
  TestStepAddActionExpected( chActionText, chExpectedText );
  A_DBGR_VariableRead( "Task_Core2_1000ms_Count", taskvalue);
  E_DBGR_VariableCheck("Task_Core2_1000ms_Count", taskvalue, Greater);
    
  //Check Core3 is running
  snprintf( chActionText, elCount(chActionText), "Check 1000ms Task Counter from Core3 "); 
  snprintf( chExpectedText, elCount(chExpectedText), "1000ms Counter from Core3 is incrementing"); 
  TestStepAddActionExpected( chActionText, chExpectedText );
  A_DBGR_VariableRead( "Task_Core3_1000ms_Count", taskvalue);
  E_DBGR_VariableCheck("Task_Core3_1000ms_Count", taskvalue, Greater);
    
  //Check Core4 is running
  snprintf( chActionText, elCount(chActionText), "Check 1000ms Task Counter from Core4 "); 
  snprintf( chExpectedText, elCount(chExpectedText), "1000ms Counter from Core4 is incrementing"); 
  TestStepAddActionExpected( chActionText, chExpectedText );
  A_DBGR_VariableRead( "Task_Core4_1000ms_Count", taskvalue);
  E_DBGR_VariableCheck("Task_Core4_1000ms_Count", taskvalue, Greater);
    
  //Check Core5 is running
  snprintf( chActionText, elCount(chActionText), "Check 1000ms Task Counter from Core5 "); 
  snprintf( chExpectedText, elCount(chExpectedText), "1000ms Counter from Core5 is incrementing"); 
  TestStepAddActionExpected( chActionText, chExpectedText );
  A_DBGR_VariableRead( "Task_Core5_1000ms_Count", taskvalue);
  E_DBGR_VariableCheck("Task_Core5_1000ms_Count", taskvalue, Greater);
  
  /*******************************************************************************************************************************************************/    
    // Test Step 3: Set flag lock_unlock_status_flag_core2=1 to check semaphore lock for core2 in function TestApp_Core2_1000ms_MainFunction
  /*******************************************************************************************************************************************************/

  snprintf( chActionText, elCount(chActionText), "Set flag lock_unlock_status_flag_core2=1 to check semaphore lock for core0 in function TestApp_Core0_1000ms_MainFunction "); 
  snprintf( chExpectedText, elCount(chExpectedText), "Verify flag lock_unlock_status_flag_core2=1 to check semaphore lock for core0 in function TestApp_Core0_1000ms_MainFunction "); 
  TestStepAddActionExpected( chActionText, chExpectedText );
    A_DBGR_RnGo();
  A_DBGR_VariableSet("lock_unlock_status_flag_core2", "1");
  E_DBGR_VariableCheck("lock_unlock_status_flag_core2", 1, Equal);


  

  
  
  /*******************************************************************************************************************************************************/    
    // Test Step 4: check var Smsts_lock[semaphore]=3 for 32 index in function Os_Test_GetHWIO_e_LockSemaphore_test() in test_os_hwio.c file
  /*******************************************************************************************************************************************************/
  snprintf( chActionText, elCount(chActionText), "check var Smsts_lock[0]=3  in function Os_Test_GetHWIO_e_LockSemaphore_test() in test_os_hwio.c file "); 
  snprintf( chExpectedText, elCount(chExpectedText), "Verify var Smsts_lock[0]=3  in function Os_Test_GetHWIO_e_LockSemaphore_test() in test_os_hwio.c file "); 
  TestStepAddActionExpected( chActionText, chExpectedText );
  E_DBGR_VariableCheck("Smsts_lock[0]", 3, Equal);
  
  snprintf( chActionText, elCount(chActionText), "check var Smsts_lock[1]=3  in function Os_Test_GetHWIO_e_LockSemaphore_test() in test_os_hwio.c file "); 
  snprintf( chExpectedText, elCount(chExpectedText), "Verify var Smsts_lock[1]=3  in function Os_Test_GetHWIO_e_LockSemaphore_test() in test_os_hwio.c file "); 
  TestStepAddActionExpected( chActionText, chExpectedText );
  E_DBGR_VariableCheck("Smsts_lock[1]", 3, Equal);
  
  snprintf( chActionText, elCount(chActionText), "check var Smsts_lock[2]=3  in function Os_Test_GetHWIO_e_LockSemaphore_test() in test_os_hwio.c file "); 
  snprintf( chExpectedText, elCount(chExpectedText), "Verify var Smsts_lock[2]=3  in function Os_Test_GetHWIO_e_LockSemaphore_test() in test_os_hwio.c file "); 
  TestStepAddActionExpected( chActionText, chExpectedText );
  E_DBGR_VariableCheck("Smsts_lock[2]", 3, Equal);
  
  snprintf( chActionText, elCount(chActionText), "check var Smsts_lock[3]=3  in function Os_Test_GetHWIO_e_LockSemaphore_test() in test_os_hwio.c file "); 
  snprintf( chExpectedText, elCount(chExpectedText), "Verify var Smsts_lock[3]=3  in function Os_Test_GetHWIO_e_LockSemaphore_test() in test_os_hwio.c file "); 
  TestStepAddActionExpected( chActionText, chExpectedText );
  E_DBGR_VariableCheck("Smsts_lock[3]", 3, Equal);
  
  snprintf( chActionText, elCount(chActionText), "check var Smsts_lock[4]=3  in function Os_Test_GetHWIO_e_LockSemaphore_test() in test_os_hwio.c file "); 
  snprintf( chExpectedText, elCount(chExpectedText), "Verify var Smsts_lock[4]=3  in function Os_Test_GetHWIO_e_LockSemaphore_test() in test_os_hwio.c file "); 
  TestStepAddActionExpected( chActionText, chExpectedText );
  E_DBGR_VariableCheck("Smsts_lock[4]", 3, Equal);
  
  snprintf( chActionText, elCount(chActionText), "check var Smsts_lock[5]=3  in function Os_Test_GetHWIO_e_LockSemaphore_test() in test_os_hwio.c file "); 
  snprintf( chExpectedText, elCount(chExpectedText), "Verify var Smsts_lock[5]=3  in function Os_Test_GetHWIO_e_LockSemaphore_test() in test_os_hwio.c file "); 
  TestStepAddActionExpected( chActionText, chExpectedText );
  E_DBGR_VariableCheck("Smsts_lock[5]", 3, Equal);
  
  snprintf( chActionText, elCount(chActionText), "check var Smsts_lock[6]=3  in function Os_Test_GetHWIO_e_LockSemaphore_test() in test_os_hwio.c file "); 
  snprintf( chExpectedText, elCount(chExpectedText), "Verify var Smsts_lock[6]=3  in function Os_Test_GetHWIO_e_LockSemaphore_test() in test_os_hwio.c file "); 
  TestStepAddActionExpected( chActionText, chExpectedText );
  E_DBGR_VariableCheck("Smsts_lock[6]", 3, Equal);
  
  snprintf( chActionText, elCount(chActionText), "check var Smsts_lock[7]=3  in function Os_Test_GetHWIO_e_LockSemaphore_test() in test_os_hwio.c file "); 
  snprintf( chExpectedText, elCount(chExpectedText), "Verify var Smsts_lock[7]=3  in function Os_Test_GetHWIO_e_LockSemaphore_test() in test_os_hwio.c file "); 
  TestStepAddActionExpected( chActionText, chExpectedText );
  E_DBGR_VariableCheck("Smsts_lock[7]", 3, Equal);
  
  snprintf( chActionText, elCount(chActionText), "check var Smsts_lock[8]=3  in function Os_Test_GetHWIO_e_LockSemaphore_test() in test_os_hwio.c file "); 
  snprintf( chExpectedText, elCount(chExpectedText), "Verify var Smsts_lock[8]=3  in function Os_Test_GetHWIO_e_LockSemaphore_test() in test_os_hwio.c file "); 
  TestStepAddActionExpected( chActionText, chExpectedText );
  E_DBGR_VariableCheck("Smsts_lock[8]", 3, Equal);
  
  snprintf( chActionText, elCount(chActionText), "check var Smsts_lock[9]=3  in function Os_Test_GetHWIO_e_LockSemaphore_test() in test_os_hwio.c file "); 
  snprintf( chExpectedText, elCount(chExpectedText), "Verify var Smsts_lock[9]=3  in function Os_Test_GetHWIO_e_LockSemaphore_test() in test_os_hwio.c file "); 
  TestStepAddActionExpected( chActionText, chExpectedText );
  E_DBGR_VariableCheck("Smsts_lock[9]", 3, Equal);
  
  snprintf( chActionText, elCount(chActionText), "check var Smsts_lock[10]=3  in function Os_Test_GetHWIO_e_LockSemaphore_test() in test_os_hwio.c file "); 
  snprintf( chExpectedText, elCount(chExpectedText), "Verify var Smsts_lock[10]=3  in function Os_Test_GetHWIO_e_LockSemaphore_test() in test_os_hwio.c file "); 
  TestStepAddActionExpected( chActionText, chExpectedText );
  E_DBGR_VariableCheck("Smsts_lock[10]", 3, Equal);
  
  snprintf( chActionText, elCount(chActionText), "check var Smsts_lock[11]=3  in function Os_Test_GetHWIO_e_LockSemaphore_test() in test_os_hwio.c file "); 
  snprintf( chExpectedText, elCount(chExpectedText), "Verify var Smsts_lock[11]=3  in function Os_Test_GetHWIO_e_LockSemaphore_test() in test_os_hwio.c file "); 
  TestStepAddActionExpected( chActionText, chExpectedText );
  E_DBGR_VariableCheck("Smsts_lock[11]", 3, Equal);
  
  snprintf( chActionText, elCount(chActionText), "check var Smsts_lock[12]=3  in function Os_Test_GetHWIO_e_LockSemaphore_test() in test_os_hwio.c file "); 
  snprintf( chExpectedText, elCount(chExpectedText), "Verify var Smsts_lock[12]=3  in function Os_Test_GetHWIO_e_LockSemaphore_test() in test_os_hwio.c file "); 
  TestStepAddActionExpected( chActionText, chExpectedText );
  E_DBGR_VariableCheck("Smsts_lock[12]", 3, Equal);
  
  snprintf( chActionText, elCount(chActionText), "check var Smsts_lock[13]=3  in function Os_Test_GetHWIO_e_LockSemaphore_test() in test_os_hwio.c file "); 
  snprintf( chExpectedText, elCount(chExpectedText), "Verify var Smsts_lock[13]=3  in function Os_Test_GetHWIO_e_LockSemaphore_test() in test_os_hwio.c file "); 
  TestStepAddActionExpected( chActionText, chExpectedText );
  E_DBGR_VariableCheck("Smsts_lock[13]", 3, Equal);
  
  snprintf( chActionText, elCount(chActionText), "check var Smsts_lock[14]=3  in function Os_Test_GetHWIO_e_LockSemaphore_test() in test_os_hwio.c file "); 
  snprintf( chExpectedText, elCount(chExpectedText), "Verify var Smsts_lock[14]=3  in function Os_Test_GetHWIO_e_LockSemaphore_test() in test_os_hwio.c file "); 
  TestStepAddActionExpected( chActionText, chExpectedText );
  E_DBGR_VariableCheck("Smsts_lock[14]", 3, Equal);
  
  snprintf( chActionText, elCount(chActionText), "check var Smsts_lock[15]=3  in function Os_Test_GetHWIO_e_LockSemaphore_test() in test_os_hwio.c file "); 
  snprintf( chExpectedText, elCount(chExpectedText), "Verify var Smsts_lock[15]=3  in function Os_Test_GetHWIO_e_LockSemaphore_test() in test_os_hwio.c file "); 
  TestStepAddActionExpected( chActionText, chExpectedText );
  E_DBGR_VariableCheck("Smsts_lock[15]", 3, Equal);
  
  snprintf( chActionText, elCount(chActionText), "check var Smsts_lock[16]=3  in function Os_Test_GetHWIO_e_LockSemaphore_test() in test_os_hwio.c file "); 
  snprintf( chExpectedText, elCount(chExpectedText), "Verify var Smsts_lock[16]=3  in function Os_Test_GetHWIO_e_LockSemaphore_test() in test_os_hwio.c file "); 
  TestStepAddActionExpected( chActionText, chExpectedText );
  E_DBGR_VariableCheck("Smsts_lock[16]", 3, Equal);
  
  snprintf( chActionText, elCount(chActionText), "check var Smsts_lock[17]=3  in function Os_Test_GetHWIO_e_LockSemaphore_test() in test_os_hwio.c file "); 
  snprintf( chExpectedText, elCount(chExpectedText), "Verify var Smsts_lock[17]=3  in function Os_Test_GetHWIO_e_LockSemaphore_test() in test_os_hwio.c file "); 
  TestStepAddActionExpected( chActionText, chExpectedText );
  E_DBGR_VariableCheck("Smsts_lock[17]", 3, Equal);
  
  snprintf( chActionText, elCount(chActionText), "check var Smsts_lock[18]=3  in function Os_Test_GetHWIO_e_LockSemaphore_test() in test_os_hwio.c file "); 
  snprintf( chExpectedText, elCount(chExpectedText), "Verify var Smsts_lock[18]=3  in function Os_Test_GetHWIO_e_LockSemaphore_test() in test_os_hwio.c file "); 
  TestStepAddActionExpected( chActionText, chExpectedText );
  E_DBGR_VariableCheck("Smsts_lock[18]", 3, Equal);
  
  snprintf( chActionText, elCount(chActionText), "check var Smsts_lock[19]=3  in function Os_Test_GetHWIO_e_LockSemaphore_test() in test_os_hwio.c file "); 
  snprintf( chExpectedText, elCount(chExpectedText), "Verify var Smsts_lock[19]=3  in function Os_Test_GetHWIO_e_LockSemaphore_test() in test_os_hwio.c file "); 
  TestStepAddActionExpected( chActionText, chExpectedText );
  E_DBGR_VariableCheck("Smsts_lock[19]", 3, Equal);
  
  
  snprintf( chActionText, elCount(chActionText), "check var Smsts_lock[20]=3  in function Os_Test_GetHWIO_e_LockSemaphore_test() in test_os_hwio.c file "); 
  snprintf( chExpectedText, elCount(chExpectedText), "Verify var Smsts_lock[20]=3  in function Os_Test_GetHWIO_e_LockSemaphore_test() in test_os_hwio.c file "); 
  TestStepAddActionExpected( chActionText, chExpectedText );
  E_DBGR_VariableCheck("Smsts_lock[20]", 3, Equal);
  
  
  snprintf( chActionText, elCount(chActionText), "check var Smsts_lock[21]=3  in function Os_Test_GetHWIO_e_LockSemaphore_test() in test_os_hwio.c file "); 
  snprintf( chExpectedText, elCount(chExpectedText), "Verify var Smsts_lock[21]=3  in function Os_Test_GetHWIO_e_LockSemaphore_test() in test_os_hwio.c file "); 
  TestStepAddActionExpected( chActionText, chExpectedText );
  E_DBGR_VariableCheck("Smsts_lock[21]", 3, Equal);
  
  
  snprintf( chActionText, elCount(chActionText), "check var Smsts_lock[22]=3  in function Os_Test_GetHWIO_e_LockSemaphore_test() in test_os_hwio.c file "); 
  snprintf( chExpectedText, elCount(chExpectedText), "Verify var Smsts_lock[22]=3  in function Os_Test_GetHWIO_e_LockSemaphore_test() in test_os_hwio.c file "); 
  TestStepAddActionExpected( chActionText, chExpectedText );
  E_DBGR_VariableCheck("Smsts_lock[22]", 3, Equal);
  
  
  snprintf( chActionText, elCount(chActionText), "check var Smsts_lock[23]=3  in function Os_Test_GetHWIO_e_LockSemaphore_test() in test_os_hwio.c file "); 
  snprintf( chExpectedText, elCount(chExpectedText), "Verify var Smsts_lock[23]=3  in function Os_Test_GetHWIO_e_LockSemaphore_test() in test_os_hwio.c file "); 
  TestStepAddActionExpected( chActionText, chExpectedText );
  E_DBGR_VariableCheck("Smsts_lock[23]", 3, Equal);
  
  
  snprintf( chActionText, elCount(chActionText), "check var Smsts_lock[24]=3  in function Os_Test_GetHWIO_e_LockSemaphore_test() in test_os_hwio.c file "); 
  snprintf( chExpectedText, elCount(chExpectedText), "Verify var Smsts_lock[24]=3  in function Os_Test_GetHWIO_e_LockSemaphore_test() in test_os_hwio.c file "); 
  TestStepAddActionExpected( chActionText, chExpectedText );
  E_DBGR_VariableCheck("Smsts_lock[24]", 3, Equal);
  
  
  snprintf( chActionText, elCount(chActionText), "check var Smsts_lock[25]=3  in function Os_Test_GetHWIO_e_LockSemaphore_test() in test_os_hwio.c file "); 
  snprintf( chExpectedText, elCount(chExpectedText), "Verify var Smsts_lock[25]=3  in function Os_Test_GetHWIO_e_LockSemaphore_test() in test_os_hwio.c file "); 
  TestStepAddActionExpected( chActionText, chExpectedText );
  E_DBGR_VariableCheck("Smsts_lock[25]", 3, Equal);
  
  
  snprintf( chActionText, elCount(chActionText), "check var Smsts_lock[26]=3  in function Os_Test_GetHWIO_e_LockSemaphore_test() in test_os_hwio.c file "); 
  snprintf( chExpectedText, elCount(chExpectedText), "Verify var Smsts_lock[26]=3  in function Os_Test_GetHWIO_e_LockSemaphore_test() in test_os_hwio.c file "); 
  TestStepAddActionExpected( chActionText, chExpectedText );
  E_DBGR_VariableCheck("Smsts_lock[26]", 3, Equal);
  
  
  snprintf( chActionText, elCount(chActionText), "check var Smsts_lock[27]=3  in function Os_Test_GetHWIO_e_LockSemaphore_test() in test_os_hwio.c file "); 
  snprintf( chExpectedText, elCount(chExpectedText), "Verify var Smsts_lock[27]=3  in function Os_Test_GetHWIO_e_LockSemaphore_test() in test_os_hwio.c file "); 
  TestStepAddActionExpected( chActionText, chExpectedText );
  E_DBGR_VariableCheck("Smsts_lock[27]", 3, Equal);
  
  snprintf( chActionText, elCount(chActionText), "check var Smsts_lock[28]=3  in function Os_Test_GetHWIO_e_LockSemaphore_test() in test_os_hwio.c file "); 
  snprintf( chExpectedText, elCount(chExpectedText), "Verify var Smsts_lock[28]=3  in function Os_Test_GetHWIO_e_LockSemaphore_test() in test_os_hwio.c file "); 
  TestStepAddActionExpected( chActionText, chExpectedText );
  E_DBGR_VariableCheck("Smsts_lock[28]", 3, Equal);
  
  
  snprintf( chActionText, elCount(chActionText), "check var Smsts_lock[29]=3  in function Os_Test_GetHWIO_e_LockSemaphore_test() in test_os_hwio.c file "); 
  snprintf( chExpectedText, elCount(chExpectedText), "Verify var Smsts_lock[29]=3  in function Os_Test_GetHWIO_e_LockSemaphore_test() in test_os_hwio.c file "); 
  TestStepAddActionExpected( chActionText, chExpectedText );
  E_DBGR_VariableCheck("Smsts_lock[29]", 3, Equal);
  
  
  snprintf( chActionText, elCount(chActionText), "check var Smsts_lock[30]=3  in function Os_Test_GetHWIO_e_LockSemaphore_test() in test_os_hwio.c file "); 
  snprintf( chExpectedText, elCount(chExpectedText), "Verify var Smsts_lock[30]=3  in function Os_Test_GetHWIO_e_LockSemaphore_test() in test_os_hwio.c file "); 
  TestStepAddActionExpected( chActionText, chExpectedText );
  E_DBGR_VariableCheck("Smsts_lock[30]", 3, Equal);
  
  
  snprintf( chActionText, elCount(chActionText), "check var Smsts_lock[31]=3  in function Os_Test_GetHWIO_e_LockSemaphore_test() in test_os_hwio.c file "); 
  snprintf( chExpectedText, elCount(chExpectedText), "Verify var Smsts_lock[31]=3  in function Os_Test_GetHWIO_e_LockSemaphore_test() in test_os_hwio.c file "); 
  TestStepAddActionExpected( chActionText, chExpectedText );
  E_DBGR_VariableCheck("Smsts_lock[31]", 3, Equal);
  
  
  
  
  /*******************************************************************************************************************************************************/    
    // Test Step 5: check var Smsts_unlock[semaphore]=0 for 32 index in function Os_Test_GetHWIO_e_LockSemaphore_test() in test_os_hwio.c file
  /*******************************************************************************************************************************************************/
  snprintf( chActionText, elCount(chActionText), "check var Smsts_unlock[0]=0  in function Os_Test_GetHWIO_e_LockSemaphore_test() in test_os_hwio.c file "); 
  snprintf( chExpectedText, elCount(chExpectedText), "Verify var Smsts_unlock[0]=0  in function Os_Test_GetHWIO_e_LockSemaphore_test() in test_os_hwio.c file "); 
  TestStepAddActionExpected( chActionText, chExpectedText );
  E_DBGR_VariableCheck("Smsts_unlock[0]", 0, Equal);
  
  snprintf( chActionText, elCount(chActionText), "check var Smsts_unlock[1]=0  in function Os_Test_GetHWIO_e_LockSemaphore_test() in test_os_hwio.c file "); 
  snprintf( chExpectedText, elCount(chExpectedText), "Verify var Smsts_unlock[1]=0  in function Os_Test_GetHWIO_e_LockSemaphore_test() in test_os_hwio.c file "); 
  TestStepAddActionExpected( chActionText, chExpectedText );
  E_DBGR_VariableCheck("Smsts_unlock[1]", 0, Equal);
  
  snprintf( chActionText, elCount(chActionText), "check var Smsts_unlock[2]=0  in function Os_Test_GetHWIO_e_LockSemaphore_test() in test_os_hwio.c file "); 
  snprintf( chExpectedText, elCount(chExpectedText), "Verify var Smsts_unlock[2]=0  in function Os_Test_GetHWIO_e_LockSemaphore_test() in test_os_hwio.c file "); 
  TestStepAddActionExpected( chActionText, chExpectedText );
  E_DBGR_VariableCheck("Smsts_unlock[2]", 0, Equal);
  
  snprintf( chActionText, elCount(chActionText), "check var Smsts_unlock[3]=0  in function Os_Test_GetHWIO_e_LockSemaphore_test() in test_os_hwio.c file "); 
  snprintf( chExpectedText, elCount(chExpectedText), "Verify var Smsts_unlock[3]=0  in function Os_Test_GetHWIO_e_LockSemaphore_test() in test_os_hwio.c file "); 
  TestStepAddActionExpected( chActionText, chExpectedText );
  E_DBGR_VariableCheck("Smsts_unlock[3]", 0, Equal);
  
  snprintf( chActionText, elCount(chActionText), "check var Smsts_unlock[4]=0  in function Os_Test_GetHWIO_e_LockSemaphore_test() in test_os_hwio.c file "); 
  snprintf( chExpectedText, elCount(chExpectedText), "Verify var Smsts_unlock[4]=0  in function Os_Test_GetHWIO_e_LockSemaphore_test() in test_os_hwio.c file "); 
  TestStepAddActionExpected( chActionText, chExpectedText );
  E_DBGR_VariableCheck("Smsts_unlock[4]", 0, Equal);
  
  snprintf( chActionText, elCount(chActionText), "check var Smsts_unlock[5]=0  in function Os_Test_GetHWIO_e_LockSemaphore_test() in test_os_hwio.c file "); 
  snprintf( chExpectedText, elCount(chExpectedText), "Verify var Smsts_unlock[5]=0  in function Os_Test_GetHWIO_e_LockSemaphore_test() in test_os_hwio.c file "); 
  TestStepAddActionExpected( chActionText, chExpectedText );
  E_DBGR_VariableCheck("Smsts_unlock[5]", 0, Equal);
  
  snprintf( chActionText, elCount(chActionText), "check var Smsts_unlock[6]=0  in function Os_Test_GetHWIO_e_LockSemaphore_test() in test_os_hwio.c file "); 
  snprintf( chExpectedText, elCount(chExpectedText), "Verify var Smsts_lock[6]=0  in function Os_Test_GetHWIO_e_LockSemaphore_test() in test_os_hwio.c file "); 
  TestStepAddActionExpected( chActionText, chExpectedText );
  E_DBGR_VariableCheck("Smsts_unlock[6]", 0, Equal);
  
  snprintf( chActionText, elCount(chActionText), "check var Smsts_unlock[7]=0  in function Os_Test_GetHWIO_e_LockSemaphore_test() in test_os_hwio.c file "); 
  snprintf( chExpectedText, elCount(chExpectedText), "Verify var Smsts_unlock[7]=0Smsts_unlock  in function Os_Test_GetHWIO_e_LockSemaphore_test() in test_os_hwio.c file "); 
  TestStepAddActionExpected( chActionText, chExpectedText );
  E_DBGR_VariableCheck("Smsts_unlock[7]", 0, Equal);
  
  snprintf( chActionText, elCount(chActionText), "check var Smsts_unlock[8]=0  in function Os_Test_GetHWIO_e_LockSemaphore_test() in test_os_hwio.c file "); 
  snprintf( chExpectedText, elCount(chExpectedText), "Verify var Smsts_unlock[8]=0  in function Os_Test_GetHWIO_e_LockSemaphore_test() in test_os_hwio.c file "); 
  TestStepAddActionExpected( chActionText, chExpectedText );
  E_DBGR_VariableCheck("Smsts_unlock[8]", 0, Equal);
  
  snprintf( chActionText, elCount(chActionText), "check var Smsts_unlock[9]=0  in function Os_Test_GetHWIO_e_LockSemaphore_test() in test_os_hwio.c file "); 
  snprintf( chExpectedText, elCount(chExpectedText), "Verify var Smsts_unlock[9]=0  in function Os_Test_GetHWIO_e_LockSemaphore_test() in test_os_hwio.c file "); 
  TestStepAddActionExpected( chActionText, chExpectedText );
  E_DBGR_VariableCheck("Smsts_unlock[9]", 0, Equal);
  
  snprintf( chActionText, elCount(chActionText), "check var Smsts_unlock[10]=0  in function Os_Test_GetHWIO_e_LockSemaphore_test() in test_os_hwio.c file "); 
  snprintf( chExpectedText, elCount(chExpectedText), "Verify var Smsts_unlock[10]=0  in function Os_Test_GetHWIO_e_LockSemaphore_test() in test_os_hwio.c file "); 
  TestStepAddActionExpected( chActionText, chExpectedText );
  E_DBGR_VariableCheck("Smsts_unlock[10]", 0, Equal);
  
  snprintf( chActionText, elCount(chActionText), "check var Smsts_unlock[11]=0  in function Os_Test_GetHWIO_e_LockSemaphore_test() in test_os_hwio.c file "); 
  snprintf( chExpectedText, elCount(chExpectedText), "Verify var Smsts_unlock[11]=0  in function Os_Test_GetHWIO_e_LockSemaphore_test() in test_os_hwio.c file "); 
  TestStepAddActionExpected( chActionText, chExpectedText );
  E_DBGR_VariableCheck("Smsts_unlock[11]", 0, Equal);
  
  snprintf( chActionText, elCount(chActionText), "check var Smsts_unlock[12]=0  in function Os_Test_GetHWIO_e_LockSemaphore_test() in test_os_hwio.c file "); 
  snprintf( chExpectedText, elCount(chExpectedText), "Verify var Smsts_unlock[12]=0  in function Os_Test_GetHWIO_e_LockSemaphore_test() in test_os_hwio.c file "); 
  TestStepAddActionExpected( chActionText, chExpectedText );
  E_DBGR_VariableCheck("Smsts_unlock[12]", 0, Equal);
  
  snprintf( chActionText, elCount(chActionText), "check var Smsts_unlock[13]=0  in function Os_Test_GetHWIO_e_LockSemaphore_test() in test_os_hwio.c file "); 
  snprintf( chExpectedText, elCount(chExpectedText), "Verify var Smsts_unlock[13]=0  in function Os_Test_GetHWIO_e_LockSemaphore_test() in test_os_hwio.c file "); 
  TestStepAddActionExpected( chActionText, chExpectedText );
  E_DBGR_VariableCheck("Smsts_unlock[13]", 0, Equal);
  
  snprintf( chActionText, elCount(chActionText), "check var Smsts_unlock[14]=0  in function Os_Test_GetHWIO_e_LockSemaphore_test() in test_os_hwio.c file "); 
  snprintf( chExpectedText, elCount(chExpectedText), "Verify var Smsts_unlock[14]=0  in function Os_Test_GetHWIO_e_LockSemaphore_test() in test_os_hwio.c file "); 
  TestStepAddActionExpected( chActionText, chExpectedText );
  E_DBGR_VariableCheck("Smsts_unlock[14]", 0, Equal);
  
  snprintf( chActionText, elCount(chActionText), "check var Smsts_unlock[15]=0  in function Os_Test_GetHWIO_e_LockSemaphore_test() in test_os_hwio.c file "); 
  snprintf( chExpectedText, elCount(chExpectedText), "Verify var Smsts_unlock[15]=0  in function Os_Test_GetHWIO_e_LockSemaphore_test() in test_os_hwio.c file "); 
  TestStepAddActionExpected( chActionText, chExpectedText );
  E_DBGR_VariableCheck("Smsts_unlock[15]", 0, Equal);
  
  snprintf( chActionText, elCount(chActionText), "check var Smsts_unlock[16]=0  in function Os_Test_GetHWIO_e_LockSemaphore_test() in test_os_hwio.c file "); 
  snprintf( chExpectedText, elCount(chExpectedText), "Verify var Smsts_unlock[16]=0  in function Os_Test_GetHWIO_e_LockSemaphore_test() in test_os_hwio.c file "); 
  TestStepAddActionExpected( chActionText, chExpectedText );
  E_DBGR_VariableCheck("Smsts_unlock[16]", 0, Equal);
  
  snprintf( chActionText, elCount(chActionText), "check var Smsts_unlock[17]=0  in function Os_Test_GetHWIO_e_LockSemaphore_test() in test_os_hwio.c file "); 
  snprintf( chExpectedText, elCount(chExpectedText), "Verify var Smsts_unlock[17]=0  in function Os_Test_GetHWIO_e_LockSemaphore_test() in test_os_hwio.c file "); 
  TestStepAddActionExpected( chActionText, chExpectedText );
  E_DBGR_VariableCheck("Smsts_unlock[17]", 0, Equal);
  
  snprintf( chActionText, elCount(chActionText), "check var Smsts_unlock[18]=0  in function Os_Test_GetHWIO_e_LockSemaphore_test() in test_os_hwio.c file "); 
  snprintf( chExpectedText, elCount(chExpectedText), "Verify var Smsts_unlock[18]=0  in function Os_Test_GetHWIO_e_LockSemaphore_test() in test_os_hwio.c file "); 
  TestStepAddActionExpected( chActionText, chExpectedText );
  E_DBGR_VariableCheck("Smsts_unlock[18]", 0, Equal);
  
  snprintf( chActionText, elCount(chActionText), "check var Smsts_unlock[19]=0  in function Os_Test_GetHWIO_e_LockSemaphore_test() in test_os_hwio.c file "); 
  snprintf( chExpectedText, elCount(chExpectedText), "Verify var Smsts_unlock[19]=0  in function Os_Test_GetHWIO_e_LockSemaphore_test() in test_os_hwio.c file "); 
  TestStepAddActionExpected( chActionText, chExpectedText );
  E_DBGR_VariableCheck("Smsts_unlock[19]", 0, Equal);
  
  
  snprintf( chActionText, elCount(chActionText), "check var Smsts_unlock[20]=0  in function Os_Test_GetHWIO_e_LockSemaphore_test() in test_os_hwio.c file "); 
  snprintf( chExpectedText, elCount(chExpectedText), "Verify var Smsts_unlock[20]=0  in function Os_Test_GetHWIO_e_LockSemaphore_test() in test_os_hwio.c file "); 
  TestStepAddActionExpected( chActionText, chExpectedText );
  E_DBGR_VariableCheck("Smsts_unlock[20]", 0, Equal);
  
  
  snprintf( chActionText, elCount(chActionText), "check var Smsts_unlock[21]=0  in function Os_Test_GetHWIO_e_LockSemaphore_test() in test_os_hwio.c file "); 
  snprintf( chExpectedText, elCount(chExpectedText), "Verify var Smsts_unlock[21]=0  in function Os_Test_GetHWIO_e_LockSemaphore_test() in test_os_hwio.c file "); 
  TestStepAddActionExpected( chActionText, chExpectedText );
  E_DBGR_VariableCheck("Smsts_unlock[21]", 0, Equal);
  
  
  snprintf( chActionText, elCount(chActionText), "check var Smsts_unlock[22]=0  in function Os_Test_GetHWIO_e_LockSemaphore_test() in test_os_hwio.c file "); 
  snprintf( chExpectedText, elCount(chExpectedText), "Verify var Smsts_unlock[22]=0  in function Os_Test_GetHWIO_e_LockSemaphore_test() in test_os_hwio.c file "); 
  TestStepAddActionExpected( chActionText, chExpectedText );
  E_DBGR_VariableCheck("Smsts_unlock[22]", 0, Equal);
  
  
  snprintf( chActionText, elCount(chActionText), "check var Smsts_unlock[23]=0  in function Os_Test_GetHWIO_e_LockSemaphore_test() in test_os_hwio.c file "); 
  snprintf( chExpectedText, elCount(chExpectedText), "Verify var Smsts_unlock[23]=0  in function Os_Test_GetHWIO_e_LockSemaphore_test() in test_os_hwio.c file "); 
  TestStepAddActionExpected( chActionText, chExpectedText );
  E_DBGR_VariableCheck("Smsts_unlock[23]", 0, Equal);
  
  
  snprintf( chActionText, elCount(chActionText), "check var Smsts_unlock[24]=0  in function Os_Test_GetHWIO_e_LockSemaphore_test() in test_os_hwio.c file "); 
  snprintf( chExpectedText, elCount(chExpectedText), "Verify var Smsts_unlock[24]=0  in function Os_Test_GetHWIO_e_LockSemaphore_test() in test_os_hwio.c file "); 
  TestStepAddActionExpected( chActionText, chExpectedText );
  E_DBGR_VariableCheck("Smsts_unlock[24]", 0, Equal);
  
  
  snprintf( chActionText, elCount(chActionText), "check var Smsts_unlock[25]=0  in function Os_Test_GetHWIO_e_LockSemaphore_test() in test_os_hwio.c file "); 
  snprintf( chExpectedText, elCount(chExpectedText), "Verify var Smsts_unloc[25]=3 0 in function Os_Test_GetHWIO_e_LockSemaphore_test() in test_os_hwio.c file "); 
  TestStepAddActionExpected( chActionText, chExpectedText );
  E_DBGR_VariableCheck("Smsts_unlock[25]", 0, Equal);
  
  
  snprintf( chActionText, elCount(chActionText), "check var Smsts_unlock[26]=0  in function Os_Test_GetHWIO_e_LockSemaphore_test() in test_os_hwio.c file "); 
  snprintf( chExpectedText, elCount(chExpectedText), "Verify var Smsts_unlock[26]=0  in function Os_Test_GetHWIO_e_LockSemaphore_test() in test_os_hwio.c file "); 
  TestStepAddActionExpected( chActionText, chExpectedText );
  E_DBGR_VariableCheck("Smsts_unlock[26]", 0, Equal);
  
  
  snprintf( chActionText, elCount(chActionText), "check var Smsts_unlock[27]=0  in function Os_Test_GetHWIO_e_LockSemaphore_test() in test_os_hwio.c file "); 
  snprintf( chExpectedText, elCount(chExpectedText), "Verify var Smsts_unlock[27]=0  in function Os_Test_GetHWIO_e_LockSemaphore_test() in test_os_hwio.c file "); 
  TestStepAddActionExpected( chActionText, chExpectedText );
  E_DBGR_VariableCheck("Smsts_unlock[27]", 0, Equal);
  
  snprintf( chActionText, elCount(chActionText), "check var Smsts_unlock[28]=0Smsts_unlock  in function Os_Test_GetHWIO_e_LockSemaphore_test() in test_os_hwio.c file "); 
  snprintf( chExpectedText, elCount(chExpectedText), "Verify var Smsts_unlock[28]=0  in function Os_Test_GetHWIO_e_LockSemaphore_test() in test_os_hwio.c file "); 
  TestStepAddActionExpected( chActionText, chExpectedText );
  E_DBGR_VariableCheck("Smsts_unlock[28]", 0, Equal);
  
  
  snprintf( chActionText, elCount(chActionText), "check var Smsts_unlock[29]=0  in function Os_Test_GetHWIO_e_LockSemaphore_test() in test_os_hwio.c file "); 
  snprintf( chExpectedText, elCount(chExpectedText), "Verify var Smsts_unlock[29]=0  in function Os_Test_GetHWIO_e_LockSemaphore_test() in test_os_hwio.c file "); 
  TestStepAddActionExpected( chActionText, chExpectedText );
  E_DBGR_VariableCheck("Smsts_unlock[29]", 0, Equal);
  
  
  snprintf( chActionText, elCount(chActionText), "check var Smsts_unlock[30]=0  in function Os_Test_GetHWIO_e_LockSemaphore_test() in test_os_hwio.c file "); 
  snprintf( chExpectedText, elCount(chExpectedText), "Verify var Smsts_unlock[30]=0  in function Os_Test_GetHWIO_e_LockSemaphore_test() in test_os_hwio.c file "); 
  TestStepAddActionExpected( chActionText, chExpectedText );
  E_DBGR_VariableCheck("Smsts_unlock[30]", 0, Equal);
  
  
  snprintf( chActionText, elCount(chActionText), "check var Smsts_unlock[31]=0  in function Os_Test_GetHWIO_e_LockSemaphore_test() in test_os_hwio.c file "); 
  snprintf( chExpectedText, elCount(chExpectedText), "Verify var Smsts_unlock[31]=0  in function Os_Test_GetHWIO_e_LockSemaphore_test() in test_os_hwio.c file "); 
  TestStepAddActionExpected( chActionText, chExpectedText );
  E_DBGR_VariableCheck("Smsts_unlock[31]", 0, Equal);
  
  
  
  
  /*******************************************************************************************************************************************************/    
    // Test Step 6: check var Smsts_status[semaphore]=3 for 32 index in function Os_Test_GetHWIO_e_LockSemaphore_test() in test_os_hwio.c file
  /*******************************************************************************************************************************************************/
  snprintf( chActionText, elCount(chActionText), "check var Smsts_status[0]=3  in function Os_Test_GetHWIO_e_LockSemaphore_test() in test_os_hwio.c file "); 
  snprintf( chExpectedText, elCount(chExpectedText), "Verify var Smsts_status[0]=3  in function Os_Test_GetHWIO_e_LockSemaphore_test() in test_os_hwio.c file "); 
  TestStepAddActionExpected( chActionText, chExpectedText );
  E_DBGR_VariableCheck("Smsts_status[0]", 3, Equal);
  
  snprintf( chActionText, elCount(chActionText), "check var Smsts_status[1]=3  in function Os_Test_GetHWIO_e_LockSemaphore_test() in test_os_hwio.c file "); 
  snprintf( chExpectedText, elCount(chExpectedText), "Verify var Smsts_status[1]=3  in function Os_Test_GetHWIO_e_LockSemaphore_test() in test_os_hwio.c file "); 
  TestStepAddActionExpected( chActionText, chExpectedText );
  E_DBGR_VariableCheck("Smsts_status[1]", 3, Equal);
  
  snprintf( chActionText, elCount(chActionText), "check var Smsts_status[2]=3  in function Os_Test_GetHWIO_e_LockSemaphore_test() in test_os_hwio.c file "); 
  snprintf( chExpectedText, elCount(chExpectedText), "Verify var Smsts_status[2]=3  in function Os_Test_GetHWIO_e_LockSemaphore_test() in test_os_hwio.c file "); 
  TestStepAddActionExpected( chActionText, chExpectedText );
  E_DBGR_VariableCheck("Smsts_status[2]", 3, Equal);
  
  snprintf( chActionText, elCount(chActionText), "check var Smsts_status[3]=3  in function Os_Test_GetHWIO_e_LockSemaphore_test() in test_os_hwio.c file "); 
  snprintf( chExpectedText, elCount(chExpectedText), "Verify var Smsts_status[3]=3  in function Os_Test_GetHWIO_e_LockSemaphore_test() in test_os_hwio.c file "); 
  TestStepAddActionExpected( chActionText, chExpectedText );
  E_DBGR_VariableCheck("Smsts_status[3]", 3, Equal);
  
  snprintf( chActionText, elCount(chActionText), "check var Smsts_status[4]=3  in function Os_Test_GetHWIO_e_LockSemaphore_test() in test_os_hwio.c file "); 
  snprintf( chExpectedText, elCount(chExpectedText), "Verify var Smsts_status[4]=3  in function Os_Test_GetHWIO_e_LockSemaphore_test() in test_os_hwio.c file "); 
  TestStepAddActionExpected( chActionText, chExpectedText );
  E_DBGR_VariableCheck("Smsts_status[4]", 3, Equal);
  
  snprintf( chActionText, elCount(chActionText), "check var Smsts_status[5]=3  in function Os_Test_GetHWIO_e_LockSemaphore_test() in test_os_hwio.c file "); 
  snprintf( chExpectedText, elCount(chExpectedText), "Verify var Smsts_status[5]=3  in function Os_Test_GetHWIO_e_LockSemaphore_test() in test_os_hwio.c file "); 
  TestStepAddActionExpected( chActionText, chExpectedText );
  E_DBGR_VariableCheck("Smsts_status[5]", 3, Equal);
  
  snprintf( chActionText, elCount(chActionText), "check var Smsts_status[6]=3  in function Os_Test_GetHWIO_e_LockSemaphore_test() in test_os_hwio.c file "); 
  snprintf( chExpectedText, elCount(chExpectedText), "Verify var Smsts_status[6]=3  in function Os_Test_GetHWIO_e_LockSemaphore_test() in test_os_hwio.c file "); 
  TestStepAddActionExpected( chActionText, chExpectedText );
  E_DBGR_VariableCheck("Smsts_status[6]", 3, Equal);
  
  snprintf( chActionText, elCount(chActionText), "check var Smsts_status[7]=3  in function Os_Test_GetHWIO_e_LockSemaphore_test() in test_os_hwio.c file "); 
  snprintf( chExpectedText, elCount(chExpectedText), "Verify var Smsts_status[7]=3  in function Os_Test_GetHWIO_e_LockSemaphore_test() in test_os_hwio.c file "); 
  TestStepAddActionExpected( chActionText, chExpectedText );
  E_DBGR_VariableCheck("Smsts_status[7]", 3, Equal);
  
  snprintf( chActionText, elCount(chActionText), "check var Smsts_status[8]=3  in function Os_Test_GetHWIO_e_LockSemaphore_test() in test_os_hwio.c file "); 
  snprintf( chExpectedText, elCount(chExpectedText), "Verify var Smsts_status[8]=3  in function Os_Test_GetHWIO_e_LockSemaphore_test() in test_os_hwio.c file "); 
  TestStepAddActionExpected( chActionText, chExpectedText );
  E_DBGR_VariableCheck("Smsts_status[8]", 3, Equal);
  
  snprintf( chActionText, elCount(chActionText), "check var Smsts_status[9]=3  in function Os_Test_GetHWIO_e_LockSemaphore_test() in test_os_hwio.c file "); 
  snprintf( chExpectedText, elCount(chExpectedText), "Verify var Smsts_status[9]=3  in function Os_Test_GetHWIO_e_LockSemaphore_test() in test_os_hwio.c file "); 
  TestStepAddActionExpected( chActionText, chExpectedText );
  E_DBGR_VariableCheck("Smsts_status[9]", 3, Equal);
  
  snprintf( chActionText, elCount(chActionText), "check var Smsts_status[10]=3  in function Os_Test_GetHWIO_e_LockSemaphore_test() in test_os_hwio.c file "); 
  snprintf( chExpectedText, elCount(chExpectedText), "Verify var Smsts_status[10]=3  in function Os_Test_GetHWIO_e_LockSemaphore_test() in test_os_hwio.c file "); 
  TestStepAddActionExpected( chActionText, chExpectedText );
  E_DBGR_VariableCheck("Smsts_status[10]", 3, Equal);
  
  snprintf( chActionText, elCount(chActionText), "check var Smsts_status[11]=3  in function Os_Test_GetHWIO_e_LockSemaphore_test() in test_os_hwio.c file "); 
  snprintf( chExpectedText, elCount(chExpectedText), "Verify var Smsts_status[11]=3  in function Os_Test_GetHWIO_e_LockSemaphore_test() in test_os_hwio.c file "); 
  TestStepAddActionExpected( chActionText, chExpectedText );
  E_DBGR_VariableCheck("Smsts_status[11]", 3, Equal);
  
  snprintf( chActionText, elCount(chActionText), "check var Smsts_status[12]=3  in function Os_Test_GetHWIO_e_LockSemaphore_test() in test_os_hwio.c file "); 
  snprintf( chExpectedText, elCount(chExpectedText), "Verify var Smsts_status[12]=3  in function Os_Test_GetHWIO_e_LockSemaphore_test() in test_os_hwio.c file "); 
  TestStepAddActionExpected( chActionText, chExpectedText );
  E_DBGR_VariableCheck("Smsts_status[12]", 3, Equal);
  
  snprintf( chActionText, elCount(chActionText), "check var Smsts_status[13]=3  in function Os_Test_GetHWIO_e_LockSemaphore_test() in test_os_hwio.c file "); 
  snprintf( chExpectedText, elCount(chExpectedText), "Verify var Smsts_status[13]=3  in function Os_Test_GetHWIO_e_LockSemaphore_test() in test_os_hwio.c file "); 
  TestStepAddActionExpected( chActionText, chExpectedText );
  E_DBGR_VariableCheck("Smsts_status[13]", 3, Equal);
  
  snprintf( chActionText, elCount(chActionText), "check var Smsts_status[14]=3  in function Os_Test_GetHWIO_e_LockSemaphore_test() in test_os_hwio.c file "); 
  snprintf( chExpectedText, elCount(chExpectedText), "Verify var Smsts_status[14]=3  in function Os_Test_GetHWIO_e_LockSemaphore_test() in test_os_hwio.c file "); 
  TestStepAddActionExpected( chActionText, chExpectedText );
  E_DBGR_VariableCheck("Smsts_status[14]", 3, Equal);
  
  snprintf( chActionText, elCount(chActionText), "check var Smsts_status[15]=3  in function Os_Test_GetHWIO_e_LockSemaphore_test() in test_os_hwio.c file "); 
  snprintf( chExpectedText, elCount(chExpectedText), "Verify var Smsts_status[15]=3  in function Os_Test_GetHWIO_e_LockSemaphore_test() in test_os_hwio.c file "); 
  TestStepAddActionExpected( chActionText, chExpectedText );
  E_DBGR_VariableCheck("Smsts_status[15]", 3, Equal);
  
  snprintf( chActionText, elCount(chActionText), "check var Smsts_status[16]=3  in function Os_Test_GetHWIO_e_LockSemaphore_test() in test_os_hwio.c file "); 
  snprintf( chExpectedText, elCount(chExpectedText), "Verify var Smsts_status[16]=3  in function Os_Test_GetHWIO_e_LockSemaphore_test() in test_os_hwio.c file "); 
  TestStepAddActionExpected( chActionText, chExpectedText );
  E_DBGR_VariableCheck("Smsts_status[16]", 3, Equal);
  
  snprintf( chActionText, elCount(chActionText), "check var Smsts_status[17]=3  in function Os_Test_GetHWIO_e_LockSemaphore_test() in test_os_hwio.c file "); 
  snprintf( chExpectedText, elCount(chExpectedText), "Verify var Smsts_status[17]=3  in function Os_Test_GetHWIO_e_LockSemaphore_test() in test_os_hwio.c file "); 
  TestStepAddActionExpected( chActionText, chExpectedText );
  E_DBGR_VariableCheck("Smsts_status[17]", 3, Equal);
  
  snprintf( chActionText, elCount(chActionText), "check var Smsts_status[18]=3  in function Os_Test_GetHWIO_e_LockSemaphore_test() in test_os_hwio.c file "); 
  snprintf( chExpectedText, elCount(chExpectedText), "Verify var Smsts_status[18]=3  in function Os_Test_GetHWIO_e_LockSemaphore_test() in test_os_hwio.c file "); 
  TestStepAddActionExpected( chActionText, chExpectedText );
  E_DBGR_VariableCheck("Smsts_status[18]", 3, Equal);
  
  snprintf( chActionText, elCount(chActionText), "check var Smsts_status[19]=3  in function Os_Test_GetHWIO_e_LockSemaphore_test() in test_os_hwio.c file "); 
  snprintf( chExpectedText, elCount(chExpectedText), "Verify var Smsts_status[19]=3  in function Os_Test_GetHWIO_e_LockSemaphore_test() in test_os_hwio.c file "); 
  TestStepAddActionExpected( chActionText, chExpectedText );
  E_DBGR_VariableCheck("Smsts_status[19]", 3, Equal);
  
  
  snprintf( chActionText, elCount(chActionText), "check var Smsts_status[20]=3  in function Os_Test_GetHWIO_e_LockSemaphore_test() in test_os_hwio.c file "); 
  snprintf( chExpectedText, elCount(chExpectedText), "Verify var Smsts_status[20]=3  in function Os_Test_GetHWIO_e_LockSemaphore_test() in test_os_hwio.c file "); 
  TestStepAddActionExpected( chActionText, chExpectedText );
  E_DBGR_VariableCheck("Smsts_status[20]", 3, Equal);
  
  
  snprintf( chActionText, elCount(chActionText), "check var Smsts_status[21]=3  in function Os_Test_GetHWIO_e_LockSemaphore_test() in test_os_hwio.c file "); 
  snprintf( chExpectedText, elCount(chExpectedText), "Verify var Smsts_status[21]=3  in function Os_Test_GetHWIO_e_LockSemaphore_test() in test_os_hwio.c file "); 
  TestStepAddActionExpected( chActionText, chExpectedText );
  E_DBGR_VariableCheck("Smsts_status[21]", 3, Equal);
  
  
  snprintf( chActionText, elCount(chActionText), "check var Smsts_status[22]=3  in function Os_Test_GetHWIO_e_LockSemaphore_test() in test_os_hwio.c file "); 
  snprintf( chExpectedText, elCount(chExpectedText), "Verify var Smsts_status[22]=3  in function Os_Test_GetHWIO_e_LockSemaphore_test() in test_os_hwio.c file "); 
  TestStepAddActionExpected( chActionText, chExpectedText );
  E_DBGR_VariableCheck("Smsts_status[22]", 3, Equal);
  
  
  snprintf( chActionText, elCount(chActionText), "check var Smsts_status[23]=3  in function Os_Test_GetHWIO_e_LockSemaphore_test() in test_os_hwio.c file "); 
  snprintf( chExpectedText, elCount(chExpectedText), "Verify var Smsts_status[23]=3  in function Os_Test_GetHWIO_e_LockSemaphore_test() in test_os_hwio.c file "); 
  TestStepAddActionExpected( chActionText, chExpectedText );
  E_DBGR_VariableCheck("Smsts_status[23]", 3, Equal);
  
  
  snprintf( chActionText, elCount(chActionText), "check var Smsts_status[24]=3  in function Os_Test_GetHWIO_e_LockSemaphore_test() in test_os_hwio.c file "); 
  snprintf( chExpectedText, elCount(chExpectedText), "Verify var Smsts_status[24]=3  in function Os_Test_GetHWIO_e_LockSemaphore_test() in test_os_hwio.c file "); 
  TestStepAddActionExpected( chActionText, chExpectedText );
  E_DBGR_VariableCheck("Smsts_status[24]", 3, Equal);
  
  
  snprintf( chActionText, elCount(chActionText), "check var Smsts_lock[25]=3  in function Os_Test_GetHWIO_e_LockSemaphore_test() in test_os_hwio.c file "); 
  snprintf( chExpectedText, elCount(chExpectedText), "Verify var Smsts_lock[25]=3  in function Os_Test_GetHWIO_e_LockSemaphore_test() in test_os_hwio.c file "); 
  TestStepAddActionExpected( chActionText, chExpectedText );
  E_DBGR_VariableCheck("Smsts_status[25]", 3, Equal);
  
  
  snprintf( chActionText, elCount(chActionText), "check var Smsts_status[26]=3  in function Os_Test_GetHWIO_e_LockSemaphore_test() in test_os_hwio.c file "); 
  snprintf( chExpectedText, elCount(chExpectedText), "Verify var Smsts_status[26]=3  in function Os_Test_GetHWIO_e_LockSemaphore_test() in test_os_hwio.c file "); 
  TestStepAddActionExpected( chActionText, chExpectedText );
  E_DBGR_VariableCheck("Smsts_status[26]", 3, Equal);
  
  
  snprintf( chActionText, elCount(chActionText), "check var Smsts_status[27]=3  in function Os_Test_GetHWIO_e_LockSemaphore_test() in test_os_hwio.c file "); 
  snprintf( chExpectedText, elCount(chExpectedText), "Verify var Smsts_status[27]=3  in function Os_Test_GetHWIO_e_LockSemaphore_test() in test_os_hwio.c file "); 
  TestStepAddActionExpected( chActionText, chExpectedText );
  E_DBGR_VariableCheck("Smsts_status[27]", 3, Equal);
  
  snprintf( chActionText, elCount(chActionText), "check var Smsts_status[28]=3  in function Os_Test_GetHWIO_e_LockSemaphore_test() in test_os_hwio.c file "); 
  snprintf( chExpectedText, elCount(chExpectedText), "Verify var Smsts_status[28]=3  in function Os_Test_GetHWIO_e_LockSemaphore_test() in test_os_hwio.c file "); 
  TestStepAddActionExpected( chActionText, chExpectedText );
  E_DBGR_VariableCheck("Smsts_status[28]", 3, Equal);
  
  
  snprintf( chActionText, elCount(chActionText), "check var Smsts_status[29]=3  in function Os_Test_GetHWIO_e_LockSemaphore_test() in test_os_hwio.c file "); 
  snprintf( chExpectedText, elCount(chExpectedText), "Verify var Smsts_status[29]=3  in function Os_Test_GetHWIO_e_LockSemaphore_test() in test_os_hwio.c file "); 
  TestStepAddActionExpected( chActionText, chExpectedText );
  E_DBGR_VariableCheck("Smsts_status[29]", 3, Equal);
  
  
  snprintf( chActionText, elCount(chActionText), "check var Smsts_status[30]=3  in function Os_Test_GetHWIO_e_LockSemaphore_test() in test_os_hwio.c file "); 
  snprintf( chExpectedText, elCount(chExpectedText), "Verify var Smsts_status[30]=3  in function Os_Test_GetHWIO_e_LockSemaphore_test() in test_os_hwio.c file "); 
  TestStepAddActionExpected( chActionText, chExpectedText );
  E_DBGR_VariableCheck("Smsts_status[30]", 3, Equal);
  
  
  snprintf( chActionText, elCount(chActionText), "check var Smsts_status[31]=3  in function Os_Test_GetHWIO_e_LockSemaphore_test() in test_os_hwio.c file "); 
  snprintf( chExpectedText, elCount(chExpectedText), "Verify var Smsts_status[31]=3  in function Os_Test_GetHWIO_e_LockSemaphore_test() in test_os_hwio.c file "); 
  TestStepAddActionExpected( chActionText, chExpectedText );
  E_DBGR_VariableCheck("Smsts_status[31]", 3, Equal);
  
  
  
  
  
  
}





/***************************************************************************************************
----------------------------------------------------------------------------------------------------
Test case name:  TC_L30SW_QT_36651207: verify_the_functionality_of_interface_to_check_lock_unlock_status_for_all_31_Semaphore_IDS_for_CPU3
----------------------------------------------------------------------------------------------------
Description:  Test_case_to_verify_the_functionality_of_interface_to_check_lock_unlock_status_for_all_31_Semaphore_IDS_for_CPU3

***************************************************************************************************/




testcase verify_the_functionality_of_interface_to_check_lock_unlock_status_for_all_31_Semaphore_IDS_for_CPU3()
{
  /***************************************************************************************************************/    
                                                // Variable Definition
  /***************************************************************************************************************/ 
  
  long taskvalue;
  
  /***************************************************************************************************************/    
                                               // Local Values
  /***************************************************************************************************************/ 
  

  
  /***************************************************************************************************************/    
                                              // Test Case Info
  /***************************************************************************************************************/
  setWriteDbgLevel(DebugOff);
  snprintf( chTestTitle, elCount(chTestTitle), "Test_case_to_verify_the_functionality_of_interface_to_check_lock_unlock_status_for_all_31_Semaphore_IDS_for_CPU3" );
  snprintf( chTestDescription, elCount(chTestDescription), "Purpose:Test_case_to_verify_the_functionality_of_interface_to_check_lock_unlock_status_for_all_31_Semaphore_IDS_for_CPU3.");
  TestCaseAddInfo( chTestTitle, "TC_L30SW_QT_36651207", chTestDescription );

  /***************************************************************************************************************/    
                                              // Start of Test Case
  /***************************************************************************************************************/
  
  /***************************************************************************************************************/    
                                              // Test Step 1 PRECONDITIONS
  /***************************************************************************************************************/
  
  snprintf( chActionText, elCount(chActionText), "Flash the Software and ECU is running"); 
  snprintf( chExpectedText, elCount(chExpectedText), "ECU should be in running state"); 
  TestStepAddActionExpected( chActionText, chExpectedText );

  A_DBGR_BreakpointDeleteAll();
  A_DBGR_RnGo();
  E_DBGR_CheckState(T32_State_Running);
  

   /***************************************************************************************************************/    
            // Test Step 2: Check all cores are in running state                                   
  /***************************************************************************************************************/
  
  //Check core0 is running
  snprintf( chActionText, elCount(chActionText), "Check 1000ms Task Counter from core0 "); 
  snprintf( chExpectedText, elCount(chExpectedText), "1000ms Counter from core0 is incrementing"); 
  TestStepAddActionExpected( chActionText, chExpectedText );
  A_DBGR_VariableRead( "Task_Core0_1000ms_Count", taskvalue);
  E_DBGR_VariableCheck("Task_Core0_1000ms_Count", taskvalue, Greater);
  
  //Check Core1 is running
  snprintf( chActionText, elCount(chActionText), "Check 1000ms Task Counter from Core1 "); 
  snprintf( chExpectedText, elCount(chExpectedText), "1000ms Counter from Core1 is incrementing"); 
  TestStepAddActionExpected( chActionText, chExpectedText );
  A_DBGR_VariableRead( "Task_Core1_1000ms_Count", taskvalue);
  E_DBGR_VariableCheck("Task_Core1_1000ms_Count", taskvalue, Greater);
  
  //Check Core2 is running
  snprintf( chActionText, elCount(chActionText), "Check 1000ms Task Counter from Core2 "); 
  snprintf( chExpectedText, elCount(chExpectedText), "1000ms Counter from Core2 is incrementing"); 
  TestStepAddActionExpected( chActionText, chExpectedText );
  A_DBGR_VariableRead( "Task_Core2_1000ms_Count", taskvalue);
  E_DBGR_VariableCheck("Task_Core2_1000ms_Count", taskvalue, Greater);
    
  //Check Core3 is running
  snprintf( chActionText, elCount(chActionText), "Check 1000ms Task Counter from Core3 "); 
  snprintf( chExpectedText, elCount(chExpectedText), "1000ms Counter from Core3 is incrementing"); 
  TestStepAddActionExpected( chActionText, chExpectedText );
  A_DBGR_VariableRead( "Task_Core3_1000ms_Count", taskvalue);
  E_DBGR_VariableCheck("Task_Core3_1000ms_Count", taskvalue, Greater);
    
  //Check Core4 is running
  snprintf( chActionText, elCount(chActionText), "Check 1000ms Task Counter from Core4 "); 
  snprintf( chExpectedText, elCount(chExpectedText), "1000ms Counter from Core4 is incrementing"); 
  TestStepAddActionExpected( chActionText, chExpectedText );
  A_DBGR_VariableRead( "Task_Core4_1000ms_Count", taskvalue);
  E_DBGR_VariableCheck("Task_Core4_1000ms_Count", taskvalue, Greater);
    
  //Check Core5 is running
  snprintf( chActionText, elCount(chActionText), "Check 1000ms Task Counter from Core5 "); 
  snprintf( chExpectedText, elCount(chExpectedText), "1000ms Counter from Core5 is incrementing"); 
  TestStepAddActionExpected( chActionText, chExpectedText );
  A_DBGR_VariableRead( "Task_Core5_1000ms_Count", taskvalue);
  E_DBGR_VariableCheck("Task_Core5_1000ms_Count", taskvalue, Greater);
  
  /*******************************************************************************************************************************************************/    
    // Test Step 3: Set flag lock_unlock_status_flag_core3=1 to check semaphore lock for core3 in function TestApp_Core3_1000ms_MainFunction
  /*******************************************************************************************************************************************************/

  snprintf( chActionText, elCount(chActionText), "Set flag lock_unlock_status_flag_core3=1 to check semaphore lock for core3 in function TestApp_core2_1000ms_MainFunction "); 
  snprintf( chExpectedText, elCount(chExpectedText), "Verify flag lock_unlock_status_flag_core3=1 to check semaphore lock for core3 in function TestApp_core2_1000ms_MainFunction "); 
  TestStepAddActionExpected( chActionText, chExpectedText );
   A_DBGR_RnGo();
  A_DBGR_VariableSet("lock_unlock_status_flag_core3", "1");
  E_DBGR_VariableCheck("lock_unlock_status_flag_core3", 1, Equal);


  
  
  

  /*******************************************************************************************************************************************************/    
    // Test Step 4: check var Smsts_lock[semaphore]=4 for 32 index in function Os_Test_GetHWIO_e_LockSemaphore_test() in test_os_hwio.c file
  /*******************************************************************************************************************************************************/
  snprintf( chActionText, elCount(chActionText), "check var Smsts_lock[0]=4  in function Os_Test_GetHWIO_e_LockSemaphore_test() in test_os_hwio.c file "); 
  snprintf( chExpectedText, elCount(chExpectedText), "Verify var Smsts_lock[0]=4  in function Os_Test_GetHWIO_e_LockSemaphore_test() in test_os_hwio.c file "); 
  TestStepAddActionExpected( chActionText, chExpectedText );
  E_DBGR_VariableCheck("Smsts_lock[0]", 4, Equal);
  
  snprintf( chActionText, elCount(chActionText), "check var Smsts_lock[1]=4  in function Os_Test_GetHWIO_e_LockSemaphore_test() in test_os_hwio.c file "); 
  snprintf( chExpectedText, elCount(chExpectedText), "Verify var Smsts_lock[1]=4  in function Os_Test_GetHWIO_e_LockSemaphore_test() in test_os_hwio.c file "); 
  TestStepAddActionExpected( chActionText, chExpectedText );
  E_DBGR_VariableCheck("Smsts_lock[1]", 4, Equal);
  
  snprintf( chActionText, elCount(chActionText), "check var Smsts_lock[2]=4  in function Os_Test_GetHWIO_e_LockSemaphore_test() in test_os_hwio.c file "); 
  snprintf( chExpectedText, elCount(chExpectedText), "Verify var Smsts_lock[2]=4  in function Os_Test_GetHWIO_e_LockSemaphore_test() in test_os_hwio.c file "); 
  TestStepAddActionExpected( chActionText, chExpectedText );
  E_DBGR_VariableCheck("Smsts_lock[2]", 4, Equal);
  
  snprintf( chActionText, elCount(chActionText), "check var Smsts_lock[3]=4  in function Os_Test_GetHWIO_e_LockSemaphore_test() in test_os_hwio.c file "); 
  snprintf( chExpectedText, elCount(chExpectedText), "Verify var Smsts_lock[3]=4  in function Os_Test_GetHWIO_e_LockSemaphore_test() in test_os_hwio.c file "); 
  TestStepAddActionExpected( chActionText, chExpectedText );
  E_DBGR_VariableCheck("Smsts_lock[3]", 4, Equal);
  
  snprintf( chActionText, elCount(chActionText), "check var Smsts_lock[4]=4  in function Os_Test_GetHWIO_e_LockSemaphore_test() in test_os_hwio.c file "); 
  snprintf( chExpectedText, elCount(chExpectedText), "Verify var Smsts_lock[4]=4  in function Os_Test_GetHWIO_e_LockSemaphore_test() in test_os_hwio.c file "); 
  TestStepAddActionExpected( chActionText, chExpectedText );
  E_DBGR_VariableCheck("Smsts_lock[4]", 4, Equal);
  
  snprintf( chActionText, elCount(chActionText), "check var Smsts_lock[5]=4  in function Os_Test_GetHWIO_e_LockSemaphore_test() in test_os_hwio.c file "); 
  snprintf( chExpectedText, elCount(chExpectedText), "Verify var Smsts_lock[5]=4  in function Os_Test_GetHWIO_e_LockSemaphore_test() in test_os_hwio.c file "); 
  TestStepAddActionExpected( chActionText, chExpectedText );
  E_DBGR_VariableCheck("Smsts_lock[5]", 4, Equal);
  
  snprintf( chActionText, elCount(chActionText), "check var Smsts_lock[6]=4  in function Os_Test_GetHWIO_e_LockSemaphore_test() in test_os_hwio.c file "); 
  snprintf( chExpectedText, elCount(chExpectedText), "Verify var Smsts_lock[6]=4  in function Os_Test_GetHWIO_e_LockSemaphore_test() in test_os_hwio.c file "); 
  TestStepAddActionExpected( chActionText, chExpectedText );
  E_DBGR_VariableCheck("Smsts_lock[6]", 4, Equal);
  
  snprintf( chActionText, elCount(chActionText), "check var Smsts_lock[7]=4  in function Os_Test_GetHWIO_e_LockSemaphore_test() in test_os_hwio.c file "); 
  snprintf( chExpectedText, elCount(chExpectedText), "Verify var Smsts_lock[7]=4  in function Os_Test_GetHWIO_e_LockSemaphore_test() in test_os_hwio.c file "); 
  TestStepAddActionExpected( chActionText, chExpectedText );
  E_DBGR_VariableCheck("Smsts_lock[7]", 4, Equal);
  
  snprintf( chActionText, elCount(chActionText), "check var Smsts_lock[8]=4  in function Os_Test_GetHWIO_e_LockSemaphore_test() in test_os_hwio.c file "); 
  snprintf( chExpectedText, elCount(chExpectedText), "Verify var Smsts_lock[8]=4  in function Os_Test_GetHWIO_e_LockSemaphore_test() in test_os_hwio.c file "); 
  TestStepAddActionExpected( chActionText, chExpectedText );
  E_DBGR_VariableCheck("Smsts_lock[8]", 4, Equal);
  
  snprintf( chActionText, elCount(chActionText), "check var Smsts_lock[9]=4  in function Os_Test_GetHWIO_e_LockSemaphore_test() in test_os_hwio.c file "); 
  snprintf( chExpectedText, elCount(chExpectedText), "Verify var Smsts_lock[9]=4  in function Os_Test_GetHWIO_e_LockSemaphore_test() in test_os_hwio.c file "); 
  TestStepAddActionExpected( chActionText, chExpectedText );
  E_DBGR_VariableCheck("Smsts_lock[9]", 4, Equal);
  
  snprintf( chActionText, elCount(chActionText), "check var Smsts_lock[10]=4  in function Os_Test_GetHWIO_e_LockSemaphore_test() in test_os_hwio.c file "); 
  snprintf( chExpectedText, elCount(chExpectedText), "Verify var Smsts_lock[10]=4  in function Os_Test_GetHWIO_e_LockSemaphore_test() in test_os_hwio.c file "); 
  TestStepAddActionExpected( chActionText, chExpectedText );
  E_DBGR_VariableCheck("Smsts_lock[10]", 4, Equal);
  
  snprintf( chActionText, elCount(chActionText), "check var Smsts_lock[11]=4  in function Os_Test_GetHWIO_e_LockSemaphore_test() in test_os_hwio.c file "); 
  snprintf( chExpectedText, elCount(chExpectedText), "Verify var Smsts_lock[11]=4  in function Os_Test_GetHWIO_e_LockSemaphore_test() in test_os_hwio.c file "); 
  TestStepAddActionExpected( chActionText, chExpectedText );
  E_DBGR_VariableCheck("Smsts_lock[11]", 4, Equal);
  
  snprintf( chActionText, elCount(chActionText), "check var Smsts_lock[12]=4  in function Os_Test_GetHWIO_e_LockSemaphore_test() in test_os_hwio.c file "); 
  snprintf( chExpectedText, elCount(chExpectedText), "Verify var Smsts_lock[12]=4  in function Os_Test_GetHWIO_e_LockSemaphore_test() in test_os_hwio.c file "); 
  TestStepAddActionExpected( chActionText, chExpectedText );
  E_DBGR_VariableCheck("Smsts_lock[12]", 4, Equal);
  
  snprintf( chActionText, elCount(chActionText), "check var Smsts_lock[13]=4  in function Os_Test_GetHWIO_e_LockSemaphore_test() in test_os_hwio.c file "); 
  snprintf( chExpectedText, elCount(chExpectedText), "Verify var Smsts_lock[13]=4  in function Os_Test_GetHWIO_e_LockSemaphore_test() in test_os_hwio.c file "); 
  TestStepAddActionExpected( chActionText, chExpectedText );
  E_DBGR_VariableCheck("Smsts_lock[13]", 4, Equal);
  
  snprintf( chActionText, elCount(chActionText), "check var Smsts_lock[14]=4  in function Os_Test_GetHWIO_e_LockSemaphore_test() in test_os_hwio.c file "); 
  snprintf( chExpectedText, elCount(chExpectedText), "Verify var Smsts_lock[14]=4  in function Os_Test_GetHWIO_e_LockSemaphore_test() in test_os_hwio.c file "); 
  TestStepAddActionExpected( chActionText, chExpectedText );
  E_DBGR_VariableCheck("Smsts_lock[14]", 4, Equal);
  
  snprintf( chActionText, elCount(chActionText), "check var Smsts_lock[15]=4  in function Os_Test_GetHWIO_e_LockSemaphore_test() in test_os_hwio.c file "); 
  snprintf( chExpectedText, elCount(chExpectedText), "Verify var Smsts_lock[15]=4  in function Os_Test_GetHWIO_e_LockSemaphore_test() in test_os_hwio.c file "); 
  TestStepAddActionExpected( chActionText, chExpectedText );
  E_DBGR_VariableCheck("Smsts_lock[15]", 4, Equal);
  
  snprintf( chActionText, elCount(chActionText), "check var Smsts_lock[16]=4  in function Os_Test_GetHWIO_e_LockSemaphore_test() in test_os_hwio.c file "); 
  snprintf( chExpectedText, elCount(chExpectedText), "Verify var Smsts_lock[16]=4  in function Os_Test_GetHWIO_e_LockSemaphore_test() in test_os_hwio.c file "); 
  TestStepAddActionExpected( chActionText, chExpectedText );
  E_DBGR_VariableCheck("Smsts_lock[16]", 4, Equal);
  
  snprintf( chActionText, elCount(chActionText), "check var Smsts_lock[17]=4  in function Os_Test_GetHWIO_e_LockSemaphore_test() in test_os_hwio.c file "); 
  snprintf( chExpectedText, elCount(chExpectedText), "Verify var Smsts_lock[17]=4  in function Os_Test_GetHWIO_e_LockSemaphore_test() in test_os_hwio.c file "); 
  TestStepAddActionExpected( chActionText, chExpectedText );
  E_DBGR_VariableCheck("Smsts_lock[17]", 4, Equal);
  
  snprintf( chActionText, elCount(chActionText), "check var Smsts_lock[18]=4  in function Os_Test_GetHWIO_e_LockSemaphore_test() in test_os_hwio.c file "); 
  snprintf( chExpectedText, elCount(chExpectedText), "Verify var Smsts_lock[18]=4  in function Os_Test_GetHWIO_e_LockSemaphore_test() in test_os_hwio.c file "); 
  TestStepAddActionExpected( chActionText, chExpectedText );
  E_DBGR_VariableCheck("Smsts_lock[18]", 4, Equal);
  
  snprintf( chActionText, elCount(chActionText), "check var Smsts_lock[19]=4  in function Os_Test_GetHWIO_e_LockSemaphore_test() in test_os_hwio.c file "); 
  snprintf( chExpectedText, elCount(chExpectedText), "Verify var Smsts_lock[19]=4  in function Os_Test_GetHWIO_e_LockSemaphore_test() in test_os_hwio.c file "); 
  TestStepAddActionExpected( chActionText, chExpectedText );
  E_DBGR_VariableCheck("Smsts_lock[19]", 4, Equal);
  
  
  snprintf( chActionText, elCount(chActionText), "check var Smsts_lock[20]=4  in function Os_Test_GetHWIO_e_LockSemaphore_test() in test_os_hwio.c file "); 
  snprintf( chExpectedText, elCount(chExpectedText), "Verify var Smsts_lock[20]=4  in function Os_Test_GetHWIO_e_LockSemaphore_test() in test_os_hwio.c file "); 
  TestStepAddActionExpected( chActionText, chExpectedText );
  E_DBGR_VariableCheck("Smsts_lock[20]", 4, Equal);
  
  
  snprintf( chActionText, elCount(chActionText), "check var Smsts_lock[21]=4  in function Os_Test_GetHWIO_e_LockSemaphore_test() in test_os_hwio.c file "); 
  snprintf( chExpectedText, elCount(chExpectedText), "Verify var Smsts_lock[21]=4  in function Os_Test_GetHWIO_e_LockSemaphore_test() in test_os_hwio.c file "); 
  TestStepAddActionExpected( chActionText, chExpectedText );
  E_DBGR_VariableCheck("Smsts_lock[21]", 4, Equal);
  
  
  snprintf( chActionText, elCount(chActionText), "check var Smsts_lock[22]=4  in function Os_Test_GetHWIO_e_LockSemaphore_test() in test_os_hwio.c file "); 
  snprintf( chExpectedText, elCount(chExpectedText), "Verify var Smsts_lock[22]=4  in function Os_Test_GetHWIO_e_LockSemaphore_test() in test_os_hwio.c file "); 
  TestStepAddActionExpected( chActionText, chExpectedText );
  E_DBGR_VariableCheck("Smsts_lock[22]", 4, Equal);
  
  
  snprintf( chActionText, elCount(chActionText), "check var Smsts_lock[23]=4  in function Os_Test_GetHWIO_e_LockSemaphore_test() in test_os_hwio.c file "); 
  snprintf( chExpectedText, elCount(chExpectedText), "Verify var Smsts_lock[23]=4  in function Os_Test_GetHWIO_e_LockSemaphore_test() in test_os_hwio.c file "); 
  TestStepAddActionExpected( chActionText, chExpectedText );
  E_DBGR_VariableCheck("Smsts_lock[23]", 4, Equal);
  
  
  snprintf( chActionText, elCount(chActionText), "check var Smsts_lock[24]=4  in function Os_Test_GetHWIO_e_LockSemaphore_test() in test_os_hwio.c file "); 
  snprintf( chExpectedText, elCount(chExpectedText), "Verify var Smsts_lock[24]=4  in function Os_Test_GetHWIO_e_LockSemaphore_test() in test_os_hwio.c file "); 
  TestStepAddActionExpected( chActionText, chExpectedText );
  E_DBGR_VariableCheck("Smsts_lock[24]", 4, Equal);
  
  
  snprintf( chActionText, elCount(chActionText), "check var Smsts_lock[25]=4  in function Os_Test_GetHWIO_e_LockSemaphore_test() in test_os_hwio.c file "); 
  snprintf( chExpectedText, elCount(chExpectedText), "Verify var Smsts_lock[25]=4  in function Os_Test_GetHWIO_e_LockSemaphore_test() in test_os_hwio.c file "); 
  TestStepAddActionExpected( chActionText, chExpectedText );
  E_DBGR_VariableCheck("Smsts_lock[25]", 4, Equal);
  
  
  snprintf( chActionText, elCount(chActionText), "check var Smsts_lock[26]=4  in function Os_Test_GetHWIO_e_LockSemaphore_test() in test_os_hwio.c file "); 
  snprintf( chExpectedText, elCount(chExpectedText), "Verify var Smsts_lock[26]=4  in function Os_Test_GetHWIO_e_LockSemaphore_test() in test_os_hwio.c file "); 
  TestStepAddActionExpected( chActionText, chExpectedText );
  E_DBGR_VariableCheck("Smsts_lock[26]", 4, Equal);
  
  
  snprintf( chActionText, elCount(chActionText), "check var Smsts_lock[27]=4  in function Os_Test_GetHWIO_e_LockSemaphore_test() in test_os_hwio.c file "); 
  snprintf( chExpectedText, elCount(chExpectedText), "Verify var Smsts_lock[27]=4  in function Os_Test_GetHWIO_e_LockSemaphore_test() in test_os_hwio.c file "); 
  TestStepAddActionExpected( chActionText, chExpectedText );
  E_DBGR_VariableCheck("Smsts_lock[27]", 4, Equal);
  
  snprintf( chActionText, elCount(chActionText), "check var Smsts_lock[28]=4  in function Os_Test_GetHWIO_e_LockSemaphore_test() in test_os_hwio.c file "); 
  snprintf( chExpectedText, elCount(chExpectedText), "Verify var Smsts_lock[28]=4  in function Os_Test_GetHWIO_e_LockSemaphore_test() in test_os_hwio.c file "); 
  TestStepAddActionExpected( chActionText, chExpectedText );
  E_DBGR_VariableCheck("Smsts_lock[28]", 4, Equal);
  
  
  snprintf( chActionText, elCount(chActionText), "check var Smsts_lock[29]=4  in function Os_Test_GetHWIO_e_LockSemaphore_test() in test_os_hwio.c file "); 
  snprintf( chExpectedText, elCount(chExpectedText), "Verify var Smsts_lock[29]=4  in function Os_Test_GetHWIO_e_LockSemaphore_test() in test_os_hwio.c file "); 
  TestStepAddActionExpected( chActionText, chExpectedText );
  E_DBGR_VariableCheck("Smsts_lock[29]", 4, Equal);
  
  
  snprintf( chActionText, elCount(chActionText), "check var Smsts_lock[30]=4  in function Os_Test_GetHWIO_e_LockSemaphore_test() in test_os_hwio.c file "); 
  snprintf( chExpectedText, elCount(chExpectedText), "Verify var Smsts_lock[30]=4  in function Os_Test_GetHWIO_e_LockSemaphore_test() in test_os_hwio.c file "); 
  TestStepAddActionExpected( chActionText, chExpectedText );
  E_DBGR_VariableCheck("Smsts_lock[30]", 4, Equal);
  
  
  snprintf( chActionText, elCount(chActionText), "check var Smsts_lock[31]=4  in function Os_Test_GetHWIO_e_LockSemaphore_test() in test_os_hwio.c file "); 
  snprintf( chExpectedText, elCount(chExpectedText), "Verify var Smsts_lock[31]=4  in function Os_Test_GetHWIO_e_LockSemaphore_test() in test_os_hwio.c file "); 
  TestStepAddActionExpected( chActionText, chExpectedText );
  E_DBGR_VariableCheck("Smsts_lock[31]", 4, Equal);
  
  
  
  
  /*******************************************************************************************************************************************************/    
    // Test Step 5: check var Smsts_unlock[semaphore]=0 for 32 index in function Os_Test_GetHWIO_e_LockSemaphore_test() in test_os_hwio.c file
  /*******************************************************************************************************************************************************/
  snprintf( chActionText, elCount(chActionText), "check var Smsts_unlock[0]=0  in function Os_Test_GetHWIO_e_LockSemaphore_test() in test_os_hwio.c file "); 
  snprintf( chExpectedText, elCount(chExpectedText), "Verify var Smsts_unlock[0]=0  in function Os_Test_GetHWIO_e_LockSemaphore_test() in test_os_hwio.c file "); 
  TestStepAddActionExpected( chActionText, chExpectedText );
  E_DBGR_VariableCheck("Smsts_unlock[0]", 0, Equal);
  
  snprintf( chActionText, elCount(chActionText), "check var Smsts_unlock[1]=0  in function Os_Test_GetHWIO_e_LockSemaphore_test() in test_os_hwio.c file "); 
  snprintf( chExpectedText, elCount(chExpectedText), "Verify var Smsts_unlock[1]=0  in function Os_Test_GetHWIO_e_LockSemaphore_test() in test_os_hwio.c file "); 
  TestStepAddActionExpected( chActionText, chExpectedText );
  E_DBGR_VariableCheck("Smsts_unlock[1]", 0, Equal);
  
  snprintf( chActionText, elCount(chActionText), "check var Smsts_unlock[2]=0  in function Os_Test_GetHWIO_e_LockSemaphore_test() in test_os_hwio.c file "); 
  snprintf( chExpectedText, elCount(chExpectedText), "Verify var Smsts_unlock[2]=0  in function Os_Test_GetHWIO_e_LockSemaphore_test() in test_os_hwio.c file "); 
  TestStepAddActionExpected( chActionText, chExpectedText );
  E_DBGR_VariableCheck("Smsts_unlock[2]", 0, Equal);
  
  snprintf( chActionText, elCount(chActionText), "check var Smsts_unlock[3]=0  in function Os_Test_GetHWIO_e_LockSemaphore_test() in test_os_hwio.c file "); 
  snprintf( chExpectedText, elCount(chExpectedText), "Verify var Smsts_unlock[3]=0  in function Os_Test_GetHWIO_e_LockSemaphore_test() in test_os_hwio.c file "); 
  TestStepAddActionExpected( chActionText, chExpectedText );
  E_DBGR_VariableCheck("Smsts_unlock[3]", 0, Equal);
  
  snprintf( chActionText, elCount(chActionText), "check var Smsts_unlock[4]=0  in function Os_Test_GetHWIO_e_LockSemaphore_test() in test_os_hwio.c file "); 
  snprintf( chExpectedText, elCount(chExpectedText), "Verify var Smsts_unlock[4]=0  in function Os_Test_GetHWIO_e_LockSemaphore_test() in test_os_hwio.c file "); 
  TestStepAddActionExpected( chActionText, chExpectedText );
  E_DBGR_VariableCheck("Smsts_unlock[4]", 0, Equal);
  
  snprintf( chActionText, elCount(chActionText), "check var Smsts_unlock[5]=0  in function Os_Test_GetHWIO_e_LockSemaphore_test() in test_os_hwio.c file "); 
  snprintf( chExpectedText, elCount(chExpectedText), "Verify var Smsts_unlock[5]=0  in function Os_Test_GetHWIO_e_LockSemaphore_test() in test_os_hwio.c file "); 
  TestStepAddActionExpected( chActionText, chExpectedText );
  E_DBGR_VariableCheck("Smsts_unlock[5]", 0, Equal);
  
  snprintf( chActionText, elCount(chActionText), "check var Smsts_unlock[6]=0  in function Os_Test_GetHWIO_e_LockSemaphore_test() in test_os_hwio.c file "); 
  snprintf( chExpectedText, elCount(chExpectedText), "Verify var Smsts_lock[6]=0  in function Os_Test_GetHWIO_e_LockSemaphore_test() in test_os_hwio.c file "); 
  TestStepAddActionExpected( chActionText, chExpectedText );
  E_DBGR_VariableCheck("Smsts_unlock[6]", 0, Equal);
  
  snprintf( chActionText, elCount(chActionText), "check var Smsts_unlock[7]=0  in function Os_Test_GetHWIO_e_LockSemaphore_test() in test_os_hwio.c file "); 
  snprintf( chExpectedText, elCount(chExpectedText), "Verify var Smsts_unlock[7]=0Smsts_unlock  in function Os_Test_GetHWIO_e_LockSemaphore_test() in test_os_hwio.c file "); 
  TestStepAddActionExpected( chActionText, chExpectedText );
  E_DBGR_VariableCheck("Smsts_unlock[7]", 0, Equal);
  
  snprintf( chActionText, elCount(chActionText), "check var Smsts_unlock[8]=0  in function Os_Test_GetHWIO_e_LockSemaphore_test() in test_os_hwio.c file "); 
  snprintf( chExpectedText, elCount(chExpectedText), "Verify var Smsts_unlock[8]=0  in function Os_Test_GetHWIO_e_LockSemaphore_test() in test_os_hwio.c file "); 
  TestStepAddActionExpected( chActionText, chExpectedText );
  E_DBGR_VariableCheck("Smsts_unlock[8]", 0, Equal);
  
  snprintf( chActionText, elCount(chActionText), "check var Smsts_unlock[9]=0  in function Os_Test_GetHWIO_e_LockSemaphore_test() in test_os_hwio.c file "); 
  snprintf( chExpectedText, elCount(chExpectedText), "Verify var Smsts_unlock[9]=0  in function Os_Test_GetHWIO_e_LockSemaphore_test() in test_os_hwio.c file "); 
  TestStepAddActionExpected( chActionText, chExpectedText );
  E_DBGR_VariableCheck("Smsts_unlock[9]", 0, Equal);
  
  snprintf( chActionText, elCount(chActionText), "check var Smsts_unlock[10]=0  in function Os_Test_GetHWIO_e_LockSemaphore_test() in test_os_hwio.c file "); 
  snprintf( chExpectedText, elCount(chExpectedText), "Verify var Smsts_unlock[10]=0  in function Os_Test_GetHWIO_e_LockSemaphore_test() in test_os_hwio.c file "); 
  TestStepAddActionExpected( chActionText, chExpectedText );
  E_DBGR_VariableCheck("Smsts_unlock[10]", 0, Equal);
  
  snprintf( chActionText, elCount(chActionText), "check var Smsts_unlock[11]=0  in function Os_Test_GetHWIO_e_LockSemaphore_test() in test_os_hwio.c file "); 
  snprintf( chExpectedText, elCount(chExpectedText), "Verify var Smsts_unlock[11]=0  in function Os_Test_GetHWIO_e_LockSemaphore_test() in test_os_hwio.c file "); 
  TestStepAddActionExpected( chActionText, chExpectedText );
  E_DBGR_VariableCheck("Smsts_unlock[11]", 0, Equal);
  
  snprintf( chActionText, elCount(chActionText), "check var Smsts_unlock[12]=0  in function Os_Test_GetHWIO_e_LockSemaphore_test() in test_os_hwio.c file "); 
  snprintf( chExpectedText, elCount(chExpectedText), "Verify var Smsts_unlock[12]=0  in function Os_Test_GetHWIO_e_LockSemaphore_test() in test_os_hwio.c file "); 
  TestStepAddActionExpected( chActionText, chExpectedText );
  E_DBGR_VariableCheck("Smsts_unlock[12]", 0, Equal);
  
  snprintf( chActionText, elCount(chActionText), "check var Smsts_unlock[13]=0  in function Os_Test_GetHWIO_e_LockSemaphore_test() in test_os_hwio.c file "); 
  snprintf( chExpectedText, elCount(chExpectedText), "Verify var Smsts_unlock[13]=0  in function Os_Test_GetHWIO_e_LockSemaphore_test() in test_os_hwio.c file "); 
  TestStepAddActionExpected( chActionText, chExpectedText );
  E_DBGR_VariableCheck("Smsts_unlock[13]", 0, Equal);
  
  snprintf( chActionText, elCount(chActionText), "check var Smsts_unlock[14]=0  in function Os_Test_GetHWIO_e_LockSemaphore_test() in test_os_hwio.c file "); 
  snprintf( chExpectedText, elCount(chExpectedText), "Verify var Smsts_unlock[14]=0  in function Os_Test_GetHWIO_e_LockSemaphore_test() in test_os_hwio.c file "); 
  TestStepAddActionExpected( chActionText, chExpectedText );
  E_DBGR_VariableCheck("Smsts_unlock[14]", 0, Equal);
  
  snprintf( chActionText, elCount(chActionText), "check var Smsts_unlock[15]=0  in function Os_Test_GetHWIO_e_LockSemaphore_test() in test_os_hwio.c file "); 
  snprintf( chExpectedText, elCount(chExpectedText), "Verify var Smsts_unlock[15]=0  in function Os_Test_GetHWIO_e_LockSemaphore_test() in test_os_hwio.c file "); 
  TestStepAddActionExpected( chActionText, chExpectedText );
  E_DBGR_VariableCheck("Smsts_unlock[15]", 0, Equal);
  
  snprintf( chActionText, elCount(chActionText), "check var Smsts_unlock[16]=0  in function Os_Test_GetHWIO_e_LockSemaphore_test() in test_os_hwio.c file "); 
  snprintf( chExpectedText, elCount(chExpectedText), "Verify var Smsts_unlock[16]=0  in function Os_Test_GetHWIO_e_LockSemaphore_test() in test_os_hwio.c file "); 
  TestStepAddActionExpected( chActionText, chExpectedText );
  E_DBGR_VariableCheck("Smsts_unlock[16]", 0, Equal);
  
  snprintf( chActionText, elCount(chActionText), "check var Smsts_unlock[17]=0  in function Os_Test_GetHWIO_e_LockSemaphore_test() in test_os_hwio.c file "); 
  snprintf( chExpectedText, elCount(chExpectedText), "Verify var Smsts_unlock[17]=0  in function Os_Test_GetHWIO_e_LockSemaphore_test() in test_os_hwio.c file "); 
  TestStepAddActionExpected( chActionText, chExpectedText );
  E_DBGR_VariableCheck("Smsts_unlock[17]", 0, Equal);
  
  snprintf( chActionText, elCount(chActionText), "check var Smsts_unlock[18]=0  in function Os_Test_GetHWIO_e_LockSemaphore_test() in test_os_hwio.c file "); 
  snprintf( chExpectedText, elCount(chExpectedText), "Verify var Smsts_unlock[18]=0  in function Os_Test_GetHWIO_e_LockSemaphore_test() in test_os_hwio.c file "); 
  TestStepAddActionExpected( chActionText, chExpectedText );
  E_DBGR_VariableCheck("Smsts_unlock[18]", 0, Equal);
  
  snprintf( chActionText, elCount(chActionText), "check var Smsts_unlock[19]=0  in function Os_Test_GetHWIO_e_LockSemaphore_test() in test_os_hwio.c file "); 
  snprintf( chExpectedText, elCount(chExpectedText), "Verify var Smsts_unlock[19]=0  in function Os_Test_GetHWIO_e_LockSemaphore_test() in test_os_hwio.c file "); 
  TestStepAddActionExpected( chActionText, chExpectedText );
  E_DBGR_VariableCheck("Smsts_unlock[19]", 0, Equal);
  
  
  snprintf( chActionText, elCount(chActionText), "check var Smsts_unlock[20]=0  in function Os_Test_GetHWIO_e_LockSemaphore_test() in test_os_hwio.c file "); 
  snprintf( chExpectedText, elCount(chExpectedText), "Verify var Smsts_unlock[20]=0  in function Os_Test_GetHWIO_e_LockSemaphore_test() in test_os_hwio.c file "); 
  TestStepAddActionExpected( chActionText, chExpectedText );
  E_DBGR_VariableCheck("Smsts_unlock[20]", 0, Equal);
  
  
  snprintf( chActionText, elCount(chActionText), "check var Smsts_unlock[21]=0  in function Os_Test_GetHWIO_e_LockSemaphore_test() in test_os_hwio.c file "); 
  snprintf( chExpectedText, elCount(chExpectedText), "Verify var Smsts_unlock[21]=0  in function Os_Test_GetHWIO_e_LockSemaphore_test() in test_os_hwio.c file "); 
  TestStepAddActionExpected( chActionText, chExpectedText );
  E_DBGR_VariableCheck("Smsts_unlock[21]", 0, Equal);
  
  
  snprintf( chActionText, elCount(chActionText), "check var Smsts_unlock[22]=0  in function Os_Test_GetHWIO_e_LockSemaphore_test() in test_os_hwio.c file "); 
  snprintf( chExpectedText, elCount(chExpectedText), "Verify var Smsts_unlock[22]=0  in function Os_Test_GetHWIO_e_LockSemaphore_test() in test_os_hwio.c file "); 
  TestStepAddActionExpected( chActionText, chExpectedText );
  E_DBGR_VariableCheck("Smsts_unlock[22]", 0, Equal);
  
  
  snprintf( chActionText, elCount(chActionText), "check var Smsts_unlock[23]=0  in function Os_Test_GetHWIO_e_LockSemaphore_test() in test_os_hwio.c file "); 
  snprintf( chExpectedText, elCount(chExpectedText), "Verify var Smsts_unlock[23]=0  in function Os_Test_GetHWIO_e_LockSemaphore_test() in test_os_hwio.c file "); 
  TestStepAddActionExpected( chActionText, chExpectedText );
  E_DBGR_VariableCheck("Smsts_unlock[23]", 0, Equal);
  
  
  snprintf( chActionText, elCount(chActionText), "check var Smsts_unlock[24]=0  in function Os_Test_GetHWIO_e_LockSemaphore_test() in test_os_hwio.c file "); 
  snprintf( chExpectedText, elCount(chExpectedText), "Verify var Smsts_unlock[24]=0  in function Os_Test_GetHWIO_e_LockSemaphore_test() in test_os_hwio.c file "); 
  TestStepAddActionExpected( chActionText, chExpectedText );
  E_DBGR_VariableCheck("Smsts_unlock[24]", 0, Equal);
  
  
  snprintf( chActionText, elCount(chActionText), "check var Smsts_unlock[25]=0  in function Os_Test_GetHWIO_e_LockSemaphore_test() in test_os_hwio.c file "); 
  snprintf( chExpectedText, elCount(chExpectedText), "Verify var Smsts_unloc[25]=4 0 in function Os_Test_GetHWIO_e_LockSemaphore_test() in test_os_hwio.c file "); 
  TestStepAddActionExpected( chActionText, chExpectedText );
  E_DBGR_VariableCheck("Smsts_unlock[25]", 0, Equal);
  
  
  snprintf( chActionText, elCount(chActionText), "check var Smsts_unlock[26]=0  in function Os_Test_GetHWIO_e_LockSemaphore_test() in test_os_hwio.c file "); 
  snprintf( chExpectedText, elCount(chExpectedText), "Verify var Smsts_unlock[26]=0  in function Os_Test_GetHWIO_e_LockSemaphore_test() in test_os_hwio.c file "); 
  TestStepAddActionExpected( chActionText, chExpectedText );
  E_DBGR_VariableCheck("Smsts_unlock[26]", 0, Equal);
  
  
  snprintf( chActionText, elCount(chActionText), "check var Smsts_unlock[27]=0  in function Os_Test_GetHWIO_e_LockSemaphore_test() in test_os_hwio.c file "); 
  snprintf( chExpectedText, elCount(chExpectedText), "Verify var Smsts_unlock[27]=0  in function Os_Test_GetHWIO_e_LockSemaphore_test() in test_os_hwio.c file "); 
  TestStepAddActionExpected( chActionText, chExpectedText );
  E_DBGR_VariableCheck("Smsts_unlock[27]", 0, Equal);
  
  snprintf( chActionText, elCount(chActionText), "check var Smsts_unlock[28]=0Smsts_unlock  in function Os_Test_GetHWIO_e_LockSemaphore_test() in test_os_hwio.c file "); 
  snprintf( chExpectedText, elCount(chExpectedText), "Verify var Smsts_unlock[28]=0  in function Os_Test_GetHWIO_e_LockSemaphore_test() in test_os_hwio.c file "); 
  TestStepAddActionExpected( chActionText, chExpectedText );
  E_DBGR_VariableCheck("Smsts_unlock[28]", 0, Equal);
  
  
  snprintf( chActionText, elCount(chActionText), "check var Smsts_unlock[29]=0  in function Os_Test_GetHWIO_e_LockSemaphore_test() in test_os_hwio.c file "); 
  snprintf( chExpectedText, elCount(chExpectedText), "Verify var Smsts_unlock[29]=0  in function Os_Test_GetHWIO_e_LockSemaphore_test() in test_os_hwio.c file "); 
  TestStepAddActionExpected( chActionText, chExpectedText );
  E_DBGR_VariableCheck("Smsts_unlock[29]", 0, Equal);
  
  
  snprintf( chActionText, elCount(chActionText), "check var Smsts_unlock[30]=0  in function Os_Test_GetHWIO_e_LockSemaphore_test() in test_os_hwio.c file "); 
  snprintf( chExpectedText, elCount(chExpectedText), "Verify var Smsts_unlock[30]=0  in function Os_Test_GetHWIO_e_LockSemaphore_test() in test_os_hwio.c file "); 
  TestStepAddActionExpected( chActionText, chExpectedText );
  E_DBGR_VariableCheck("Smsts_unlock[30]", 0, Equal);
  
  
  snprintf( chActionText, elCount(chActionText), "check var Smsts_unlock[31]=0  in function Os_Test_GetHWIO_e_LockSemaphore_test() in test_os_hwio.c file "); 
  snprintf( chExpectedText, elCount(chExpectedText), "Verify var Smsts_unlock[31]=0  in function Os_Test_GetHWIO_e_LockSemaphore_test() in test_os_hwio.c file "); 
  TestStepAddActionExpected( chActionText, chExpectedText );
  E_DBGR_VariableCheck("Smsts_unlock[31]", 0, Equal);
  
  
  
  
  /*******************************************************************************************************************************************************/    
    // Test Step 6: check var Smsts_status[semaphore]=4 for 32 index in function Os_Test_GetHWIO_e_LockSemaphore_test() in test_os_hwio.c file
  /*******************************************************************************************************************************************************/
  snprintf( chActionText, elCount(chActionText), "check var Smsts_status[0]=4  in function Os_Test_GetHWIO_e_LockSemaphore_test() in test_os_hwio.c file "); 
  snprintf( chExpectedText, elCount(chExpectedText), "Verify var Smsts_status[0]=4  in function Os_Test_GetHWIO_e_LockSemaphore_test() in test_os_hwio.c file "); 
  TestStepAddActionExpected( chActionText, chExpectedText );
  E_DBGR_VariableCheck("Smsts_status[0]", 4, Equal);
  
  snprintf( chActionText, elCount(chActionText), "check var Smsts_status[1]=4  in function Os_Test_GetHWIO_e_LockSemaphore_test() in test_os_hwio.c file "); 
  snprintf( chExpectedText, elCount(chExpectedText), "Verify var Smsts_status[1]=4  in function Os_Test_GetHWIO_e_LockSemaphore_test() in test_os_hwio.c file "); 
  TestStepAddActionExpected( chActionText, chExpectedText );
  E_DBGR_VariableCheck("Smsts_status[1]", 4, Equal);
  
  snprintf( chActionText, elCount(chActionText), "check var Smsts_status[2]=4  in function Os_Test_GetHWIO_e_LockSemaphore_test() in test_os_hwio.c file "); 
  snprintf( chExpectedText, elCount(chExpectedText), "Verify var Smsts_status[2]=4  in function Os_Test_GetHWIO_e_LockSemaphore_test() in test_os_hwio.c file "); 
  TestStepAddActionExpected( chActionText, chExpectedText );
  E_DBGR_VariableCheck("Smsts_status[2]", 4, Equal);
  
  snprintf( chActionText, elCount(chActionText), "check var Smsts_status[3]=4  in function Os_Test_GetHWIO_e_LockSemaphore_test() in test_os_hwio.c file "); 
  snprintf( chExpectedText, elCount(chExpectedText), "Verify var Smsts_status[3]=4  in function Os_Test_GetHWIO_e_LockSemaphore_test() in test_os_hwio.c file "); 
  TestStepAddActionExpected( chActionText, chExpectedText );
  E_DBGR_VariableCheck("Smsts_status[3]", 4, Equal);
  
  snprintf( chActionText, elCount(chActionText), "check var Smsts_status[4]=4  in function Os_Test_GetHWIO_e_LockSemaphore_test() in test_os_hwio.c file "); 
  snprintf( chExpectedText, elCount(chExpectedText), "Verify var Smsts_status[4]=4  in function Os_Test_GetHWIO_e_LockSemaphore_test() in test_os_hwio.c file "); 
  TestStepAddActionExpected( chActionText, chExpectedText );
  E_DBGR_VariableCheck("Smsts_status[4]", 4, Equal);
  
  snprintf( chActionText, elCount(chActionText), "check var Smsts_status[5]=4  in function Os_Test_GetHWIO_e_LockSemaphore_test() in test_os_hwio.c file "); 
  snprintf( chExpectedText, elCount(chExpectedText), "Verify var Smsts_status[5]=4  in function Os_Test_GetHWIO_e_LockSemaphore_test() in test_os_hwio.c file "); 
  TestStepAddActionExpected( chActionText, chExpectedText );
  E_DBGR_VariableCheck("Smsts_status[5]", 4, Equal);
  
  snprintf( chActionText, elCount(chActionText), "check var Smsts_status[6]=4  in function Os_Test_GetHWIO_e_LockSemaphore_test() in test_os_hwio.c file "); 
  snprintf( chExpectedText, elCount(chExpectedText), "Verify var Smsts_status[6]=4  in function Os_Test_GetHWIO_e_LockSemaphore_test() in test_os_hwio.c file "); 
  TestStepAddActionExpected( chActionText, chExpectedText );
  E_DBGR_VariableCheck("Smsts_status[6]", 4, Equal);
  
  snprintf( chActionText, elCount(chActionText), "check var Smsts_status[7]=4  in function Os_Test_GetHWIO_e_LockSemaphore_test() in test_os_hwio.c file "); 
  snprintf( chExpectedText, elCount(chExpectedText), "Verify var Smsts_status[7]=4  in function Os_Test_GetHWIO_e_LockSemaphore_test() in test_os_hwio.c file "); 
  TestStepAddActionExpected( chActionText, chExpectedText );
  E_DBGR_VariableCheck("Smsts_status[7]", 4, Equal);
  
  snprintf( chActionText, elCount(chActionText), "check var Smsts_status[8]=4  in function Os_Test_GetHWIO_e_LockSemaphore_test() in test_os_hwio.c file "); 
  snprintf( chExpectedText, elCount(chExpectedText), "Verify var Smsts_status[8]=4  in function Os_Test_GetHWIO_e_LockSemaphore_test() in test_os_hwio.c file "); 
  TestStepAddActionExpected( chActionText, chExpectedText );
  E_DBGR_VariableCheck("Smsts_status[8]", 4, Equal);
  
  snprintf( chActionText, elCount(chActionText), "check var Smsts_status[9]=4  in function Os_Test_GetHWIO_e_LockSemaphore_test() in test_os_hwio.c file "); 
  snprintf( chExpectedText, elCount(chExpectedText), "Verify var Smsts_status[9]=4  in function Os_Test_GetHWIO_e_LockSemaphore_test() in test_os_hwio.c file "); 
  TestStepAddActionExpected( chActionText, chExpectedText );
  E_DBGR_VariableCheck("Smsts_status[9]", 4, Equal);
  
  snprintf( chActionText, elCount(chActionText), "check var Smsts_status[10]=4  in function Os_Test_GetHWIO_e_LockSemaphore_test() in test_os_hwio.c file "); 
  snprintf( chExpectedText, elCount(chExpectedText), "Verify var Smsts_status[10]=4  in function Os_Test_GetHWIO_e_LockSemaphore_test() in test_os_hwio.c file "); 
  TestStepAddActionExpected( chActionText, chExpectedText );
  E_DBGR_VariableCheck("Smsts_status[10]", 4, Equal);
  
  snprintf( chActionText, elCount(chActionText), "check var Smsts_status[11]=4  in function Os_Test_GetHWIO_e_LockSemaphore_test() in test_os_hwio.c file "); 
  snprintf( chExpectedText, elCount(chExpectedText), "Verify var Smsts_status[11]=4  in function Os_Test_GetHWIO_e_LockSemaphore_test() in test_os_hwio.c file "); 
  TestStepAddActionExpected( chActionText, chExpectedText );
  E_DBGR_VariableCheck("Smsts_status[11]", 4, Equal);
  
  snprintf( chActionText, elCount(chActionText), "check var Smsts_status[12]=4  in function Os_Test_GetHWIO_e_LockSemaphore_test() in test_os_hwio.c file "); 
  snprintf( chExpectedText, elCount(chExpectedText), "Verify var Smsts_status[12]=4  in function Os_Test_GetHWIO_e_LockSemaphore_test() in test_os_hwio.c file "); 
  TestStepAddActionExpected( chActionText, chExpectedText );
  E_DBGR_VariableCheck("Smsts_status[12]", 4, Equal);
  
  snprintf( chActionText, elCount(chActionText), "check var Smsts_status[13]=4  in function Os_Test_GetHWIO_e_LockSemaphore_test() in test_os_hwio.c file "); 
  snprintf( chExpectedText, elCount(chExpectedText), "Verify var Smsts_status[13]=4  in function Os_Test_GetHWIO_e_LockSemaphore_test() in test_os_hwio.c file "); 
  TestStepAddActionExpected( chActionText, chExpectedText );
  E_DBGR_VariableCheck("Smsts_status[13]", 4, Equal);
  
  snprintf( chActionText, elCount(chActionText), "check var Smsts_status[14]=4  in function Os_Test_GetHWIO_e_LockSemaphore_test() in test_os_hwio.c file "); 
  snprintf( chExpectedText, elCount(chExpectedText), "Verify var Smsts_status[14]=4  in function Os_Test_GetHWIO_e_LockSemaphore_test() in test_os_hwio.c file "); 
  TestStepAddActionExpected( chActionText, chExpectedText );
  E_DBGR_VariableCheck("Smsts_status[14]", 4, Equal);
  
  snprintf( chActionText, elCount(chActionText), "check var Smsts_status[15]=4  in function Os_Test_GetHWIO_e_LockSemaphore_test() in test_os_hwio.c file "); 
  snprintf( chExpectedText, elCount(chExpectedText), "Verify var Smsts_status[15]=4  in function Os_Test_GetHWIO_e_LockSemaphore_test() in test_os_hwio.c file "); 
  TestStepAddActionExpected( chActionText, chExpectedText );
  E_DBGR_VariableCheck("Smsts_status[15]", 4, Equal);
  
  snprintf( chActionText, elCount(chActionText), "check var Smsts_status[16]=4  in function Os_Test_GetHWIO_e_LockSemaphore_test() in test_os_hwio.c file "); 
  snprintf( chExpectedText, elCount(chExpectedText), "Verify var Smsts_status[16]=4  in function Os_Test_GetHWIO_e_LockSemaphore_test() in test_os_hwio.c file "); 
  TestStepAddActionExpected( chActionText, chExpectedText );
  E_DBGR_VariableCheck("Smsts_status[16]", 4, Equal);
  
  snprintf( chActionText, elCount(chActionText), "check var Smsts_status[17]=4  in function Os_Test_GetHWIO_e_LockSemaphore_test() in test_os_hwio.c file "); 
  snprintf( chExpectedText, elCount(chExpectedText), "Verify var Smsts_status[17]=4  in function Os_Test_GetHWIO_e_LockSemaphore_test() in test_os_hwio.c file "); 
  TestStepAddActionExpected( chActionText, chExpectedText );
  E_DBGR_VariableCheck("Smsts_status[17]", 4, Equal);
  
  snprintf( chActionText, elCount(chActionText), "check var Smsts_status[18]=4  in function Os_Test_GetHWIO_e_LockSemaphore_test() in test_os_hwio.c file "); 
  snprintf( chExpectedText, elCount(chExpectedText), "Verify var Smsts_status[18]=4  in function Os_Test_GetHWIO_e_LockSemaphore_test() in test_os_hwio.c file "); 
  TestStepAddActionExpected( chActionText, chExpectedText );
  E_DBGR_VariableCheck("Smsts_status[18]", 4, Equal);
  
  snprintf( chActionText, elCount(chActionText), "check var Smsts_status[19]=4  in function Os_Test_GetHWIO_e_LockSemaphore_test() in test_os_hwio.c file "); 
  snprintf( chExpectedText, elCount(chExpectedText), "Verify var Smsts_status[19]=4  in function Os_Test_GetHWIO_e_LockSemaphore_test() in test_os_hwio.c file "); 
  TestStepAddActionExpected( chActionText, chExpectedText );
  E_DBGR_VariableCheck("Smsts_status[19]", 4, Equal);
  
  
  snprintf( chActionText, elCount(chActionText), "check var Smsts_status[20]=4  in function Os_Test_GetHWIO_e_LockSemaphore_test() in test_os_hwio.c file "); 
  snprintf( chExpectedText, elCount(chExpectedText), "Verify var Smsts_status[20]=4  in function Os_Test_GetHWIO_e_LockSemaphore_test() in test_os_hwio.c file "); 
  TestStepAddActionExpected( chActionText, chExpectedText );
  E_DBGR_VariableCheck("Smsts_status[20]", 4, Equal);
  
  
  snprintf( chActionText, elCount(chActionText), "check var Smsts_status[21]=4  in function Os_Test_GetHWIO_e_LockSemaphore_test() in test_os_hwio.c file "); 
  snprintf( chExpectedText, elCount(chExpectedText), "Verify var Smsts_status[21]=4  in function Os_Test_GetHWIO_e_LockSemaphore_test() in test_os_hwio.c file "); 
  TestStepAddActionExpected( chActionText, chExpectedText );
  E_DBGR_VariableCheck("Smsts_status[21]", 4, Equal);
  
  
  snprintf( chActionText, elCount(chActionText), "check var Smsts_status[22]=4  in function Os_Test_GetHWIO_e_LockSemaphore_test() in test_os_hwio.c file "); 
  snprintf( chExpectedText, elCount(chExpectedText), "Verify var Smsts_status[22]=4  in function Os_Test_GetHWIO_e_LockSemaphore_test() in test_os_hwio.c file "); 
  TestStepAddActionExpected( chActionText, chExpectedText );
  E_DBGR_VariableCheck("Smsts_status[22]", 4, Equal);
  
  
  snprintf( chActionText, elCount(chActionText), "check var Smsts_status[23]=4  in function Os_Test_GetHWIO_e_LockSemaphore_test() in test_os_hwio.c file "); 
  snprintf( chExpectedText, elCount(chExpectedText), "Verify var Smsts_status[23]=4  in function Os_Test_GetHWIO_e_LockSemaphore_test() in test_os_hwio.c file "); 
  TestStepAddActionExpected( chActionText, chExpectedText );
  E_DBGR_VariableCheck("Smsts_status[23]", 4, Equal);
  
  
  snprintf( chActionText, elCount(chActionText), "check var Smsts_status[24]=4  in function Os_Test_GetHWIO_e_LockSemaphore_test() in test_os_hwio.c file "); 
  snprintf( chExpectedText, elCount(chExpectedText), "Verify var Smsts_status[24]=4  in function Os_Test_GetHWIO_e_LockSemaphore_test() in test_os_hwio.c file "); 
  TestStepAddActionExpected( chActionText, chExpectedText );
  E_DBGR_VariableCheck("Smsts_status[24]", 4, Equal);
  
  
  snprintf( chActionText, elCount(chActionText), "check var Smsts_lock[25]=4  in function Os_Test_GetHWIO_e_LockSemaphore_test() in test_os_hwio.c file "); 
  snprintf( chExpectedText, elCount(chExpectedText), "Verify var Smsts_lock[25]=4  in function Os_Test_GetHWIO_e_LockSemaphore_test() in test_os_hwio.c file "); 
  TestStepAddActionExpected( chActionText, chExpectedText );
  E_DBGR_VariableCheck("Smsts_status[25]", 4, Equal);
  
  
  snprintf( chActionText, elCount(chActionText), "check var Smsts_status[26]=4  in function Os_Test_GetHWIO_e_LockSemaphore_test() in test_os_hwio.c file "); 
  snprintf( chExpectedText, elCount(chExpectedText), "Verify var Smsts_status[26]=4  in function Os_Test_GetHWIO_e_LockSemaphore_test() in test_os_hwio.c file "); 
  TestStepAddActionExpected( chActionText, chExpectedText );
  E_DBGR_VariableCheck("Smsts_status[26]", 4, Equal);
  
  
  snprintf( chActionText, elCount(chActionText), "check var Smsts_status[27]=4  in function Os_Test_GetHWIO_e_LockSemaphore_test() in test_os_hwio.c file "); 
  snprintf( chExpectedText, elCount(chExpectedText), "Verify var Smsts_status[27]=4  in function Os_Test_GetHWIO_e_LockSemaphore_test() in test_os_hwio.c file "); 
  TestStepAddActionExpected( chActionText, chExpectedText );
  E_DBGR_VariableCheck("Smsts_status[27]", 4, Equal);
  
  snprintf( chActionText, elCount(chActionText), "check var Smsts_status[28]=4  in function Os_Test_GetHWIO_e_LockSemaphore_test() in test_os_hwio.c file "); 
  snprintf( chExpectedText, elCount(chExpectedText), "Verify var Smsts_status[28]=4  in function Os_Test_GetHWIO_e_LockSemaphore_test() in test_os_hwio.c file "); 
  TestStepAddActionExpected( chActionText, chExpectedText );
  E_DBGR_VariableCheck("Smsts_status[28]", 4, Equal);
  
  
  snprintf( chActionText, elCount(chActionText), "check var Smsts_status[29]=4  in function Os_Test_GetHWIO_e_LockSemaphore_test() in test_os_hwio.c file "); 
  snprintf( chExpectedText, elCount(chExpectedText), "Verify var Smsts_status[29]=4  in function Os_Test_GetHWIO_e_LockSemaphore_test() in test_os_hwio.c file "); 
  TestStepAddActionExpected( chActionText, chExpectedText );
  E_DBGR_VariableCheck("Smsts_status[29]", 4, Equal);
  
  
  snprintf( chActionText, elCount(chActionText), "check var Smsts_status[30]=4  in function Os_Test_GetHWIO_e_LockSemaphore_test() in test_os_hwio.c file "); 
  snprintf( chExpectedText, elCount(chExpectedText), "Verify var Smsts_status[30]=4  in function Os_Test_GetHWIO_e_LockSemaphore_test() in test_os_hwio.c file "); 
  TestStepAddActionExpected( chActionText, chExpectedText );
  E_DBGR_VariableCheck("Smsts_status[30]", 4, Equal);
  
  
  snprintf( chActionText, elCount(chActionText), "check var Smsts_status[31]=4  in function Os_Test_GetHWIO_e_LockSemaphore_test() in test_os_hwio.c file "); 
  snprintf( chExpectedText, elCount(chExpectedText), "Verify var Smsts_status[31]=4  in function Os_Test_GetHWIO_e_LockSemaphore_test() in test_os_hwio.c file "); 
  TestStepAddActionExpected( chActionText, chExpectedText );
  E_DBGR_VariableCheck("Smsts_status[31]", 4, Equal);
  
  
  
  
  
  
}





/***************************************************************************************************
----------------------------------------------------------------------------------------------------
Test case name:  TC_L30SW_QT_36651207: verify_the_functionality_of_interface_to_check_lock_unlock_status_for_all_31_Semaphore_IDS_for_CPU4
----------------------------------------------------------------------------------------------------
Description:  Test_case_to_verify_the_functionality_of_interface_to_check_lock_unlock_status_for_all_31_Semaphore_IDS_for_CPU4

***************************************************************************************************/



testcase verify_the_functionality_of_interface_to_check_lock_unlock_status_for_all_31_Semaphore_IDS_for_CPU4()
{
  /***************************************************************************************************************/    
                                                // Variable Definition
  /***************************************************************************************************************/ 
  
  long taskvalue;
  
  /***************************************************************************************************************/    
                                               // Local Values
  /***************************************************************************************************************/ 
  

  
  /***************************************************************************************************************/    
                                              // Test Case Info
  /***************************************************************************************************************/
  setWriteDbgLevel(DebugOff);
  snprintf( chTestTitle, elCount(chTestTitle), "Test_case_to_verify_the_functionality_of_interface_to_check_lock_unlock_status_for_all_31_Semaphore_IDS_for_CPU4" );
  snprintf( chTestDescription, elCount(chTestDescription), "Purpose:Test_case_to_verify_the_functionality_of_interface_to_check_lock_unlock_status_for_all_31_Semaphore_IDS_for_CPU4.");
  TestCaseAddInfo( chTestTitle, "TC_L30SW_QT_36651207", chTestDescription );

  /***************************************************************************************************************/    
                                              // Start of Test Case
  /***************************************************************************************************************/
  
  /***************************************************************************************************************/    
                                              // Test Step 1 PRECONDITIONS
  /***************************************************************************************************************/
  
  snprintf( chActionText, elCount(chActionText), "Flash the Software and ECU is running"); 
  snprintf( chExpectedText, elCount(chExpectedText), "ECU should be in running state"); 
  TestStepAddActionExpected( chActionText, chExpectedText );

  A_DBGR_BreakpointDeleteAll();
  A_DBGR_RnGo();
  E_DBGR_CheckState(T32_State_Running);
  

   /***************************************************************************************************************/    
            // Test Step 2: Check all cores are in running state                                   
  /***************************************************************************************************************/
  
  //Check core0 is running
  snprintf( chActionText, elCount(chActionText), "Check 1000ms Task Counter from core0 "); 
  snprintf( chExpectedText, elCount(chExpectedText), "1000ms Counter from core0 is incrementing"); 
  TestStepAddActionExpected( chActionText, chExpectedText );
  A_DBGR_VariableRead( "Task_Core0_1000ms_Count", taskvalue);
  E_DBGR_VariableCheck("Task_Core0_1000ms_Count", taskvalue, Greater);
  
  //Check Core1 is running
  snprintf( chActionText, elCount(chActionText), "Check 1000ms Task Counter from Core1 "); 
  snprintf( chExpectedText, elCount(chExpectedText), "1000ms Counter from Core1 is incrementing"); 
  TestStepAddActionExpected( chActionText, chExpectedText );
  A_DBGR_VariableRead( "Task_Core1_1000ms_Count", taskvalue);
  E_DBGR_VariableCheck("Task_Core1_1000ms_Count", taskvalue, Greater);
  
  //Check Core2 is running
  snprintf( chActionText, elCount(chActionText), "Check 1000ms Task Counter from Core2 "); 
  snprintf( chExpectedText, elCount(chExpectedText), "1000ms Counter from Core2 is incrementing"); 
  TestStepAddActionExpected( chActionText, chExpectedText );
  A_DBGR_VariableRead( "Task_Core2_1000ms_Count", taskvalue);
  E_DBGR_VariableCheck("Task_Core2_1000ms_Count", taskvalue, Greater);
    
  //Check Core3 is running
  snprintf( chActionText, elCount(chActionText), "Check 1000ms Task Counter from Core3 "); 
  snprintf( chExpectedText, elCount(chExpectedText), "1000ms Counter from Core3 is incrementing"); 
  TestStepAddActionExpected( chActionText, chExpectedText );
  A_DBGR_VariableRead( "Task_Core3_1000ms_Count", taskvalue);
  E_DBGR_VariableCheck("Task_Core3_1000ms_Count", taskvalue, Greater);
    
  //Check Core4 is running
  snprintf( chActionText, elCount(chActionText), "Check 1000ms Task Counter from Core4 "); 
  snprintf( chExpectedText, elCount(chExpectedText), "1000ms Counter from Core4 is incrementing"); 
  TestStepAddActionExpected( chActionText, chExpectedText );
  A_DBGR_VariableRead( "Task_Core4_1000ms_Count", taskvalue);
  E_DBGR_VariableCheck("Task_Core4_1000ms_Count", taskvalue, Greater);
    
  //Check Core5 is running
  snprintf( chActionText, elCount(chActionText), "Check 1000ms Task Counter from Core5 "); 
  snprintf( chExpectedText, elCount(chExpectedText), "1000ms Counter from Core5 is incrementing"); 
  TestStepAddActionExpected( chActionText, chExpectedText );
  A_DBGR_VariableRead( "Task_Core5_1000ms_Count", taskvalue);
  E_DBGR_VariableCheck("Task_Core5_1000ms_Count", taskvalue, Greater);
  
  /*******************************************************************************************************************************************************/    
    // Test Step 3: Set flag lock_unlock_status_flag_core4=1 to check semaphore lock for core4 in function TestApp_Core4_1000ms_MainFunction
  /*******************************************************************************************************************************************************/

  snprintf( chActionText, elCount(chActionText), "Set flag lock_unlock_status_flag_core4=1 to check semaphore lock for core4 in function TestApp_core4_1000ms_MainFunction "); 
  snprintf( chExpectedText, elCount(chExpectedText), "Verify flag lock_unlock_status_flag_core4=1 to check semaphore lock for core4 in function TestApp_core4_1000ms_MainFunction "); 
  TestStepAddActionExpected( chActionText, chExpectedText );
   A_DBGR_RnGo();
  A_DBGR_VariableSet("lock_unlock_status_flag_core4", "1");
  E_DBGR_VariableCheck("lock_unlock_status_flag_core4", 1, Equal);


  
  
  
  /*******************************************************************************************************************************************************/    
    // Test Step 4: check var Smsts_lock[semaphore]=5 for 32 index in function Os_Test_GetHWIO_e_LockSemaphore_test() in test_os_hwio.c file
  /*******************************************************************************************************************************************************/
  snprintf( chActionText, elCount(chActionText), "check var Smsts_lock[0]=5  in function Os_Test_GetHWIO_e_LockSemaphore_test() in test_os_hwio.c file "); 
  snprintf( chExpectedText, elCount(chExpectedText), "Verify var Smsts_lock[0]=5  in function Os_Test_GetHWIO_e_LockSemaphore_test() in test_os_hwio.c file "); 
  TestStepAddActionExpected( chActionText, chExpectedText );
  E_DBGR_VariableCheck("Smsts_lock[0]", 5, Equal);
  
  snprintf( chActionText, elCount(chActionText), "check var Smsts_lock[1]=5  in function Os_Test_GetHWIO_e_LockSemaphore_test() in test_os_hwio.c file "); 
  snprintf( chExpectedText, elCount(chExpectedText), "Verify var Smsts_lock[1]=5  in function Os_Test_GetHWIO_e_LockSemaphore_test() in test_os_hwio.c file "); 
  TestStepAddActionExpected( chActionText, chExpectedText );
  E_DBGR_VariableCheck("Smsts_lock[1]", 5, Equal);
  
  snprintf( chActionText, elCount(chActionText), "check var Smsts_lock[2]=5  in function Os_Test_GetHWIO_e_LockSemaphore_test() in test_os_hwio.c file "); 
  snprintf( chExpectedText, elCount(chExpectedText), "Verify var Smsts_lock[2]=5  in function Os_Test_GetHWIO_e_LockSemaphore_test() in test_os_hwio.c file "); 
  TestStepAddActionExpected( chActionText, chExpectedText );
  E_DBGR_VariableCheck("Smsts_lock[2]", 5, Equal);
  
  snprintf( chActionText, elCount(chActionText), "check var Smsts_lock[3]=5  in function Os_Test_GetHWIO_e_LockSemaphore_test() in test_os_hwio.c file "); 
  snprintf( chExpectedText, elCount(chExpectedText), "Verify var Smsts_lock[3]=5  in function Os_Test_GetHWIO_e_LockSemaphore_test() in test_os_hwio.c file "); 
  TestStepAddActionExpected( chActionText, chExpectedText );
  E_DBGR_VariableCheck("Smsts_lock[3]", 5, Equal);
  
  snprintf( chActionText, elCount(chActionText), "check var Smsts_lock[4]=5  in function Os_Test_GetHWIO_e_LockSemaphore_test() in test_os_hwio.c file "); 
  snprintf( chExpectedText, elCount(chExpectedText), "Verify var Smsts_lock[4]=5  in function Os_Test_GetHWIO_e_LockSemaphore_test() in test_os_hwio.c file "); 
  TestStepAddActionExpected( chActionText, chExpectedText );
  E_DBGR_VariableCheck("Smsts_lock[4]", 5, Equal);
  
  snprintf( chActionText, elCount(chActionText), "check var Smsts_lock[5]=5  in function Os_Test_GetHWIO_e_LockSemaphore_test() in test_os_hwio.c file "); 
  snprintf( chExpectedText, elCount(chExpectedText), "Verify var Smsts_lock[5]=5  in function Os_Test_GetHWIO_e_LockSemaphore_test() in test_os_hwio.c file "); 
  TestStepAddActionExpected( chActionText, chExpectedText );
  E_DBGR_VariableCheck("Smsts_lock[5]", 5, Equal);
  
  snprintf( chActionText, elCount(chActionText), "check var Smsts_lock[6]=5  in function Os_Test_GetHWIO_e_LockSemaphore_test() in test_os_hwio.c file "); 
  snprintf( chExpectedText, elCount(chExpectedText), "Verify var Smsts_lock[6]=5  in function Os_Test_GetHWIO_e_LockSemaphore_test() in test_os_hwio.c file "); 
  TestStepAddActionExpected( chActionText, chExpectedText );
  E_DBGR_VariableCheck("Smsts_lock[6]", 5, Equal);
  
  snprintf( chActionText, elCount(chActionText), "check var Smsts_lock[7]=5  in function Os_Test_GetHWIO_e_LockSemaphore_test() in test_os_hwio.c file "); 
  snprintf( chExpectedText, elCount(chExpectedText), "Verify var Smsts_lock[7]=5  in function Os_Test_GetHWIO_e_LockSemaphore_test() in test_os_hwio.c file "); 
  TestStepAddActionExpected( chActionText, chExpectedText );
  E_DBGR_VariableCheck("Smsts_lock[7]", 5, Equal);
  
  snprintf( chActionText, elCount(chActionText), "check var Smsts_lock[8]=5  in function Os_Test_GetHWIO_e_LockSemaphore_test() in test_os_hwio.c file "); 
  snprintf( chExpectedText, elCount(chExpectedText), "Verify var Smsts_lock[8]=5  in function Os_Test_GetHWIO_e_LockSemaphore_test() in test_os_hwio.c file "); 
  TestStepAddActionExpected( chActionText, chExpectedText );
  E_DBGR_VariableCheck("Smsts_lock[8]", 5, Equal);
  
  snprintf( chActionText, elCount(chActionText), "check var Smsts_lock[9]=5  in function Os_Test_GetHWIO_e_LockSemaphore_test() in test_os_hwio.c file "); 
  snprintf( chExpectedText, elCount(chExpectedText), "Verify var Smsts_lock[9]=5  in function Os_Test_GetHWIO_e_LockSemaphore_test() in test_os_hwio.c file "); 
  TestStepAddActionExpected( chActionText, chExpectedText );
  E_DBGR_VariableCheck("Smsts_lock[9]", 5, Equal);
  
  snprintf( chActionText, elCount(chActionText), "check var Smsts_lock[10]=5  in function Os_Test_GetHWIO_e_LockSemaphore_test() in test_os_hwio.c file "); 
  snprintf( chExpectedText, elCount(chExpectedText), "Verify var Smsts_lock[10]=5  in function Os_Test_GetHWIO_e_LockSemaphore_test() in test_os_hwio.c file "); 
  TestStepAddActionExpected( chActionText, chExpectedText );
  E_DBGR_VariableCheck("Smsts_lock[10]", 5, Equal);
  
  snprintf( chActionText, elCount(chActionText), "check var Smsts_lock[11]=5  in function Os_Test_GetHWIO_e_LockSemaphore_test() in test_os_hwio.c file "); 
  snprintf( chExpectedText, elCount(chExpectedText), "Verify var Smsts_lock[11]=5  in function Os_Test_GetHWIO_e_LockSemaphore_test() in test_os_hwio.c file "); 
  TestStepAddActionExpected( chActionText, chExpectedText );
  E_DBGR_VariableCheck("Smsts_lock[11]", 5, Equal);
  
  snprintf( chActionText, elCount(chActionText), "check var Smsts_lock[12]=5  in function Os_Test_GetHWIO_e_LockSemaphore_test() in test_os_hwio.c file "); 
  snprintf( chExpectedText, elCount(chExpectedText), "Verify var Smsts_lock[12]=5  in function Os_Test_GetHWIO_e_LockSemaphore_test() in test_os_hwio.c file "); 
  TestStepAddActionExpected( chActionText, chExpectedText );
  E_DBGR_VariableCheck("Smsts_lock[12]", 5, Equal);
  
  snprintf( chActionText, elCount(chActionText), "check var Smsts_lock[13]=5  in function Os_Test_GetHWIO_e_LockSemaphore_test() in test_os_hwio.c file "); 
  snprintf( chExpectedText, elCount(chExpectedText), "Verify var Smsts_lock[13]=5  in function Os_Test_GetHWIO_e_LockSemaphore_test() in test_os_hwio.c file "); 
  TestStepAddActionExpected( chActionText, chExpectedText );
  E_DBGR_VariableCheck("Smsts_lock[13]", 5, Equal);
  
  snprintf( chActionText, elCount(chActionText), "check var Smsts_lock[14]=5  in function Os_Test_GetHWIO_e_LockSemaphore_test() in test_os_hwio.c file "); 
  snprintf( chExpectedText, elCount(chExpectedText), "Verify var Smsts_lock[14]=5  in function Os_Test_GetHWIO_e_LockSemaphore_test() in test_os_hwio.c file "); 
  TestStepAddActionExpected( chActionText, chExpectedText );
  E_DBGR_VariableCheck("Smsts_lock[14]", 5, Equal);
  
  snprintf( chActionText, elCount(chActionText), "check var Smsts_lock[15]=5  in function Os_Test_GetHWIO_e_LockSemaphore_test() in test_os_hwio.c file "); 
  snprintf( chExpectedText, elCount(chExpectedText), "Verify var Smsts_lock[15]=5  in function Os_Test_GetHWIO_e_LockSemaphore_test() in test_os_hwio.c file "); 
  TestStepAddActionExpected( chActionText, chExpectedText );
  E_DBGR_VariableCheck("Smsts_lock[15]", 5, Equal);
  
  snprintf( chActionText, elCount(chActionText), "check var Smsts_lock[16]=5  in function Os_Test_GetHWIO_e_LockSemaphore_test() in test_os_hwio.c file "); 
  snprintf( chExpectedText, elCount(chExpectedText), "Verify var Smsts_lock[16]=5  in function Os_Test_GetHWIO_e_LockSemaphore_test() in test_os_hwio.c file "); 
  TestStepAddActionExpected( chActionText, chExpectedText );
  E_DBGR_VariableCheck("Smsts_lock[16]", 5, Equal);
  
  snprintf( chActionText, elCount(chActionText), "check var Smsts_lock[17]=5  in function Os_Test_GetHWIO_e_LockSemaphore_test() in test_os_hwio.c file "); 
  snprintf( chExpectedText, elCount(chExpectedText), "Verify var Smsts_lock[17]=5  in function Os_Test_GetHWIO_e_LockSemaphore_test() in test_os_hwio.c file "); 
  TestStepAddActionExpected( chActionText, chExpectedText );
  E_DBGR_VariableCheck("Smsts_lock[17]", 5, Equal);
  
  snprintf( chActionText, elCount(chActionText), "check var Smsts_lock[18]=5  in function Os_Test_GetHWIO_e_LockSemaphore_test() in test_os_hwio.c file "); 
  snprintf( chExpectedText, elCount(chExpectedText), "Verify var Smsts_lock[18]=5  in function Os_Test_GetHWIO_e_LockSemaphore_test() in test_os_hwio.c file "); 
  TestStepAddActionExpected( chActionText, chExpectedText );
  E_DBGR_VariableCheck("Smsts_lock[18]", 5, Equal);
  
  snprintf( chActionText, elCount(chActionText), "check var Smsts_lock[19]=5  in function Os_Test_GetHWIO_e_LockSemaphore_test() in test_os_hwio.c file "); 
  snprintf( chExpectedText, elCount(chExpectedText), "Verify var Smsts_lock[19]=5  in function Os_Test_GetHWIO_e_LockSemaphore_test() in test_os_hwio.c file "); 
  TestStepAddActionExpected( chActionText, chExpectedText );
  E_DBGR_VariableCheck("Smsts_lock[19]", 5, Equal);
  
  
  snprintf( chActionText, elCount(chActionText), "check var Smsts_lock[20]=5  in function Os_Test_GetHWIO_e_LockSemaphore_test() in test_os_hwio.c file "); 
  snprintf( chExpectedText, elCount(chExpectedText), "Verify var Smsts_lock[20]=5  in function Os_Test_GetHWIO_e_LockSemaphore_test() in test_os_hwio.c file "); 
  TestStepAddActionExpected( chActionText, chExpectedText );
  E_DBGR_VariableCheck("Smsts_lock[20]", 5, Equal);
  
  
  snprintf( chActionText, elCount(chActionText), "check var Smsts_lock[21]=5  in function Os_Test_GetHWIO_e_LockSemaphore_test() in test_os_hwio.c file "); 
  snprintf( chExpectedText, elCount(chExpectedText), "Verify var Smsts_lock[21]=5  in function Os_Test_GetHWIO_e_LockSemaphore_test() in test_os_hwio.c file "); 
  TestStepAddActionExpected( chActionText, chExpectedText );
  E_DBGR_VariableCheck("Smsts_lock[21]", 5, Equal);
  
  
  snprintf( chActionText, elCount(chActionText), "check var Smsts_lock[22]=5  in function Os_Test_GetHWIO_e_LockSemaphore_test() in test_os_hwio.c file "); 
  snprintf( chExpectedText, elCount(chExpectedText), "Verify var Smsts_lock[22]=5  in function Os_Test_GetHWIO_e_LockSemaphore_test() in test_os_hwio.c file "); 
  TestStepAddActionExpected( chActionText, chExpectedText );
  E_DBGR_VariableCheck("Smsts_lock[22]", 5, Equal);
  
  
  snprintf( chActionText, elCount(chActionText), "check var Smsts_lock[23]=5  in function Os_Test_GetHWIO_e_LockSemaphore_test() in test_os_hwio.c file "); 
  snprintf( chExpectedText, elCount(chExpectedText), "Verify var Smsts_lock[23]=5  in function Os_Test_GetHWIO_e_LockSemaphore_test() in test_os_hwio.c file "); 
  TestStepAddActionExpected( chActionText, chExpectedText );
  E_DBGR_VariableCheck("Smsts_lock[23]", 5, Equal);
  
  
  snprintf( chActionText, elCount(chActionText), "check var Smsts_lock[24]=5  in function Os_Test_GetHWIO_e_LockSemaphore_test() in test_os_hwio.c file "); 
  snprintf( chExpectedText, elCount(chExpectedText), "Verify var Smsts_lock[24]=5  in function Os_Test_GetHWIO_e_LockSemaphore_test() in test_os_hwio.c file "); 
  TestStepAddActionExpected( chActionText, chExpectedText );
  E_DBGR_VariableCheck("Smsts_lock[24]", 5, Equal);
  
  
  snprintf( chActionText, elCount(chActionText), "check var Smsts_lock[25]=5  in function Os_Test_GetHWIO_e_LockSemaphore_test() in test_os_hwio.c file "); 
  snprintf( chExpectedText, elCount(chExpectedText), "Verify var Smsts_lock[25]=5  in function Os_Test_GetHWIO_e_LockSemaphore_test() in test_os_hwio.c file "); 
  TestStepAddActionExpected( chActionText, chExpectedText );
  E_DBGR_VariableCheck("Smsts_lock[25]", 5, Equal);
  
  
  snprintf( chActionText, elCount(chActionText), "check var Smsts_lock[26]=5  in function Os_Test_GetHWIO_e_LockSemaphore_test() in test_os_hwio.c file "); 
  snprintf( chExpectedText, elCount(chExpectedText), "Verify var Smsts_lock[26]=5  in function Os_Test_GetHWIO_e_LockSemaphore_test() in test_os_hwio.c file "); 
  TestStepAddActionExpected( chActionText, chExpectedText );
  E_DBGR_VariableCheck("Smsts_lock[26]", 5, Equal);
  
  
  snprintf( chActionText, elCount(chActionText), "check var Smsts_lock[27]=5  in function Os_Test_GetHWIO_e_LockSemaphore_test() in test_os_hwio.c file "); 
  snprintf( chExpectedText, elCount(chExpectedText), "Verify var Smsts_lock[27]=5  in function Os_Test_GetHWIO_e_LockSemaphore_test() in test_os_hwio.c file "); 
  TestStepAddActionExpected( chActionText, chExpectedText );
  E_DBGR_VariableCheck("Smsts_lock[27]", 5, Equal);
  
  snprintf( chActionText, elCount(chActionText), "check var Smsts_lock[28]=5  in function Os_Test_GetHWIO_e_LockSemaphore_test() in test_os_hwio.c file "); 
  snprintf( chExpectedText, elCount(chExpectedText), "Verify var Smsts_lock[28]=5  in function Os_Test_GetHWIO_e_LockSemaphore_test() in test_os_hwio.c file "); 
  TestStepAddActionExpected( chActionText, chExpectedText );
  E_DBGR_VariableCheck("Smsts_lock[28]", 5, Equal);
  
  
  snprintf( chActionText, elCount(chActionText), "check var Smsts_lock[29]=5  in function Os_Test_GetHWIO_e_LockSemaphore_test() in test_os_hwio.c file "); 
  snprintf( chExpectedText, elCount(chExpectedText), "Verify var Smsts_lock[29]=5  in function Os_Test_GetHWIO_e_LockSemaphore_test() in test_os_hwio.c file "); 
  TestStepAddActionExpected( chActionText, chExpectedText );
  E_DBGR_VariableCheck("Smsts_lock[29]", 5, Equal);
  
  
  snprintf( chActionText, elCount(chActionText), "check var Smsts_lock[30]=5  in function Os_Test_GetHWIO_e_LockSemaphore_test() in test_os_hwio.c file "); 
  snprintf( chExpectedText, elCount(chExpectedText), "Verify var Smsts_lock[30]=5  in function Os_Test_GetHWIO_e_LockSemaphore_test() in test_os_hwio.c file "); 
  TestStepAddActionExpected( chActionText, chExpectedText );
  E_DBGR_VariableCheck("Smsts_lock[30]", 5, Equal);
  
  
  snprintf( chActionText, elCount(chActionText), "check var Smsts_lock[31]=5  in function Os_Test_GetHWIO_e_LockSemaphore_test() in test_os_hwio.c file "); 
  snprintf( chExpectedText, elCount(chExpectedText), "Verify var Smsts_lock[31]=5  in function Os_Test_GetHWIO_e_LockSemaphore_test() in test_os_hwio.c file "); 
  TestStepAddActionExpected( chActionText, chExpectedText );
  E_DBGR_VariableCheck("Smsts_lock[31]", 5, Equal);
  
  
  
  
  /*******************************************************************************************************************************************************/    
    // Test Step 5: check var Smsts_unlock[semaphore]=0 for 32 index in function Os_Test_GetHWIO_e_LockSemaphore_test() in test_os_hwio.c file
  /*******************************************************************************************************************************************************/
  snprintf( chActionText, elCount(chActionText), "check var Smsts_unlock[0]=0  in function Os_Test_GetHWIO_e_LockSemaphore_test() in test_os_hwio.c file "); 
  snprintf( chExpectedText, elCount(chExpectedText), "Verify var Smsts_unlock[0]=0  in function Os_Test_GetHWIO_e_LockSemaphore_test() in test_os_hwio.c file "); 
  TestStepAddActionExpected( chActionText, chExpectedText );
  E_DBGR_VariableCheck("Smsts_unlock[0]", 0, Equal);
  
  snprintf( chActionText, elCount(chActionText), "check var Smsts_unlock[1]=0  in function Os_Test_GetHWIO_e_LockSemaphore_test() in test_os_hwio.c file "); 
  snprintf( chExpectedText, elCount(chExpectedText), "Verify var Smsts_unlock[1]=0  in function Os_Test_GetHWIO_e_LockSemaphore_test() in test_os_hwio.c file "); 
  TestStepAddActionExpected( chActionText, chExpectedText );
  E_DBGR_VariableCheck("Smsts_unlock[1]", 0, Equal);
  
  snprintf( chActionText, elCount(chActionText), "check var Smsts_unlock[2]=0  in function Os_Test_GetHWIO_e_LockSemaphore_test() in test_os_hwio.c file "); 
  snprintf( chExpectedText, elCount(chExpectedText), "Verify var Smsts_unlock[2]=0  in function Os_Test_GetHWIO_e_LockSemaphore_test() in test_os_hwio.c file "); 
  TestStepAddActionExpected( chActionText, chExpectedText );
  E_DBGR_VariableCheck("Smsts_unlock[2]", 0, Equal);
  
  snprintf( chActionText, elCount(chActionText), "check var Smsts_unlock[3]=0  in function Os_Test_GetHWIO_e_LockSemaphore_test() in test_os_hwio.c file "); 
  snprintf( chExpectedText, elCount(chExpectedText), "Verify var Smsts_unlock[3]=0  in function Os_Test_GetHWIO_e_LockSemaphore_test() in test_os_hwio.c file "); 
  TestStepAddActionExpected( chActionText, chExpectedText );
  E_DBGR_VariableCheck("Smsts_unlock[3]", 0, Equal);
  
  snprintf( chActionText, elCount(chActionText), "check var Smsts_unlock[4]=0  in function Os_Test_GetHWIO_e_LockSemaphore_test() in test_os_hwio.c file "); 
  snprintf( chExpectedText, elCount(chExpectedText), "Verify var Smsts_unlock[4]=0  in function Os_Test_GetHWIO_e_LockSemaphore_test() in test_os_hwio.c file "); 
  TestStepAddActionExpected( chActionText, chExpectedText );
  E_DBGR_VariableCheck("Smsts_unlock[4]", 0, Equal);
  
  snprintf( chActionText, elCount(chActionText), "check var Smsts_unlock[5]=0  in function Os_Test_GetHWIO_e_LockSemaphore_test() in test_os_hwio.c file "); 
  snprintf( chExpectedText, elCount(chExpectedText), "Verify var Smsts_unlock[5]=0  in function Os_Test_GetHWIO_e_LockSemaphore_test() in test_os_hwio.c file "); 
  TestStepAddActionExpected( chActionText, chExpectedText );
  E_DBGR_VariableCheck("Smsts_unlock[5]", 0, Equal);
  
  snprintf( chActionText, elCount(chActionText), "check var Smsts_unlock[6]=0  in function Os_Test_GetHWIO_e_LockSemaphore_test() in test_os_hwio.c file "); 
  snprintf( chExpectedText, elCount(chExpectedText), "Verify var Smsts_lock[6]=0  in function Os_Test_GetHWIO_e_LockSemaphore_test() in test_os_hwio.c file "); 
  TestStepAddActionExpected( chActionText, chExpectedText );
  E_DBGR_VariableCheck("Smsts_unlock[6]", 0, Equal);
  
  snprintf( chActionText, elCount(chActionText), "check var Smsts_unlock[7]=0  in function Os_Test_GetHWIO_e_LockSemaphore_test() in test_os_hwio.c file "); 
  snprintf( chExpectedText, elCount(chExpectedText), "Verify var Smsts_unlock[7]=0   in function Os_Test_GetHWIO_e_LockSemaphore_test() in test_os_hwio.c file "); 
  TestStepAddActionExpected( chActionText, chExpectedText );
  E_DBGR_VariableCheck("Smsts_unlock[7]", 0, Equal);
  
  snprintf( chActionText, elCount(chActionText), "check var Smsts_unlock[8]=0  in function Os_Test_GetHWIO_e_LockSemaphore_test() in test_os_hwio.c file "); 
  snprintf( chExpectedText, elCount(chExpectedText), "Verify var Smsts_unlock[8]=0  in function Os_Test_GetHWIO_e_LockSemaphore_test() in test_os_hwio.c file "); 
  TestStepAddActionExpected( chActionText, chExpectedText );
  E_DBGR_VariableCheck("Smsts_unlock[8]", 0, Equal);
  
  snprintf( chActionText, elCount(chActionText), "check var Smsts_unlock[9]=0  in function Os_Test_GetHWIO_e_LockSemaphore_test() in test_os_hwio.c file "); 
  snprintf( chExpectedText, elCount(chExpectedText), "Verify var Smsts_unlock[9]=0  in function Os_Test_GetHWIO_e_LockSemaphore_test() in test_os_hwio.c file "); 
  TestStepAddActionExpected( chActionText, chExpectedText );
  E_DBGR_VariableCheck("Smsts_unlock[9]", 0, Equal);
  
  snprintf( chActionText, elCount(chActionText), "check var Smsts_unlock[10]=0  in function Os_Test_GetHWIO_e_LockSemaphore_test() in test_os_hwio.c file "); 
  snprintf( chExpectedText, elCount(chExpectedText), "Verify var Smsts_unlock[10]=0  in function Os_Test_GetHWIO_e_LockSemaphore_test() in test_os_hwio.c file "); 
  TestStepAddActionExpected( chActionText, chExpectedText );
  E_DBGR_VariableCheck("Smsts_unlock[10]", 0, Equal);
  
  snprintf( chActionText, elCount(chActionText), "check var Smsts_unlock[11]=0  in function Os_Test_GetHWIO_e_LockSemaphore_test() in test_os_hwio.c file "); 
  snprintf( chExpectedText, elCount(chExpectedText), "Verify var Smsts_unlock[11]=0  in function Os_Test_GetHWIO_e_LockSemaphore_test() in test_os_hwio.c file "); 
  TestStepAddActionExpected( chActionText, chExpectedText );
  E_DBGR_VariableCheck("Smsts_unlock[11]", 0, Equal);
  
  snprintf( chActionText, elCount(chActionText), "check var Smsts_unlock[12]=0  in function Os_Test_GetHWIO_e_LockSemaphore_test() in test_os_hwio.c file "); 
  snprintf( chExpectedText, elCount(chExpectedText), "Verify var Smsts_unlock[12]=0  in function Os_Test_GetHWIO_e_LockSemaphore_test() in test_os_hwio.c file "); 
  TestStepAddActionExpected( chActionText, chExpectedText );
  E_DBGR_VariableCheck("Smsts_unlock[12]", 0, Equal);
  
  snprintf( chActionText, elCount(chActionText), "check var Smsts_unlock[13]=0  in function Os_Test_GetHWIO_e_LockSemaphore_test() in test_os_hwio.c file "); 
  snprintf( chExpectedText, elCount(chExpectedText), "Verify var Smsts_unlock[13]=0  in function Os_Test_GetHWIO_e_LockSemaphore_test() in test_os_hwio.c file "); 
  TestStepAddActionExpected( chActionText, chExpectedText );
  E_DBGR_VariableCheck("Smsts_unlock[13]", 0, Equal);
  
  snprintf( chActionText, elCount(chActionText), "check var Smsts_unlock[14]=0  in function Os_Test_GetHWIO_e_LockSemaphore_test() in test_os_hwio.c file "); 
  snprintf( chExpectedText, elCount(chExpectedText), "Verify var Smsts_unlock[14]=0  in function Os_Test_GetHWIO_e_LockSemaphore_test() in test_os_hwio.c file "); 
  TestStepAddActionExpected( chActionText, chExpectedText );
  E_DBGR_VariableCheck("Smsts_unlock[14]", 0, Equal);
  
  snprintf( chActionText, elCount(chActionText), "check var Smsts_unlock[15]=0  in function Os_Test_GetHWIO_e_LockSemaphore_test() in test_os_hwio.c file "); 
  snprintf( chExpectedText, elCount(chExpectedText), "Verify var Smsts_unlock[15]=0  in function Os_Test_GetHWIO_e_LockSemaphore_test() in test_os_hwio.c file "); 
  TestStepAddActionExpected( chActionText, chExpectedText );
  E_DBGR_VariableCheck("Smsts_unlock[15]", 0, Equal);
  
  snprintf( chActionText, elCount(chActionText), "check var Smsts_unlock[16]=0  in function Os_Test_GetHWIO_e_LockSemaphore_test() in test_os_hwio.c file "); 
  snprintf( chExpectedText, elCount(chExpectedText), "Verify var Smsts_unlock[16]=0  in function Os_Test_GetHWIO_e_LockSemaphore_test() in test_os_hwio.c file "); 
  TestStepAddActionExpected( chActionText, chExpectedText );
  E_DBGR_VariableCheck("Smsts_unlock[16]", 0, Equal);
  
  snprintf( chActionText, elCount(chActionText), "check var Smsts_unlock[17]=0  in function Os_Test_GetHWIO_e_LockSemaphore_test() in test_os_hwio.c file "); 
  snprintf( chExpectedText, elCount(chExpectedText), "Verify var Smsts_unlock[17]=0  in function Os_Test_GetHWIO_e_LockSemaphore_test() in test_os_hwio.c file "); 
  TestStepAddActionExpected( chActionText, chExpectedText );
  E_DBGR_VariableCheck("Smsts_unlock[17]", 0, Equal);
  
  snprintf( chActionText, elCount(chActionText), "check var Smsts_unlock[18]=0  in function Os_Test_GetHWIO_e_LockSemaphore_test() in test_os_hwio.c file "); 
  snprintf( chExpectedText, elCount(chExpectedText), "Verify var Smsts_unlock[18]=0  in function Os_Test_GetHWIO_e_LockSemaphore_test() in test_os_hwio.c file "); 
  TestStepAddActionExpected( chActionText, chExpectedText );
  E_DBGR_VariableCheck("Smsts_unlock[18]", 0, Equal);
  
  snprintf( chActionText, elCount(chActionText), "check var Smsts_unlock[19]=0  in function Os_Test_GetHWIO_e_LockSemaphore_test() in test_os_hwio.c file "); 
  snprintf( chExpectedText, elCount(chExpectedText), "Verify var Smsts_unlock[19]=0  in function Os_Test_GetHWIO_e_LockSemaphore_test() in test_os_hwio.c file "); 
  TestStepAddActionExpected( chActionText, chExpectedText );
  E_DBGR_VariableCheck("Smsts_unlock[19]", 0, Equal);
  
  
  snprintf( chActionText, elCount(chActionText), "check var Smsts_unlock[20]=0  in function Os_Test_GetHWIO_e_LockSemaphore_test() in test_os_hwio.c file "); 
  snprintf( chExpectedText, elCount(chExpectedText), "Verify var Smsts_unlock[20]=0  in function Os_Test_GetHWIO_e_LockSemaphore_test() in test_os_hwio.c file "); 
  TestStepAddActionExpected( chActionText, chExpectedText );
  E_DBGR_VariableCheck("Smsts_unlock[20]", 0, Equal);
  
  
  snprintf( chActionText, elCount(chActionText), "check var Smsts_unlock[21]=0  in function Os_Test_GetHWIO_e_LockSemaphore_test() in test_os_hwio.c file "); 
  snprintf( chExpectedText, elCount(chExpectedText), "Verify var Smsts_unlock[21]=0  in function Os_Test_GetHWIO_e_LockSemaphore_test() in test_os_hwio.c file "); 
  TestStepAddActionExpected( chActionText, chExpectedText );
  E_DBGR_VariableCheck("Smsts_unlock[21]", 0, Equal);
  
  
  snprintf( chActionText, elCount(chActionText), "check var Smsts_unlock[22]=0  in function Os_Test_GetHWIO_e_LockSemaphore_test() in test_os_hwio.c file "); 
  snprintf( chExpectedText, elCount(chExpectedText), "Verify var Smsts_unlock[22]=0  in function Os_Test_GetHWIO_e_LockSemaphore_test() in test_os_hwio.c file "); 
  TestStepAddActionExpected( chActionText, chExpectedText );
  E_DBGR_VariableCheck("Smsts_unlock[22]", 0, Equal);
  
  
  snprintf( chActionText, elCount(chActionText), "check var Smsts_unlock[23]=0  in function Os_Test_GetHWIO_e_LockSemaphore_test() in test_os_hwio.c file "); 
  snprintf( chExpectedText, elCount(chExpectedText), "Verify var Smsts_unlock[23]=0  in function Os_Test_GetHWIO_e_LockSemaphore_test() in test_os_hwio.c file "); 
  TestStepAddActionExpected( chActionText, chExpectedText );
  E_DBGR_VariableCheck("Smsts_unlock[23]", 0, Equal);
  
  
  snprintf( chActionText, elCount(chActionText), "check var Smsts_unlock[24]=0  in function Os_Test_GetHWIO_e_LockSemaphore_test() in test_os_hwio.c file "); 
  snprintf( chExpectedText, elCount(chExpectedText), "Verify var Smsts_unlock[24]=0  in function Os_Test_GetHWIO_e_LockSemaphore_test() in test_os_hwio.c file "); 
  TestStepAddActionExpected( chActionText, chExpectedText );
  E_DBGR_VariableCheck("Smsts_unlock[24]", 0, Equal);
  
  
  snprintf( chActionText, elCount(chActionText), "check var Smsts_unlock[25]=0  in function Os_Test_GetHWIO_e_LockSemaphore_test() in test_os_hwio.c file "); 
  snprintf( chExpectedText, elCount(chExpectedText), "Verify var Smsts_unloc[25]=5 0 in function Os_Test_GetHWIO_e_LockSemaphore_test() in test_os_hwio.c file "); 
  TestStepAddActionExpected( chActionText, chExpectedText );
  E_DBGR_VariableCheck("Smsts_unlock[25]", 0, Equal);
  
  
  snprintf( chActionText, elCount(chActionText), "check var Smsts_unlock[26]=0  in function Os_Test_GetHWIO_e_LockSemaphore_test() in test_os_hwio.c file "); 
  snprintf( chExpectedText, elCount(chExpectedText), "Verify var Smsts_unlock[26]=0  in function Os_Test_GetHWIO_e_LockSemaphore_test() in test_os_hwio.c file "); 
  TestStepAddActionExpected( chActionText, chExpectedText );
  E_DBGR_VariableCheck("Smsts_unlock[26]", 0, Equal);
  
  
  snprintf( chActionText, elCount(chActionText), "check var Smsts_unlock[27]=0  in function Os_Test_GetHWIO_e_LockSemaphore_test() in test_os_hwio.c file "); 
  snprintf( chExpectedText, elCount(chExpectedText), "Verify var Smsts_unlock[27]=0  in function Os_Test_GetHWIO_e_LockSemaphore_test() in test_os_hwio.c file "); 
  TestStepAddActionExpected( chActionText, chExpectedText );
  E_DBGR_VariableCheck("Smsts_unlock[27]", 0, Equal);
  
  snprintf( chActionText, elCount(chActionText), "check var Smsts_unlock[28]=0Smsts_unlock  in function Os_Test_GetHWIO_e_LockSemaphore_test() in test_os_hwio.c file "); 
  snprintf( chExpectedText, elCount(chExpectedText), "Verify var Smsts_unlock[28]=0  in function Os_Test_GetHWIO_e_LockSemaphore_test() in test_os_hwio.c file "); 
  TestStepAddActionExpected( chActionText, chExpectedText );
  E_DBGR_VariableCheck("Smsts_unlock[28]", 0, Equal);
  
  
  snprintf( chActionText, elCount(chActionText), "check var Smsts_unlock[29]=0  in function Os_Test_GetHWIO_e_LockSemaphore_test() in test_os_hwio.c file "); 
  snprintf( chExpectedText, elCount(chExpectedText), "Verify var Smsts_unlock[29]=0  in function Os_Test_GetHWIO_e_LockSemaphore_test() in test_os_hwio.c file "); 
  TestStepAddActionExpected( chActionText, chExpectedText );
  E_DBGR_VariableCheck("Smsts_unlock[29]", 0, Equal);
  
  
  snprintf( chActionText, elCount(chActionText), "check var Smsts_unlock[30]=0  in function Os_Test_GetHWIO_e_LockSemaphore_test() in test_os_hwio.c file "); 
  snprintf( chExpectedText, elCount(chExpectedText), "Verify var Smsts_unlock[30]=0  in function Os_Test_GetHWIO_e_LockSemaphore_test() in test_os_hwio.c file "); 
  TestStepAddActionExpected( chActionText, chExpectedText );
  E_DBGR_VariableCheck("Smsts_unlock[30]", 0, Equal);
  
  
  snprintf( chActionText, elCount(chActionText), "check var Smsts_unlock[31]=0  in function Os_Test_GetHWIO_e_LockSemaphore_test() in test_os_hwio.c file "); 
  snprintf( chExpectedText, elCount(chExpectedText), "Verify var Smsts_unlock[31]=0  in function Os_Test_GetHWIO_e_LockSemaphore_test() in test_os_hwio.c file "); 
  TestStepAddActionExpected( chActionText, chExpectedText );
  E_DBGR_VariableCheck("Smsts_unlock[31]", 0, Equal);
  
  
  
  
  /*******************************************************************************************************************************************************/    
    // Test Step 6: check var Smsts_status[semaphore]=5 for 32 index in function Os_Test_GetHWIO_e_LockSemaphore_test() in test_os_hwio.c file
  /*******************************************************************************************************************************************************/
  snprintf( chActionText, elCount(chActionText), "check var Smsts_status[0]=5  in function Os_Test_GetHWIO_e_LockSemaphore_test() in test_os_hwio.c file "); 
  snprintf( chExpectedText, elCount(chExpectedText), "Verify var Smsts_status[0]=5  in function Os_Test_GetHWIO_e_LockSemaphore_test() in test_os_hwio.c file "); 
  TestStepAddActionExpected( chActionText, chExpectedText );
  E_DBGR_VariableCheck("Smsts_status[0]", 5, Equal);
  
  snprintf( chActionText, elCount(chActionText), "check var Smsts_status[1]=5  in function Os_Test_GetHWIO_e_LockSemaphore_test() in test_os_hwio.c file "); 
  snprintf( chExpectedText, elCount(chExpectedText), "Verify var Smsts_status[1]=5  in function Os_Test_GetHWIO_e_LockSemaphore_test() in test_os_hwio.c file "); 
  TestStepAddActionExpected( chActionText, chExpectedText );
  E_DBGR_VariableCheck("Smsts_status[1]", 5, Equal);
  
  snprintf( chActionText, elCount(chActionText), "check var Smsts_status[2]=5  in function Os_Test_GetHWIO_e_LockSemaphore_test() in test_os_hwio.c file "); 
  snprintf( chExpectedText, elCount(chExpectedText), "Verify var Smsts_status[2]=5  in function Os_Test_GetHWIO_e_LockSemaphore_test() in test_os_hwio.c file "); 
  TestStepAddActionExpected( chActionText, chExpectedText );
  E_DBGR_VariableCheck("Smsts_status[2]", 5, Equal);
  
  snprintf( chActionText, elCount(chActionText), "check var Smsts_status[3]=5  in function Os_Test_GetHWIO_e_LockSemaphore_test() in test_os_hwio.c file "); 
  snprintf( chExpectedText, elCount(chExpectedText), "Verify var Smsts_status[3]=5  in function Os_Test_GetHWIO_e_LockSemaphore_test() in test_os_hwio.c file "); 
  TestStepAddActionExpected( chActionText, chExpectedText );
  E_DBGR_VariableCheck("Smsts_status[3]", 5, Equal);
  
  snprintf( chActionText, elCount(chActionText), "check var Smsts_status[4]=5  in function Os_Test_GetHWIO_e_LockSemaphore_test() in test_os_hwio.c file "); 
  snprintf( chExpectedText, elCount(chExpectedText), "Verify var Smsts_status[4]=5  in function Os_Test_GetHWIO_e_LockSemaphore_test() in test_os_hwio.c file "); 
  TestStepAddActionExpected( chActionText, chExpectedText );
  E_DBGR_VariableCheck("Smsts_status[4]", 5, Equal);
  
  snprintf( chActionText, elCount(chActionText), "check var Smsts_status[5]=5  in function Os_Test_GetHWIO_e_LockSemaphore_test() in test_os_hwio.c file "); 
  snprintf( chExpectedText, elCount(chExpectedText), "Verify var Smsts_status[5]=5  in function Os_Test_GetHWIO_e_LockSemaphore_test() in test_os_hwio.c file "); 
  TestStepAddActionExpected( chActionText, chExpectedText );
  E_DBGR_VariableCheck("Smsts_status[5]", 5, Equal);
  
  snprintf( chActionText, elCount(chActionText), "check var Smsts_status[6]=5  in function Os_Test_GetHWIO_e_LockSemaphore_test() in test_os_hwio.c file "); 
  snprintf( chExpectedText, elCount(chExpectedText), "Verify var Smsts_status[6]=5  in function Os_Test_GetHWIO_e_LockSemaphore_test() in test_os_hwio.c file "); 
  TestStepAddActionExpected( chActionText, chExpectedText );
  E_DBGR_VariableCheck("Smsts_status[6]", 5, Equal);
  
  snprintf( chActionText, elCount(chActionText), "check var Smsts_status[7]=5  in function Os_Test_GetHWIO_e_LockSemaphore_test() in test_os_hwio.c file "); 
  snprintf( chExpectedText, elCount(chExpectedText), "Verify var Smsts_status[7]=5  in function Os_Test_GetHWIO_e_LockSemaphore_test() in test_os_hwio.c file "); 
  TestStepAddActionExpected( chActionText, chExpectedText );
  E_DBGR_VariableCheck("Smsts_status[7]", 5, Equal);
  
  snprintf( chActionText, elCount(chActionText), "check var Smsts_status[8]=5  in function Os_Test_GetHWIO_e_LockSemaphore_test() in test_os_hwio.c file "); 
  snprintf( chExpectedText, elCount(chExpectedText), "Verify var Smsts_status[8]=5  in function Os_Test_GetHWIO_e_LockSemaphore_test() in test_os_hwio.c file "); 
  TestStepAddActionExpected( chActionText, chExpectedText );
  E_DBGR_VariableCheck("Smsts_status[8]", 5, Equal);
  
  snprintf( chActionText, elCount(chActionText), "check var Smsts_status[9]=5  in function Os_Test_GetHWIO_e_LockSemaphore_test() in test_os_hwio.c file "); 
  snprintf( chExpectedText, elCount(chExpectedText), "Verify var Smsts_status[9]=5  in function Os_Test_GetHWIO_e_LockSemaphore_test() in test_os_hwio.c file "); 
  TestStepAddActionExpected( chActionText, chExpectedText );
  E_DBGR_VariableCheck("Smsts_status[9]", 5, Equal);
  
  snprintf( chActionText, elCount(chActionText), "check var Smsts_status[10]=5  in function Os_Test_GetHWIO_e_LockSemaphore_test() in test_os_hwio.c file "); 
  snprintf( chExpectedText, elCount(chExpectedText), "Verify var Smsts_status[10]=5  in function Os_Test_GetHWIO_e_LockSemaphore_test() in test_os_hwio.c file "); 
  TestStepAddActionExpected( chActionText, chExpectedText );
  E_DBGR_VariableCheck("Smsts_status[10]", 5, Equal);
  
  snprintf( chActionText, elCount(chActionText), "check var Smsts_status[11]=5  in function Os_Test_GetHWIO_e_LockSemaphore_test() in test_os_hwio.c file "); 
  snprintf( chExpectedText, elCount(chExpectedText), "Verify var Smsts_status[11]=5  in function Os_Test_GetHWIO_e_LockSemaphore_test() in test_os_hwio.c file "); 
  TestStepAddActionExpected( chActionText, chExpectedText );
  E_DBGR_VariableCheck("Smsts_status[11]", 5, Equal);
  
  snprintf( chActionText, elCount(chActionText), "check var Smsts_status[12]=5  in function Os_Test_GetHWIO_e_LockSemaphore_test() in test_os_hwio.c file "); 
  snprintf( chExpectedText, elCount(chExpectedText), "Verify var Smsts_status[12]=5  in function Os_Test_GetHWIO_e_LockSemaphore_test() in test_os_hwio.c file "); 
  TestStepAddActionExpected( chActionText, chExpectedText );
  E_DBGR_VariableCheck("Smsts_status[12]", 5, Equal);
  
  snprintf( chActionText, elCount(chActionText), "check var Smsts_status[13]=5  in function Os_Test_GetHWIO_e_LockSemaphore_test() in test_os_hwio.c file "); 
  snprintf( chExpectedText, elCount(chExpectedText), "Verify var Smsts_status[13]=5  in function Os_Test_GetHWIO_e_LockSemaphore_test() in test_os_hwio.c file "); 
  TestStepAddActionExpected( chActionText, chExpectedText );
  E_DBGR_VariableCheck("Smsts_status[13]", 5, Equal);
  
  snprintf( chActionText, elCount(chActionText), "check var Smsts_status[14]=5  in function Os_Test_GetHWIO_e_LockSemaphore_test() in test_os_hwio.c file "); 
  snprintf( chExpectedText, elCount(chExpectedText), "Verify var Smsts_status[14]=5  in function Os_Test_GetHWIO_e_LockSemaphore_test() in test_os_hwio.c file "); 
  TestStepAddActionExpected( chActionText, chExpectedText );
  E_DBGR_VariableCheck("Smsts_status[14]", 5, Equal);
  
  snprintf( chActionText, elCount(chActionText), "check var Smsts_status[15]=5  in function Os_Test_GetHWIO_e_LockSemaphore_test() in test_os_hwio.c file "); 
  snprintf( chExpectedText, elCount(chExpectedText), "Verify var Smsts_status[15]=5  in function Os_Test_GetHWIO_e_LockSemaphore_test() in test_os_hwio.c file "); 
  TestStepAddActionExpected( chActionText, chExpectedText );
  E_DBGR_VariableCheck("Smsts_status[15]", 5, Equal);
  
  snprintf( chActionText, elCount(chActionText), "check var Smsts_status[16]=5  in function Os_Test_GetHWIO_e_LockSemaphore_test() in test_os_hwio.c file "); 
  snprintf( chExpectedText, elCount(chExpectedText), "Verify var Smsts_status[16]=5  in function Os_Test_GetHWIO_e_LockSemaphore_test() in test_os_hwio.c file "); 
  TestStepAddActionExpected( chActionText, chExpectedText );
  E_DBGR_VariableCheck("Smsts_status[16]", 5, Equal);
  
  snprintf( chActionText, elCount(chActionText), "check var Smsts_status[17]=5  in function Os_Test_GetHWIO_e_LockSemaphore_test() in test_os_hwio.c file "); 
  snprintf( chExpectedText, elCount(chExpectedText), "Verify var Smsts_status[17]=5  in function Os_Test_GetHWIO_e_LockSemaphore_test() in test_os_hwio.c file "); 
  TestStepAddActionExpected( chActionText, chExpectedText );
  E_DBGR_VariableCheck("Smsts_status[17]", 5, Equal);
  
  snprintf( chActionText, elCount(chActionText), "check var Smsts_status[18]=5  in function Os_Test_GetHWIO_e_LockSemaphore_test() in test_os_hwio.c file "); 
  snprintf( chExpectedText, elCount(chExpectedText), "Verify var Smsts_status[18]=5  in function Os_Test_GetHWIO_e_LockSemaphore_test() in test_os_hwio.c file "); 
  TestStepAddActionExpected( chActionText, chExpectedText );
  E_DBGR_VariableCheck("Smsts_status[18]", 5, Equal);
  
  snprintf( chActionText, elCount(chActionText), "check var Smsts_status[19]=5  in function Os_Test_GetHWIO_e_LockSemaphore_test() in test_os_hwio.c file "); 
  snprintf( chExpectedText, elCount(chExpectedText), "Verify var Smsts_status[19]=5  in function Os_Test_GetHWIO_e_LockSemaphore_test() in test_os_hwio.c file "); 
  TestStepAddActionExpected( chActionText, chExpectedText );
  E_DBGR_VariableCheck("Smsts_status[19]", 5, Equal);
  
  
  snprintf( chActionText, elCount(chActionText), "check var Smsts_status[20]=5  in function Os_Test_GetHWIO_e_LockSemaphore_test() in test_os_hwio.c file "); 
  snprintf( chExpectedText, elCount(chExpectedText), "Verify var Smsts_status[20]=5  in function Os_Test_GetHWIO_e_LockSemaphore_test() in test_os_hwio.c file "); 
  TestStepAddActionExpected( chActionText, chExpectedText );
  E_DBGR_VariableCheck("Smsts_status[20]", 5, Equal);
  
  
  snprintf( chActionText, elCount(chActionText), "check var Smsts_status[21]=5  in function Os_Test_GetHWIO_e_LockSemaphore_test() in test_os_hwio.c file "); 
  snprintf( chExpectedText, elCount(chExpectedText), "Verify var Smsts_status[21]=5  in function Os_Test_GetHWIO_e_LockSemaphore_test() in test_os_hwio.c file "); 
  TestStepAddActionExpected( chActionText, chExpectedText );
  E_DBGR_VariableCheck("Smsts_status[21]", 5, Equal);
  
  
  snprintf( chActionText, elCount(chActionText), "check var Smsts_status[22]=5  in function Os_Test_GetHWIO_e_LockSemaphore_test() in test_os_hwio.c file "); 
  snprintf( chExpectedText, elCount(chExpectedText), "Verify var Smsts_status[22]=5  in function Os_Test_GetHWIO_e_LockSemaphore_test() in test_os_hwio.c file "); 
  TestStepAddActionExpected( chActionText, chExpectedText );
  E_DBGR_VariableCheck("Smsts_status[22]", 5, Equal);
  
  
  snprintf( chActionText, elCount(chActionText), "check var Smsts_status[23]=5  in function Os_Test_GetHWIO_e_LockSemaphore_test() in test_os_hwio.c file "); 
  snprintf( chExpectedText, elCount(chExpectedText), "Verify var Smsts_status[23]=5  in function Os_Test_GetHWIO_e_LockSemaphore_test() in test_os_hwio.c file "); 
  TestStepAddActionExpected( chActionText, chExpectedText );
  E_DBGR_VariableCheck("Smsts_status[23]", 5, Equal);
  
  
  snprintf( chActionText, elCount(chActionText), "check var Smsts_status[24]=5  in function Os_Test_GetHWIO_e_LockSemaphore_test() in test_os_hwio.c file "); 
  snprintf( chExpectedText, elCount(chExpectedText), "Verify var Smsts_status[24]=5  in function Os_Test_GetHWIO_e_LockSemaphore_test() in test_os_hwio.c file "); 
  TestStepAddActionExpected( chActionText, chExpectedText );
  E_DBGR_VariableCheck("Smsts_status[24]", 5, Equal);
  
  
  snprintf( chActionText, elCount(chActionText), "check var Smsts_lock[25]=5  in function Os_Test_GetHWIO_e_LockSemaphore_test() in test_os_hwio.c file "); 
  snprintf( chExpectedText, elCount(chExpectedText), "Verify var Smsts_lock[25]=5  in function Os_Test_GetHWIO_e_LockSemaphore_test() in test_os_hwio.c file "); 
  TestStepAddActionExpected( chActionText, chExpectedText );
  E_DBGR_VariableCheck("Smsts_status[25]", 5, Equal);
  
  
  snprintf( chActionText, elCount(chActionText), "check var Smsts_status[26]=5  in function Os_Test_GetHWIO_e_LockSemaphore_test() in test_os_hwio.c file "); 
  snprintf( chExpectedText, elCount(chExpectedText), "Verify var Smsts_status[26]=5  in function Os_Test_GetHWIO_e_LockSemaphore_test() in test_os_hwio.c file "); 
  TestStepAddActionExpected( chActionText, chExpectedText );
  E_DBGR_VariableCheck("Smsts_status[26]", 5, Equal);
  
  
  snprintf( chActionText, elCount(chActionText), "check var Smsts_status[27]=5  in function Os_Test_GetHWIO_e_LockSemaphore_test() in test_os_hwio.c file "); 
  snprintf( chExpectedText, elCount(chExpectedText), "Verify var Smsts_status[27]=5  in function Os_Test_GetHWIO_e_LockSemaphore_test() in test_os_hwio.c file "); 
  TestStepAddActionExpected( chActionText, chExpectedText );
  E_DBGR_VariableCheck("Smsts_status[27]", 5, Equal);
  
  snprintf( chActionText, elCount(chActionText), "check var Smsts_status[28]=5  in function Os_Test_GetHWIO_e_LockSemaphore_test() in test_os_hwio.c file "); 
  snprintf( chExpectedText, elCount(chExpectedText), "Verify var Smsts_status[28]=5  in function Os_Test_GetHWIO_e_LockSemaphore_test() in test_os_hwio.c file "); 
  TestStepAddActionExpected( chActionText, chExpectedText );
  E_DBGR_VariableCheck("Smsts_status[28]", 5, Equal);
  
  
  snprintf( chActionText, elCount(chActionText), "check var Smsts_status[29]=5  in function Os_Test_GetHWIO_e_LockSemaphore_test() in test_os_hwio.c file "); 
  snprintf( chExpectedText, elCount(chExpectedText), "Verify var Smsts_status[29]=5  in function Os_Test_GetHWIO_e_LockSemaphore_test() in test_os_hwio.c file "); 
  TestStepAddActionExpected( chActionText, chExpectedText );
  E_DBGR_VariableCheck("Smsts_status[29]", 5, Equal);
  
  
  snprintf( chActionText, elCount(chActionText), "check var Smsts_status[30]=5  in function Os_Test_GetHWIO_e_LockSemaphore_test() in test_os_hwio.c file "); 
  snprintf( chExpectedText, elCount(chExpectedText), "Verify var Smsts_status[30]=5  in function Os_Test_GetHWIO_e_LockSemaphore_test() in test_os_hwio.c file "); 
  TestStepAddActionExpected( chActionText, chExpectedText );
  E_DBGR_VariableCheck("Smsts_status[30]", 5, Equal);
  
  
  snprintf( chActionText, elCount(chActionText), "check var Smsts_status[31]=5  in function Os_Test_GetHWIO_e_LockSemaphore_test() in test_os_hwio.c file "); 
  snprintf( chExpectedText, elCount(chExpectedText), "Verify var Smsts_status[31]=5  in function Os_Test_GetHWIO_e_LockSemaphore_test() in test_os_hwio.c file "); 
  TestStepAddActionExpected( chActionText, chExpectedText );
  E_DBGR_VariableCheck("Smsts_status[31]", 5, Equal);
  
  
  
  
  
  
}



/***************************************************************************************************
----------------------------------------------------------------------------------------------------
Test case name:  TC_L30SW_QT_36651207: verify_the_functionality_of_interface_to_check_lock_unlock_status_for_all_31_Semaphore_IDS_for_CPU5
----------------------------------------------------------------------------------------------------
Description:  Test_case_to_verify_the_functionality_of_interface_to_check_lock_unlock_status_for_all_31_Semaphore_IDS_for_CPU5

***************************************************************************************************/



testcase verify_the_functionality_of_interface_to_check_lock_unlock_status_for_all_31_Semaphore_IDS_for_CPU5()
{
  /***************************************************************************************************************/    
                                                // Variable Definition
  /***************************************************************************************************************/ 
  
  long taskvalue;
  
  /***************************************************************************************************************/    
                                               // Local Values
  /***************************************************************************************************************/ 
  

  
  /***************************************************************************************************************/    
                                              // Test Case Info
  /***************************************************************************************************************/
  setWriteDbgLevel(DebugOff);
  snprintf( chTestTitle, elCount(chTestTitle), "Test_case_to_verify_the_functionality_of_interface_to_check_lock_unlock_status_for_all_31_Semaphore_IDS_for_CPU5" );
  snprintf( chTestDescription, elCount(chTestDescription), "Purpose:Test_case_to_verify_the_functionality_of_interface_to_check_lock_unlock_status_for_all_31_Semaphore_IDS_for_CPU5.");
  TestCaseAddInfo( chTestTitle, "TC_L30SW_QT_36651207", chTestDescription );

  /***************************************************************************************************************/    
                                              // Start of Test Case
  /***************************************************************************************************************/
  
  /***************************************************************************************************************/    
                                              // Test Step 1 PRECONDITIONS
  /***************************************************************************************************************/
  
  snprintf( chActionText, elCount(chActionText), "Flash the Software and ECU is running"); 
  snprintf( chExpectedText, elCount(chExpectedText), "ECU should be in running state"); 
  TestStepAddActionExpected( chActionText, chExpectedText );

  A_DBGR_BreakpointDeleteAll();
  A_DBGR_RnGo();
  E_DBGR_CheckState(T32_State_Running);
  

   /***************************************************************************************************************/    
            // Test Step 2: Check all cores are in running state                                   
  /***************************************************************************************************************/
  
  //Check core0 is running
  snprintf( chActionText, elCount(chActionText), "Check 1000ms Task Counter from core0 "); 
  snprintf( chExpectedText, elCount(chExpectedText), "1000ms Counter from core0 is incrementing"); 
  TestStepAddActionExpected( chActionText, chExpectedText );
  A_DBGR_VariableRead( "Task_Core0_1000ms_Count", taskvalue);
  E_DBGR_VariableCheck("Task_Core0_1000ms_Count", taskvalue, Greater);
  
  //Check Core1 is running
  snprintf( chActionText, elCount(chActionText), "Check 1000ms Task Counter from Core1 "); 
  snprintf( chExpectedText, elCount(chExpectedText), "1000ms Counter from Core1 is incrementing"); 
  TestStepAddActionExpected( chActionText, chExpectedText );
  A_DBGR_VariableRead( "Task_Core1_1000ms_Count", taskvalue);
  E_DBGR_VariableCheck("Task_Core1_1000ms_Count", taskvalue, Greater);
  
  //Check Core2 is running
  snprintf( chActionText, elCount(chActionText), "Check 1000ms Task Counter from Core2 "); 
  snprintf( chExpectedText, elCount(chExpectedText), "1000ms Counter from Core2 is incrementing"); 
  TestStepAddActionExpected( chActionText, chExpectedText );
  A_DBGR_VariableRead( "Task_Core2_1000ms_Count", taskvalue);
  E_DBGR_VariableCheck("Task_Core2_1000ms_Count", taskvalue, Greater);
    
  //Check Core3 is running
  snprintf( chActionText, elCount(chActionText), "Check 1000ms Task Counter from Core3 "); 
  snprintf( chExpectedText, elCount(chExpectedText), "1000ms Counter from Core3 is incrementing"); 
  TestStepAddActionExpected( chActionText, chExpectedText );
  A_DBGR_VariableRead( "Task_Core3_1000ms_Count", taskvalue);
  E_DBGR_VariableCheck("Task_Core3_1000ms_Count", taskvalue, Greater);
    
  //Check Core4 is running
  snprintf( chActionText, elCount(chActionText), "Check 1000ms Task Counter from Core4 "); 
  snprintf( chExpectedText, elCount(chExpectedText), "1000ms Counter from Core4 is incrementing"); 
  TestStepAddActionExpected( chActionText, chExpectedText );
  A_DBGR_VariableRead( "Task_Core4_1000ms_Count", taskvalue);
  E_DBGR_VariableCheck("Task_Core4_1000ms_Count", taskvalue, Greater);
    
  //Check Core5 is running
  snprintf( chActionText, elCount(chActionText), "Check 1000ms Task Counter from Core5 "); 
  snprintf( chExpectedText, elCount(chExpectedText), "1000ms Counter from Core5 is incrementing"); 
  TestStepAddActionExpected( chActionText, chExpectedText );
  A_DBGR_VariableRead( "Task_Core5_1000ms_Count", taskvalue);
  E_DBGR_VariableCheck("Task_Core5_1000ms_Count", taskvalue, Greater);
  
  /*******************************************************************************************************************************************************/    
    // Test Step 3: Set flag lock_unlock_status_flag_core5=1 to check semaphore lock for core4 in function TestApp_Core5_1000ms_MainFunction
  /*******************************************************************************************************************************************************/

  snprintf( chActionText, elCount(chActionText), "Set flag lock_unlock_status_flag_core5=1 to check semaphore lock for core5 in function TestApp_core5_1000ms_MainFunction "); 
  snprintf( chExpectedText, elCount(chExpectedText), "Verify flag lock_unlock_status_flag_core5=1 to check semaphore lock for core5 in function TestApp_core5_1000ms_MainFunction "); 
   
  TestStepAddActionExpected( chActionText, chExpectedText );
  A_DBGR_VariableSet("lock_unlock_status_flag_core5", "1");
  E_DBGR_VariableCheck("lock_unlock_status_flag_core5", 1, Equal);


  
    
  
  
  /*******************************************************************************************************************************************************/    
    // Test Step 4: check var Smsts_lock[semaphore]=6 for 32 index in function Os_Test_GetHWIO_e_LockSemaphore_test() in test_os_hwio.c file
  /*******************************************************************************************************************************************************/
  snprintf( chActionText, elCount(chActionText), "check var Smsts_lock[0]=6 in function Os_Test_GetHWIO_e_LockSemaphore_test() in test_os_hwio.c file "); 
  snprintf( chExpectedText, elCount(chExpectedText), "Verify var Smsts_lock[0]=6 in function Os_Test_GetHWIO_e_LockSemaphore_test() in test_os_hwio.c file "); 
  TestStepAddActionExpected( chActionText, chExpectedText );
  E_DBGR_VariableCheck("Smsts_lock[0]", 6, Equal);
  
  snprintf( chActionText, elCount(chActionText), "check var Smsts_lock[1]=6 in function Os_Test_GetHWIO_e_LockSemaphore_test() in test_os_hwio.c file "); 
  snprintf( chExpectedText, elCount(chExpectedText), "Verify var Smsts_lock[1]=6 in function Os_Test_GetHWIO_e_LockSemaphore_test() in test_os_hwio.c file "); 
  TestStepAddActionExpected( chActionText, chExpectedText );
  E_DBGR_VariableCheck("Smsts_lock[1]", 6, Equal);
  
  snprintf( chActionText, elCount(chActionText), "check var Smsts_lock[2]=6 in function Os_Test_GetHWIO_e_LockSemaphore_test() in test_os_hwio.c file "); 
  snprintf( chExpectedText, elCount(chExpectedText), "Verify var Smsts_lock[2]=6 in function Os_Test_GetHWIO_e_LockSemaphore_test() in test_os_hwio.c file "); 
  TestStepAddActionExpected( chActionText, chExpectedText );
  E_DBGR_VariableCheck("Smsts_lock[2]", 6, Equal);
  
  snprintf( chActionText, elCount(chActionText), "check var Smsts_lock[3]=6 in function Os_Test_GetHWIO_e_LockSemaphore_test() in test_os_hwio.c file "); 
  snprintf( chExpectedText, elCount(chExpectedText), "Verify var Smsts_lock[3]=6 in function Os_Test_GetHWIO_e_LockSemaphore_test() in test_os_hwio.c file "); 
  TestStepAddActionExpected( chActionText, chExpectedText );
  E_DBGR_VariableCheck("Smsts_lock[3]", 6, Equal);
  
  snprintf( chActionText, elCount(chActionText), "check var Smsts_lock[4]=6 in function Os_Test_GetHWIO_e_LockSemaphore_test() in test_os_hwio.c file "); 
  snprintf( chExpectedText, elCount(chExpectedText), "Verify var Smsts_lock[4]=6 in function Os_Test_GetHWIO_e_LockSemaphore_test() in test_os_hwio.c file "); 
  TestStepAddActionExpected( chActionText, chExpectedText );
  E_DBGR_VariableCheck("Smsts_lock[4]", 6, Equal);
  
  snprintf( chActionText, elCount(chActionText), "check var Smsts_lock[5]=6 in function Os_Test_GetHWIO_e_LockSemaphore_test() in test_os_hwio.c file "); 
  snprintf( chExpectedText, elCount(chExpectedText), "Verify var Smsts_lock[5]=6 in function Os_Test_GetHWIO_e_LockSemaphore_test() in test_os_hwio.c file "); 
  TestStepAddActionExpected( chActionText, chExpectedText );
  E_DBGR_VariableCheck("Smsts_lock[5]", 6, Equal);
  
  snprintf( chActionText, elCount(chActionText), "check var Smsts_lock[6]=6 in function Os_Test_GetHWIO_e_LockSemaphore_test() in test_os_hwio.c file "); 
  snprintf( chExpectedText, elCount(chExpectedText), "Verify var Smsts_lock[6]=6 in function Os_Test_GetHWIO_e_LockSemaphore_test() in test_os_hwio.c file "); 
  TestStepAddActionExpected( chActionText, chExpectedText );
  E_DBGR_VariableCheck("Smsts_lock[6]", 6, Equal);
  
  snprintf( chActionText, elCount(chActionText), "check var Smsts_lock[7]=6 in function Os_Test_GetHWIO_e_LockSemaphore_test() in test_os_hwio.c file "); 
  snprintf( chExpectedText, elCount(chExpectedText), "Verify var Smsts_lock[7]=6 in function Os_Test_GetHWIO_e_LockSemaphore_test() in test_os_hwio.c file "); 
  TestStepAddActionExpected( chActionText, chExpectedText );
  E_DBGR_VariableCheck("Smsts_lock[7]", 6, Equal);
  
  snprintf( chActionText, elCount(chActionText), "check var Smsts_lock[8]=6 in function Os_Test_GetHWIO_e_LockSemaphore_test() in test_os_hwio.c file "); 
  snprintf( chExpectedText, elCount(chExpectedText), "Verify var Smsts_lock[8]=6 in function Os_Test_GetHWIO_e_LockSemaphore_test() in test_os_hwio.c file "); 
  TestStepAddActionExpected( chActionText, chExpectedText );
  E_DBGR_VariableCheck("Smsts_lock[8]", 6, Equal);
  
  snprintf( chActionText, elCount(chActionText), "check var Smsts_lock[9]=6 in function Os_Test_GetHWIO_e_LockSemaphore_test() in test_os_hwio.c file "); 
  snprintf( chExpectedText, elCount(chExpectedText), "Verify var Smsts_lock[9]=6 in function Os_Test_GetHWIO_e_LockSemaphore_test() in test_os_hwio.c file "); 
  TestStepAddActionExpected( chActionText, chExpectedText );
  E_DBGR_VariableCheck("Smsts_lock[9]", 6, Equal);
  
  snprintf( chActionText, elCount(chActionText), "check var Smsts_lock[10]=6 in function Os_Test_GetHWIO_e_LockSemaphore_test() in test_os_hwio.c file "); 
  snprintf( chExpectedText, elCount(chExpectedText), "Verify var Smsts_lock[10]=6 in function Os_Test_GetHWIO_e_LockSemaphore_test() in test_os_hwio.c file "); 
  TestStepAddActionExpected( chActionText, chExpectedText );
  E_DBGR_VariableCheck("Smsts_lock[10]", 6, Equal);
  
  snprintf( chActionText, elCount(chActionText), "check var Smsts_lock[11]=6 in function Os_Test_GetHWIO_e_LockSemaphore_test() in test_os_hwio.c file "); 
  snprintf( chExpectedText, elCount(chExpectedText), "Verify var Smsts_lock[11]=6 in function Os_Test_GetHWIO_e_LockSemaphore_test() in test_os_hwio.c file "); 
  TestStepAddActionExpected( chActionText, chExpectedText );
  E_DBGR_VariableCheck("Smsts_lock[11]", 6, Equal);
  
  snprintf( chActionText, elCount(chActionText), "check var Smsts_lock[12]=6 in function Os_Test_GetHWIO_e_LockSemaphore_test() in test_os_hwio.c file "); 
  snprintf( chExpectedText, elCount(chExpectedText), "Verify var Smsts_lock[12]=6 in function Os_Test_GetHWIO_e_LockSemaphore_test() in test_os_hwio.c file "); 
  TestStepAddActionExpected( chActionText, chExpectedText );
  E_DBGR_VariableCheck("Smsts_lock[12]", 6, Equal);
  
  snprintf( chActionText, elCount(chActionText), "check var Smsts_lock[13]=6 in function Os_Test_GetHWIO_e_LockSemaphore_test() in test_os_hwio.c file "); 
  snprintf( chExpectedText, elCount(chExpectedText), "Verify var Smsts_lock[13]=6 in function Os_Test_GetHWIO_e_LockSemaphore_test() in test_os_hwio.c file "); 
  TestStepAddActionExpected( chActionText, chExpectedText );
  E_DBGR_VariableCheck("Smsts_lock[13]", 6, Equal);
  
  snprintf( chActionText, elCount(chActionText), "check var Smsts_lock[14]=6 in function Os_Test_GetHWIO_e_LockSemaphore_test() in test_os_hwio.c file "); 
  snprintf( chExpectedText, elCount(chExpectedText), "Verify var Smsts_lock[14]=6 in function Os_Test_GetHWIO_e_LockSemaphore_test() in test_os_hwio.c file "); 
  TestStepAddActionExpected( chActionText, chExpectedText );
  E_DBGR_VariableCheck("Smsts_lock[14]", 6, Equal);
  
  snprintf( chActionText, elCount(chActionText), "check var Smsts_lock[15]=6 in function Os_Test_GetHWIO_e_LockSemaphore_test() in test_os_hwio.c file "); 
  snprintf( chExpectedText, elCount(chExpectedText), "Verify var Smsts_lock[15]=6 in function Os_Test_GetHWIO_e_LockSemaphore_test() in test_os_hwio.c file "); 
  TestStepAddActionExpected( chActionText, chExpectedText );
  E_DBGR_VariableCheck("Smsts_lock[15]", 6, Equal);
  
  snprintf( chActionText, elCount(chActionText), "check var Smsts_lock[16]=6 in function Os_Test_GetHWIO_e_LockSemaphore_test() in test_os_hwio.c file "); 
  snprintf( chExpectedText, elCount(chExpectedText), "Verify var Smsts_lock[16]=6 in function Os_Test_GetHWIO_e_LockSemaphore_test() in test_os_hwio.c file "); 
  TestStepAddActionExpected( chActionText, chExpectedText );
  E_DBGR_VariableCheck("Smsts_lock[16]", 6, Equal);
  
  snprintf( chActionText, elCount(chActionText), "check var Smsts_lock[17]=6 in function Os_Test_GetHWIO_e_LockSemaphore_test() in test_os_hwio.c file "); 
  snprintf( chExpectedText, elCount(chExpectedText), "Verify var Smsts_lock[17]=6 in function Os_Test_GetHWIO_e_LockSemaphore_test() in test_os_hwio.c file "); 
  TestStepAddActionExpected( chActionText, chExpectedText );
  E_DBGR_VariableCheck("Smsts_lock[17]", 6, Equal);
  
  snprintf( chActionText, elCount(chActionText), "check var Smsts_lock[18]=6 in function Os_Test_GetHWIO_e_LockSemaphore_test() in test_os_hwio.c file "); 
  snprintf( chExpectedText, elCount(chExpectedText), "Verify var Smsts_lock[18]=6 in function Os_Test_GetHWIO_e_LockSemaphore_test() in test_os_hwio.c file "); 
  TestStepAddActionExpected( chActionText, chExpectedText );
  E_DBGR_VariableCheck("Smsts_lock[18]", 6, Equal);
  
  snprintf( chActionText, elCount(chActionText), "check var Smsts_lock[19]=6 in function Os_Test_GetHWIO_e_LockSemaphore_test() in test_os_hwio.c file "); 
  snprintf( chExpectedText, elCount(chExpectedText), "Verify var Smsts_lock[19]=6 in function Os_Test_GetHWIO_e_LockSemaphore_test() in test_os_hwio.c file "); 
  TestStepAddActionExpected( chActionText, chExpectedText );
  E_DBGR_VariableCheck("Smsts_lock[19]", 6, Equal);
  
  
  snprintf( chActionText, elCount(chActionText), "check var Smsts_lock[20]=6 in function Os_Test_GetHWIO_e_LockSemaphore_test() in test_os_hwio.c file "); 
  snprintf( chExpectedText, elCount(chExpectedText), "Verify var Smsts_lock[20]=6 in function Os_Test_GetHWIO_e_LockSemaphore_test() in test_os_hwio.c file "); 
  TestStepAddActionExpected( chActionText, chExpectedText );
  E_DBGR_VariableCheck("Smsts_lock[20]", 6, Equal);
  
  
  snprintf( chActionText, elCount(chActionText), "check var Smsts_lock[21]=6 in function Os_Test_GetHWIO_e_LockSemaphore_test() in test_os_hwio.c file "); 
  snprintf( chExpectedText, elCount(chExpectedText), "Verify var Smsts_lock[21]=6 in function Os_Test_GetHWIO_e_LockSemaphore_test() in test_os_hwio.c file "); 
  TestStepAddActionExpected( chActionText, chExpectedText );
  E_DBGR_VariableCheck("Smsts_lock[21]", 6, Equal);
  
  
  snprintf( chActionText, elCount(chActionText), "check var Smsts_lock[22]=6 in function Os_Test_GetHWIO_e_LockSemaphore_test() in test_os_hwio.c file "); 
  snprintf( chExpectedText, elCount(chExpectedText), "Verify var Smsts_lock[22]=6 in function Os_Test_GetHWIO_e_LockSemaphore_test() in test_os_hwio.c file "); 
  TestStepAddActionExpected( chActionText, chExpectedText );
  E_DBGR_VariableCheck("Smsts_lock[22]", 6, Equal);
  
  
  snprintf( chActionText, elCount(chActionText), "check var Smsts_lock[23]=6 in function Os_Test_GetHWIO_e_LockSemaphore_test() in test_os_hwio.c file "); 
  snprintf( chExpectedText, elCount(chExpectedText), "Verify var Smsts_lock[23]=6 in function Os_Test_GetHWIO_e_LockSemaphore_test() in test_os_hwio.c file "); 
  TestStepAddActionExpected( chActionText, chExpectedText );
  E_DBGR_VariableCheck("Smsts_lock[23]", 6, Equal);
  
  
  snprintf( chActionText, elCount(chActionText), "check var Smsts_lock[24]=6 in function Os_Test_GetHWIO_e_LockSemaphore_test() in test_os_hwio.c file "); 
  snprintf( chExpectedText, elCount(chExpectedText), "Verify var Smsts_lock[24]=6 in function Os_Test_GetHWIO_e_LockSemaphore_test() in test_os_hwio.c file "); 
  TestStepAddActionExpected( chActionText, chExpectedText );
  E_DBGR_VariableCheck("Smsts_lock[24]", 6, Equal);
  
  
  snprintf( chActionText, elCount(chActionText), "check var Smsts_lock[25]=6 in function Os_Test_GetHWIO_e_LockSemaphore_test() in test_os_hwio.c file "); 
  snprintf( chExpectedText, elCount(chExpectedText), "Verify var Smsts_lock[25]=6 in function Os_Test_GetHWIO_e_LockSemaphore_test() in test_os_hwio.c file "); 
  TestStepAddActionExpected( chActionText, chExpectedText );
  E_DBGR_VariableCheck("Smsts_lock[25]", 6, Equal);
  
  
  snprintf( chActionText, elCount(chActionText), "check var Smsts_lock[26]=6 in function Os_Test_GetHWIO_e_LockSemaphore_test() in test_os_hwio.c file "); 
  snprintf( chExpectedText, elCount(chExpectedText), "Verify var Smsts_lock[26]=6 in function Os_Test_GetHWIO_e_LockSemaphore_test() in test_os_hwio.c file "); 
  TestStepAddActionExpected( chActionText, chExpectedText );
  E_DBGR_VariableCheck("Smsts_lock[26]", 6, Equal);
  
  
  snprintf( chActionText, elCount(chActionText), "check var Smsts_lock[27]=6 in function Os_Test_GetHWIO_e_LockSemaphore_test() in test_os_hwio.c file "); 
  snprintf( chExpectedText, elCount(chExpectedText), "Verify var Smsts_lock[27]=6 in function Os_Test_GetHWIO_e_LockSemaphore_test() in test_os_hwio.c file "); 
  TestStepAddActionExpected( chActionText, chExpectedText );
  E_DBGR_VariableCheck("Smsts_lock[27]", 6, Equal);
  
  snprintf( chActionText, elCount(chActionText), "check var Smsts_lock[28]=6 in function Os_Test_GetHWIO_e_LockSemaphore_test() in test_os_hwio.c file "); 
  snprintf( chExpectedText, elCount(chExpectedText), "Verify var Smsts_lock[28]=6 in function Os_Test_GetHWIO_e_LockSemaphore_test() in test_os_hwio.c file "); 
  TestStepAddActionExpected( chActionText, chExpectedText );
  E_DBGR_VariableCheck("Smsts_lock[28]", 6, Equal);
  
  
  snprintf( chActionText, elCount(chActionText), "check var Smsts_lock[29]=6 in function Os_Test_GetHWIO_e_LockSemaphore_test() in test_os_hwio.c file "); 
  snprintf( chExpectedText, elCount(chExpectedText), "Verify var Smsts_lock[29]=6 in function Os_Test_GetHWIO_e_LockSemaphore_test() in test_os_hwio.c file "); 
  TestStepAddActionExpected( chActionText, chExpectedText );
  E_DBGR_VariableCheck("Smsts_lock[29]", 6, Equal);
  
  
  snprintf( chActionText, elCount(chActionText), "check var Smsts_lock[30]=6 in function Os_Test_GetHWIO_e_LockSemaphore_test() in test_os_hwio.c file "); 
  snprintf( chExpectedText, elCount(chExpectedText), "Verify var Smsts_lock[30]=6 in function Os_Test_GetHWIO_e_LockSemaphore_test() in test_os_hwio.c file "); 
  TestStepAddActionExpected( chActionText, chExpectedText );
  E_DBGR_VariableCheck("Smsts_lock[30]", 6, Equal);
  
  
  snprintf( chActionText, elCount(chActionText), "check var Smsts_lock[31]=6 in function Os_Test_GetHWIO_e_LockSemaphore_test() in test_os_hwio.c file "); 
  snprintf( chExpectedText, elCount(chExpectedText), "Verify var Smsts_lock[31]=6 in function Os_Test_GetHWIO_e_LockSemaphore_test() in test_os_hwio.c file "); 
  TestStepAddActionExpected( chActionText, chExpectedText );
  E_DBGR_VariableCheck("Smsts_lock[31]", 6, Equal);
  
  
  
  
  /*******************************************************************************************************************************************************/    
    // Test Step 5: check var Smsts_unlock[semaphore]=0 for 32 index in function Os_Test_GetHWIO_e_LockSemaphore_test() in test_os_hwio.c file
  /*******************************************************************************************************************************************************/
  snprintf( chActionText, elCount(chActionText), "check var Smsts_unlock[0]=0  in function Os_Test_GetHWIO_e_LockSemaphore_test() in test_os_hwio.c file "); 
  snprintf( chExpectedText, elCount(chExpectedText), "Verify var Smsts_unlock[0]=0  in function Os_Test_GetHWIO_e_LockSemaphore_test() in test_os_hwio.c file "); 
  TestStepAddActionExpected( chActionText, chExpectedText );
  E_DBGR_VariableCheck("Smsts_unlock[0]", 0, Equal);
  
  snprintf( chActionText, elCount(chActionText), "check var Smsts_unlock[1]=0  in function Os_Test_GetHWIO_e_LockSemaphore_test() in test_os_hwio.c file "); 
  snprintf( chExpectedText, elCount(chExpectedText), "Verify var Smsts_unlock[1]=0  in function Os_Test_GetHWIO_e_LockSemaphore_test() in test_os_hwio.c file "); 
  TestStepAddActionExpected( chActionText, chExpectedText );
  E_DBGR_VariableCheck("Smsts_unlock[1]", 0, Equal);
  
  snprintf( chActionText, elCount(chActionText), "check var Smsts_unlock[2]=0  in function Os_Test_GetHWIO_e_LockSemaphore_test() in test_os_hwio.c file "); 
  snprintf( chExpectedText, elCount(chExpectedText), "Verify var Smsts_unlock[2]=0  in function Os_Test_GetHWIO_e_LockSemaphore_test() in test_os_hwio.c file "); 
  TestStepAddActionExpected( chActionText, chExpectedText );
  E_DBGR_VariableCheck("Smsts_unlock[2]", 0, Equal);
  
  snprintf( chActionText, elCount(chActionText), "check var Smsts_unlock[3]=0  in function Os_Test_GetHWIO_e_LockSemaphore_test() in test_os_hwio.c file "); 
  snprintf( chExpectedText, elCount(chExpectedText), "Verify var Smsts_unlock[3]=0  in function Os_Test_GetHWIO_e_LockSemaphore_test() in test_os_hwio.c file "); 
  TestStepAddActionExpected( chActionText, chExpectedText );
  E_DBGR_VariableCheck("Smsts_unlock[3]", 0, Equal);
  
  snprintf( chActionText, elCount(chActionText), "check var Smsts_unlock[4]=0  in function Os_Test_GetHWIO_e_LockSemaphore_test() in test_os_hwio.c file "); 
  snprintf( chExpectedText, elCount(chExpectedText), "Verify var Smsts_unlock[4]=0  in function Os_Test_GetHWIO_e_LockSemaphore_test() in test_os_hwio.c file "); 
  TestStepAddActionExpected( chActionText, chExpectedText );
  E_DBGR_VariableCheck("Smsts_unlock[4]", 0, Equal);
  
  snprintf( chActionText, elCount(chActionText), "check var Smsts_unlock[5]=0  in function Os_Test_GetHWIO_e_LockSemaphore_test() in test_os_hwio.c file "); 
  snprintf( chExpectedText, elCount(chExpectedText), "Verify var Smsts_unlock[5]=0  in function Os_Test_GetHWIO_e_LockSemaphore_test() in test_os_hwio.c file "); 
  TestStepAddActionExpected( chActionText, chExpectedText );
  E_DBGR_VariableCheck("Smsts_unlock[5]", 0, Equal);
  
  snprintf( chActionText, elCount(chActionText), "check var Smsts_unlock[6]=0  in function Os_Test_GetHWIO_e_LockSemaphore_test() in test_os_hwio.c file "); 
  snprintf( chExpectedText, elCount(chExpectedText), "Verify var Smsts_lock[6]=0  in function Os_Test_GetHWIO_e_LockSemaphore_test() in test_os_hwio.c file "); 
  TestStepAddActionExpected( chActionText, chExpectedText );
  E_DBGR_VariableCheck("Smsts_unlock[6]", 0, Equal);
  
  snprintf( chActionText, elCount(chActionText), "check var Smsts_unlock[7]=0  in function Os_Test_GetHWIO_e_LockSemaphore_test() in test_os_hwio.c file "); 
  snprintf( chExpectedText, elCount(chExpectedText), "Verify var Smsts_unlock[7]=0Smsts_unlock  in function Os_Test_GetHWIO_e_LockSemaphore_test() in test_os_hwio.c file "); 
  TestStepAddActionExpected( chActionText, chExpectedText );
  E_DBGR_VariableCheck("Smsts_unlock[7]", 0, Equal);
  
  snprintf( chActionText, elCount(chActionText), "check var Smsts_unlock[8]=0  in function Os_Test_GetHWIO_e_LockSemaphore_test() in test_os_hwio.c file "); 
  snprintf( chExpectedText, elCount(chExpectedText), "Verify var Smsts_unlock[8]=0  in function Os_Test_GetHWIO_e_LockSemaphore_test() in test_os_hwio.c file "); 
  TestStepAddActionExpected( chActionText, chExpectedText );
  E_DBGR_VariableCheck("Smsts_unlock[8]", 0, Equal);
  
  snprintf( chActionText, elCount(chActionText), "check var Smsts_unlock[9]=0  in function Os_Test_GetHWIO_e_LockSemaphore_test() in test_os_hwio.c file "); 
  snprintf( chExpectedText, elCount(chExpectedText), "Verify var Smsts_unlock[9]=0  in function Os_Test_GetHWIO_e_LockSemaphore_test() in test_os_hwio.c file "); 
  TestStepAddActionExpected( chActionText, chExpectedText );
  E_DBGR_VariableCheck("Smsts_unlock[9]", 0, Equal);
  
  snprintf( chActionText, elCount(chActionText), "check var Smsts_unlock[10]=0  in function Os_Test_GetHWIO_e_LockSemaphore_test() in test_os_hwio.c file "); 
  snprintf( chExpectedText, elCount(chExpectedText), "Verify var Smsts_unlock[10]=0  in function Os_Test_GetHWIO_e_LockSemaphore_test() in test_os_hwio.c file "); 
  TestStepAddActionExpected( chActionText, chExpectedText );
  E_DBGR_VariableCheck("Smsts_unlock[10]", 0, Equal);
  
  snprintf( chActionText, elCount(chActionText), "check var Smsts_unlock[11]=0  in function Os_Test_GetHWIO_e_LockSemaphore_test() in test_os_hwio.c file "); 
  snprintf( chExpectedText, elCount(chExpectedText), "Verify var Smsts_unlock[11]=0  in function Os_Test_GetHWIO_e_LockSemaphore_test() in test_os_hwio.c file "); 
  TestStepAddActionExpected( chActionText, chExpectedText );
  E_DBGR_VariableCheck("Smsts_unlock[11]", 0, Equal);
  
  snprintf( chActionText, elCount(chActionText), "check var Smsts_unlock[12]=0  in function Os_Test_GetHWIO_e_LockSemaphore_test() in test_os_hwio.c file "); 
  snprintf( chExpectedText, elCount(chExpectedText), "Verify var Smsts_unlock[12]=0  in function Os_Test_GetHWIO_e_LockSemaphore_test() in test_os_hwio.c file "); 
  TestStepAddActionExpected( chActionText, chExpectedText );
  E_DBGR_VariableCheck("Smsts_unlock[12]", 0, Equal);
  
  snprintf( chActionText, elCount(chActionText), "check var Smsts_unlock[13]=0  in function Os_Test_GetHWIO_e_LockSemaphore_test() in test_os_hwio.c file "); 
  snprintf( chExpectedText, elCount(chExpectedText), "Verify var Smsts_unlock[13]=0  in function Os_Test_GetHWIO_e_LockSemaphore_test() in test_os_hwio.c file "); 
  TestStepAddActionExpected( chActionText, chExpectedText );
  E_DBGR_VariableCheck("Smsts_unlock[13]", 0, Equal);
  
  snprintf( chActionText, elCount(chActionText), "check var Smsts_unlock[14]=0  in function Os_Test_GetHWIO_e_LockSemaphore_test() in test_os_hwio.c file "); 
  snprintf( chExpectedText, elCount(chExpectedText), "Verify var Smsts_unlock[14]=0  in function Os_Test_GetHWIO_e_LockSemaphore_test() in test_os_hwio.c file "); 
  TestStepAddActionExpected( chActionText, chExpectedText );
  E_DBGR_VariableCheck("Smsts_unlock[14]", 0, Equal);
  
  snprintf( chActionText, elCount(chActionText), "check var Smsts_unlock[15]=0  in function Os_Test_GetHWIO_e_LockSemaphore_test() in test_os_hwio.c file "); 
  snprintf( chExpectedText, elCount(chExpectedText), "Verify var Smsts_unlock[15]=0  in function Os_Test_GetHWIO_e_LockSemaphore_test() in test_os_hwio.c file "); 
  TestStepAddActionExpected( chActionText, chExpectedText );
  E_DBGR_VariableCheck("Smsts_unlock[15]", 0, Equal);
  
  snprintf( chActionText, elCount(chActionText), "check var Smsts_unlock[16]=0  in function Os_Test_GetHWIO_e_LockSemaphore_test() in test_os_hwio.c file "); 
  snprintf( chExpectedText, elCount(chExpectedText), "Verify var Smsts_unlock[16]=0  in function Os_Test_GetHWIO_e_LockSemaphore_test() in test_os_hwio.c file "); 
  TestStepAddActionExpected( chActionText, chExpectedText );
  E_DBGR_VariableCheck("Smsts_unlock[16]", 0, Equal);
  
  snprintf( chActionText, elCount(chActionText), "check var Smsts_unlock[17]=0  in function Os_Test_GetHWIO_e_LockSemaphore_test() in test_os_hwio.c file "); 
  snprintf( chExpectedText, elCount(chExpectedText), "Verify var Smsts_unlock[17]=0  in function Os_Test_GetHWIO_e_LockSemaphore_test() in test_os_hwio.c file "); 
  TestStepAddActionExpected( chActionText, chExpectedText );
  E_DBGR_VariableCheck("Smsts_unlock[17]", 0, Equal);
  
  snprintf( chActionText, elCount(chActionText), "check var Smsts_unlock[18]=0  in function Os_Test_GetHWIO_e_LockSemaphore_test() in test_os_hwio.c file "); 
  snprintf( chExpectedText, elCount(chExpectedText), "Verify var Smsts_unlock[18]=0  in function Os_Test_GetHWIO_e_LockSemaphore_test() in test_os_hwio.c file "); 
  TestStepAddActionExpected( chActionText, chExpectedText );
  E_DBGR_VariableCheck("Smsts_unlock[18]", 0, Equal);
  
  snprintf( chActionText, elCount(chActionText), "check var Smsts_unlock[19]=0  in function Os_Test_GetHWIO_e_LockSemaphore_test() in test_os_hwio.c file "); 
  snprintf( chExpectedText, elCount(chExpectedText), "Verify var Smsts_unlock[19]=0  in function Os_Test_GetHWIO_e_LockSemaphore_test() in test_os_hwio.c file "); 
  TestStepAddActionExpected( chActionText, chExpectedText );
  E_DBGR_VariableCheck("Smsts_unlock[19]", 0, Equal);
  
  
  snprintf( chActionText, elCount(chActionText), "check var Smsts_unlock[20]=0  in function Os_Test_GetHWIO_e_LockSemaphore_test() in test_os_hwio.c file "); 
  snprintf( chExpectedText, elCount(chExpectedText), "Verify var Smsts_unlock[20]=0  in function Os_Test_GetHWIO_e_LockSemaphore_test() in test_os_hwio.c file "); 
  TestStepAddActionExpected( chActionText, chExpectedText );
  E_DBGR_VariableCheck("Smsts_unlock[20]", 0, Equal);
  
  
  snprintf( chActionText, elCount(chActionText), "check var Smsts_unlock[21]=0  in function Os_Test_GetHWIO_e_LockSemaphore_test() in test_os_hwio.c file "); 
  snprintf( chExpectedText, elCount(chExpectedText), "Verify var Smsts_unlock[21]=0  in function Os_Test_GetHWIO_e_LockSemaphore_test() in test_os_hwio.c file "); 
  TestStepAddActionExpected( chActionText, chExpectedText );
  E_DBGR_VariableCheck("Smsts_unlock[21]", 0, Equal);
  
  
  snprintf( chActionText, elCount(chActionText), "check var Smsts_unlock[22]=0  in function Os_Test_GetHWIO_e_LockSemaphore_test() in test_os_hwio.c file "); 
  snprintf( chExpectedText, elCount(chExpectedText), "Verify var Smsts_unlock[22]=0  in function Os_Test_GetHWIO_e_LockSemaphore_test() in test_os_hwio.c file "); 
  TestStepAddActionExpected( chActionText, chExpectedText );
  E_DBGR_VariableCheck("Smsts_unlock[22]", 0, Equal);
  
  
  snprintf( chActionText, elCount(chActionText), "check var Smsts_unlock[23]=0  in function Os_Test_GetHWIO_e_LockSemaphore_test() in test_os_hwio.c file "); 
  snprintf( chExpectedText, elCount(chExpectedText), "Verify var Smsts_unlock[23]=0  in function Os_Test_GetHWIO_e_LockSemaphore_test() in test_os_hwio.c file "); 
  TestStepAddActionExpected( chActionText, chExpectedText );
  E_DBGR_VariableCheck("Smsts_unlock[23]", 0, Equal);
  
  
  snprintf( chActionText, elCount(chActionText), "check var Smsts_unlock[24]=0  in function Os_Test_GetHWIO_e_LockSemaphore_test() in test_os_hwio.c file "); 
  snprintf( chExpectedText, elCount(chExpectedText), "Verify var Smsts_unlock[24]=0  in function Os_Test_GetHWIO_e_LockSemaphore_test() in test_os_hwio.c file "); 
  TestStepAddActionExpected( chActionText, chExpectedText );
  E_DBGR_VariableCheck("Smsts_unlock[24]", 0, Equal);
  
  
  snprintf( chActionText, elCount(chActionText), "check var Smsts_unlock[25]=0  in function Os_Test_GetHWIO_e_LockSemaphore_test() in test_os_hwio.c file "); 
  snprintf( chExpectedText, elCount(chExpectedText), "Verify var Smsts_unloc[25]=60 in function Os_Test_GetHWIO_e_LockSemaphore_test() in test_os_hwio.c file "); 
  TestStepAddActionExpected( chActionText, chExpectedText );
  E_DBGR_VariableCheck("Smsts_unlock[25]", 0, Equal);
  
  
  snprintf( chActionText, elCount(chActionText), "check var Smsts_unlock[26]=0  in function Os_Test_GetHWIO_e_LockSemaphore_test() in test_os_hwio.c file "); 
  snprintf( chExpectedText, elCount(chExpectedText), "Verify var Smsts_unlock[26]=0  in function Os_Test_GetHWIO_e_LockSemaphore_test() in test_os_hwio.c file "); 
  TestStepAddActionExpected( chActionText, chExpectedText );
  E_DBGR_VariableCheck("Smsts_unlock[26]", 0, Equal);
  
  
  snprintf( chActionText, elCount(chActionText), "check var Smsts_unlock[27]=0  in function Os_Test_GetHWIO_e_LockSemaphore_test() in test_os_hwio.c file "); 
  snprintf( chExpectedText, elCount(chExpectedText), "Verify var Smsts_unlock[27]=0  in function Os_Test_GetHWIO_e_LockSemaphore_test() in test_os_hwio.c file "); 
  TestStepAddActionExpected( chActionText, chExpectedText );
  E_DBGR_VariableCheck("Smsts_unlock[27]", 0, Equal);
  
  snprintf( chActionText, elCount(chActionText), "check var Smsts_unlock[28]=0Smsts_unlock  in function Os_Test_GetHWIO_e_LockSemaphore_test() in test_os_hwio.c file "); 
  snprintf( chExpectedText, elCount(chExpectedText), "Verify var Smsts_unlock[28]=0  in function Os_Test_GetHWIO_e_LockSemaphore_test() in test_os_hwio.c file "); 
  TestStepAddActionExpected( chActionText, chExpectedText );
  E_DBGR_VariableCheck("Smsts_unlock[28]", 0, Equal);
  
  
  snprintf( chActionText, elCount(chActionText), "check var Smsts_unlock[29]=0  in function Os_Test_GetHWIO_e_LockSemaphore_test() in test_os_hwio.c file "); 
  snprintf( chExpectedText, elCount(chExpectedText), "Verify var Smsts_unlock[29]=0  in function Os_Test_GetHWIO_e_LockSemaphore_test() in test_os_hwio.c file "); 
  TestStepAddActionExpected( chActionText, chExpectedText );
  E_DBGR_VariableCheck("Smsts_unlock[29]", 0, Equal);
  
  
  snprintf( chActionText, elCount(chActionText), "check var Smsts_unlock[30]=0  in function Os_Test_GetHWIO_e_LockSemaphore_test() in test_os_hwio.c file "); 
  snprintf( chExpectedText, elCount(chExpectedText), "Verify var Smsts_unlock[30]=0  in function Os_Test_GetHWIO_e_LockSemaphore_test() in test_os_hwio.c file "); 
  TestStepAddActionExpected( chActionText, chExpectedText );
  E_DBGR_VariableCheck("Smsts_unlock[30]", 0, Equal);
  
  
  snprintf( chActionText, elCount(chActionText), "check var Smsts_unlock[31]=0  in function Os_Test_GetHWIO_e_LockSemaphore_test() in test_os_hwio.c file "); 
  snprintf( chExpectedText, elCount(chExpectedText), "Verify var Smsts_unlock[31]=0  in function Os_Test_GetHWIO_e_LockSemaphore_test() in test_os_hwio.c file "); 
  TestStepAddActionExpected( chActionText, chExpectedText );
  E_DBGR_VariableCheck("Smsts_unlock[31]", 0, Equal);
  
  
  
  
  /*******************************************************************************************************************************************************/    
    // Test Step 6: check var Smsts_status[semaphore]=6for 32 index in function Os_Test_GetHWIO_e_LockSemaphore_test() in test_os_hwio.c file
  /*******************************************************************************************************************************************************/
  snprintf( chActionText, elCount(chActionText), "check var Smsts_status[0]=6 in function Os_Test_GetHWIO_e_LockSemaphore_test() in test_os_hwio.c file "); 
  snprintf( chExpectedText, elCount(chExpectedText), "Verify var Smsts_status[0]=6 in function Os_Test_GetHWIO_e_LockSemaphore_test() in test_os_hwio.c file "); 
  TestStepAddActionExpected( chActionText, chExpectedText );
  E_DBGR_VariableCheck("Smsts_status[0]", 6, Equal);
  
  snprintf( chActionText, elCount(chActionText), "check var Smsts_status[1]=6 in function Os_Test_GetHWIO_e_LockSemaphore_test() in test_os_hwio.c file "); 
  snprintf( chExpectedText, elCount(chExpectedText), "Verify var Smsts_status[1]=6 in function Os_Test_GetHWIO_e_LockSemaphore_test() in test_os_hwio.c file "); 
  TestStepAddActionExpected( chActionText, chExpectedText );
  E_DBGR_VariableCheck("Smsts_status[1]", 6, Equal);
  
  snprintf( chActionText, elCount(chActionText), "check var Smsts_status[2]=6 in function Os_Test_GetHWIO_e_LockSemaphore_test() in test_os_hwio.c file "); 
  snprintf( chExpectedText, elCount(chExpectedText), "Verify var Smsts_status[2]=6 in function Os_Test_GetHWIO_e_LockSemaphore_test() in test_os_hwio.c file "); 
  TestStepAddActionExpected( chActionText, chExpectedText );
  E_DBGR_VariableCheck("Smsts_status[2]", 6, Equal);
  
  snprintf( chActionText, elCount(chActionText), "check var Smsts_status[3]=6 in function Os_Test_GetHWIO_e_LockSemaphore_test() in test_os_hwio.c file "); 
  snprintf( chExpectedText, elCount(chExpectedText), "Verify var Smsts_status[3]=6 in function Os_Test_GetHWIO_e_LockSemaphore_test() in test_os_hwio.c file "); 
  TestStepAddActionExpected( chActionText, chExpectedText );
  E_DBGR_VariableCheck("Smsts_status[3]", 6, Equal);
  
  snprintf( chActionText, elCount(chActionText), "check var Smsts_status[4]=6 in function Os_Test_GetHWIO_e_LockSemaphore_test() in test_os_hwio.c file "); 
  snprintf( chExpectedText, elCount(chExpectedText), "Verify var Smsts_status[4]=6 in function Os_Test_GetHWIO_e_LockSemaphore_test() in test_os_hwio.c file "); 
  TestStepAddActionExpected( chActionText, chExpectedText );
  E_DBGR_VariableCheck("Smsts_status[4]", 6, Equal);
  
  snprintf( chActionText, elCount(chActionText), "check var Smsts_status[5]=6 in function Os_Test_GetHWIO_e_LockSemaphore_test() in test_os_hwio.c file "); 
  snprintf( chExpectedText, elCount(chExpectedText), "Verify var Smsts_status[5]=6 in function Os_Test_GetHWIO_e_LockSemaphore_test() in test_os_hwio.c file "); 
  TestStepAddActionExpected( chActionText, chExpectedText );
  E_DBGR_VariableCheck("Smsts_status[5]", 6, Equal);
  
  snprintf( chActionText, elCount(chActionText), "check var Smsts_status[6]=6 in function Os_Test_GetHWIO_e_LockSemaphore_test() in test_os_hwio.c file "); 
  snprintf( chExpectedText, elCount(chExpectedText), "Verify var Smsts_status[6]=6 in function Os_Test_GetHWIO_e_LockSemaphore_test() in test_os_hwio.c file "); 
  TestStepAddActionExpected( chActionText, chExpectedText );
  E_DBGR_VariableCheck("Smsts_status[6]", 6, Equal);
  
  snprintf( chActionText, elCount(chActionText), "check var Smsts_status[7]=6 in function Os_Test_GetHWIO_e_LockSemaphore_test() in test_os_hwio.c file "); 
  snprintf( chExpectedText, elCount(chExpectedText), "Verify var Smsts_status[7]=6 in function Os_Test_GetHWIO_e_LockSemaphore_test() in test_os_hwio.c file "); 
  TestStepAddActionExpected( chActionText, chExpectedText );
  E_DBGR_VariableCheck("Smsts_status[7]", 6, Equal);
  
  snprintf( chActionText, elCount(chActionText), "check var Smsts_status[8]=6 in function Os_Test_GetHWIO_e_LockSemaphore_test() in test_os_hwio.c file "); 
  snprintf( chExpectedText, elCount(chExpectedText), "Verify var Smsts_status[8]=6 in function Os_Test_GetHWIO_e_LockSemaphore_test() in test_os_hwio.c file "); 
  TestStepAddActionExpected( chActionText, chExpectedText );
  E_DBGR_VariableCheck("Smsts_status[8]", 6, Equal);
  
  snprintf( chActionText, elCount(chActionText), "check var Smsts_status[9]=6 in function Os_Test_GetHWIO_e_LockSemaphore_test() in test_os_hwio.c file "); 
  snprintf( chExpectedText, elCount(chExpectedText), "Verify var Smsts_status[9]=6 in function Os_Test_GetHWIO_e_LockSemaphore_test() in test_os_hwio.c file "); 
  TestStepAddActionExpected( chActionText, chExpectedText );
  E_DBGR_VariableCheck("Smsts_status[9]", 6, Equal);
  
  snprintf( chActionText, elCount(chActionText), "check var Smsts_status[10]=6 in function Os_Test_GetHWIO_e_LockSemaphore_test() in test_os_hwio.c file "); 
  snprintf( chExpectedText, elCount(chExpectedText), "Verify var Smsts_status[10]=6 in function Os_Test_GetHWIO_e_LockSemaphore_test() in test_os_hwio.c file "); 
  TestStepAddActionExpected( chActionText, chExpectedText );
  E_DBGR_VariableCheck("Smsts_status[10]", 6, Equal);
  
  snprintf( chActionText, elCount(chActionText), "check var Smsts_status[11]=6 in function Os_Test_GetHWIO_e_LockSemaphore_test() in test_os_hwio.c file "); 
  snprintf( chExpectedText, elCount(chExpectedText), "Verify var Smsts_status[11]=6 in function Os_Test_GetHWIO_e_LockSemaphore_test() in test_os_hwio.c file "); 
  TestStepAddActionExpected( chActionText, chExpectedText );
  E_DBGR_VariableCheck("Smsts_status[11]", 6, Equal);
  
  snprintf( chActionText, elCount(chActionText), "check var Smsts_status[12]=6 in function Os_Test_GetHWIO_e_LockSemaphore_test() in test_os_hwio.c file "); 
  snprintf( chExpectedText, elCount(chExpectedText), "Verify var Smsts_status[12]=6 in function Os_Test_GetHWIO_e_LockSemaphore_test() in test_os_hwio.c file "); 
  TestStepAddActionExpected( chActionText, chExpectedText );
  E_DBGR_VariableCheck("Smsts_status[12]", 6, Equal);
  
  snprintf( chActionText, elCount(chActionText), "check var Smsts_status[13]=6 in function Os_Test_GetHWIO_e_LockSemaphore_test() in test_os_hwio.c file "); 
  snprintf( chExpectedText, elCount(chExpectedText), "Verify var Smsts_status[13]=6 in function Os_Test_GetHWIO_e_LockSemaphore_test() in test_os_hwio.c file "); 
  TestStepAddActionExpected( chActionText, chExpectedText );
  E_DBGR_VariableCheck("Smsts_status[13]", 6, Equal);
  
  snprintf( chActionText, elCount(chActionText), "check var Smsts_status[14]=6 in function Os_Test_GetHWIO_e_LockSemaphore_test() in test_os_hwio.c file "); 
  snprintf( chExpectedText, elCount(chExpectedText), "Verify var Smsts_status[14]=6 in function Os_Test_GetHWIO_e_LockSemaphore_test() in test_os_hwio.c file "); 
  TestStepAddActionExpected( chActionText, chExpectedText );
  E_DBGR_VariableCheck("Smsts_status[14]", 6, Equal);
  
  snprintf( chActionText, elCount(chActionText), "check var Smsts_status[15]=6 in function Os_Test_GetHWIO_e_LockSemaphore_test() in test_os_hwio.c file "); 
  snprintf( chExpectedText, elCount(chExpectedText), "Verify var Smsts_status[15]=6 in function Os_Test_GetHWIO_e_LockSemaphore_test() in test_os_hwio.c file "); 
  TestStepAddActionExpected( chActionText, chExpectedText );
  E_DBGR_VariableCheck("Smsts_status[15]", 6, Equal);
  
  snprintf( chActionText, elCount(chActionText), "check var Smsts_status[16]=6 in function Os_Test_GetHWIO_e_LockSemaphore_test() in test_os_hwio.c file "); 
  snprintf( chExpectedText, elCount(chExpectedText), "Verify var Smsts_status[16]=6 in function Os_Test_GetHWIO_e_LockSemaphore_test() in test_os_hwio.c file "); 
  TestStepAddActionExpected( chActionText, chExpectedText );
  E_DBGR_VariableCheck("Smsts_status[16]", 6, Equal);
  
  snprintf( chActionText, elCount(chActionText), "check var Smsts_status[17]=6 in function Os_Test_GetHWIO_e_LockSemaphore_test() in test_os_hwio.c file "); 
  snprintf( chExpectedText, elCount(chExpectedText), "Verify var Smsts_status[17]=6 in function Os_Test_GetHWIO_e_LockSemaphore_test() in test_os_hwio.c file "); 
  TestStepAddActionExpected( chActionText, chExpectedText );
  E_DBGR_VariableCheck("Smsts_status[17]", 6, Equal);
  
  snprintf( chActionText, elCount(chActionText), "check var Smsts_status[18]=6 in function Os_Test_GetHWIO_e_LockSemaphore_test() in test_os_hwio.c file "); 
  snprintf( chExpectedText, elCount(chExpectedText), "Verify var Smsts_status[18]=6 in function Os_Test_GetHWIO_e_LockSemaphore_test() in test_os_hwio.c file "); 
  TestStepAddActionExpected( chActionText, chExpectedText );
  E_DBGR_VariableCheck("Smsts_status[18]", 6, Equal);
  
  snprintf( chActionText, elCount(chActionText), "check var Smsts_status[19]=6 in function Os_Test_GetHWIO_e_LockSemaphore_test() in test_os_hwio.c file "); 
  snprintf( chExpectedText, elCount(chExpectedText), "Verify var Smsts_status[19]=6 in function Os_Test_GetHWIO_e_LockSemaphore_test() in test_os_hwio.c file "); 
  TestStepAddActionExpected( chActionText, chExpectedText );
  E_DBGR_VariableCheck("Smsts_status[19]", 6, Equal);
  
  
  snprintf( chActionText, elCount(chActionText), "check var Smsts_status[20]=6 in function Os_Test_GetHWIO_e_LockSemaphore_test() in test_os_hwio.c file "); 
  snprintf( chExpectedText, elCount(chExpectedText), "Verify var Smsts_status[20]=6 in function Os_Test_GetHWIO_e_LockSemaphore_test() in test_os_hwio.c file "); 
  TestStepAddActionExpected( chActionText, chExpectedText );
  E_DBGR_VariableCheck("Smsts_status[20]", 6, Equal);
  
  
  snprintf( chActionText, elCount(chActionText), "check var Smsts_status[21]=6 in function Os_Test_GetHWIO_e_LockSemaphore_test() in test_os_hwio.c file "); 
  snprintf( chExpectedText, elCount(chExpectedText), "Verify var Smsts_status[21]=6 in function Os_Test_GetHWIO_e_LockSemaphore_test() in test_os_hwio.c file "); 
  TestStepAddActionExpected( chActionText, chExpectedText );
  E_DBGR_VariableCheck("Smsts_status[21]", 6, Equal);
  
  
  snprintf( chActionText, elCount(chActionText), "check var Smsts_status[22]=6 in function Os_Test_GetHWIO_e_LockSemaphore_test() in test_os_hwio.c file "); 
  snprintf( chExpectedText, elCount(chExpectedText), "Verify var Smsts_status[22]=6 in function Os_Test_GetHWIO_e_LockSemaphore_test() in test_os_hwio.c file "); 
  TestStepAddActionExpected( chActionText, chExpectedText );
  E_DBGR_VariableCheck("Smsts_status[22]", 6, Equal);
  
  
  snprintf( chActionText, elCount(chActionText), "check var Smsts_status[23]=6 in function Os_Test_GetHWIO_e_LockSemaphore_test() in test_os_hwio.c file "); 
  snprintf( chExpectedText, elCount(chExpectedText), "Verify var Smsts_status[23]=6 in function Os_Test_GetHWIO_e_LockSemaphore_test() in test_os_hwio.c file "); 
  TestStepAddActionExpected( chActionText, chExpectedText );
  E_DBGR_VariableCheck("Smsts_status[23]", 6, Equal);
  
  
  snprintf( chActionText, elCount(chActionText), "check var Smsts_status[24]=6 in function Os_Test_GetHWIO_e_LockSemaphore_test() in test_os_hwio.c file "); 
  snprintf( chExpectedText, elCount(chExpectedText), "Verify var Smsts_status[24]=6 in function Os_Test_GetHWIO_e_LockSemaphore_test() in test_os_hwio.c file "); 
  TestStepAddActionExpected( chActionText, chExpectedText );
  E_DBGR_VariableCheck("Smsts_status[24]", 6, Equal);
  
  
  snprintf( chActionText, elCount(chActionText), "check var Smsts_lock[25]=6 in function Os_Test_GetHWIO_e_LockSemaphore_test() in test_os_hwio.c file "); 
  snprintf( chExpectedText, elCount(chExpectedText), "Verify var Smsts_lock[25]=6 in function Os_Test_GetHWIO_e_LockSemaphore_test() in test_os_hwio.c file "); 
  TestStepAddActionExpected( chActionText, chExpectedText );
  E_DBGR_VariableCheck("Smsts_status[25]", 6, Equal);
  
  
  snprintf( chActionText, elCount(chActionText), "check var Smsts_status[26]=6 in function Os_Test_GetHWIO_e_LockSemaphore_test() in test_os_hwio.c file "); 
  snprintf( chExpectedText, elCount(chExpectedText), "Verify var Smsts_status[26]=6 in function Os_Test_GetHWIO_e_LockSemaphore_test() in test_os_hwio.c file "); 
  TestStepAddActionExpected( chActionText, chExpectedText );
  E_DBGR_VariableCheck("Smsts_status[26]", 6, Equal);
  
  
  snprintf( chActionText, elCount(chActionText), "check var Smsts_status[27]=6 in function Os_Test_GetHWIO_e_LockSemaphore_test() in test_os_hwio.c file "); 
  snprintf( chExpectedText, elCount(chExpectedText), "Verify var Smsts_status[27]=6 in function Os_Test_GetHWIO_e_LockSemaphore_test() in test_os_hwio.c file "); 
  TestStepAddActionExpected( chActionText, chExpectedText );
  E_DBGR_VariableCheck("Smsts_status[27]", 6, Equal);
  
  snprintf( chActionText, elCount(chActionText), "check var Smsts_status[28]=6 in function Os_Test_GetHWIO_e_LockSemaphore_test() in test_os_hwio.c file "); 
  snprintf( chExpectedText, elCount(chExpectedText), "Verify var Smsts_status[28]=6 in function Os_Test_GetHWIO_e_LockSemaphore_test() in test_os_hwio.c file "); 
  TestStepAddActionExpected( chActionText, chExpectedText );
  E_DBGR_VariableCheck("Smsts_status[28]", 6, Equal);
  
  
  snprintf( chActionText, elCount(chActionText), "check var Smsts_status[29]=6 in function Os_Test_GetHWIO_e_LockSemaphore_test() in test_os_hwio.c file "); 
  snprintf( chExpectedText, elCount(chExpectedText), "Verify var Smsts_status[29]=6 in function Os_Test_GetHWIO_e_LockSemaphore_test() in test_os_hwio.c file "); 
  TestStepAddActionExpected( chActionText, chExpectedText );
  E_DBGR_VariableCheck("Smsts_status[29]", 6, Equal);
  
  
  snprintf( chActionText, elCount(chActionText), "check var Smsts_status[30]=6 in function Os_Test_GetHWIO_e_LockSemaphore_test() in test_os_hwio.c file "); 
  snprintf( chExpectedText, elCount(chExpectedText), "Verify var Smsts_status[30]=6 in function Os_Test_GetHWIO_e_LockSemaphore_test() in test_os_hwio.c file "); 
  TestStepAddActionExpected( chActionText, chExpectedText );
  E_DBGR_VariableCheck("Smsts_status[30]", 6, Equal);
  
  
  snprintf( chActionText, elCount(chActionText), "check var Smsts_status[31]=6 in function Os_Test_GetHWIO_e_LockSemaphore_test() in test_os_hwio.c file "); 
  snprintf( chExpectedText, elCount(chExpectedText), "Verify var Smsts_status[31]=6 in function Os_Test_GetHWIO_e_LockSemaphore_test() in test_os_hwio.c file "); 
  TestStepAddActionExpected( chActionText, chExpectedText );
  E_DBGR_VariableCheck("Smsts_status[31]", 6, Equal);
  
  
  
  
  
  
}






/***************************************************************************************************
----------------------------------------------------------------------------------------------------
Test case name:  TC_L30SW_QT_36651207: verify_the_functionality_of_interface_to_Perform_semaphore_lock_in_core1_and_get_status_from_core2
----------------------------------------------------------------------------------------------------
Description:  Test_case_to_verify_the_functionality_of_interface_to_Perform_semaphore_lock_in_core1_and_get_status_from_core2

***************************************************************************************************/


testcase verify_the_functionality_of_interface_to_Perform_semaphore_lock_in_core1_and_get_status_from_core2()
{
  /***************************************************************************************************************/    
                                                // Variable Definition
  /***************************************************************************************************************/ 
  
  long taskvalue;
  
  /***************************************************************************************************************/    
                                               // Local Values
  /***************************************************************************************************************/ 
  

  
  /***************************************************************************************************************/    
                                              // Test Case Info
  /***************************************************************************************************************/
  setWriteDbgLevel(DebugOff);
  snprintf( chTestTitle, elCount(chTestTitle), "verify_the_functionality_of_interface_to_Perform_semaphore_lock_in_core1_and_get_status_from_core2" );
  snprintf( chTestDescription, elCount(chTestDescription), "Purpose:verify_the_functionality_of_interface_to_Perform_semaphore_lock_in_core1_and_get_status_from_core2.");
  TestCaseAddInfo( chTestTitle, "TC_L30SW_QT_36651207", chTestDescription );

  /***************************************************************************************************************/    
                                              // Start of Test Case
  /***************************************************************************************************************/
  
  /***************************************************************************************************************/    
                                              // Test Step 1 PRECONDITIONS
  /***************************************************************************************************************/
  
  snprintf( chActionText, elCount(chActionText), "Flash the Software and ECU is running"); 
  snprintf( chExpectedText, elCount(chExpectedText), "ECU should be in running state"); 
  TestStepAddActionExpected( chActionText, chExpectedText );

  A_DBGR_BreakpointDeleteAll();
  A_DBGR_RnGo();
  E_DBGR_CheckState(T32_State_Running);
  

   /***************************************************************************************************************/    
            // Test Step 2: Check all cores are in running state                                   
  /***************************************************************************************************************/
  
  //Check core0 is running
  snprintf( chActionText, elCount(chActionText), "Check 1000ms Task Counter from core0 "); 
  snprintf( chExpectedText, elCount(chExpectedText), "1000ms Counter from core0 is incrementing"); 
  TestStepAddActionExpected( chActionText, chExpectedText );
  A_DBGR_VariableRead( "Task_Core0_1000ms_Count", taskvalue);
  E_DBGR_VariableCheck("Task_Core0_1000ms_Count", taskvalue, Greater);
  
  //Check Core1 is running
  snprintf( chActionText, elCount(chActionText), "Check 1000ms Task Counter from Core1 "); 
  snprintf( chExpectedText, elCount(chExpectedText), "1000ms Counter from Core1 is incrementing"); 
  TestStepAddActionExpected( chActionText, chExpectedText );
  A_DBGR_VariableRead( "Task_Core1_1000ms_Count", taskvalue);
  E_DBGR_VariableCheck("Task_Core1_1000ms_Count", taskvalue, Greater);
  
  //Check Core2 is running
  snprintf( chActionText, elCount(chActionText), "Check 1000ms Task Counter from Core2 "); 
  snprintf( chExpectedText, elCount(chExpectedText), "1000ms Counter from Core2 is incrementing"); 
  TestStepAddActionExpected( chActionText, chExpectedText );
  A_DBGR_VariableRead( "Task_Core2_1000ms_Count", taskvalue);
  E_DBGR_VariableCheck("Task_Core2_1000ms_Count", taskvalue, Greater);
    
  //Check Core3 is running
  snprintf( chActionText, elCount(chActionText), "Check 1000ms Task Counter from Core3 "); 
  snprintf( chExpectedText, elCount(chExpectedText), "1000ms Counter from Core3 is incrementing"); 
  TestStepAddActionExpected( chActionText, chExpectedText );
  A_DBGR_VariableRead( "Task_Core3_1000ms_Count", taskvalue);
  E_DBGR_VariableCheck("Task_Core3_1000ms_Count", taskvalue, Greater);
    
  //Check Core4 is running
  snprintf( chActionText, elCount(chActionText), "Check 1000ms Task Counter from Core4 "); 
  snprintf( chExpectedText, elCount(chExpectedText), "1000ms Counter from Core4 is incrementing"); 
  TestStepAddActionExpected( chActionText, chExpectedText );
  A_DBGR_VariableRead( "Task_Core4_1000ms_Count", taskvalue);
  E_DBGR_VariableCheck("Task_Core4_1000ms_Count", taskvalue, Greater);
    
  //Check Core5 is running
  snprintf( chActionText, elCount(chActionText), "Check 1000ms Task Counter from Core5 "); 
  snprintf( chExpectedText, elCount(chExpectedText), "1000ms Counter from Core5 is incrementing"); 
  TestStepAddActionExpected( chActionText, chExpectedText );
  A_DBGR_VariableRead( "Task_Core5_1000ms_Count", taskvalue);
  E_DBGR_VariableCheck("Task_Core5_1000ms_Count", taskvalue, Greater);
  
  /*******************************************************************************************************************************************************/    
    // Test Step 3: Set flag lock_core1_status_core2_flag=1 to check semaphore lock for core1 in function TestApp_Core1_1000ms_MainFunction
  /*******************************************************************************************************************************************************/

  snprintf( chActionText, elCount(chActionText), "Set flag lock_core1_status_core2_flag=1 to check semaphore lock for core1 in function TestApp_Core1_1000ms_MainFunction "); 
  snprintf( chExpectedText, elCount(chExpectedText), "Verify flag lock_core1_status_core2_flag=1 to check semaphore lock for core1 in function TestApp_Core1_1000ms_MainFunction "); 
  TestStepAddActionExpected( chActionText, chExpectedText );
  A_DBGR_VariableSet("lock_core1_status_core2_flag", "1");
  E_DBGR_VariableCheck("lock_core1_status_core2_flag", 1, Equal);
  
  
  
  snprintf( chActionText, elCount(chActionText), "Set breakpoint in  file testapp.c in function TestApp_Core1_1000ms_MainFunction in Os_Test_GetHWIO_e_LockSemaphore_core1(1,1);      "); 
  snprintf( chExpectedText, elCount(chExpectedText), "Verify Breakpoint got hit at function  TestApp_Core1_1000ms_MainFunction in Os_Test_GetHWIO_e_LockSemaphore_core1(1,1);       "); 
  TestStepAddActionExpected( chActionText, chExpectedText );
  //A_DBGR_R();
  A_DBGR_BreakpointSet("TestApp_Core1_1000ms_MainFunction\\33");  
  A_DBGR_Go();
  E_DBGR_BreakpointCheckForHalt("TestApp_Core1_1000ms_MainFunction\\33");
  
   snprintf( chActionText, elCount(chActionText), "Set breakpoint in  file testapp.c in function TestApp_Core1_1000ms_MainFunction in Os_Test_GetHWIO_e_LockSemaphore_core1(1,1);      "); 
  snprintf( chExpectedText, elCount(chExpectedText), "Verify Breakpoint got hit at function  TestApp_Core1_1000ms_MainFunction in Os_Test_GetHWIO_e_LockSemaphore_core1(1,1);       "); 
  TestStepAddActionExpected( chActionText, chExpectedText );
  //A_DBGR_R();
  A_DBGR_BreakpointSet("Os_Test_GetHWIO_e_LockSemaphore_core1\\5");  
  A_DBGR_Go();
  E_DBGR_BreakpointCheckForHalt("Os_Test_GetHWIO_e_LockSemaphore_core1\\5");

  
    
  
  
  /*******************************************************************************************************************************************************/    
    // Test Step 4: check var Smsts_lock_core1=2 to check semaphore lock in core1 in function Os_Test_GetHWIO_e_LockSemaphore_core1() in test_os_hwio.c file
  /*******************************************************************************************************************************************************/
  snprintf( chActionText, elCount(chActionText), "check var Smsts_lock_core1=2 to check semaphore lock in core1 in function Os_Test_GetHWIO_e_LockSemaphore_core1() in test_os_hwio.c file "); 
  snprintf( chExpectedText, elCount(chExpectedText), "Verify var Smsts_lock_core1=2 to check semaphore lock in core1 in function Os_Test_GetHWIO_e_LockSemaphore_core1() in testapp.c file "); 
  TestStepAddActionExpected( chActionText, chExpectedText );
  E_DBGR_VariableCheck("Smsts_lock_core1", 2, Equal);
  
  
 
  
  /*******************************************************************************************************************************************************/    
    // Test Step 5: set lock_flag=1 to check the status in core2 in function TestApp_Core2_1000ms_MainFunction in testapp.c file 
  /*******************************************************************************************************************************************************/
  snprintf( chActionText, elCount(chActionText), "set flag lock_flag=1 to check the status in core2 in function TestApp_Core2_1000ms_MainFunction in testapp.c file  "); 
  snprintf( chExpectedText, elCount(chExpectedText), "Verify flag lock_flag=1 to check the status in core2 in function TestApp_Core2_1000ms_MainFunction in testapp.c file "); 
  TestStepAddActionExpected( chActionText, chExpectedText );
  A_DBGR_VariableSet("lock_flag", "1");
  E_DBGR_VariableCheck("lock_flag", 1, Equal);
  
  snprintf( chActionText, elCount(chActionText), "Set breakpoint in  file testapp.c in function TestApp_Core1_1000ms_MainFunction in Os_Test_GetHWIO_e_LockSemaphore_core1(1,1);      "); 
  snprintf( chExpectedText, elCount(chExpectedText), "Verify Breakpoint got hit at function  TestApp_Core1_1000ms_MainFunction in Os_Test_GetHWIO_e_LockSemaphore_core1(1,1);       "); 
  TestStepAddActionExpected( chActionText, chExpectedText );
  //A_DBGR_R();
  A_DBGR_BreakpointSet("TestApp_Core2_1000ms_MainFunction\\39");  
  A_DBGR_Go();
  E_DBGR_BreakpointCheckForHalt("TestApp_Core2_1000ms_MainFunction\\39");
  
  
   snprintf( chActionText, elCount(chActionText), "Set breakpoint in  file testapp.c in function TestApp_Core1_1000ms_MainFunction in Os_Test_GetHWIO_e_LockSemaphore_core1(1,1);      "); 
  snprintf( chExpectedText, elCount(chExpectedText), "Verify Breakpoint got hit at function  TestApp_Core1_1000ms_MainFunction in Os_Test_GetHWIO_e_LockSemaphore_core1(1,1);       "); 
  TestStepAddActionExpected( chActionText, chExpectedText );
  //A_DBGR_R();
  A_DBGR_BreakpointSet("Os_Test_GetHWIO_e_SemaphoreSts_core1\\6");  
  A_DBGR_Go();
  E_DBGR_BreakpointCheckForHalt("Os_Test_GetHWIO_e_SemaphoreSts_core1\\6");
  
  
  
   snprintf( chActionText, elCount(chActionText), "delete all breakpoints "); 
  snprintf( chExpectedText, elCount(chExpectedText), "Verify breakpoints got deleted"); 
  TestStepAddActionExpected( chActionText, chExpectedText );
  A_DBGR_BreakpointDeleteAll();
  
  
    A_DBGR_Go();
   testWaitForTimeout(5000);
  
  /*******************************************************************************************************************************************************/    
    // Test Step 6: check var Smsts_core1 =2 to check semaphore status in core2 in function Os_Test_GetHWIO_e_LockSemaphore_core1() in test_os_hwio.c file
  /*******************************************************************************************************************************************************/
  snprintf( chActionText, elCount(chActionText), "check var Smsts_core1 =2 to check semaphore status in core2 in function Os_Test_GetHWIO_e_LockSemaphore_core1() in test_os_hwio.c file "); 
  snprintf( chExpectedText, elCount(chExpectedText), "Verify var Smsts_core1 =2 to check semaphore status in core2 in function Os_Test_GetHWIO_e_LockSemaphore_core1() in test_os_hwio.c file "); 
  //TestStepAddActionExpected( chActionText, chExpectedText );
  E_DBGR_VariableCheck("Smsts_core1", 2, Equal);
  









}






/***************************************************************************************************
----------------------------------------------------------------------------------------------------
Test case name:  TC_L30SW_QT_36651207: verify_the_functionality_of_interface_to_Perform_semaphore_lock_in_core1_and_should_not_unlock_with_same_semaphore_in_core2
----------------------------------------------------------------------------------------------------
Description:  Test_case_to_verify_the_functionality_of_interface_to_Perform_semaphore_lock_in_core1_and_should_not_unlock_with_same_semaphore_in_core2

***************************************************************************************************/


testcase verify_the_functionality_of_interface_to_Perform_semaphore_lock_in_core1_and_should_not_unlock_with_same_semaphore_in_core2()
{
  /***************************************************************************************************************/    
                                                // Variable Definition
  /***************************************************************************************************************/ 
  
  long taskvalue;
  
  /***************************************************************************************************************/    
                                               // Local Values
  /***************************************************************************************************************/ 
  

  
  /***************************************************************************************************************/    
                                              // Test Case Info
  /***************************************************************************************************************/
  setWriteDbgLevel(DebugOff);
  snprintf( chTestTitle, elCount(chTestTitle), "verify_the_functionality_of_interface_to_Perform_semaphore_lock_in_core1_and_should_not_unlock_with_same_semaphore_in_core2" );
  snprintf( chTestDescription, elCount(chTestDescription), "Purpose:verify_the_functionality_of_interface_to_Perform_semaphore_lock_in_core1_and_should_not_unlock_with_same_semaphore_in_core2.");
  TestCaseAddInfo( chTestTitle, "TC_L30SW_QT_36651207", chTestDescription );

  /***************************************************************************************************************/    
                                              // Start of Test Case
  /***************************************************************************************************************/
  
  /***************************************************************************************************************/    
                                              // Test Step 1 PRECONDITIONS
  /***************************************************************************************************************/
  
  snprintf( chActionText, elCount(chActionText), "Flash the Software and ECU is running"); 
  snprintf( chExpectedText, elCount(chExpectedText), "ECU should be in running state"); 
  TestStepAddActionExpected( chActionText, chExpectedText );

  A_DBGR_BreakpointDeleteAll();
  A_DBGR_RnGo();
  E_DBGR_CheckState(T32_State_Running);
  

   /***************************************************************************************************************/    
            // Test Step 2: Check all cores are in running state                                   
  /***************************************************************************************************************/
  
  //Check core0 is running
  snprintf( chActionText, elCount(chActionText), "Check 1000ms Task Counter from core0 "); 
  snprintf( chExpectedText, elCount(chExpectedText), "1000ms Counter from core0 is incrementing"); 
  TestStepAddActionExpected( chActionText, chExpectedText );
  A_DBGR_VariableRead( "Task_Core0_1000ms_Count", taskvalue);
  E_DBGR_VariableCheck("Task_Core0_1000ms_Count", taskvalue, Greater);
  
  //Check Core1 is running
  snprintf( chActionText, elCount(chActionText), "Check 1000ms Task Counter from Core1 "); 
  snprintf( chExpectedText, elCount(chExpectedText), "1000ms Counter from Core1 is incrementing"); 
  TestStepAddActionExpected( chActionText, chExpectedText );
  A_DBGR_VariableRead( "Task_Core1_1000ms_Count", taskvalue);
  E_DBGR_VariableCheck("Task_Core1_1000ms_Count", taskvalue, Greater);
  
  //Check Core2 is running
  snprintf( chActionText, elCount(chActionText), "Check 1000ms Task Counter from Core2 "); 
  snprintf( chExpectedText, elCount(chExpectedText), "1000ms Counter from Core2 is incrementing"); 
  TestStepAddActionExpected( chActionText, chExpectedText );
  A_DBGR_VariableRead( "Task_Core2_1000ms_Count", taskvalue);
  E_DBGR_VariableCheck("Task_Core2_1000ms_Count", taskvalue, Greater);
    
  //Check Core3 is running
  snprintf( chActionText, elCount(chActionText), "Check 1000ms Task Counter from Core3 "); 
  snprintf( chExpectedText, elCount(chExpectedText), "1000ms Counter from Core3 is incrementing"); 
  TestStepAddActionExpected( chActionText, chExpectedText );
  A_DBGR_VariableRead( "Task_Core3_1000ms_Count", taskvalue);
  E_DBGR_VariableCheck("Task_Core3_1000ms_Count", taskvalue, Greater);
    
  //Check Core4 is running
  snprintf( chActionText, elCount(chActionText), "Check 1000ms Task Counter from Core4 "); 
  snprintf( chExpectedText, elCount(chExpectedText), "1000ms Counter from Core4 is incrementing"); 
  TestStepAddActionExpected( chActionText, chExpectedText );
  A_DBGR_VariableRead( "Task_Core4_1000ms_Count", taskvalue);
  E_DBGR_VariableCheck("Task_Core4_1000ms_Count", taskvalue, Greater);
    
  //Check Core5 is running
  snprintf( chActionText, elCount(chActionText), "Check 1000ms Task Counter from Core5 "); 
  snprintf( chExpectedText, elCount(chExpectedText), "1000ms Counter from Core5 is incrementing"); 
  TestStepAddActionExpected( chActionText, chExpectedText );
  A_DBGR_VariableRead( "Task_Core5_1000ms_Count", taskvalue);
  E_DBGR_VariableCheck("Task_Core5_1000ms_Count", taskvalue, Greater);
  
  
  
  
  /*******************************************************************************************************************************************************/    
    // Test Step 4: Set flag lock_core1_status_core2_flag=1 to check semaphore lock for core1 in function TestApp_Core1_1000ms_MainFunction
  /*******************************************************************************************************************************************************/

  snprintf( chActionText, elCount(chActionText), "Set flag lock_core1_should_not_unlock_core2_flag=1 to check semaphore lock for core1 in function TestApp_Core1_1000ms_MainFunction "); 
  snprintf( chExpectedText, elCount(chExpectedText), "Verify flag lock_core1_should_not_unlock_core2_flag=1 to check semaphore lock for core1 in function TestApp_Core1_1000ms_MainFunction "); 
  TestStepAddActionExpected( chActionText, chExpectedText );
  A_DBGR_VariableSet("lock_core1_should_not_unlock_core2_flag", "1");
  E_DBGR_VariableCheck("lock_core1_should_not_unlock_core2_flag", 1, Equal);

  
  
  /*******************************************************************************************************************************************************/    
    // Test Step 5: Set breakpoint in  file testapp.c in function TestApp_Core1_1000ms_MainFunction in Os_Test_GetHWIO_e_LockSemaphore_core1(1,1);     
  /*******************************************************************************************************************************************************/
  snprintf( chActionText, elCount(chActionText), "Set breakpoint in  file testapp.c in function TestApp_Core1_1000ms_MainFunction in Os_Test_GetHWIO_e_LockSemaphore_core1(1,1);      "); 
  snprintf( chExpectedText, elCount(chExpectedText), "Verify Breakpoint got hit at function  TestApp_Core1_1000ms_MainFunction in Os_Test_GetHWIO_e_LockSemaphore_core1(1,1);       "); 
  TestStepAddActionExpected( chActionText, chExpectedText );
  //A_DBGR_R();
  A_DBGR_BreakpointSet("TestApp_Core1_1000ms_MainFunction\\41");  
  A_DBGR_Go();
  E_DBGR_BreakpointCheckForHalt("TestApp_Core1_1000ms_MainFunction\\41");
  
  
  snprintf( chActionText, elCount(chActionText), "Set breakpoint in  file test_os_hwio.c in function call  Smsts_lock_core1 = PerfmHWIO_e_LockSemaphore(semaphore_id); in Os_Test_GetHWIO_e_LockSemaphore_core1()      "); 
  snprintf( chExpectedText, elCount(chExpectedText), "Verify Breakpoint got hit at function call  Smsts_lock_core1 = PerfmHWIO_e_LockSemaphore(semaphore_id); in Os_Test_GetHWIO_e_LockSemaphore_core1()  "); 
  TestStepAddActionExpected( chActionText, chExpectedText );
  //A_DBGR_R();
  A_DBGR_BreakpointSet("Os_Test_GetHWIO_e_LockSemaphore_core1\\5");  
  A_DBGR_Go();
  E_DBGR_BreakpointCheckForHalt("Os_Test_GetHWIO_e_LockSemaphore_core1\\5");
  
  
 
 
  
  /*******************************************************************************************************************************************************/    
    // Test Step 6: check var Smsts_lock_core1=2 to check semaphore lock in core1 in function Os_Test_GetHWIO_e_LockSemaphore_core1() in test_os_hwio.c file
  /*******************************************************************************************************************************************************/
  snprintf( chActionText, elCount(chActionText), "check var Smsts_lock_core1=2 to check semaphore lock in core1 in function Os_Test_GetHWIO_e_LockSemaphore_core1() in test_os_hwio.c file "); 
  snprintf( chExpectedText, elCount(chExpectedText), "Verify var Smsts_lock_core1=2 to check semaphore lock in core1 in function Os_Test_GetHWIO_e_LockSemaphore_core1() in testapp.c file "); 
  TestStepAddActionExpected( chActionText, chExpectedText );
  E_DBGR_VariableCheck("Smsts_lock_core1", 2, Equal);
  
  
  
  
  snprintf( chActionText, elCount(chActionText), "delete all breakpoints "); 
  snprintf( chExpectedText, elCount(chExpectedText), "Verify breakpoints got deleted"); 
  TestStepAddActionExpected( chActionText, chExpectedText );
  A_DBGR_BreakpointDeleteAll();
  
  
  
  
  
  
  /*******************************************************************************************************************************************************/    
    // Test Step 7: set flag =1 to check the status in core2 in function TestApp_Core2_1000ms_MainFunction in testapp.c file 
  /*******************************************************************************************************************************************************/
  snprintf( chActionText, elCount(chActionText), "set flag flag =1 to check the status in core2 in function TestApp_Core2_1000ms_MainFunction in testapp.c file  "); 
  snprintf( chExpectedText, elCount(chExpectedText), "Verify flag flag =1 to check the status in core2 in function TestApp_Core2_1000ms_MainFunction in testapp.c file "); 
  //TestStepAddActionExpected( chActionText, chExpectedText );
  A_DBGR_VariableSet("flag", "1");
  E_DBGR_VariableCheck("flag", 1, Equal);
  
  /*******************************************************************************************************************************************************/    
    // Test Step 8: Set breakpoint in  file testapp.c in function TestApp_Core2_1000ms_MainFunction in Os_Test_GetHWIO_e_UnlockLockSemaphore_core2(1);     
  /*******************************************************************************************************************************************************/

  
  snprintf( chActionText, elCount(chActionText), "Set breakpoint in  file test_os_hwio.c in function call  Smsts_lock_core1 = PerfmHWIO_e_LockSemaphore(semaphore_id); in Os_Test_GetHWIO_e_LockSemaphore_core1()      "); 
  snprintf( chExpectedText, elCount(chExpectedText), "Verify Breakpoint got hit at function call  Smsts_lock_core1 = PerfmHWIO_e_LockSemaphore(semaphore_id); in Os_Test_GetHWIO_e_LockSemaphore_core1()  "); 
  TestStepAddActionExpected( chActionText, chExpectedText );
  //A_DBGR_R();
  A_DBGR_BreakpointSet("Os_Test_GetHWIO_e_UnlockLockSemaphore_core2\\5");  
  A_DBGR_Go();
  E_DBGR_BreakpointCheckForHalt("Os_Test_GetHWIO_e_UnlockLockSemaphore_core2\\5");
  
  
  
  snprintf( chActionText, elCount(chActionText), "delete all breakpoints "); 
  snprintf( chExpectedText, elCount(chExpectedText), "Verify breakpoints got deleted"); 
  TestStepAddActionExpected( chActionText, chExpectedText );
  A_DBGR_BreakpointDeleteAll();
  
  
  
  A_DBGR_Go();
 
  testWaitForTimeout(3000);
  
 

  
  
  
  /*******************************************************************************************************************************************************/    
    // Test Step 9: check var Smsts_unlock_core2  =2 to check semaphore should not unlock in core2 in function Os_Test_GetHWIO_e_LockSemaphore_core1() in test_os_hwio.c file
  /*******************************************************************************************************************************************************/
  snprintf( chActionText, elCount(chActionText), "check var Smsts_unlock_core2  =2 to check semaphore should not unlock in core2 in function Os_Test_GetHWIO_e_LockSemaphore_core1() in test_os_hwio.c file "); 
  snprintf( chExpectedText, elCount(chExpectedText), "Verify var Smsts_unlock_core2  =2 to check semaphore should not unlock in core2 in function Os_Test_GetHWIO_e_LockSemaphore_core1() in test_os_hwio.c file "); 
  //TestStepAddActionExpected( chActionText, chExpectedText );
  E_DBGR_VariableCheck("Smsts_unlock_core2", 2, Equal);
  









}







/***************************************************************************************************
----------------------------------------------------------------------------------------------------
Test case name:  TC_L30SW_QT_36651207: verify_the_functionality_of_interface_PerfmHWIO_e_LockSemaphore_to_perform_lock_in_core1_and_try_to_lock_in_core2_with_same_semaphore_id
----------------------------------------------------------------------------------------------------
Description:  verify_the_functionality_of_interface_PerfmHWIO_e_LockSemaphore_to_perform_lock_in_core1_and_try_to_lock_in_core2_with_same_semaphore_id

***************************************************************************************************/


testcase verify_the_functionality_of_interface_PerfmHWIO_e_LockSemaphore_lock_in_core1_and_try_to_lock_in_core2_with_same_semaphore_id()
{
  /***************************************************************************************************************/    
                                                // Variable Definition
  /***************************************************************************************************************/ 
  
  long taskvalue;
  
  /***************************************************************************************************************/    
                                               // Local Values
  /***************************************************************************************************************/ 
  

  
  /***************************************************************************************************************/    
                                              // Test Case Info
  /***************************************************************************************************************/
  setWriteDbgLevel(DebugOff);
  snprintf( chTestTitle, elCount(chTestTitle), "verify_the_functionality_of_interface_PerfmHWIO_e_LockSemaphore_lock_in_core1_and_try_to_lock_in_core2_with_same_semaphore_id" );
  snprintf( chTestDescription, elCount(chTestDescription), "Purpose:verify_the_functionality_of_interface_PerfmHWIO_e_LockSemaphore_lock_in_core1_and_try_to_lock_in_core2_with_same_semaphore_id.");
  TestCaseAddInfo( chTestTitle, "TC_L30SW_QT_36651207", chTestDescription );

  /***************************************************************************************************************/    
                                              // Start of Test Case
  /***************************************************************************************************************/
  
  /***************************************************************************************************************/    
                                              // Test Step 1 PRECONDITIONS
  /***************************************************************************************************************/
  
  snprintf( chActionText, elCount(chActionText), "Flash the Software and ECU is running"); 
  snprintf( chExpectedText, elCount(chExpectedText), "ECU should be in running state"); 
  TestStepAddActionExpected( chActionText, chExpectedText );

  A_DBGR_BreakpointDeleteAll();
  A_DBGR_RnGo();
  E_DBGR_CheckState(T32_State_Running);
  

   /***************************************************************************************************************/    
            // Test Step 2: Check all cores are in running state                                   
  /***************************************************************************************************************/
  
  //Check core0 is running
  snprintf( chActionText, elCount(chActionText), "Check 1000ms Task Counter from core0 "); 
  snprintf( chExpectedText, elCount(chExpectedText), "1000ms Counter from core0 is incrementing"); 
  TestStepAddActionExpected( chActionText, chExpectedText );
  A_DBGR_VariableRead( "Task_Core0_1000ms_Count", taskvalue);
  E_DBGR_VariableCheck("Task_Core0_1000ms_Count", taskvalue, Greater);
  
  //Check Core1 is running
  snprintf( chActionText, elCount(chActionText), "Check 1000ms Task Counter from Core1 "); 
  snprintf( chExpectedText, elCount(chExpectedText), "1000ms Counter from Core1 is incrementing"); 
  TestStepAddActionExpected( chActionText, chExpectedText );
  A_DBGR_VariableRead( "Task_Core1_1000ms_Count", taskvalue);
  E_DBGR_VariableCheck("Task_Core1_1000ms_Count", taskvalue, Greater);
  
  //Check Core2 is running
  snprintf( chActionText, elCount(chActionText), "Check 1000ms Task Counter from Core2 "); 
  snprintf( chExpectedText, elCount(chExpectedText), "1000ms Counter from Core2 is incrementing"); 
  TestStepAddActionExpected( chActionText, chExpectedText );
  A_DBGR_VariableRead( "Task_Core2_1000ms_Count", taskvalue);
  E_DBGR_VariableCheck("Task_Core2_1000ms_Count", taskvalue, Greater);
    
  //Check Core3 is running
  snprintf( chActionText, elCount(chActionText), "Check 1000ms Task Counter from Core3 "); 
  snprintf( chExpectedText, elCount(chExpectedText), "1000ms Counter from Core3 is incrementing"); 
  TestStepAddActionExpected( chActionText, chExpectedText );
  A_DBGR_VariableRead( "Task_Core3_1000ms_Count", taskvalue);
  E_DBGR_VariableCheck("Task_Core3_1000ms_Count", taskvalue, Greater);
    
  //Check Core4 is running
  snprintf( chActionText, elCount(chActionText), "Check 1000ms Task Counter from Core4 "); 
  snprintf( chExpectedText, elCount(chExpectedText), "1000ms Counter from Core4 is incrementing"); 
  TestStepAddActionExpected( chActionText, chExpectedText );
  A_DBGR_VariableRead( "Task_Core4_1000ms_Count", taskvalue);
  E_DBGR_VariableCheck("Task_Core4_1000ms_Count", taskvalue, Greater);
    
  //Check Core5 is running
  snprintf( chActionText, elCount(chActionText), "Check 1000ms Task Counter from Core5 "); 
  snprintf( chExpectedText, elCount(chExpectedText), "1000ms Counter from Core5 is incrementing"); 
  TestStepAddActionExpected( chActionText, chExpectedText );
  A_DBGR_VariableRead( "Task_Core5_1000ms_Count", taskvalue);
  E_DBGR_VariableCheck("Task_Core5_1000ms_Count", taskvalue, Greater);
  
  
  
  
  /*******************************************************************************************************************************************************/    
    // Test Step 3: Set flag lock_core1_try_lock_core2_flag=1 to check semaphore lock for core1 in function TestApp_Core1_1000ms_MainFunction
  /*******************************************************************************************************************************************************/

  snprintf( chActionText, elCount(chActionText), "Set flag lock_core1_try_lock_core2_flag=1 to check semaphore lock for core1 in function TestApp_Core1_1000ms_MainFunction "); 
  snprintf( chExpectedText, elCount(chExpectedText), "Verify flag lock_core1_try_lock_core2_flag=1 to check semaphore lock for core1 in function TestApp_Core1_1000ms_MainFunction "); 
  TestStepAddActionExpected( chActionText, chExpectedText );
  A_DBGR_VariableSet("lock_core1_try_lock_core2_flag", "1");
  E_DBGR_VariableCheck("lock_core1_try_lock_core2_flag", 1, Equal);

  
  
  /*******************************************************************************************************************************************************/    
    // Test Step 4: Set breakpoint in  file testapp.c in function TestApp_Core1_1000ms_MainFunction in Os_Test_GetHWIO_e_LockSemaphore_core1(1,1);     
  /*******************************************************************************************************************************************************/
  snprintf( chActionText, elCount(chActionText), "Set breakpoint in  file testapp.c in function TestApp_Core1_1000ms_MainFunction in Os_Test_GetHWIO_e_LockSemaphore_core1(1,1);      "); 
  snprintf( chExpectedText, elCount(chExpectedText), "Verify Breakpoint got hit at function  TestApp_Core1_1000ms_MainFunction in Os_Test_GetHWIO_e_LockSemaphore_core1(1,1);       "); 
  TestStepAddActionExpected( chActionText, chExpectedText );
  //A_DBGR_R();
  A_DBGR_BreakpointSet("TestApp_Core1_1000ms_MainFunction\\61");  
  A_DBGR_Go();
  E_DBGR_BreakpointCheckForHalt("TestApp_Core1_1000ms_MainFunction\\61");
  
  
  snprintf( chActionText, elCount(chActionText), "Set breakpoint in  file test_os_hwio.c in function call  Smsts_lock_core1 = PerfmHWIO_e_LockSemaphore(semaphore_id); in Os_Test_GetHWIO_e_LockSemaphore_core1()      "); 
  snprintf( chExpectedText, elCount(chExpectedText), "Verify Breakpoint got hit at function call  Smsts_lock_core1 = PerfmHWIO_e_LockSemaphore(semaphore_id); in Os_Test_GetHWIO_e_LockSemaphore_core1()  "); 
  TestStepAddActionExpected( chActionText, chExpectedText );
  //A_DBGR_R();
  A_DBGR_BreakpointSet("Os_Test_GetHWIO_e_LockSemaphore_core1\\5");  
  A_DBGR_Go();
  E_DBGR_BreakpointCheckForHalt("Os_Test_GetHWIO_e_LockSemaphore_core1\\5");
  
  
  
  
  
  
  
  
  
  
  /*******************************************************************************************************************************************************/    
    // Test Step 5: check var Smsts_lock_core1=2 to check semaphore lock in core1 in function Os_Test_GetHWIO_e_LockSemaphore_core1() in test_os_hwio.c file
  /*******************************************************************************************************************************************************/
  snprintf( chActionText, elCount(chActionText), "check var Smsts_lock_core1=2 to check semaphore lock in core1 in function Os_Test_GetHWIO_e_LockSemaphore_core1() in test_os_hwio.c file "); 
  snprintf( chExpectedText, elCount(chExpectedText), "Verify var Smsts_lock_core1=2 to check semaphore lock in core1 in function Os_Test_GetHWIO_e_LockSemaphore_core1() in testapp.c file "); 
  TestStepAddActionExpected( chActionText, chExpectedText );
  E_DBGR_VariableCheck("Smsts_lock_core1", 2, Equal);
  
  
  
  
  
  /*******************************************************************************************************************************************************/    
    // Test Step 6:  Set breakpoint in  file testapp.c in function TestApp_Core1_1000ms_MainFunction in Os_Test_GetHWIO_e_LockSemaphore_core1(1,1);  
  /*******************************************************************************************************************************************************/
  
  snprintf( chActionText, elCount(chActionText), "check var Smsts_core1=2 to check semaphore lock in core1 in function Os_Test_GetHWIO_e_LockSemaphore_core1() in test_os_hwio.c file "); 
  snprintf( chExpectedText, elCount(chExpectedText), "Verify var Smsts_core1=2 to check semaphore lock in core1 in function Os_Test_GetHWIO_e_LockSemaphore_core1() in testapp.c file "); 
  TestStepAddActionExpected( chActionText, chExpectedText );
  E_DBGR_VariableCheck("Smsts_core1", 2, Equal);
  
  
  snprintf( chActionText, elCount(chActionText), "delete all breakpoints "); 
  snprintf( chExpectedText, elCount(chExpectedText), "Verify breakpoints got deleted"); 
  TestStepAddActionExpected( chActionText, chExpectedText );
  A_DBGR_BreakpointDeleteAll();
  
  
  
  /*******************************************************************************************************************************************************/    
    // Test Step 7: set lock_flag_1   =1 to check the status in core2 in function TestApp_Core2_1000ms_MainFunction in testapp.c file 
  /*******************************************************************************************************************************************************/
  snprintf( chActionText, elCount(chActionText), "set flag lock_flag_1   =1 to check the status in core2 in function TestApp_Core2_1000ms_MainFunction in testapp.c file  "); 
  snprintf( chExpectedText, elCount(chExpectedText), "Verify flag lock_flag_1   =1 to check the status in core2 in function TestApp_Core2_1000ms_MainFunction in testapp.c file "); 
  //TestStepAddActionExpected( chActionText, chExpectedText );
  A_DBGR_VariableSet("lock_flag_1", "1");
  E_DBGR_VariableCheck("lock_flag_1", 1, Equal);
  
  /*******************************************************************************************************************************************************/    
    // Test Step 8: Set breakpoint in  file testapp.c in function TestApp_Core2_1000ms_MainFunction in Os_Test_GetHWIO_e_LockSemaphore_core2(1,2);      
  /*******************************************************************************************************************************************************/
  snprintf( chActionText, elCount(chActionText), "Set breakpoint in  file testapp.c in function TestApp_Core2_1000ms_MainFunction in Os_Test_GetHWIO_e_LockSemaphore_core2(1,2);   "); 
  snprintf( chExpectedText, elCount(chExpectedText), "Verify Breakpoint got hit at function  TestApp_Core2_1000ms_MainFunction in Os_Test_GetHWIO_e_LockSemaphore_core2(1,2);       "); 
  TestStepAddActionExpected( chActionText, chExpectedText );
  //A_DBGR_R();
  A_DBGR_BreakpointSet("TestApp_Core2_1000ms_MainFunction\\49");  
  A_DBGR_Go();
  E_DBGR_BreakpointCheckForHalt("TestApp_Core2_1000ms_MainFunction\\49");
  
  snprintf( chActionText, elCount(chActionText), "Set breakpoint in  file testapp.c in function TestApp_Core2_1000ms_MainFunction in Os_Test_GetHWIO_e_LockSemaphore_core2(1,2);   "); 
  snprintf( chExpectedText, elCount(chExpectedText), "Verify Breakpoint got hit at function  TestApp_Core2_1000ms_MainFunction in Os_Test_GetHWIO_e_LockSemaphore_core2(1,2);       "); 
  TestStepAddActionExpected( chActionText, chExpectedText );
  //A_DBGR_R();
  A_DBGR_BreakpointSet("Os_Test_GetHWIO_e_LockSemaphore_core2\\5");  
  A_DBGR_Go();
  E_DBGR_BreakpointCheckForHalt("Os_Test_GetHWIO_e_LockSemaphore_core2\\5");
  
  
  snprintf( chActionText, elCount(chActionText), "delete all breakpoints "); 
  snprintf( chExpectedText, elCount(chExpectedText), "Verify breakpoints got deleted"); 
  TestStepAddActionExpected( chActionText, chExpectedText );
  A_DBGR_BreakpointDeleteAll();
  
  
    A_DBGR_Go();
  

  testWaitForTimeout(3000);
  
  
  /*******************************************************************************************************************************************************/    
    // Test Step 9: check var Smsts_lock_core2=2 to check semaphore try lock  in core2 in function Os_Test_GetHWIO_e_LockSemaphore_core1() in test_os_hwio.c file
  /*******************************************************************************************************************************************************/
  snprintf( chActionText, elCount(chActionText), "check var Smsts_lock_core2=2 to check semaphore try lock  in core2 in function Os_Test_GetHWIO_e_LockSemaphore_core1() in test_os_hwio.c file "); 
  snprintf( chExpectedText, elCount(chExpectedText), "Verify var Smsts_lock_core2=2 to check semaphore try lock  in core2 in function Os_Test_GetHWIO_e_LockSemaphore_core1() in test_os_hwio.c file  "); 
  //TestStepAddActionExpected( chActionText, chExpectedText );
  E_DBGR_VariableCheck("Smsts_lock_core2", 3, Equal);
  
  
  snprintf( chActionText, elCount(chActionText), "check var Smsts_core2=2 to check semaphore try lock  in core2 in function Os_Test_GetHWIO_e_LockSemaphore_core1() in test_os_hwio.c file "); 
  snprintf( chExpectedText, elCount(chExpectedText), "Verify var Smsts_core2=2 to check semaphore try lock  in core2 in function Os_Test_GetHWIO_e_LockSemaphore_core1() in test_os_hwio.c file"); 
  TestStepAddActionExpected( chActionText, chExpectedText );
  E_DBGR_VariableCheck("Smsts_core2", 3, Equal);
  
  









}

/*
void MainTest ()
{


  
  
}
*/