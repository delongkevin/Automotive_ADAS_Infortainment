/*@!Encoding:1252*/

includes
{
 
  #include "..\..\AutomationDependent\ProjectSpecific\GenLib_Includes.cin"
}

variables
{
  char chTestDescription[500];
  char chActionText[500];
  char chExpectedText[500];
  char chTestTitle[100];
  
  byte dat_102[3] = {0xAA,0x55,0xAA};
  mstimer delay;
  
}

  on timer delay 
  {
    write("wait for 3 Sec");
  }



testcase To_Verify_CSM_Random_Number_Generate()
{
  /***************************************************************************************************************/    
                                                // Variable Definition
  /***************************************************************************************************************/ 
  
  long var;
  
  /***************************************************************************************************************/    
                                               // Local Values
  /***************************************************************************************************************/ 
  

  
  /***************************************************************************************************************/    
                                              // Test Case Info
  /***************************************************************************************************************/
  setWriteDbgLevel(DebugOff);
  snprintf( chTestTitle, elCount(chTestTitle), "To_Verify_CSM_Random_Number_Generate" );
  snprintf( chTestDescription, elCount(chTestDescription), "Purpose:To_Verify_CSM_Random_Number_Generate");
  TestCaseAddInfo( chTestTitle, "TC_L30SW_IT_37285146", chTestDescription );

  /***************************************************************************************************************/    
                                              // Start of Test Case
  /***************************************************************************************************************/
  
  /***************************************************************************************************************/    
                                              // Test Step 1 PRECONDITIONS
  /***************************************************************************************************************/
  
  snprintf( chActionText, elCount(chActionText), "Flash the Software and ECU is running"); 
  snprintf( chExpectedText, elCount(chExpectedText), "ECU should be in running state"); 
  TestStepAddActionExpected( chActionText, chExpectedText );
  A_DBGR_BreakpointDeleteAll();
  A_DBGR_R();

   /********************************************************************************************************************************************************************************************************************************************/    
               // Test Step 2 set breakpoint at line cybersec_features_test( void ) of the file test_spds_hwio.c
  /*********************************************************************************************************************************************************************************************************************************************/
   snprintf( chActionText, elCount(chActionText), "set breakpoint at line cybersec_features_test( void ) of the file test_spds_hwio.c"); 
  snprintf( chExpectedText, elCount(chExpectedText), "Verify Breakpoint got hit at function cybersec_features_test( void )"); 
 // TestStepAddActionExpected( chActionText, chExpectedText );
  //A_DBGR_R();
  A_DBGR_BreakpointSet("cybersec_features_test\\2");
  A_DBGR_Go_Safe();
  waitForNotRunning(20000);
  E_DBGR_BreakpointCheckForHalt("cybersec_features_test\\2");
  
  
  snprintf( chActionText, elCount(chActionText), "verify var CysecFeatureNum should be set"); 
  snprintf( chExpectedText, elCount(chExpectedText), "var CysecFeatureNum  should be set"); 
  TestStepAddActionExpected( chActionText, chExpectedText );
  A_DBGR_VariableSet("CysecFeatureNum", "7");
  E_DBGR_VariableCheck("CysecFeatureNum",7, Equal);
  
  snprintf( chActionText, elCount(chActionText), "Delete all BP's"); 
  snprintf( chExpectedText, elCount(chExpectedText), "All BP's are deleted"); 
  TestStepAddActionExpected( chActionText, chExpectedText );
  A_DBGR_BreakpointDeleteAll();
   /********************************************************************************************************************************************************************************************************************************************/    
               // Test Step 3 set breakpoint at line SetHWIO_h_CSM_RandomGenerate( CsmConf_CsmJob_CsmJob_PseudoRandomNumberGenerate, App_RngResult, App_RngResultLen ) of the file test_spds_hwio.c
  /*********************************************************************************************************************************************************************************************************************************************/
  
  snprintf( chActionText, elCount(chActionText), "set breakpoint at line SetHWIO_h_CSM_RandomGenerate( CsmConf_CsmJob_CsmJob_PseudoRandomNumberGenerate, App_RngResult, App_RngResultLen ) of the file test_spds_hwio.c"); 
  snprintf( chExpectedText, elCount(chExpectedText), "set breakpoint at line SetHWIO_h_CSM_RandomGenerate( CsmConf_CsmJob_CsmJob_PseudoRandomNumberGenerate, App_RngResult, App_RngResultLen )"); 
 // TestStepAddActionExpected( chActionText, chExpectedText );
  A_DBGR_BreakpointSet("App_RandomGenerate\\12");
  A_DBGR_Go();
  waitForNotRunning(20000);
  E_DBGR_BreakpointCheckForHalt("App_RandomGenerate\\12");
  
  
  
  snprintf( chActionText, elCount(chActionText), "verify var CSM_STATUS should be set"); 
  snprintf( chExpectedText, elCount(chExpectedText), "var CSM_STATUS should be set"); 
  TestStepAddActionExpected( chActionText, chExpectedText );
  //A_DBGR_VariableSet("CSM_STATUS", "0");
  E_DBGR_VariableCheck("CSM_STATUS",0, Equal);  
  
 
}


testcase To_Verify_CSM_Random_Seed_Finish()
{
  /***************************************************************************************************************/    
                                                // Variable Definition
  /***************************************************************************************************************/ 
  
  long var;
  
  /***************************************************************************************************************/    
                                               // Local Values
  /***************************************************************************************************************/ 
  

  
  /***************************************************************************************************************/    
                                              // Test Case Info
  /***************************************************************************************************************/
  setWriteDbgLevel(DebugOff);
  snprintf( chTestTitle, elCount(chTestTitle), "To_Verify_CSM_Random_Seed_Finish" );
  snprintf( chTestDescription, elCount(chTestDescription), "Purpose:To_Verify_CSM_Random_Seed_Finish");
  TestCaseAddInfo( chTestTitle, "TC_L30SW_IT_37285146", chTestDescription );

  /***************************************************************************************************************/    
                                              // Start of Test Case
  /***************************************************************************************************************/
  
  /***************************************************************************************************************/    
                                              // Test Step 1 PRECONDITIONS
  /***************************************************************************************************************/
  
  snprintf( chActionText, elCount(chActionText), "Flash the Software and ECU is running"); 
  snprintf( chExpectedText, elCount(chExpectedText), "ECU should be in running state"); 
  TestStepAddActionExpected( chActionText, chExpectedText );

  A_DBGR_BreakpointDeleteAll();
  A_DBGR_R();
  
   /********************************************************************************************************************************************************************************************************************************************/    
               // Test Step 2 set breakpoint at line cybersec_features_test( void ) of the file test_spds_hwio.c
  /*********************************************************************************************************************************************************************************************************************************************/
   snprintf( chActionText, elCount(chActionText), "set breakpoint at line cybersec_features_test( void ) of the file test_spds_hwio.c"); 
  snprintf( chExpectedText, elCount(chExpectedText), "Verify Breakpoint got hit at function cybersec_features_test( void )"); 
  //TestStepAddActionExpected( chActionText, chExpectedText );
  //A_DBGR_R();
  A_DBGR_BreakpointSet("cybersec_features_test\\2");
  A_DBGR_Go_Safe();
  waitForNotRunning(20000);
  E_DBGR_BreakpointCheckForHalt("cybersec_features_test\\2");
  
  
  snprintf( chActionText, elCount(chActionText), "verify var CysecFeatureNum should be set"); 
  snprintf( chExpectedText, elCount(chExpectedText), "var CysecFeatureNum  should be set"); 
  TestStepAddActionExpected( chActionText, chExpectedText );
  A_DBGR_VariableSet("CysecFeatureNum", "7");
  E_DBGR_VariableCheck("CysecFeatureNum",7, Equal);
  
  snprintf( chActionText, elCount(chActionText), "Delete all BP's"); 
  snprintf( chExpectedText, elCount(chExpectedText), "All BP's are deleted"); 
  TestStepAddActionExpected( chActionText, chExpectedText );
  A_DBGR_BreakpointDeleteAll();
   /********************************************************************************************************************************************************************************************************************************************/    
               // Test Step 3 set breakpoint at line SetHWIO_h_CSM_RandomSeedFinish( CsmConf_CsmJob_CsmJob_RandomSeedGenerate ) of the file test_spds_hwio.c
  /*********************************************************************************************************************************************************************************************************************************************/
  
  snprintf( chActionText, elCount(chActionText), "set breakpoint at line SetHWIO_h_CSM_RandomSeedFinish( CsmConf_CsmJob_CsmJob_RandomSeedGenerate ) of the file test_spds_hwio.c"); 
  snprintf( chExpectedText, elCount(chExpectedText), "set breakpoint at line SetHWIO_h_CSM_RandomSeedFinish( CsmConf_CsmJob_CsmJob_RandomSeedGenerate )"); 
 // TestStepAddActionExpected( chActionText, chExpectedText );
  A_DBGR_BreakpointSet("App_RandomGenerate\\7");
  A_DBGR_Go();
  waitForNotRunning(20000);
  E_DBGR_BreakpointCheckForHalt("App_RandomGenerate\\7");
  
  
  
  snprintf( chActionText, elCount(chActionText), "verify var CSM_STATUS should be set"); 
  snprintf( chExpectedText, elCount(chExpectedText), "var CSM_STATUS should be set"); 
  TestStepAddActionExpected( chActionText, chExpectedText );
  //A_DBGR_VariableSet("CSM_STATUS", "0");
  E_DBGR_VariableCheck("CSM_STATUS",0, Equal);  
  
 
 
  
}


testcase To_Verify_CSM_Random_Seed_Update()
{
 /***************************************************************************************************************/    
                                                // Variable Definition
  /***************************************************************************************************************/ 
  
  long var;
  
  /***************************************************************************************************************/    
                                               // Local Values
  /***************************************************************************************************************/ 
  

  
  /***************************************************************************************************************/    
                                              // Test Case Info
  /***************************************************************************************************************/
  setWriteDbgLevel(DebugOff);
  snprintf( chTestTitle, elCount(chTestTitle), "To_Verify_CSM_Random_Seed_Update" );
  snprintf( chTestDescription, elCount(chTestDescription), "Purpose:To_Verify_CSM_Random_Seed_Update");
  TestCaseAddInfo( chTestTitle, "TC_L30SW_IT_37285146", chTestDescription );

  /***************************************************************************************************************/    
                                              // Start of Test Case
  /***************************************************************************************************************/
  
  /***************************************************************************************************************/    
                                              // Test Step 1 PRECONDITIONS
  /***************************************************************************************************************/
  
  snprintf( chActionText, elCount(chActionText), "Flash the Software and ECU is running"); 
  snprintf( chExpectedText, elCount(chExpectedText), "ECU should be in running state"); 
  TestStepAddActionExpected( chActionText, chExpectedText );
  
  A_DBGR_BreakpointDeleteAll();
  A_DBGR_R();

   /********************************************************************************************************************************************************************************************************************************************/    
               // Test Step 2 set breakpoint at line cybersec_features_test( void ) of the file test_spds_hwio.c
  /*********************************************************************************************************************************************************************************************************************************************/
   snprintf( chActionText, elCount(chActionText), "set breakpoint at line cybersec_features_test( void ) of the file test_spds_hwio.c"); 
  snprintf( chExpectedText, elCount(chExpectedText), "Verify Breakpoint got hit at function cybersec_features_test( void )"); 
 // TestStepAddActionExpected( chActionText, chExpectedText );
  //A_DBGR_R();
  A_DBGR_BreakpointSet("cybersec_features_test\\2");
  A_DBGR_Go_Safe();
  waitForNotRunning(20000);
  E_DBGR_BreakpointCheckForHalt("cybersec_features_test\\2");
  
  
  snprintf( chActionText, elCount(chActionText), "verify var CysecFeatureNum should be set"); 
  snprintf( chExpectedText, elCount(chExpectedText), "var CysecFeatureNum  should be set"); 
  TestStepAddActionExpected( chActionText, chExpectedText );
  A_DBGR_VariableSet("CysecFeatureNum", "7");
  E_DBGR_VariableCheck("CysecFeatureNum",7, Equal);
  
  snprintf( chActionText, elCount(chActionText), "Delete all BP's"); 
  snprintf( chExpectedText, elCount(chExpectedText), "All BP's are deleted"); 
  TestStepAddActionExpected( chActionText, chExpectedText );
  A_DBGR_BreakpointDeleteAll();
   /********************************************************************************************************************************************************************************************************************************************/    
               // Test Step 3 set breakpoint at line SetHWIO_h_CSM_RandomSeedUpdate( CsmConf_CsmJob_CsmJob_RandomSeedGenerate, DummySeedData, 1 ) of the file test_spds_hwio.c
  /*********************************************************************************************************************************************************************************************************************************************/
  
  snprintf( chActionText, elCount(chActionText), "set breakpoint at line SetHWIO_h_CSM_RandomSeedUpdate( CsmConf_CsmJob_CsmJob_RandomSeedGenerate, DummySeedData, 1 ) of the file test_spds_hwio.c"); 
  snprintf( chExpectedText, elCount(chExpectedText), "set breakpoint at line SetHWIO_h_CSM_RandomSeedUpdate( CsmConf_CsmJob_CsmJob_RandomSeedGenerate, DummySeedData, 1 )"); 
  //TestStepAddActionExpected( chActionText, chExpectedText );
  A_DBGR_BreakpointSet("App_RandomGenerate\\6");
  A_DBGR_Go();
  waitForNotRunning(20000);
  E_DBGR_BreakpointCheckForHalt("App_RandomGenerate\\6");
  
  
  
  snprintf( chActionText, elCount(chActionText), "verify var CSM_STATUS should be set"); 
  snprintf( chExpectedText, elCount(chExpectedText), "var CSM_STATUS should be set"); 
  TestStepAddActionExpected( chActionText, chExpectedText );
  //A_DBGR_VariableSet("CSM_STATUS", "0");
  E_DBGR_VariableCheck("CSM_STATUS",0, Equal);  
  
 
 
  
}



testcase To_Verify_CSM_Random_Seed_Start()
{
   /***************************************************************************************************************/    
                                                // Variable Definition
  /***************************************************************************************************************/ 
  
  long var;
  
  /***************************************************************************************************************/    
                                               // Local Values
  /***************************************************************************************************************/ 
  

  
  /***************************************************************************************************************/    
                                              // Test Case Info
  /***************************************************************************************************************/
  setWriteDbgLevel(DebugOff);
  snprintf( chTestTitle, elCount(chTestTitle), "To_Verify_CSM_Random_Seed_Start" );
  snprintf( chTestDescription, elCount(chTestDescription), "Purpose:To_Verify_CSM_Random_Seed_Start");
  TestCaseAddInfo( chTestTitle, "TC_L30SW_IT_37285146", chTestDescription );

  /***************************************************************************************************************/    
                                              // Start of Test Case
  /***************************************************************************************************************/
  
  /***************************************************************************************************************/    
                                              // Test Step 1 PRECONDITIONS
  /***************************************************************************************************************/
  
  snprintf( chActionText, elCount(chActionText), "Flash the Software and ECU is running"); 
  snprintf( chExpectedText, elCount(chExpectedText), "ECU should be in running state"); 
  TestStepAddActionExpected( chActionText, chExpectedText );

  A_DBGR_BreakpointDeleteAll();
  A_DBGR_R();
  

   /********************************************************************************************************************************************************************************************************************************************/    
               // Test Step 2 set breakpoint at line cybersec_features_test( void ) of the file test_spds_hwio.c
  /*********************************************************************************************************************************************************************************************************************************************/
   snprintf( chActionText, elCount(chActionText), "set breakpoint at line cybersec_features_test( void ) of the file test_spds_hwio.c"); 
  snprintf( chExpectedText, elCount(chExpectedText), "Verify Breakpoint got hit at function cybersec_features_test( void )"); 
  //TestStepAddActionExpected( chActionText, chExpectedText );
  //A_DBGR_R();
  A_DBGR_BreakpointSet("cybersec_features_test\\2");
  A_DBGR_Go_Safe();
   waitForNotRunning(20000);
  E_DBGR_BreakpointCheckForHalt("cybersec_features_test\\2");
  
  
  snprintf( chActionText, elCount(chActionText), "verify var CysecFeatureNum should be set"); 
  snprintf( chExpectedText, elCount(chExpectedText), "var CysecFeatureNum  should be set"); 
  TestStepAddActionExpected( chActionText, chExpectedText );
  A_DBGR_VariableSet("CysecFeatureNum", "7");
  E_DBGR_VariableCheck("CysecFeatureNum",7, Equal);
  
  snprintf( chActionText, elCount(chActionText), "Delete all BP's"); 
  snprintf( chExpectedText, elCount(chExpectedText), "All BP's are deleted"); 
  TestStepAddActionExpected( chActionText, chExpectedText );
  A_DBGR_BreakpointDeleteAll();
   /********************************************************************************************************************************************************************************************************************************************/    
               // Test Step 3 set breakpoint at line SetHWIO_h_CSM_RandomSeedStart( CsmConf_CsmJob_CsmJob_RandomSeedGenerate ) of the file test_spds_hwio.c
  /*********************************************************************************************************************************************************************************************************************************************/
  
  snprintf( chActionText, elCount(chActionText), "set breakpoint at line SetHWIO_h_CSM_RandomSeedStart( CsmConf_CsmJob_CsmJob_RandomSeedGenerate ) of the file test_spds_hwio.c"); 
  snprintf( chExpectedText, elCount(chExpectedText), "set breakpoint at line SetHWIO_h_CSM_RandomSeedStart( CsmConf_CsmJob_CsmJob_RandomSeedGenerate )"); 
  //TestStepAddActionExpected( chActionText, chExpectedText );
  A_DBGR_BreakpointSet("App_RandomGenerate\\5");
  A_DBGR_Go();
  waitForNotRunning(20000);
  E_DBGR_BreakpointCheckForHalt("App_RandomGenerate\\5");
  
  
  
  snprintf( chActionText, elCount(chActionText), "verify var CSM_STATUS should be set"); 
  snprintf( chExpectedText, elCount(chExpectedText), "var CSM_STATUS should be set"); 
  TestStepAddActionExpected( chActionText, chExpectedText );
  //A_DBGR_VariableSet("CSM_STATUS", "0");
  E_DBGR_VariableCheck("CSM_STATUS",0, Equal);  
  
 
 
  
}



testcase To_Verify_CSM_Symmetric_Key_Wrapping_Finish()
{
   /***************************************************************************************************************/    
                                                // Variable Definition
  /***************************************************************************************************************/ 
  
  long var;
  
  /***************************************************************************************************************/    
                                               // Local Values
  /***************************************************************************************************************/ 
  

  
  /***************************************************************************************************************/    
                                              // Test Case Info
  /***************************************************************************************************************/
  setWriteDbgLevel(DebugOff);
  snprintf( chTestTitle, elCount(chTestTitle), "To_Verify_CSM_Symmetric_Key_Wrapping_Finish" );
  snprintf( chTestDescription, elCount(chTestDescription), "Purpose:To_Verify_CSM_Symmetric_Key_Wrapping_Finish");
  TestCaseAddInfo( chTestTitle, "TC_L30SW_IT_37285146", chTestDescription );

  /***************************************************************************************************************/    
                                              // Start of Test Case
  /***************************************************************************************************************/
  
  /***************************************************************************************************************/    
                                              // Test Step 1 PRECONDITIONS
  /***************************************************************************************************************/
  
  snprintf( chActionText, elCount(chActionText), "Flash the Software and ECU is running"); 
  snprintf( chExpectedText, elCount(chExpectedText), "ECU should be in running state"); 
  TestStepAddActionExpected( chActionText, chExpectedText );

  A_DBGR_BreakpointDeleteAll();
   A_DBGR_R();

   /********************************************************************************************************************************************************************************************************************************************/    
               // Test Step 2 set breakpoint at line cybersec_features_test( void ) of the file test_spds_hwio.c
  /*********************************************************************************************************************************************************************************************************************************************/
   snprintf( chActionText, elCount(chActionText), "set breakpoint at line cybersec_features_test( void ) of the file test_spds_hwio.c"); 
  snprintf( chExpectedText, elCount(chExpectedText), "Verify Breakpoint got hit at function cybersec_features_test( void )"); 
 // TestStepAddActionExpected( chActionText, chExpectedText );
  //A_DBGR_R();
  A_DBGR_BreakpointSet("cybersec_features_test\\2");
  A_DBGR_Go_Safe();
   waitForNotRunning(20000);
  E_DBGR_BreakpointCheckForHalt("cybersec_features_test\\2");
  
  
  snprintf( chActionText, elCount(chActionText), "verify var CysecFeatureNum should be set"); 
  snprintf( chExpectedText, elCount(chExpectedText), "var CysecFeatureNum  should be set"); 
  TestStepAddActionExpected( chActionText, chExpectedText );
  A_DBGR_VariableSet("CysecFeatureNum", "10");
  E_DBGR_VariableCheck("CysecFeatureNum",10, Equal);
  
  snprintf( chActionText, elCount(chActionText), "Delete all BP's"); 
  snprintf( chExpectedText, elCount(chExpectedText), "All BP's are deleted"); 
  TestStepAddActionExpected( chActionText, chExpectedText );
  A_DBGR_BreakpointDeleteAll();
   /********************************************************************************************************************************************************************************************************************************************/    
               // Test Step 3 set breakpoint at line SetHWIO_h_CSM_SymKeyWrapSymFinish( 0 ) of the file test_spds_hwio.c
  /*********************************************************************************************************************************************************************************************************************************************/
  
  snprintf( chActionText, elCount(chActionText), "set breakpoint at line SetHWIO_h_CSM_SymKeyWrapSymFinish( 0 ) of the file test_spds_hwio.c"); 
  snprintf( chExpectedText, elCount(chExpectedText), "set breakpoint at line SetHWIO_h_CSM_SymKeyWrapSymFinish( 0 )"); 
 // TestStepAddActionExpected( chActionText, chExpectedText );
  A_DBGR_BreakpointSet("App_SymKeyWrapSym\\25");
  A_DBGR_Go();
  waitForNotRunning(20000);
  E_DBGR_BreakpointCheckForHalt("App_SymKeyWrapSym\\25");
  
  
  
  snprintf( chActionText, elCount(chActionText), "verify var CSM_STATUS should be set"); 
  snprintf( chExpectedText, elCount(chExpectedText), "var CSM_STATUS should be set"); 
  TestStepAddActionExpected( chActionText, chExpectedText );
  //A_DBGR_VariableSet("CSM_STATUS", "0");
  E_DBGR_VariableCheck("CSM_STATUS",0, Equal);  
  
}


testcase  To_Verify_CSM_Symmetric_Key_Wrapping_Update()
{
   /***************************************************************************************************************/    
                                                // Variable Definition
  /***************************************************************************************************************/ 
  
  long var;
  
  /***************************************************************************************************************/    
                                               // Local Values
  /***************************************************************************************************************/ 
  

  
  /***************************************************************************************************************/    
                                              // Test Case Info
  /***************************************************************************************************************/
  setWriteDbgLevel(DebugOff);
  snprintf( chTestTitle, elCount(chTestTitle), "To_Verify_CSM_Symmetric_Key_Wrapping_Update" );
  snprintf( chTestDescription, elCount(chTestDescription), "Purpose:To_Verify_CSM_Symmetric_Key_Wrapping_Update");
  TestCaseAddInfo( chTestTitle, "TC_L30SW_IT_37285146", chTestDescription );

  /***************************************************************************************************************/    
                                              // Start of Test Case
  /***************************************************************************************************************/
  
  /***************************************************************************************************************/    
                                              // Test Step 1 PRECONDITIONS
  /***************************************************************************************************************/
  
  snprintf( chActionText, elCount(chActionText), "Flash the Software and ECU is running"); 
  snprintf( chExpectedText, elCount(chExpectedText), "ECU should be in running state"); 
  TestStepAddActionExpected( chActionText, chExpectedText );

  A_DBGR_BreakpointDeleteAll();
  A_DBGR_BreakpointSet("cybersec_features_test\\2");
  A_DBGR_R();
  A_DBGR_Go_Safe();

   /********************************************************************************************************************************************************************************************************************************************/    
               // Test Step 2 set breakpoint at line cybersec_features_test( void ) of the file test_spds_hwio.c
  /*********************************************************************************************************************************************************************************************************************************************/
   snprintf( chActionText, elCount(chActionText), "set breakpoint at line cybersec_features_test( void ) of the file test_spds_hwio.c"); 
  snprintf( chExpectedText, elCount(chExpectedText), "Verify Breakpoint got hit at function cybersec_features_test( void )"); 
  //TestStepAddActionExpected( chActionText, chExpectedText );
  waitForNotRunning(20000);
  E_DBGR_BreakpointCheckForHalt("cybersec_features_test\\2");
  
  
  snprintf( chActionText, elCount(chActionText), "verify var CysecFeatureNum should be set"); 
  snprintf( chExpectedText, elCount(chExpectedText), "var CysecFeatureNum  should be set"); 
  TestStepAddActionExpected( chActionText, chExpectedText );
  A_DBGR_VariableSet("CysecFeatureNum", "10");
  E_DBGR_VariableCheck("CysecFeatureNum",10, Equal);
  
  snprintf( chActionText, elCount(chActionText), "Delete all BP's"); 
  snprintf( chExpectedText, elCount(chExpectedText), "All BP's are deleted"); 
  TestStepAddActionExpected( chActionText, chExpectedText );
   /********************************************************************************************************************************************************************************************************************************************/
               // Test Step 3 set breakpoint at line SetHWIO_h_CSM_SymKeyWrapSymUpdate( 0, App_WrapKeyOutputBuffer, &App_WrapKeyBufferLen ) of the file test_spds_hwio.c
  /*********************************************************************************************************************************************************************************************************************************************/
  
  snprintf( chActionText, elCount(chActionText), "set breakpoint at line SetHWIO_h_CSM_SymKeyWrapSymUpdate( 0, App_WrapKeyOutputBuffer, &App_WrapKeyBufferLen ) of the file test_spds_hwio.c"); 
  snprintf( chExpectedText, elCount(chExpectedText), "set breakpoint at line SetHWIO_h_CSM_SymKeyWrapSymUpdate( 0, App_WrapKeyOutputBuffer, &App_WrapKeyBufferLen )"); 
 // TestStepAddActionExpected( chActionText, chExpectedText );
  A_DBGR_BreakpointDeleteAll();
  A_DBGR_BreakpointSet("App_SymKeyWrapSym\\24");
  A_DBGR_Go();
  waitForNotRunning(20000);
  E_DBGR_BreakpointCheckForHalt("App_SymKeyWrapSym\\24");
  
  
  
  snprintf( chActionText, elCount(chActionText), "verify var CSM_STATUS should be set"); 
  snprintf( chExpectedText, elCount(chExpectedText), "var CSM_STATUS should be set"); 
  TestStepAddActionExpected( chActionText, chExpectedText );
  //A_DBGR_VariableSet("CSM_STATUS", "0");
  E_DBGR_VariableCheck("CSM_STATUS",0, Equal);  
}


testcase  To_Verify_CSM_Symmetric_Key_Wrapping_Start()
{
 /***************************************************************************************************************/    
                                                // Variable Definition
  /***************************************************************************************************************/ 
  
  long var;
  
  /***************************************************************************************************************/    
                                               // Local Values
  /***************************************************************************************************************/ 
  

  
  /***************************************************************************************************************/    
                                              // Test Case Info
  /***************************************************************************************************************/
  setWriteDbgLevel(DebugOff);
  snprintf( chTestTitle, elCount(chTestTitle), "To_Verify_CSM_Symmetric_Key_Wrapping_Start" );
  snprintf( chTestDescription, elCount(chTestDescription), "Purpose:To_Verify_CSM_Symmetric_Key_Wrapping_Start");
  TestCaseAddInfo( chTestTitle, "TC_L30SW_IT_37285146", chTestDescription );

  /***************************************************************************************************************/    
                                              // Start of Test Case
  /***************************************************************************************************************/
  
  /***************************************************************************************************************/    
                                              // Test Step 1 PRECONDITIONS
  /***************************************************************************************************************/
  
  snprintf( chActionText, elCount(chActionText), "Flash the Software and ECU is running"); 
  snprintf( chExpectedText, elCount(chExpectedText), "ECU should be in running state"); 
  TestStepAddActionExpected( chActionText, chExpectedText );

  A_DBGR_BreakpointDeleteAll();
  A_DBGR_R();

   /********************************************************************************************************************************************************************************************************************************************/    
               // Test Step 2 set breakpoint at line cybersec_features_test( void ) of the file test_spds_hwio.c
  /*********************************************************************************************************************************************************************************************************************************************/
   snprintf( chActionText, elCount(chActionText), "set breakpoint at line cybersec_features_test( void ) of the file test_spds_hwio.c"); 
  snprintf( chExpectedText, elCount(chExpectedText), "Verify Breakpoint got hit at function cybersec_features_test( void )"); 
  //TestStepAddActionExpected( chActionText, chExpectedText );
  //A_DBGR_R();
  A_DBGR_BreakpointSet("cybersec_features_test\\2");
  A_DBGR_Go_Safe();
  waitForNotRunning(20000);
  E_DBGR_BreakpointCheckForHalt("cybersec_features_test\\2");
  
  
  snprintf( chActionText, elCount(chActionText), "verify var CysecFeatureNum should be set"); 
  snprintf( chExpectedText, elCount(chExpectedText), "var CysecFeatureNum  should be set"); 
  TestStepAddActionExpected( chActionText, chExpectedText );
  A_DBGR_VariableSet("CysecFeatureNum", "10");
  E_DBGR_VariableCheck("CysecFeatureNum",10, Equal);
  
  snprintf( chActionText, elCount(chActionText), "Delete all BP's"); 
  snprintf( chExpectedText, elCount(chExpectedText), "All BP's are deleted"); 
  TestStepAddActionExpected( chActionText, chExpectedText );
  A_DBGR_BreakpointDeleteAll();
   /********************************************************************************************************************************************************************************************************************************************/    
               // Test Step 3 set breakpoint at line SetHWIO_h_CSM_SymKeyWrapSymStart( 0, &key, &Wrapkey ) of the file test_spds_hwio.c
  /*********************************************************************************************************************************************************************************************************************************************/
  
  snprintf( chActionText, elCount(chActionText), "set breakpoint at line SetHWIO_h_CSM_SymKeyWrapSymStart( 0, &key, &Wrapkey ) of the file test_spds_hwio.c"); 
  snprintf( chExpectedText, elCount(chExpectedText), "set breakpoint at line SetHWIO_h_CSM_SymKeyWrapSymStart( 0, &key, &Wrapkey )"); 
 // TestStepAddActionExpected( chActionText, chExpectedText );
  A_DBGR_BreakpointSet("App_SymKeyWrapSym\\23");
  A_DBGR_Go();
  waitForNotRunning(25000);
  E_DBGR_BreakpointCheckForHalt("App_SymKeyWrapSym\\23");
  
  
  
  snprintf( chActionText, elCount(chActionText), "verify var CSM_STATUS should be set"); 
  snprintf( chExpectedText, elCount(chExpectedText), "var CSM_STATUS should be set"); 
  TestStepAddActionExpected( chActionText, chExpectedText );
  //A_DBGR_VariableSet("CSM_STATUS", "0");
  E_DBGR_VariableCheck("CSM_STATUS",0, Equal); 
  
}


testcase  To_Verify_CSM_Symmetric_Key_Extract_Start()
{
  /***************************************************************************************************************/    
                                                // Variable Definition
  /***************************************************************************************************************/ 
  
  long var;
  
  /***************************************************************************************************************/    
                                               // Local Values
  /***************************************************************************************************************/ 
  

  
  /***************************************************************************************************************/    
                                              // Test Case Info
  /***************************************************************************************************************/
  setWriteDbgLevel(DebugOff);
  snprintf( chTestTitle, elCount(chTestTitle), "To_Verify_CSM_Symmetric_Key_Extract_Start" );
  snprintf( chTestDescription, elCount(chTestDescription), "Purpose:To_Verify_CSM_Symmetric_Key_Extract_Start");
  TestCaseAddInfo( chTestTitle, "TC_L30SW_IT_37285146", chTestDescription );

  /***************************************************************************************************************/    
                                              // Start of Test Case
  /***************************************************************************************************************/
  
  /***************************************************************************************************************/    
                                              // Test Step 1 PRECONDITIONS
  /***************************************************************************************************************/
  
  snprintf( chActionText, elCount(chActionText), "Flash the Software and ECU is running"); 
  snprintf( chExpectedText, elCount(chExpectedText), "ECU should be in running state"); 
  TestStepAddActionExpected( chActionText, chExpectedText );

  A_DBGR_BreakpointDeleteAll();
 A_DBGR_R();

   /********************************************************************************************************************************************************************************************************************************************/    
               // Test Step 2 set breakpoint at line cybersec_features_test( void ) of the file test_spds_hwio.c
  /*********************************************************************************************************************************************************************************************************************************************/
   snprintf( chActionText, elCount(chActionText), "set breakpoint at line cybersec_features_test( void ) of the file test_spds_hwio.c"); 
  snprintf( chExpectedText, elCount(chExpectedText), "Verify Breakpoint got hit at function cybersec_features_test( void )"); 
//  TestStepAddActionExpected( chActionText, chExpectedText );
  //A_DBGR_R();
  A_DBGR_BreakpointSet("cybersec_features_test\\2");
  A_DBGR_Go_Safe();
  waitForNotRunning(20000);
  E_DBGR_BreakpointCheckForHalt("cybersec_features_test\\2");
  
  
  snprintf( chActionText, elCount(chActionText), "verify var CysecFeatureNum should be set"); 
  snprintf( chExpectedText, elCount(chExpectedText), "var CysecFeatureNum  should be set"); 
  TestStepAddActionExpected( chActionText, chExpectedText );
  A_DBGR_VariableSet("CysecFeatureNum", "5");
  E_DBGR_VariableCheck("CysecFeatureNum",5, Equal);
  
  snprintf( chActionText, elCount(chActionText), "Delete all BP's"); 
  snprintf( chExpectedText, elCount(chExpectedText), "All BP's are deleted"); 
  TestStepAddActionExpected( chActionText, chExpectedText );
  A_DBGR_BreakpointDeleteAll();
   /********************************************************************************************************************************************************************************************************************************************/    
               // Test Step 3 set breakpoint at line SetHWIO_h_CSM_SymKeyExtractStart( 0 ) of the file test_spds_hwio.c
  /*********************************************************************************************************************************************************************************************************************************************/
  
  snprintf( chActionText, elCount(chActionText), "set breakpoint at line SetHWIO_h_CSM_SymKeyExtractStart( 0 ) of the file test_spds_hwio.c"); 
  snprintf( chExpectedText, elCount(chExpectedText), "set breakpoint at line SetHWIO_h_CSM_SymKeyExtractStart( 0 )"); 
  //TestStepAddActionExpected( chActionText, chExpectedText );
  A_DBGR_BreakpointSet("App_GMCmacGenerate\\13");
  A_DBGR_Go();
  waitForNotRunning(20000);
  E_DBGR_BreakpointCheckForHalt("App_GMCmacGenerate\\13");
  
  
  
  snprintf( chActionText, elCount(chActionText), "verify var CSM_STATUS should be set"); 
  snprintf( chExpectedText, elCount(chExpectedText), "var CSM_STATUS should be set"); 
  TestStepAddActionExpected( chActionText, chExpectedText );
  //A_DBGR_VariableSet("CSM_STATUS", "0");
  E_DBGR_VariableCheck("CSM_STATUS",0, Equal); 
  
}


testcase  To_Verify_CSM_Symmetric_Key_Extract_Update()
{
  /***************************************************************************************************************/    
                                                // Variable Definition
  /***************************************************************************************************************/ 
  
  long var;
  
  /***************************************************************************************************************/    
                                               // Local Values
  /***************************************************************************************************************/ 
  

  
  /***************************************************************************************************************/    
                                              // Test Case Info
  /***************************************************************************************************************/
  setWriteDbgLevel(DebugOff);
  snprintf( chTestTitle, elCount(chTestTitle), "To_Verify_CSM_Symmetric_Key_Extract_Update" );
  snprintf( chTestDescription, elCount(chTestDescription), "Purpose:To_Verify_CSM_Symmetric_Key_Extract_Update");
  TestCaseAddInfo( chTestTitle, "TC_L30SW_IT_37285146", chTestDescription );

  /***************************************************************************************************************/    
                                              // Start of Test Case
  /***************************************************************************************************************/
  
  /***************************************************************************************************************/    
                                              // Test Step 1 PRECONDITIONS
  /***************************************************************************************************************/
  
  snprintf( chActionText, elCount(chActionText), "Flash the Software and ECU is running"); 
  snprintf( chExpectedText, elCount(chExpectedText), "ECU should be in running state"); 
  TestStepAddActionExpected( chActionText, chExpectedText );

  A_DBGR_BreakpointDeleteAll();
 A_DBGR_R();
   /********************************************************************************************************************************************************************************************************************************************/    
               // Test Step 2 set breakpoint at line cybersec_features_test( void ) of the file test_spds_hwio.c
  /*********************************************************************************************************************************************************************************************************************************************/
   snprintf( chActionText, elCount(chActionText), "set breakpoint at line cybersec_features_test( void ) of the file test_spds_hwio.c"); 
  snprintf( chExpectedText, elCount(chExpectedText), "Verify Breakpoint got hit at function cybersec_features_test( void )"); 
  //TestStepAddActionExpected( chActionText, chExpectedText );
  //A_DBGR_R();
  A_DBGR_BreakpointSet("cybersec_features_test\\2");
  A_DBGR_Go_Safe();
  waitForNotRunning(20000);
  E_DBGR_BreakpointCheckForHalt("cybersec_features_test\\2");
  
  
  snprintf( chActionText, elCount(chActionText), "verify var CysecFeatureNum should be set"); 
  snprintf( chExpectedText, elCount(chExpectedText), "var CysecFeatureNum  should be set"); 
  TestStepAddActionExpected( chActionText, chExpectedText );
  A_DBGR_VariableSet("CysecFeatureNum", "5");
  E_DBGR_VariableCheck("CysecFeatureNum",5, Equal);
  
  snprintf( chActionText, elCount(chActionText), "Delete all BP's"); 
  snprintf( chExpectedText, elCount(chExpectedText), "All BP's are deleted"); 
  TestStepAddActionExpected( chActionText, chExpectedText );
  A_DBGR_BreakpointDeleteAll();
   /********************************************************************************************************************************************************************************************************************************************/    
               // Test Step 3 set breakpoint at line SetHWIO_h_CSM_SymKeyExtractUpdate( 0, App_KeyInputData3, 16 ) of the file test_spds_hwio.c
  /*********************************************************************************************************************************************************************************************************************************************/
  
  snprintf( chActionText, elCount(chActionText), "set breakpoint at line SetHWIO_h_CSM_SymKeyExtractUpdate( 0, App_KeyInputData3, 16 ) of the file test_spds_hwio.c"); 
  snprintf( chExpectedText, elCount(chExpectedText), "set breakpoint at line SetHWIO_h_CSM_SymKeyExtractUpdate( 0, App_KeyInputData3, 16 )"); 
 // TestStepAddActionExpected( chActionText, chExpectedText );
  A_DBGR_BreakpointSet("App_GMCmacGenerate\\14");
  A_DBGR_Go();
  waitForNotRunning(20000);
  E_DBGR_BreakpointCheckForHalt("App_GMCmacGenerate\\14");
  
  
  
  snprintf( chActionText, elCount(chActionText), "verify var CSM_STATUS should be set"); 
  snprintf( chExpectedText, elCount(chExpectedText), "var CSM_STATUS should be set"); 
  TestStepAddActionExpected( chActionText, chExpectedText );
  //A_DBGR_VariableSet("CSM_STATUS", "0");
  E_DBGR_VariableCheck("CSM_STATUS",0, Equal); 
  
}


testcase  To_Verify_CSM_Symmetric_Key_Extract_Finish()
{
  /***************************************************************************************************************/    
                                                // Variable Definition
  /***************************************************************************************************************/ 
  
  long var;
  
  /***************************************************************************************************************/    
                                               // Local Values
  /***************************************************************************************************************/ 
  

  
  /***************************************************************************************************************/    
                                              // Test Case Info
  /***************************************************************************************************************/
  setWriteDbgLevel(DebugOff);
  snprintf( chTestTitle, elCount(chTestTitle), "To_Verify_CSM_Symmetric_Key_Extract_Finish" );
  snprintf( chTestDescription, elCount(chTestDescription), "Purpose:To_Verify_CSM_Symmetric_Key_Extract_Finish");
  TestCaseAddInfo( chTestTitle, "TC_L30SW_IT_37285146", chTestDescription );

  /***************************************************************************************************************/    
                                              // Start of Test Case
  /***************************************************************************************************************/
  
  /***************************************************************************************************************/    
                                              // Test Step 1 PRECONDITIONS
  /***************************************************************************************************************/
  
  snprintf( chActionText, elCount(chActionText), "Flash the Software and ECU is running"); 
  snprintf( chExpectedText, elCount(chExpectedText), "ECU should be in running state"); 
  TestStepAddActionExpected( chActionText, chExpectedText );

  A_DBGR_BreakpointDeleteAll();
  A_DBGR_R();

   /********************************************************************************************************************************************************************************************************************************************/    
               // Test Step 2 set breakpoint at line cybersec_features_test( void ) of the file test_spds_hwio.c
  /*********************************************************************************************************************************************************************************************************************************************/
   snprintf( chActionText, elCount(chActionText), "set breakpoint at line cybersec_features_test( void ) of the file test_spds_hwio.c"); 
  snprintf( chExpectedText, elCount(chExpectedText), "Verify Breakpoint got hit at function cybersec_features_test( void )"); 
 // TestStepAddActionExpected( chActionText, chExpectedText );
  //A_DBGR_R();
  A_DBGR_BreakpointSet("cybersec_features_test\\2");
  A_DBGR_Go_Safe();
  waitForNotRunning(20000);
  E_DBGR_BreakpointCheckForHalt("cybersec_features_test\\2");
  
  
  snprintf( chActionText, elCount(chActionText), "verify var CysecFeatureNum should be set"); 
  snprintf( chExpectedText, elCount(chExpectedText), "var CysecFeatureNum  should be set"); 
  TestStepAddActionExpected( chActionText, chExpectedText );
  A_DBGR_VariableSet("CysecFeatureNum", "5");
  E_DBGR_VariableCheck("CysecFeatureNum",5, Equal);
  
  snprintf( chActionText, elCount(chActionText), "Delete all BP's"); 
  snprintf( chExpectedText, elCount(chExpectedText), "All BP's are deleted"); 
  TestStepAddActionExpected( chActionText, chExpectedText );
  A_DBGR_BreakpointDeleteAll();
   /********************************************************************************************************************************************************************************************************************************************/    
               // Test Step 3 set breakpoint at line SetHWIO_h_CSM_SymKeyExtractFinish( 0, &key ) of the file test_spds_hwio.c
  /*********************************************************************************************************************************************************************************************************************************************/
  
  snprintf( chActionText, elCount(chActionText), "set breakpoint at line SetHWIO_h_CSM_SymKeyExtractFinish( 0, &key ) of the file test_spds_hwio.c"); 
  snprintf( chExpectedText, elCount(chExpectedText), "set breakpoint at line SetHWIO_h_CSM_SymKeyExtractFinish( 0, &key )"); 
  //TestStepAddActionExpected( chActionText, chExpectedText );
  A_DBGR_BreakpointSet("App_GMCmacGenerate\\15");
  A_DBGR_Go();
  waitForNotRunning(20000);
  E_DBGR_BreakpointCheckForHalt("App_GMCmacGenerate\\15");
  
  
  
  snprintf( chActionText, elCount(chActionText), "verify var CSM_STATUS should be set"); 
  snprintf( chExpectedText, elCount(chExpectedText), "var CSM_STATUS should be set"); 
  TestStepAddActionExpected( chActionText, chExpectedText );
  //A_DBGR_VariableSet("CSM_STATUS", "0");
  E_DBGR_VariableCheck("CSM_STATUS",0, Equal);  
  
 
  
}



testcase  To_Verify_Security_Peripheral_Error_LLS_NoError()
{
  /***************************************************************************************************************/    
                                                // Variable Definition
  /***************************************************************************************************************/ 
  
  long var;
  
  /***************************************************************************************************************/    
                                               // Local Values
  /***************************************************************************************************************/ 
  

  
  /***************************************************************************************************************/    
                                              // Test Case Info
  /***************************************************************************************************************/
  setWriteDbgLevel(DebugOff);
  snprintf( chTestTitle, elCount(chTestTitle), "To_Verify_Security_Peripheral_Error_LLS_NoError" );
  snprintf( chTestDescription, elCount(chTestDescription), "Purpose:To_Verify_Security_Peripheral_Error_LLS_NoError");
  TestCaseAddInfo( chTestTitle, "TC_L30SW_IT_37285146", chTestDescription );

  /***************************************************************************************************************/    
                                              // Start of Test Case
  /***************************************************************************************************************/
  
  /***************************************************************************************************************/    
                                              // Test Step 1 PRECONDITIONS
  /***************************************************************************************************************/
  
  snprintf( chActionText, elCount(chActionText), "Flash the Software and ECU is running"); 
  snprintf( chExpectedText, elCount(chExpectedText), "ECU should be in running state"); 
  TestStepAddActionExpected( chActionText, chExpectedText );

  A_DBGR_BreakpointDeleteAll();
  A_DBGR_R();
   /********************************************************************************************************************************************************************************************************************************************/    
               // Test Step 2 set breakpoint at line cybersec_features_test( void ) of the file test_spds_hwio.c
  /*********************************************************************************************************************************************************************************************************************************************/
   snprintf( chActionText, elCount(chActionText), "set breakpoint at line cybersec_features_test( void ) of the file test_spds_hwio.c"); 
  snprintf( chExpectedText, elCount(chExpectedText), "Verify Breakpoint got hit at function cybersec_features_test( void )"); 
  //TestStepAddActionExpected( chActionText, chExpectedText );
  //A_DBGR_R();
  A_DBGR_BreakpointSet("cybersec_features_test\\2");
  A_DBGR_Go_Safe();
  waitForNotRunning(20000);
  E_DBGR_BreakpointCheckForHalt("cybersec_features_test\\2");
  
  
  snprintf( chActionText, elCount(chActionText), "verify var CysecFeatureNum should be set"); 
  snprintf( chExpectedText, elCount(chExpectedText), "var CysecFeatureNum  should be set"); 
  TestStepAddActionExpected( chActionText, chExpectedText );
  A_DBGR_VariableSet("CysecFeatureNum", "5");
  E_DBGR_VariableCheck("CysecFeatureNum",5, Equal);
  
  snprintf( chActionText, elCount(chActionText), "Delete all BP's"); 
  snprintf( chExpectedText, elCount(chExpectedText), "All BP's are deleted"); 
  TestStepAddActionExpected( chActionText, chExpectedText );
  A_DBGR_BreakpointDeleteAll();
   /********************************************************************************************************************************************************************************************************************************************/    
               // Test Step 3 set breakpoint at line SECURITY_PERIPHERAL_ERRORS = GetHWIO_e_SecPeriphErrs() of the file test_spds_hwio.c
  /*********************************************************************************************************************************************************************************************************************************************/
  
  snprintf( chActionText, elCount(chActionText), "set breakpoint at line SECURITY_PERIPHERAL_ERRORS = GetHWIO_e_SecPeriphErrs() of the file test_spds_hwio.c"); 
  snprintf( chExpectedText, elCount(chExpectedText), "set breakpoint at line SECURITY_PERIPHERAL_ERRORS = GetHWIO_e_SecPeriphErrs()"); 
 // TestStepAddActionExpected( chActionText, chExpectedText );
  A_DBGR_BreakpointSet("App_GMCmacGenerate\\16");
  A_DBGR_Go();
  waitForNotRunning(20000);
  E_DBGR_BreakpointCheckForHalt("App_GMCmacGenerate\\16");
  
  
  
  snprintf( chActionText, elCount(chActionText), "verify var SECURITY_PERIPHERAL_ERRORS should be set"); 
  snprintf( chExpectedText, elCount(chExpectedText), "var SECURITY_PERIPHERAL_ERRORS should be set"); 
  TestStepAddActionExpected( chActionText, chExpectedText );
  //A_DBGR_VariableSet("CSM_STATUS", "0");
  E_DBGR_VariableCheck("SECURITY_PERIPHERAL_ERRORS",0, Equal);  
  
   
  
}



testcase To_Verify_CSM_MAC_Verify_Update()
{
  /***************************************************************************************************************/    
                                                // Variable Definition
  /***************************************************************************************************************/ 
  
  long var;
  
  /***************************************************************************************************************/    
                                               // Local Values
  /***************************************************************************************************************/ 
  



  
  /***************************************************************************************************************/    
                                              // Test Case Info
  /***************************************************************************************************************/
  setWriteDbgLevel(DebugOff);
  snprintf( chTestTitle, elCount(chTestTitle), "To_Verify_CSM_MAC_Verify_Update" );
  snprintf( chTestDescription, elCount(chTestDescription), "Purpose:To_Verify_CSM_MAC_Verify_Update");
  TestCaseAddInfo( chTestTitle, "TC_L30SW_IT_37285158", chTestDescription );



  /***************************************************************************************************************/    
                                              // Start of Test Case
  /***************************************************************************************************************/
  
  /***************************************************************************************************************/    
                                              // Test Step 1 PRECONDITIONS
  /***************************************************************************************************************/
  
  snprintf( chActionText, elCount(chActionText), "Flash the Software and ECU is running"); 
  snprintf( chExpectedText, elCount(chExpectedText), "ECU should be in running state"); 
  TestStepAddActionExpected( chActionText, chExpectedText );



  A_DBGR_BreakpointDeleteAll();
   A_DBGR_R();
   /********************************************************************************************************************************************************************************************************************************************/    
               // Test Step 2 set breakpoint at line cybersec_features_test( void ) of the file test_spds_hwio.c
  /*********************************************************************************************************************************************************************************************************************************************/
   snprintf( chActionText, elCount(chActionText), "set breakpoint at line cybersec_features_test( void ) of the file test_spds_hwio.c"); 
  snprintf( chExpectedText, elCount(chExpectedText), "Verify Breakpoint got hit at function cybersec_features_test( void )"); 
  //TestStepAddActionExpected( chActionText, chExpectedText );
  A_DBGR_BreakpointSet("cybersec_features_test\\2");
  A_DBGR_Go_Safe();
  waitForNotRunning(20000);
  E_DBGR_BreakpointCheckForHalt("cybersec_features_test\\2");
  
  
  snprintf( chActionText, elCount(chActionText), "verify var CysecFeatureNum should be set"); 
  snprintf( chExpectedText, elCount(chExpectedText), "var CysecFeatureNum  should be set"); 
  TestStepAddActionExpected( chActionText, chExpectedText );
  A_DBGR_VariableSet("CysecFeatureNum", "6");
  E_DBGR_VariableCheck("CysecFeatureNum",6, Equal);
  
  snprintf( chActionText, elCount(chActionText), "Delete all BP's"); 
  snprintf( chExpectedText, elCount(chExpectedText), "All BP's are deleted"); 
  TestStepAddActionExpected( chActionText, chExpectedText );
  A_DBGR_BreakpointDeleteAll();
  
   /********************************************************************************************************************************************************************************************************************************************/    
               // Test Step 3 set breakpoint at line SetHWIO_h_CSM_MacVerifyUpdate( CsmConf_CsmJob_CsmJob_MacVerify_She_Key_003, App_au8CmacData_1, APP_CMAC_DATA_SIZE_1 ) of the file test_spds_hwio.c
  /*********************************************************************************************************************************************************************************************************************************************/
  
  snprintf( chActionText, elCount(chActionText), "set breakpoint at line SetHWIO_h_CSM_MacVerifyUpdate( CsmConf_CsmJob_CsmJob_MacVerify_She_Key_003, App_au8CmacData_1, APP_CMAC_DATA_SIZE_1 ) of the file test_spds_hwio.c"); 
  snprintf( chExpectedText, elCount(chExpectedText), "set breakpoint at line SetHWIO_h_CSM_MacVerifyUpdate( CsmConf_CsmJob_CsmJob_MacVerify_She_Key_003, App_au8CmacData_1, APP_CMAC_DATA_SIZE_1 )"); 
  //TestStepAddActionExpected( chActionText, chExpectedText );
  A_DBGR_BreakpointSet("App_GMCmacVerify\\27");
  A_DBGR_Go();
  waitForNotRunning(20000);
  E_DBGR_BreakpointCheckForHalt("App_GMCmacVerify\\27");
  
  
  
  snprintf( chActionText, elCount(chActionText), "verify var CSM_STATUS should be set"); 
  snprintf( chExpectedText, elCount(chExpectedText), "var CSM_STATUS should be set"); 
  TestStepAddActionExpected( chActionText, chExpectedText );
  //A_DBGR_VariableSet("CSM_STATUS", "0");
  E_DBGR_VariableCheck("CSM_STATUS",0, Equal);  
   
  
}



testcase   To_Verify_CSM_MAC_Verify_Finish()
{
  /***************************************************************************************************************/    
                                                // Variable Definition
  /***************************************************************************************************************/ 
  
  long var;
  
  /***************************************************************************************************************/    
                                               // Local Values
  /***************************************************************************************************************/ 
  



  
  /***************************************************************************************************************/    
                                              // Test Case Info
  /***************************************************************************************************************/
  setWriteDbgLevel(DebugOff);
  snprintf( chTestTitle, elCount(chTestTitle), "To_Verify_CSM_MAC_Verify_Finish" );
  snprintf( chTestDescription, elCount(chTestDescription), "Purpose:To_Verify_CSM_MAC_Verify_Finish");
  TestCaseAddInfo( chTestTitle, "TC_L30SW_IT_37285161", chTestDescription );



  /***************************************************************************************************************/    
                                              // Start of Test Case
  /***************************************************************************************************************/
  
  /***************************************************************************************************************/    
                                              // Test Step 1 PRECONDITIONS
  /***************************************************************************************************************/
  
  snprintf( chActionText, elCount(chActionText), "Flash the Software and ECU is running"); 
  snprintf( chExpectedText, elCount(chExpectedText), "ECU should be in running state"); 
  TestStepAddActionExpected( chActionText, chExpectedText );



  A_DBGR_BreakpointDeleteAll();
  A_DBGR_R();
   /********************************************************************************************************************************************************************************************************************************************/    
               // Test Step 2 set breakpoint at line cybersec_features_test( void ) of the file test_spds_hwio.c
  /*********************************************************************************************************************************************************************************************************************************************/
   snprintf( chActionText, elCount(chActionText), "set breakpoint at line cybersec_features_test( void ) of the file test_spds_hwio.c"); 
  snprintf( chExpectedText, elCount(chExpectedText), "Verify Breakpoint got hit at function cybersec_features_test( void )"); 
  //TestStepAddActionExpected( chActionText, chExpectedText );
  //A_DBGR_R();
  A_DBGR_BreakpointSet("cybersec_features_test\\2");
  A_DBGR_Go_Safe();
  waitForNotRunning(20000);
  E_DBGR_BreakpointCheckForHalt("cybersec_features_test\\2");
  
  
  snprintf( chActionText, elCount(chActionText), "verify var CysecFeatureNum should be set"); 
  snprintf( chExpectedText, elCount(chExpectedText), "var CysecFeatureNum  should be set"); 
  TestStepAddActionExpected( chActionText, chExpectedText );
  A_DBGR_VariableSet("CysecFeatureNum", "6");
  E_DBGR_VariableCheck("CysecFeatureNum",6, Equal);
  
  snprintf( chActionText, elCount(chActionText), "Delete all BP's"); 
  snprintf( chExpectedText, elCount(chExpectedText), "All BP's are deleted"); 
  TestStepAddActionExpected( chActionText, chExpectedText );
  A_DBGR_BreakpointDeleteAll();
   /********************************************************************************************************************************************************************************************************************************************/    
               // Test Step 3 set breakpoint at line SetHWIO_h_CSM_MacVerifyFinish( CsmConf_CsmJob_CsmJob_MacVerify_She_Key_003, App_au8CmacTag_4, 128, &App_CmacVerifyResult ) of the file test_spds_hwio.c
  /*********************************************************************************************************************************************************************************************************************************************/
  
  snprintf( chActionText, elCount(chActionText), "set breakpoint at line SetHWIO_h_CSM_MacVerifyFinish( CsmConf_CsmJob_CsmJob_MacVerify_She_Key_003, App_au8CmacTag_4, 128, &App_CmacVerifyResult ) of the file test_spds_hwio.c"); 
  snprintf( chExpectedText, elCount(chExpectedText), "set breakpoint at line SetHWIO_h_CSM_MacVerifyFinish( CsmConf_CsmJob_CsmJob_MacVerify_She_Key_003, App_au8CmacTag_4, 128, &App_CmacVerifyResult )"); 
 // TestStepAddActionExpected( chActionText, chExpectedText );
  A_DBGR_BreakpointSet("App_GMCmacVerify\\28");
  A_DBGR_Go();
  waitForNotRunning(20000);
  E_DBGR_BreakpointCheckForHalt("App_GMCmacVerify\\28");
  
  
  
  snprintf( chActionText, elCount(chActionText), "verify var CSM_STATUS should be set"); 
  snprintf( chExpectedText, elCount(chExpectedText), "var CSM_STATUS should be set"); 
  TestStepAddActionExpected( chActionText, chExpectedText );
  //A_DBGR_VariableSet("CSM_STATUS", "0");
  E_DBGR_VariableCheck("CSM_STATUS",0, Equal);  
   
  
}





testcase   To_Verify_CSM_MAC_Verify_Start()
{
   /***************************************************************************************************************/    
                                                // Variable Definition
  /***************************************************************************************************************/ 
  
  long var;
  
  /***************************************************************************************************************/    
                                               // Local Values
  /***************************************************************************************************************/ 
  



  
  /***************************************************************************************************************/    
                                              // Test Case Info
  /***************************************************************************************************************/
  setWriteDbgLevel(DebugOff);
  snprintf( chTestTitle, elCount(chTestTitle), "To_Verify_CSM_MAC_Verify_Finish" );
  snprintf( chTestDescription, elCount(chTestDescription), "Purpose:To_Verify_CSM_MAC_Verify_Finish");
  TestCaseAddInfo( chTestTitle, "TC_L30SW_IT_37285161", chTestDescription );



  /***************************************************************************************************************/    
                                              // Start of Test Case
  /***************************************************************************************************************/
  
  /***************************************************************************************************************/    
                                              // Test Step 1 PRECONDITIONS
  /***************************************************************************************************************/
  
  snprintf( chActionText, elCount(chActionText), "Flash the Software and ECU is running"); 
  snprintf( chExpectedText, elCount(chExpectedText), "ECU should be in running state"); 
  TestStepAddActionExpected( chActionText, chExpectedText );
   A_DBGR_BreakpointDeleteAll();
  A_DBGR_R();
   /********************************************************************************************************************************************************************************************************************************************/    
               // Test Step 2 set breakpoint at line cybersec_features_test( void ) of the file test_spds_hwio.c
  /*********************************************************************************************************************************************************************************************************************************************/
   snprintf( chActionText, elCount(chActionText), "set breakpoint at line cybersec_features_test( void ) of the file test_spds_hwio.c"); 
  snprintf( chExpectedText, elCount(chExpectedText), "Verify Breakpoint got hit at function cybersec_features_test( void )"); 
  //TestStepAddActionExpected( chActionText, chExpectedText );
  //A_DBGR_R();
  A_DBGR_BreakpointSet("cybersec_features_test\\2");
  A_DBGR_Go_Safe();
  waitForNotRunning(20000);
  E_DBGR_BreakpointCheckForHalt("cybersec_features_test\\2");
  
  
  snprintf( chActionText, elCount(chActionText), "verify var CysecFeatureNum should be set"); 
  snprintf( chExpectedText, elCount(chExpectedText), "var CysecFeatureNum  should be set"); 
  TestStepAddActionExpected( chActionText, chExpectedText );
  A_DBGR_VariableSet("CysecFeatureNum", "6");
  E_DBGR_VariableCheck("CysecFeatureNum",6, Equal);
  
  snprintf( chActionText, elCount(chActionText), "Delete all BP's"); 
  snprintf( chExpectedText, elCount(chExpectedText), "All BP's are deleted"); 
  TestStepAddActionExpected( chActionText, chExpectedText );
  A_DBGR_BreakpointDeleteAll();
   /********************************************************************************************************************************************************************************************************************************************/    
               // Test Step 3 set breakpoint at line SetHWIO_h_CSM_MacVerifyStart( CsmConf_CsmJob_CsmJob_MacVerify_She_Key_003, &key ) of the file test_spds_hwio.c
  /*********************************************************************************************************************************************************************************************************************************************/
  
  snprintf( chActionText, elCount(chActionText), "set breakpoint at line SetHWIO_h_CSM_MacVerifyStart( CsmConf_CsmJob_CsmJob_MacVerify_She_Key_003, &key ) of the file test_spds_hwio.c"); 
  snprintf( chExpectedText, elCount(chExpectedText), "set breakpoint at line SetHWIO_h_CSM_MacVerifyStart( CsmConf_CsmJob_CsmJob_MacVerify_She_Key_003, &key )"); 
  //TestStepAddActionExpected( chActionText, chExpectedText );
  A_DBGR_BreakpointSet("App_GMCmacVerify\\26");
  A_DBGR_Go();
  waitForNotRunning(20000);
  E_DBGR_BreakpointCheckForHalt("App_GMCmacVerify\\26");
  
  
  
  snprintf( chActionText, elCount(chActionText), "verify var CSM_STATUS should be set"); 
  snprintf( chExpectedText, elCount(chExpectedText), "var CSM_STATUS should be set"); 
  TestStepAddActionExpected( chActionText, chExpectedText );
  //A_DBGR_VariableSet("CSM_STATUS", "0");
  E_DBGR_VariableCheck("CSM_STATUS",0, Equal);  
   
  
}


  
testcase   To_Verify_CSM_Symmetric_Block_Decrypt_Update()
{
  /***************************************************************************************************************/    
                                                // Variable Definition
  /***************************************************************************************************************/ 
  
  long var;
  
  /***************************************************************************************************************/    
                                               // Local Values
  /***************************************************************************************************************/ 
  



  
  /***************************************************************************************************************/    
                                              // Test Case Info
  /***************************************************************************************************************/
  setWriteDbgLevel(DebugOff);
  snprintf( chTestTitle, elCount(chTestTitle), "To_Verify_CSM_Symmetric_Block_Decrypt_Update" );
  snprintf( chTestDescription, elCount(chTestDescription), "Purpose:To_Verify_CSM_Symmetric_Block_Decrypt_Update");
  TestCaseAddInfo( chTestTitle, "TC_L30SW_IT_37285161", chTestDescription );



  /***************************************************************************************************************/    
                                              // Start of Test Case
  /***************************************************************************************************************/
  
  /***************************************************************************************************************/    
                                              // Test Step 1 PRECONDITIONS
  /***************************************************************************************************************/
  
  snprintf( chActionText, elCount(chActionText), "Flash the Software and ECU is running"); 
  snprintf( chExpectedText, elCount(chExpectedText), "ECU should be in running state"); 
  TestStepAddActionExpected( chActionText, chExpectedText );

 A_DBGR_R();
   /********************************************************************************************************************************************************************************************************************************************/    
               // Test Step 2 set breakpoint at line cybersec_features_test( void ) of the file test_spds_hwio.c
  /*********************************************************************************************************************************************************************************************************************************************/
   snprintf( chActionText, elCount(chActionText), "set breakpoint at line cybersec_features_test( void ) of the file test_spds_hwio.c"); 
  snprintf( chExpectedText, elCount(chExpectedText), "Verify Breakpoint got hit at function cybersec_features_test( void )"); 
 //TestStepAddActionExpected( chActionText, chExpectedText );
  //A_DBGR_R();
  A_DBGR_BreakpointSet("cybersec_features_test\\2");
  A_DBGR_Go();
  A_DBGR_Go();
  testWaitForTimeout(10000);
  E_DBGR_BreakpointCheckForHalt("cybersec_features_test\\2");
  
  
  snprintf( chActionText, elCount(chActionText), "verify var CysecFeatureNum should be set"); 
  snprintf( chExpectedText, elCount(chExpectedText), "var CysecFeatureNum  should be set"); 
  TestStepAddActionExpected( chActionText, chExpectedText );
  A_DBGR_VariableSet("CysecFeatureNum", "9");
  E_DBGR_VariableCheck("CysecFeatureNum",9, Equal);
  
  snprintf( chActionText, elCount(chActionText), "Delete all BP's"); 
  snprintf( chExpectedText, elCount(chExpectedText), "All BP's are deleted"); 
  TestStepAddActionExpected( chActionText, chExpectedText );
  A_DBGR_BreakpointDeleteAll();
   /********************************************************************************************************************************************************************************************************************************************/    
               // Test Step 3 set breakpoint at line SetHWIO_h_CSM_SymBlkDecryptUpdate( CsmConf_CsmJob_CsmJob_DecryptECB_She_Key_004, App_au8Aes128EcbCiphertext_2, APP_AES128_ECB_CIPHER_TEXT_SIZE_2, App_au8Aes128EcbResult, &App_u32Aes128EcbResultSize ) of the file test_spds_hwio.c
  /*********************************************************************************************************************************************************************************************************************************************/
  
  snprintf( chActionText, elCount(chActionText), "set breakpoint at line SetHWIO_h_CSM_SymBlkDecryptUpdate( CsmConf_CsmJob_CsmJob_DecryptECB_She_Key_004, App_au8Aes128EcbCiphertext_2, APP_AES128_ECB_CIPHER_TEXT_SIZE_2, App_au8Aes128EcbResult, &App_u32Aes128EcbResultSize ) of the file test_spds_hwio.c"); 
  snprintf( chExpectedText, elCount(chExpectedText), "set breakpoint at line SetHWIO_h_CSM_SymBlkDecryptUpdate( CsmConf_CsmJob_CsmJob_DecryptECB_She_Key_004, App_au8Aes128EcbCiphertext_2, APP_AES128_ECB_CIPHER_TEXT_SIZE_2, App_au8Aes128EcbResult, &App_u32Aes128EcbResultSize )"); 
 // TestStepAddActionExpected( chActionText, chExpectedText );
  A_DBGR_BreakpointSet("App_GMAes128Decrypt\\32");
  A_DBGR_Go();
  A_DBGR_Go();
  E_DBGR_BreakpointCheckForHalt("App_GMAes128Decrypt\\32");
  
  
  
  snprintf( chActionText, elCount(chActionText), "verify var CSM_STATUS should be set"); 
  snprintf( chExpectedText, elCount(chExpectedText), "var CSM_STATUS should be set"); 
  TestStepAddActionExpected( chActionText, chExpectedText );
  //A_DBGR_VariableSet("CSM_STATUS", "0");
  E_DBGR_VariableCheck("CSM_STATUS",0, Equal);  
 
}


testcase   To_Verify_CSM_Symmetric_Block_Decrypt_Start()
{
  /***************************************************************************************************************/    
                                                // Variable Definition
  /***************************************************************************************************************/ 
  
  long var;
  
  /***************************************************************************************************************/    
                                               // Local Values
  /***************************************************************************************************************/ 
  



  
  /***************************************************************************************************************/    
                                              // Test Case Info
  /***************************************************************************************************************/
  setWriteDbgLevel(DebugOff);
  snprintf( chTestTitle, elCount(chTestTitle), "To_Verify_CSM_Symmetric_Block_Decrypt_Start" );
  snprintf( chTestDescription, elCount(chTestDescription), "Purpose:To_Verify_CSM_Symmetric_Block_Decrypt_Start");
  TestCaseAddInfo( chTestTitle, "TC_L30SW_IT_37285161", chTestDescription );



  /***************************************************************************************************************/    
                                              // Start of Test Case
  /***************************************************************************************************************/
  
  /***************************************************************************************************************/    
                                              // Test Step 1 PRECONDITIONS
  /***************************************************************************************************************/
  
  snprintf( chActionText, elCount(chActionText), "Flash the Software and ECU is running"); 
  snprintf( chExpectedText, elCount(chExpectedText), "ECU should be in running state"); 
  TestStepAddActionExpected( chActionText, chExpectedText );



  A_DBGR_BreakpointDeleteAll();
  A_DBGR_R();
   /********************************************************************************************************************************************************************************************************************************************/    
               // Test Step 2 set breakpoint at line cybersec_features_test( void ) of the file test_spds_hwio.c
  /*********************************************************************************************************************************************************************************************************************************************/
   snprintf( chActionText, elCount(chActionText), "set breakpoint at line cybersec_features_test( void ) of the file test_spds_hwio.c"); 
  snprintf( chExpectedText, elCount(chExpectedText), "Verify Breakpoint got hit at function cybersec_features_test( void )"); 
  //TestStepAddActionExpected( chActionText, chExpectedText );
  //A_DBGR_R();
  A_DBGR_BreakpointSet("cybersec_features_test\\2");
  A_DBGR_Go();
  A_DBGR_Go();
  testWaitForTimeout(10000);


  E_DBGR_BreakpointCheckForHalt("cybersec_features_test\\2");
  
  
  snprintf( chActionText, elCount(chActionText), "verify var CysecFeatureNum should be set"); 
  snprintf( chExpectedText, elCount(chExpectedText), "var CysecFeatureNum  should be set"); 
  TestStepAddActionExpected( chActionText, chExpectedText );
  A_DBGR_VariableSet("CysecFeatureNum", "9");
  E_DBGR_VariableCheck("CysecFeatureNum",9, Equal);
  
  snprintf( chActionText, elCount(chActionText), "Delete all BP's"); 
  snprintf( chExpectedText, elCount(chExpectedText), "All BP's are deleted"); 
  TestStepAddActionExpected( chActionText, chExpectedText );
  A_DBGR_BreakpointDeleteAll();
   /********************************************************************************************************************************************************************************************************************************************/    
               // Test Step 3 set breakpoint at line SetHWIO_h_CSM_SymBlkDecryptStart( CsmConf_CsmJob_CsmJob_DecryptECB_She_Key_004, &key ) of the file test_spds_hwio.c
  /*********************************************************************************************************************************************************************************************************************************************/
  
  snprintf( chActionText, elCount(chActionText), "set breakpoint at line SetHWIO_h_CSM_SymBlkDecryptStart( CsmConf_CsmJob_CsmJob_DecryptECB_She_Key_004, &key ) of the file test_spds_hwio.c"); 
  snprintf( chExpectedText, elCount(chExpectedText), "set breakpoint at line SetHWIO_h_CSM_SymBlkDecryptStart( CsmConf_CsmJob_CsmJob_DecryptECB_She_Key_004, &key )"); 
  //TestStepAddActionExpected( chActionText, chExpectedText );
  A_DBGR_BreakpointSet("App_GMAes128Decrypt\\31");
  A_DBGR_Go();
  A_DBGR_Go();
  E_DBGR_BreakpointCheckForHalt("App_GMAes128Decrypt\\31");
  
  
  
  snprintf( chActionText, elCount(chActionText), "verify var CSM_STATUS should be set"); 
  snprintf( chExpectedText, elCount(chExpectedText), "var CSM_STATUS should be set"); 
  TestStepAddActionExpected( chActionText, chExpectedText );
  //A_DBGR_VariableSet("CSM_STATUS", "0");
  E_DBGR_VariableCheck("CSM_STATUS",0, Equal);  
  
}


testcase   To_Verify_CSM_Symmetric_Block_Decrypt_Finish()
{
 /***************************************************************************************************************/    
                                                // Variable Definition
  /***************************************************************************************************************/ 
  
  long var;
  
  /***************************************************************************************************************/    
                                               // Local Values
  /***************************************************************************************************************/ 
  



  
  /***************************************************************************************************************/    
                                              // Test Case Info
  /***************************************************************************************************************/
  setWriteDbgLevel(DebugOff);
  snprintf( chTestTitle, elCount(chTestTitle), "To_Verify_CSM_Symmetric_Block_Decrypt_Finish" );
  snprintf( chTestDescription, elCount(chTestDescription), "Purpose:To_Verify_CSM_Symmetric_Block_Decrypt_Finish");
  TestCaseAddInfo( chTestTitle, "TC_L30SW_IT_37285161", chTestDescription );



  /***************************************************************************************************************/    
                                              // Start of Test Case
  /***************************************************************************************************************/
  
  /***************************************************************************************************************/    
                                              // Test Step 1 PRECONDITIONS
  /***************************************************************************************************************/
  
  snprintf( chActionText, elCount(chActionText), "Flash the Software and ECU is running"); 
  snprintf( chExpectedText, elCount(chExpectedText), "ECU should be in running state"); 
  TestStepAddActionExpected( chActionText, chExpectedText );



  A_DBGR_BreakpointDeleteAll();
  A_DBGR_R();
   /********************************************************************************************************************************************************************************************************************************************/    
               // Test Step 2 set breakpoint at line cybersec_features_test( void ) of the file test_spds_hwio.c
  /*********************************************************************************************************************************************************************************************************************************************/
   snprintf( chActionText, elCount(chActionText), "set breakpoint at line cybersec_features_test( void ) of the file test_spds_hwio.c"); 
  snprintf( chExpectedText, elCount(chExpectedText), "Verify Breakpoint got hit at function cybersec_features_test( void )"); 
  //TestStepAddActionExpected( chActionText, chExpectedText );
  //A_DBGR_R();
  A_DBGR_BreakpointSet("cybersec_features_test\\2");
  A_DBGR_Go();
  A_DBGR_Go();
  testWaitForTimeout(10000);
  E_DBGR_BreakpointCheckForHalt("cybersec_features_test\\2");
  
  
  snprintf( chActionText, elCount(chActionText), "verify var CysecFeatureNum should be set"); 
  snprintf( chExpectedText, elCount(chExpectedText), "var CysecFeatureNum  should be set"); 
  TestStepAddActionExpected( chActionText, chExpectedText );
  A_DBGR_VariableSet("CysecFeatureNum", "9");
  E_DBGR_VariableCheck("CysecFeatureNum",9, Equal);
  
  snprintf( chActionText, elCount(chActionText), "Delete all BP's"); 
  snprintf( chExpectedText, elCount(chExpectedText), "All BP's are deleted"); 
  TestStepAddActionExpected( chActionText, chExpectedText );
  A_DBGR_BreakpointDeleteAll();
   /********************************************************************************************************************************************************************************************************************************************/    
               // Test Step 3 set breakpoint at line SetHWIO_h_CSM_SymBlkDecryptFinish( CsmConf_CsmJob_CsmJob_DecryptECB_She_Key_004 ) of the file test_spds_hwio.c
  /*********************************************************************************************************************************************************************************************************************************************/
  
  snprintf( chActionText, elCount(chActionText), "set breakpoint at line SetHWIO_h_CSM_SymBlkDecryptFinish( CsmConf_CsmJob_CsmJob_DecryptECB_She_Key_004 ) of the file test_spds_hwio.c"); 
  snprintf( chExpectedText, elCount(chExpectedText), "set breakpoint at line SetHWIO_h_CSM_SymBlkDecryptFinish( CsmConf_CsmJob_CsmJob_DecryptECB_She_Key_004 )"); 
  //TestStepAddActionExpected( chActionText, chExpectedText );
  A_DBGR_BreakpointSet("App_GMAes128Decrypt\\33");
  A_DBGR_Go();
  A_DBGR_Go();
  E_DBGR_BreakpointCheckForHalt("App_GMAes128Decrypt\\33");
  
  
  
  snprintf( chActionText, elCount(chActionText), "verify var CSM_STATUS should be set"); 
  snprintf( chExpectedText, elCount(chExpectedText), "var CSM_STATUS should be set"); 
  TestStepAddActionExpected( chActionText, chExpectedText );
  //A_DBGR_VariableSet("CSM_STATUS", "0");
  E_DBGR_VariableCheck("CSM_STATUS",0, Equal);   
  
}
  


testcase   To_Verify_CSM_Symmetric_Encrypt_Update()
{
 /***************************************************************************************************************/    
                                                // Variable Definition
  /***************************************************************************************************************/ 
  
  long var;
  
  /***************************************************************************************************************/    
                                               // Local Values
  /***************************************************************************************************************/ 
  



  
  /***************************************************************************************************************/    
                                              // Test Case Info
  /***************************************************************************************************************/
  setWriteDbgLevel(DebugOff);
  snprintf( chTestTitle, elCount(chTestTitle), "To_Verify_CSM_Symmetric_Encrypt_Update" );
  snprintf( chTestDescription, elCount(chTestDescription), "Purpose:To_Verify_CSM_Symmetric_Encrypt_Update");
  TestCaseAddInfo( chTestTitle, "TC_L30SW_IT_37285161", chTestDescription );



  /***************************************************************************************************************/    
                                              // Start of Test Case
  /***************************************************************************************************************/
  
  /***************************************************************************************************************/    
                                              // Test Step 1 PRECONDITIONS
  /***************************************************************************************************************/
  
  snprintf( chActionText, elCount(chActionText), "Flash the Software and ECU is running"); 
  snprintf( chExpectedText, elCount(chExpectedText), "ECU should be in running state"); 
  TestStepAddActionExpected( chActionText, chExpectedText );



  A_DBGR_BreakpointDeleteAll();
 A_DBGR_R();
   /********************************************************************************************************************************************************************************************************************************************/    
               // Test Step 2 set breakpoint at line cybersec_features_test( void ) of the file test_spds_hwio.c
  /*********************************************************************************************************************************************************************************************************************************************/
   snprintf( chActionText, elCount(chActionText), "set breakpoint at line cybersec_features_test( void ) of the file test_spds_hwio.c"); 
  snprintf( chExpectedText, elCount(chExpectedText), "Verify Breakpoint got hit at function cybersec_features_test( void )"); 
  //TestStepAddActionExpected( chActionText, chExpectedText );
  //A_DBGR_R();
  A_DBGR_BreakpointSet("cybersec_features_test\\2");
  A_DBGR_Go();
  A_DBGR_Go();
  testWaitForTimeout(10000);
  E_DBGR_BreakpointCheckForHalt("cybersec_features_test\\2");
  
  
  snprintf( chActionText, elCount(chActionText), "verify var CysecFeatureNum should be set"); 
  snprintf( chExpectedText, elCount(chExpectedText), "var CysecFeatureNum  should be set"); 
  TestStepAddActionExpected( chActionText, chExpectedText );
  A_DBGR_VariableSet("CysecFeatureNum", "8");
  E_DBGR_VariableCheck("CysecFeatureNum",8, Equal);
  
  snprintf( chActionText, elCount(chActionText), "Delete all BP's"); 
  snprintf( chExpectedText, elCount(chExpectedText), "All BP's are deleted"); 
  TestStepAddActionExpected( chActionText, chExpectedText );
  A_DBGR_BreakpointDeleteAll();
   /********************************************************************************************************************************************************************************************************************************************/    
               // Test Step 3 set breakpoint at line SetHWIO_h_CSM_SymEncryptUpdate( CsmConf_CsmJob_CsmJob_EncryptCBC_She_Key_004, App_au8Aes128CbcPlaintext_1, APP_AES128_CBC_PLAIN_TEXT_SIZE_1, App_au8Aes128CbcResult, &App_u32Aes128CbcResultSize ) of the file test_spds_hwio.c
  /*********************************************************************************************************************************************************************************************************************************************/
  
  snprintf( chActionText, elCount(chActionText), "set breakpoint at line SetHWIO_h_CSM_SymEncryptUpdate( CsmConf_CsmJob_CsmJob_EncryptCBC_She_Key_004, App_au8Aes128CbcPlaintext_1, APP_AES128_CBC_PLAIN_TEXT_SIZE_1, App_au8Aes128CbcResult, &App_u32Aes128CbcResultSize ) of the file test_spds_hwio.c"); 
  snprintf( chExpectedText, elCount(chExpectedText), "set breakpoint at line SetHWIO_h_CSM_SymEncryptUpdate( CsmConf_CsmJob_CsmJob_EncryptCBC_She_Key_004, App_au8Aes128CbcPlaintext_1, APP_AES128_CBC_PLAIN_TEXT_SIZE_1, App_au8Aes128CbcResult, &App_u32Aes128CbcResultSize )"); 
  //TestStepAddActionExpected( chActionText, chExpectedText );
  A_DBGR_BreakpointSet("App_SymKeyWrapSym\\24");
  A_DBGR_Go();
  A_DBGR_Go();
  E_DBGR_BreakpointCheckForHalt("App_SymKeyWrapSym\\24");
  
  
  
  snprintf( chActionText, elCount(chActionText), "verify var CSM_STATUS should be set"); 
  snprintf( chExpectedText, elCount(chExpectedText), "var CSM_STATUS should be set"); 
  TestStepAddActionExpected( chActionText, chExpectedText );
  //A_DBGR_VariableSet("CSM_STATUS", "0");
  E_DBGR_VariableCheck("CSM_STATUS",0, Equal);    
  
}


testcase   To_Verify_CSM_Symmetric_Decrypt_Update()
{
  /***************************************************************************************************************/    
                                                // Variable Definition
  /***************************************************************************************************************/ 
  
  long var;
  
  /***************************************************************************************************************/    
                                               // Local Values
  /***************************************************************************************************************/ 
  



  
  /***************************************************************************************************************/    
                                              // Test Case Info
  /***************************************************************************************************************/
  setWriteDbgLevel(DebugOff);
  snprintf( chTestTitle, elCount(chTestTitle), "To_Verify_CSM_Symmetric_Decrypt_Update" );
  snprintf( chTestDescription, elCount(chTestDescription), "Purpose:To_Verify_CSM_Symmetric_Decrypt_Update");
  TestCaseAddInfo( chTestTitle, "TC_L30SW_IT_37285161", chTestDescription );



  /***************************************************************************************************************/    
                                              // Start of Test Case
  /***************************************************************************************************************/
  
  /***************************************************************************************************************/    
                                              // Test Step 1 PRECONDITIONS
  /***************************************************************************************************************/
  
  snprintf( chActionText, elCount(chActionText), "Flash the Software and ECU is running"); 
  snprintf( chExpectedText, elCount(chExpectedText), "ECU should be in running state"); 
  TestStepAddActionExpected( chActionText, chExpectedText );



  A_DBGR_BreakpointDeleteAll();
  A_DBGR_R();
   /********************************************************************************************************************************************************************************************************************************************/    
               // Test Step 2 set breakpoint at line cybersec_features_test( void ) of the file test_spds_hwio.c
  /*********************************************************************************************************************************************************************************************************************************************/
   snprintf( chActionText, elCount(chActionText), "set breakpoint at line cybersec_features_test( void ) of the file test_spds_hwio.c"); 
  snprintf( chExpectedText, elCount(chExpectedText), "Verify Breakpoint got hit at function cybersec_features_test( void )"); 
  //TestStepAddActionExpected( chActionText, chExpectedText );
  //A_DBGR_R();
  A_DBGR_BreakpointSet("cybersec_features_test\\2");
  A_DBGR_Go();
  A_DBGR_Go();
  testWaitForTimeout(10000);
  E_DBGR_BreakpointCheckForHalt("cybersec_features_test\\2");
  
  
  snprintf( chActionText, elCount(chActionText), "verify var CysecFeatureNum should be set"); 
  snprintf( chExpectedText, elCount(chExpectedText), "var CysecFeatureNum  should be set"); 
  TestStepAddActionExpected( chActionText, chExpectedText );
  A_DBGR_VariableSet("CysecFeatureNum", "9");
  E_DBGR_VariableCheck("CysecFeatureNum",9, Equal);
  
  snprintf( chActionText, elCount(chActionText), "Delete all BP's"); 
  snprintf( chExpectedText, elCount(chExpectedText), "All BP's are deleted"); 
  TestStepAddActionExpected( chActionText, chExpectedText );
  A_DBGR_BreakpointDeleteAll();
   /********************************************************************************************************************************************************************************************************************************************/    
               // Test Step 3 set breakpoint at line SetHWIO_h_CSM_SymDecryptUpdate( CsmConf_CsmJob_CsmJob_DecryptCBC_She_Key_004, App_au8Aes128CbcCiphertext_1, APP_AES128_CBC_CIPHER_TEXT_SIZE_1, App_au8Aes128CbcResult, &App_u32Aes128CbcResultSize ) of the file test_spds_hwio.c
  /*********************************************************************************************************************************************************************************************************************************************/
  
  snprintf( chActionText, elCount(chActionText), "set breakpoint at line SetHWIO_h_CSM_SymDecryptUpdate( CsmConf_CsmJob_CsmJob_DecryptCBC_She_Key_004, App_au8Aes128CbcCiphertext_1, APP_AES128_CBC_CIPHER_TEXT_SIZE_1, App_au8Aes128CbcResult, &App_u32Aes128CbcResultSize ) of the file test_spds_hwio.c"); 
  snprintf( chExpectedText, elCount(chExpectedText), "set breakpoint at line SetHWIO_h_CSM_SymDecryptUpdate( CsmConf_CsmJob_CsmJob_DecryptCBC_She_Key_004, App_au8Aes128CbcCiphertext_1, APP_AES128_CBC_CIPHER_TEXT_SIZE_1, App_au8Aes128CbcResult, &App_u32Aes128CbcResultSize )"); 
  //TestStepAddActionExpected( chActionText, chExpectedText );
  A_DBGR_BreakpointSet("App_GMAes128Decrypt\\80");
  A_DBGR_Go();
  A_DBGR_Go();
  E_DBGR_BreakpointCheckForHalt("App_GMAes128Decrypt\\80");
  
  
  
  snprintf( chActionText, elCount(chActionText), "verify var CSM_STATUS should be set"); 
  snprintf( chExpectedText, elCount(chExpectedText), "var CSM_STATUS should be set"); 
  TestStepAddActionExpected( chActionText, chExpectedText );
  //A_DBGR_VariableSet("CSM_STATUS", "0");
  E_DBGR_VariableCheck("CSM_STATUS",0, Equal);     
  
}




testcase To_Verify_CSM_Symmetric_Decrypt_Finish()
{
  /***************************************************************************************************************/    
                                                // Variable Definition
  /***************************************************************************************************************/ 
  
  long var;
  
  /***************************************************************************************************************/    
                                               // Local Values
  /***************************************************************************************************************/ 
  

  
  /***************************************************************************************************************/    
                                              // Test Case Info
  /***************************************************************************************************************/
  setWriteDbgLevel(DebugOff);
  snprintf( chTestTitle, elCount(chTestTitle), "To_Verify_CSM_Symmetric_Decrypt_Finish" );
  snprintf( chTestDescription, elCount(chTestDescription), "Purpose:To_Verify_CSM_Symmetric_Decrypt_Finish");
  TestCaseAddInfo( chTestTitle, "TC_L30SW_IT_37285169", chTestDescription );

  /***************************************************************************************************************/    
                                              // Start of Test Case
  /***************************************************************************************************************/
  
  /***************************************************************************************************************/    
                                              // Test Step 1 PRECONDITIONS
  /***************************************************************************************************************/
  
  snprintf( chActionText, elCount(chActionText), "Flash the Software and ECU is running"); 
  snprintf( chExpectedText, elCount(chExpectedText), "ECU should be in running state"); 
  TestStepAddActionExpected( chActionText, chExpectedText );

  A_DBGR_BreakpointDeleteAll();
  A_DBGR_R();
   /********************************************************************************************************************************************************************************************************************************************/    
               // Test Step 2 set breakpoint at line cybersec_features_test( void ) of the file test_spds_hwio.c
  /*********************************************************************************************************************************************************************************************************************************************/
   snprintf( chActionText, elCount(chActionText), "set breakpoint at line cybersec_features_test( void ) of the file test_spds_hwio.c"); 
  snprintf( chExpectedText, elCount(chExpectedText), "Verify Breakpoint got hit at function cybersec_features_test( void )"); 
 // TestStepAddActionExpected( chActionText, chExpectedText );
  //A_DBGR_R();
  A_DBGR_BreakpointSet("cybersec_features_test\\2");
  A_DBGR_Go();
  A_DBGR_Go();
  testWaitForTimeout(10000);
  E_DBGR_BreakpointCheckForHalt("cybersec_features_test\\2");
  
  
  snprintf( chActionText, elCount(chActionText), "verify var CysecFeatureNum should be set"); 
  snprintf( chExpectedText, elCount(chExpectedText), "var CysecFeatureNum  should be set"); 
  TestStepAddActionExpected( chActionText, chExpectedText );
  A_DBGR_VariableSet("CysecFeatureNum", "9");
  E_DBGR_VariableCheck("CysecFeatureNum",9, Equal);
  
  snprintf( chActionText, elCount(chActionText), "Delete all BP's"); 
  snprintf( chExpectedText, elCount(chExpectedText), "All BP's are deleted"); 
  TestStepAddActionExpected( chActionText, chExpectedText );
  A_DBGR_BreakpointDeleteAll();
   /********************************************************************************************************************************************************************************************************************************************/    
               // Test Step 3 set breakpoint at line SetHWIO_h_CSM_SymDecryptFinish( CsmConf_CsmJob_CsmJob_DecryptCBC_She_Key_004, App_au8Aes128CbcResult, &App_u32Aes128CbcResultSize ) of the file test_spds_hwio.c
  /*********************************************************************************************************************************************************************************************************************************************/
  
  snprintf( chActionText, elCount(chActionText), "set breakpoint at line SetHWIO_h_CSM_SymDecryptFinish( CsmConf_CsmJob_CsmJob_DecryptCBC_She_Key_004, App_au8Aes128CbcResult, &App_u32Aes128CbcResultSize ) of the file test_spds_hwio.c"); 
  snprintf( chExpectedText, elCount(chExpectedText), "set breakpoint at line SetHWIO_h_CSM_SymDecryptFinish( CsmConf_CsmJob_CsmJob_DecryptCBC_She_Key_004, App_au8Aes128CbcResult, &App_u32Aes128CbcResultSize )"); 
 // TestStepAddActionExpected( chActionText, chExpectedText );
  A_DBGR_BreakpointSet("App_GMAes128Decrypt\\81");
  A_DBGR_Go();
  A_DBGR_Go();
  E_DBGR_BreakpointCheckForHalt("App_GMAes128Decrypt\\81");
  
  
  
  snprintf( chActionText, elCount(chActionText), "verify var CSM_STATUS should be set"); 
  snprintf( chExpectedText, elCount(chExpectedText), "var CSM_STATUS should be set"); 
  TestStepAddActionExpected( chActionText, chExpectedText );
  //A_DBGR_VariableSet("CSM_STATUS", "0");
  E_DBGR_VariableCheck("CSM_STATUS",0, Equal); 
  
  
}


testcase To_Verify_CSM_Symmetric_Decrypt_Start()
{
  /***************************************************************************************************************/    
                                                // Variable Definition
  /***************************************************************************************************************/ 
  
  long var;
  
  /***************************************************************************************************************/    
                                               // Local Values
  /***************************************************************************************************************/ 
  

  
  /***************************************************************************************************************/    
                                              // Test Case Info
  /***************************************************************************************************************/
  setWriteDbgLevel(DebugOff);
  snprintf( chTestTitle, elCount(chTestTitle), "To_Verify_CSM_Symmetric_Decrypt_Start" );
  snprintf( chTestDescription, elCount(chTestDescription), "Purpose:To_Verify_CSM_Symmetric_Decrypt_Start");
  TestCaseAddInfo( chTestTitle, "TC_L30SW_IT_37285169", chTestDescription );

  /***************************************************************************************************************/    
                                              // Start of Test Case
  /***************************************************************************************************************/
  
  /***************************************************************************************************************/    
                                              // Test Step 1 PRECONDITIONS
  /***************************************************************************************************************/
  
  snprintf( chActionText, elCount(chActionText), "Flash the Software and ECU is running"); 
  snprintf( chExpectedText, elCount(chExpectedText), "ECU should be in running state"); 
  TestStepAddActionExpected( chActionText, chExpectedText );

  A_DBGR_BreakpointDeleteAll();
 A_DBGR_R();

   /********************************************************************************************************************************************************************************************************************************************/    
               // Test Step 2 set breakpoint at line cybersec_features_test( void ) of the file test_spds_hwio.c
  /*********************************************************************************************************************************************************************************************************************************************/
   snprintf( chActionText, elCount(chActionText), "set breakpoint at line cybersec_features_test( void ) of the file test_spds_hwio.c"); 
  snprintf( chExpectedText, elCount(chExpectedText), "Verify Breakpoint got hit at function cybersec_features_test( void )"); 
  //TestStepAddActionExpected( chActionText, chExpectedText );
  //A_DBGR_R();
  A_DBGR_BreakpointSet("cybersec_features_test\\2");
  A_DBGR_Go();
  A_DBGR_Go();
  testWaitForTimeout(10000);
  E_DBGR_BreakpointCheckForHalt("cybersec_features_test\\2");
  
  
  snprintf( chActionText, elCount(chActionText), "verify var CysecFeatureNum should be set"); 
  snprintf( chExpectedText, elCount(chExpectedText), "var CysecFeatureNum  should be set"); 
  TestStepAddActionExpected( chActionText, chExpectedText );
  A_DBGR_VariableSet("CysecFeatureNum", "9");
  E_DBGR_VariableCheck("CysecFeatureNum",9, Equal);
  
  snprintf( chActionText, elCount(chActionText), "Delete all BP's"); 
  snprintf( chExpectedText, elCount(chExpectedText), "All BP's are deleted"); 
  TestStepAddActionExpected( chActionText, chExpectedText );
  A_DBGR_BreakpointDeleteAll();
   /********************************************************************************************************************************************************************************************************************************************/    
               // Test Step 3 set breakpoint at line SetHWIO_h_CSM_SymDecryptStart( CsmConf_CsmJob_CsmJob_DecryptCBC_She_Key_004, &key, &initvector, initvectorlen ) of the file test_spds_hwio.c
  /*********************************************************************************************************************************************************************************************************************************************/
  
  snprintf( chActionText, elCount(chActionText), "set breakpoint at line SetHWIO_h_CSM_SymDecryptStart( CsmConf_CsmJob_CsmJob_DecryptCBC_She_Key_004, &key, &initvector, initvectorlen ) of the file test_spds_hwio.c"); 
  snprintf( chExpectedText, elCount(chExpectedText), "set breakpoint at line SetHWIO_h_CSM_SymDecryptStart( CsmConf_CsmJob_CsmJob_DecryptCBC_She_Key_004, &key, &initvector, initvectorlen )"); 
 // TestStepAddActionExpected( chActionText, chExpectedText );
  A_DBGR_BreakpointSet("App_GMAes128Decrypt\\79");
  A_DBGR_Go();
  A_DBGR_Go();
  E_DBGR_BreakpointCheckForHalt("App_GMAes128Decrypt\\79");
  
  
  
  snprintf( chActionText, elCount(chActionText), "verify var CSM_STATUS should be set"); 
  snprintf( chExpectedText, elCount(chExpectedText), "var CSM_STATUS should be set"); 
  TestStepAddActionExpected( chActionText, chExpectedText );
  //A_DBGR_VariableSet("CSM_STATUS", "0");
  E_DBGR_VariableCheck("CSM_STATUS",0, Equal); 
  
  
}


testcase To_Verify_CSM_Symmetric_Encrypt_Finish()
{
   /***************************************************************************************************************/    
                                                // Variable Definition
  /***************************************************************************************************************/ 
  
  long var;
  
  /***************************************************************************************************************/    
                                               // Local Values
  /***************************************************************************************************************/ 
  

  
  /***************************************************************************************************************/    
                                              // Test Case Info
  /***************************************************************************************************************/
  setWriteDbgLevel(DebugOff);
  snprintf( chTestTitle, elCount(chTestTitle), "To_Verify_CSM_Symmetric_Encrypt_Finish" );
  snprintf( chTestDescription, elCount(chTestDescription), "Purpose:To_Verify_CSM_Symmetric_Encrypt_Finish");
  TestCaseAddInfo( chTestTitle, "TC_L30SW_IT_37285169", chTestDescription );

  /***************************************************************************************************************/    
                                              // Start of Test Case
  /***************************************************************************************************************/
  
  /***************************************************************************************************************/    
                                              // Test Step 1 PRECONDITIONS
  /***************************************************************************************************************/
  
  snprintf( chActionText, elCount(chActionText), "Flash the Software and ECU is running"); 
  snprintf( chExpectedText, elCount(chExpectedText), "ECU should be in running state"); 
  TestStepAddActionExpected( chActionText, chExpectedText );

  A_DBGR_BreakpointDeleteAll();
  A_DBGR_R();

   /********************************************************************************************************************************************************************************************************************************************/    
               // Test Step 2 set breakpoint at line cybersec_features_test( void ) of the file test_spds_hwio.c
  /*********************************************************************************************************************************************************************************************************************************************/
   snprintf( chActionText, elCount(chActionText), "set breakpoint at line cybersec_features_test( void ) of the file test_spds_hwio.c"); 
  snprintf( chExpectedText, elCount(chExpectedText), "Verify Breakpoint got hit at function cybersec_features_test( void )"); 
 // TestStepAddActionExpected( chActionText, chExpectedText );
  //A_DBGR_R();
  A_DBGR_BreakpointSet("cybersec_features_test\\2");
  A_DBGR_Go();
  A_DBGR_Go();
  testWaitForTimeout(10000);
  E_DBGR_BreakpointCheckForHalt("cybersec_features_test\\2");
  
  
  snprintf( chActionText, elCount(chActionText), "verify var CysecFeatureNum should be set"); 
  snprintf( chExpectedText, elCount(chExpectedText), "var CysecFeatureNum  should be set"); 
  TestStepAddActionExpected( chActionText, chExpectedText );
  A_DBGR_VariableSet("CysecFeatureNum", "8");
  E_DBGR_VariableCheck("CysecFeatureNum",8, Equal);
  
  snprintf( chActionText, elCount(chActionText), "Delete all BP's"); 
  snprintf( chExpectedText, elCount(chExpectedText), "All BP's are deleted"); 
  TestStepAddActionExpected( chActionText, chExpectedText );
  A_DBGR_BreakpointDeleteAll();
   /********************************************************************************************************************************************************************************************************************************************/    
               // Test Step 3 set breakpoint at line SetHWIO_h_CSM_SymEncryptFinish( CsmConf_CsmJob_CsmJob_EncryptCBC_She_Key_004, App_au8Aes128CbcResult, &App_u32Aes128CbcResultSize ) of the file test_spds_hwio.c
  /*********************************************************************************************************************************************************************************************************************************************/
  
  snprintf( chActionText, elCount(chActionText), "set breakpoint at line SetHWIO_h_CSM_SymEncryptFinish( CsmConf_CsmJob_CsmJob_EncryptCBC_She_Key_004, App_au8Aes128CbcResult, &App_u32Aes128CbcResultSize ) of the file test_spds_hwio.c"); 
  snprintf( chExpectedText, elCount(chExpectedText), "set breakpoint at line SetHWIO_h_CSM_SymEncryptFinish( CsmConf_CsmJob_CsmJob_EncryptCBC_She_Key_004, App_au8Aes128CbcResult, &App_u32Aes128CbcResultSize )"); 
 // TestStepAddActionExpected( chActionText, chExpectedText );
  A_DBGR_BreakpointSet("App_SymKeyWrapSym\\25");
  A_DBGR_Go();
  A_DBGR_Go();
  E_DBGR_BreakpointCheckForHalt("App_SymKeyWrapSym\\25");
  
  
  
  snprintf( chActionText, elCount(chActionText), "verify var CSM_STATUS should be set"); 
  snprintf( chExpectedText, elCount(chExpectedText), "var CSM_STATUS should be set"); 
  TestStepAddActionExpected( chActionText, chExpectedText );
  //A_DBGR_VariableSet("CSM_STATUS", "0");
  E_DBGR_VariableCheck("CSM_STATUS",0, Equal); 
  
}



testcase To_Verify_CSM_Symmetric_Encrypt_Start()
{
  /***************************************************************************************************************/    
                                                // Variable Definition
  /***************************************************************************************************************/ 
  
  long var;
  
  /***************************************************************************************************************/    
                                               // Local Values
  /***************************************************************************************************************/ 
  

  
  /***************************************************************************************************************/    
                                              // Test Case Info
  /***************************************************************************************************************/
  setWriteDbgLevel(DebugOff);
  snprintf( chTestTitle, elCount(chTestTitle), "To_Verify_CSM_Symmetric_Encrypt_Start" );
  snprintf( chTestDescription, elCount(chTestDescription), "Purpose:To_Verify_CSM_Symmetric_Encrypt_Start");
  TestCaseAddInfo( chTestTitle, "TC_L30SW_IT_37285169", chTestDescription );

  /***************************************************************************************************************/    
                                              // Start of Test Case
  /***************************************************************************************************************/
  
  /***************************************************************************************************************/    
                                              // Test Step 1 PRECONDITIONS
  /***************************************************************************************************************/
  
  snprintf( chActionText, elCount(chActionText), "Flash the Software and ECU is running"); 
  snprintf( chExpectedText, elCount(chExpectedText), "ECU should be in running state"); 
  TestStepAddActionExpected( chActionText, chExpectedText );

  A_DBGR_BreakpointDeleteAll();
   A_DBGR_R();
   /********************************************************************************************************************************************************************************************************************************************/    
               // Test Step 2 set breakpoint at line cybersec_features_test( void ) of the file test_spds_hwio.c
  /*********************************************************************************************************************************************************************************************************************************************/
   snprintf( chActionText, elCount(chActionText), "set breakpoint at line cybersec_features_test( void ) of the file test_spds_hwio.c"); 
  snprintf( chExpectedText, elCount(chExpectedText), "Verify Breakpoint got hit at function cybersec_features_test( void )"); 
 // TestStepAddActionExpected( chActionText, chExpectedText );
  //A_DBGR_R();
  A_DBGR_BreakpointSet("cybersec_features_test\\2");
  A_DBGR_Go();
  A_DBGR_Go();
  testWaitForTimeout(10000);
  E_DBGR_BreakpointCheckForHalt("cybersec_features_test\\2");
  
  
  snprintf( chActionText, elCount(chActionText), "verify var CysecFeatureNum should be set"); 
  snprintf( chExpectedText, elCount(chExpectedText), "var CysecFeatureNum  should be set"); 
  TestStepAddActionExpected( chActionText, chExpectedText );
  A_DBGR_VariableSet("CysecFeatureNum", "8");
  E_DBGR_VariableCheck("CysecFeatureNum",8, Equal);
  
  snprintf( chActionText, elCount(chActionText), "Delete all BP's"); 
  snprintf( chExpectedText, elCount(chExpectedText), "All BP's are deleted"); 
  TestStepAddActionExpected( chActionText, chExpectedText );
  A_DBGR_BreakpointDeleteAll();
   /********************************************************************************************************************************************************************************************************************************************/    
               // Test Step 3 set breakpoint at line SetHWIO_h_CSM_SymEncryptStart( CsmConf_CsmJob_CsmJob_EncryptCBC_She_Key_004, &key, &initvector, initvectorlen ) of the file test_spds_hwio.c
  /*********************************************************************************************************************************************************************************************************************************************/
  
  snprintf( chActionText, elCount(chActionText), "set breakpoint at line SetHWIO_h_CSM_SymEncryptStart( CsmConf_CsmJob_CsmJob_EncryptCBC_She_Key_004, &key, &initvector, initvectorlen ) of the file test_spds_hwio.c"); 
  snprintf( chExpectedText, elCount(chExpectedText), "set breakpoint at line SetHWIO_h_CSM_SymEncryptStart( CsmConf_CsmJob_CsmJob_EncryptCBC_She_Key_004, &key, &initvector, initvectorlen )"); 
 // TestStepAddActionExpected( chActionText, chExpectedText );
  A_DBGR_BreakpointSet("App_SymKeyWrapSym\\23");
  A_DBGR_Go();
   A_DBGR_Go();
  E_DBGR_BreakpointCheckForHalt("App_SymKeyWrapSym\\23");
  
  
  
  snprintf( chActionText, elCount(chActionText), "verify var CSM_STATUS should be set"); 
  snprintf( chExpectedText, elCount(chExpectedText), "var CSM_STATUS should be set"); 
  TestStepAddActionExpected( chActionText, chExpectedText );
  //A_DBGR_VariableSet("CSM_STATUS", "0");
  E_DBGR_VariableCheck("CSM_STATUS",0, Equal); 
  
  
}


