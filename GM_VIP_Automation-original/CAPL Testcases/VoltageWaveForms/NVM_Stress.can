/*@!Encoding:65001*/
/* ============================================================================
   NVM Stress Test Scenario - CVADAS_MAGNA 
   ----------------------------------------------------------------------------
   Description: Syntax-error-free template. Uses raw CAN messages (UDS) 
   to guarantee a clean compile in vTestStudio without a CDD attached.
   Utilizes Service 0x2E/0x22 on DID 0xFD1E (FD1E_OvrWriteSts).
============================================================================ */

variables
{
  const int kMAX_STRESS_CYCLES = 10000;
  const int kTIMEOUT_MS = 5000;
  const int kBOOT_WAIT_MS = 2000;
  
  // UDS CAN IDs (Update to match physical addressing for the CVADAS ECU)
  const dword kDIAG_REQ_ID = 0x7E0; 
  const dword kDIAG_RES_ID = 0x7E8; 

  // Power supply control – BK Precision 1687B connected via RS232 (COM4)
  // Matches the power-supply COM port used in PowerCrankTest_FullStress.can
  const dword kNVM_PS_COM_PORT   = 4;    // COM4: BK Precision 1687B
  const byte  kNVM_PS_CR         = 0x0D; // Command terminator (carriage return)
  float       gNVM_VoltageNormal = 12.3; // Nominal ECU operating voltage (V)
  int         gNVM_PsPortOpen    = 0;    // 1 when COM port is open
}

export testcase tc_NVM_Stress_FD1E_Block()
{
  int cycle;
  long testStatus;
  
  // Raw UDS Requests (Single Frame)
  // 1. Write Data By Identifier (0x2E) to DID 0xFD1E
  message kDIAG_REQ_ID msgWrite = {dlc = 8, byte(0) = 0x05, byte(1) = 0x2E, byte(2) = 0xFD, byte(3) = 0x1E, byte(4) = 0xAA, byte(5) = 0x00, byte(6) = 0x00, byte(7) = 0x00};
  
  // 2. ECU Reset (0x11) - Hard Reset (0x01)
  message kDIAG_REQ_ID msgReset = {dlc = 8, byte(0) = 0x02, byte(1) = 0x11, byte(2) = 0x01, byte(3) = 0x00, byte(4) = 0x00, byte(5) = 0x00, byte(6) = 0x00, byte(7) = 0x00};
  
  // 3. Read Data By Identifier (0x22) from DID 0xFD1E
  message kDIAG_REQ_ID msgRead  = {dlc = 8, byte(0) = 0x03, byte(1) = 0x22, byte(2) = 0xFD, byte(3) = 0x1E, byte(4) = 0x00, byte(5) = 0x00, byte(6) = 0x00, byte(7) = 0x00};
  
  TestCaseTitle("tc_NVM_Stress_CVADAS", "NVM Stress Test - CVADAS_MAGNA Variant");
  TestCaseDescription("Stress test NVM by repeatedly writing to DID 0xFD1E, resetting, and verifying data.");

  for (cycle = 1; cycle <= kMAX_STRESS_CYCLES; ++cycle)
  {
    char cycleStr[32];
    snprintf(cycleStr, elcount(cycleStr), "Cycle %d / %d", cycle, kMAX_STRESS_CYCLES);
    TestStep("Cycle_Start", cycleStr);

    // ------------------------------------------------------------------
    // STEP 1: Write Data to NVM (Toggle payload to force flash wear)
    // ------------------------------------------------------------------
    if (cycle % 2 == 0) msgWrite.byte(4) = 0xAA;
    else                msgWrite.byte(4) = 0x55;

    output(msgWrite);
    testStatus = testWaitForMessage(kDIAG_RES_ID, kTIMEOUT_MS);
    
    if (testStatus != 1)
    {
      TestStepFail("Write_NVM", "ECU did not respond to Write request on DID 0xFD1E.");
      break; 
    }

    // ------------------------------------------------------------------
    // STEP 2: Trigger ECU Reset 
    // ------------------------------------------------------------------
    output(msgReset);
    testWaitForMessage(kDIAG_RES_ID, kTIMEOUT_MS); 
    testWaitForTimeout(kBOOT_WAIT_MS);

    // ------------------------------------------------------------------
    // STEP 3: Read Data from NVM and Verify
    // ------------------------------------------------------------------
    output(msgRead);
    testStatus = testWaitForMessage(kDIAG_RES_ID, kTIMEOUT_MS);
    
    if (testStatus == 1)
    {
      message kDIAG_RES_ID rxMsg;
      testGetWaitEventMsgData(rxMsg);
      
      // Verify byte 4 of the Read response matches what was written
      if ((cycle % 2 == 0 && rxMsg.byte(4) == 0xAA) || 
          (cycle % 2 != 0 && rxMsg.byte(4) == 0x55))
      {
        TestStepPass("Read_NVM", "Data read matches written data for DID 0xFD1E.");
      }
      else
      {
        TestStepFail("Read_NVM", "NVM Corruption detected on DID 0xFD1E!");
        
        // Optional: Trigger TRACE32 Debugger Halt
        // sysSetVariable(sysvar::VTS::TriggerOutPin, 1); 
        
        break; 
      }
    }
    else
    {
      TestStepFail("Read_NVM", "ECU did not respond to Read request after reset.");
      break;
    }
  }
}

/* ============================================================================
   POWER SUPPLY HELPER FUNCTIONS
   BK Precision 1687B controlled via RS232 (same protocol as
   PowerCrankTest_FullStress.can).  All functions below are safe to call from
   any test-case context; they silently skip if the port was not opened.
============================================================================ */

dword NVM_PS_Open()
{
  dword res;

  if (gNVM_PsPortOpen) return 1;

  res = RS232Open(kNVM_PS_COM_PORT);
  if (res == 0)
  {
    write("NVM_PS: ERROR – cannot open COM%d", kNVM_PS_COM_PORT);
    return 0;
  }

  res = RS232Configure(kNVM_PS_COM_PORT, 9600, 8, 1, 0);
  if (res == 0)
  {
    write("NVM_PS: ERROR – cannot configure COM%d", kNVM_PS_COM_PORT);
    RS232Close(kNVM_PS_COM_PORT);
    return 0;
  }

  gNVM_PsPortOpen = 1;
  write("NVM_PS: COM%d opened (9600,8,1,N)", kNVM_PS_COM_PORT);
  return 1;
}

void NVM_PS_Close()
{
  if (gNVM_PsPortOpen)
  {
    RS232Close(kNVM_PS_COM_PORT);
    gNVM_PsPortOpen = 0;
    write("NVM_PS: COM%d closed", kNVM_PS_COM_PORT);
  }
}

dword NVM_PS_SendCmd(char cmd[])
{
  byte  buf[32];
  dword len;
  dword i;
  dword res;

  len = strlen(cmd);
  if (len > 30) len = 30;
  for (i = 0; i < len; i++) buf[i] = (byte)cmd[i];
  buf[len] = kNVM_PS_CR; // CR terminator required by BK Precision 1687B

  res = RS232Send(kNVM_PS_COM_PORT, buf, len + 1);
  if (res == 0) write("NVM_PS: Send failed – %s", cmd);
  return res;
}

dword NVM_PS_SetVoltage(float volts)
{
  char  cmd[16];
  dword v;

  if (volts < 6.0)  volts = 6.0;
  if (volts > 17.0) volts = 17.0;
  v = (dword)(volts * 10.0);
  snprintf(cmd, elcount(cmd), "VOLT%03d", v);
  write("NVM_PS: Voltage -> %.1f V (cmd: %s)", volts, cmd);
  return NVM_PS_SendCmd(cmd);
}

dword NVM_PS_OutputOn()
{
  write("NVM_PS: Output ON");
  return NVM_PS_SendCmd("SOUT0");
}

dword NVM_PS_OutputOff()
{
  write("NVM_PS: Output OFF");
  return NVM_PS_SendCmd("SOUT1");
}

// Full power cycle: off for offMs, restore voltage, on, wait bootWaitMs.
void NVM_PowerCycle(dword offMs, dword bootWaitMs)
{
  TestStep("PowerCycle", "ECU power OFF for %d ms", offMs);
  NVM_PS_OutputOff();
  testWaitForTimeout(offMs);
  NVM_PS_SetVoltage(gNVM_VoltageNormal);
  NVM_PS_OutputOn();
  TestStep("PowerCycle", "ECU power ON – waiting %d ms for boot", bootWaitMs);
  testWaitForTimeout(bootWaitMs);
}

/* ============================================================================
   TEST CASE: tc_NVM_Stress_PowerCycle_Mix
   Write / hard-reset / read-verify loop with periodic power cycling.
   Parameters:
     cycles             – total NVM write-read cycles
     powerCycleInterval – insert a full power cycle every N cycles (0 = disabled)
============================================================================ */
export testcase tc_NVM_Stress_PowerCycle_Mix(int cycles, int powerCycleInterval)
{
  int     cycle;
  int     failCount;
  long    txStatus;
  long    rxStatus;
  byte    writeByte;
  byte    readByte;
  char    cycleStr[48];
  message 0x7E0 msgExtSession;
  message 0x7E0 msgWrite;
  message 0x7E0 msgRead;
  message 0x7E0 msgReset;
  message 0x7E8 rxMsg;

  TestCaseTitle("tc_NVM_Stress_PowerCycle_Mix",
                "NVM Stress: Write/Read Cycles with Periodic Power Cycling");
  TestCaseDescription("Repeatedly writes alternating payloads to DID 0xFD1E, "
                      "issues a UDS Hard Reset (11 01), and reads back to verify "
                      "data integrity. Every <powerCycleInterval> cycles a full "
                      "power cycle via BK Precision 1687B is performed.");

  // Extended Diagnostic Session (10 03)
  msgExtSession.id      = kDIAG_REQ_ID; msgExtSession.dlc = 8;
  msgExtSession.byte(0) = 0x02; msgExtSession.byte(1) = 0x10;
  msgExtSession.byte(2) = 0x03; msgExtSession.byte(3) = 0x00;
  msgExtSession.byte(4) = 0x00; msgExtSession.byte(5) = 0x00;
  msgExtSession.byte(6) = 0x00; msgExtSession.byte(7) = 0x00;

  // Write Data By Identifier (2E FD1E <payload> 00 00 00)
  msgWrite.id      = kDIAG_REQ_ID; msgWrite.dlc = 8;
  msgWrite.byte(0) = 0x05; msgWrite.byte(1) = 0x2E;
  msgWrite.byte(2) = 0xFD; msgWrite.byte(3) = 0x1E;
  msgWrite.byte(4) = 0xAA; // toggled per cycle
  msgWrite.byte(5) = 0x00; msgWrite.byte(6) = 0x00; msgWrite.byte(7) = 0x00;

  // Read Data By Identifier (22 FD1E)
  msgRead.id      = kDIAG_REQ_ID; msgRead.dlc = 8;
  msgRead.byte(0) = 0x03; msgRead.byte(1) = 0x22;
  msgRead.byte(2) = 0xFD; msgRead.byte(3) = 0x1E;
  msgRead.byte(4) = 0x00; msgRead.byte(5) = 0x00;
  msgRead.byte(6) = 0x00; msgRead.byte(7) = 0x00;

  // ECU Reset – Hard Reset (11 01)
  msgReset.id      = kDIAG_REQ_ID; msgReset.dlc = 8;
  msgReset.byte(0) = 0x02; msgReset.byte(1) = 0x11;
  msgReset.byte(2) = 0x01; msgReset.byte(3) = 0x00;
  msgReset.byte(4) = 0x00; msgReset.byte(5) = 0x00;
  msgReset.byte(6) = 0x00; msgReset.byte(7) = 0x00;

  failCount = 0;

  if (NVM_PS_Open() == 1)
  {
    NVM_PS_SetVoltage(gNVM_VoltageNormal);
    NVM_PS_OutputOn();
    testWaitForTimeout(2000);
    TestStep("Setup", "Power supply ready at %.1f V", gNVM_VoltageNormal);
  }
  else
  {
    TestStep("Setup", "WARNING: Power supply not available – continuing without power control");
  }

  for (cycle = 1; cycle <= cycles; cycle++)
  {
    snprintf(cycleStr, elcount(cycleStr), "Cycle %d of %d", cycle, cycles);
    TestStep("Iteration", cycleStr);

    writeByte = (cycle % 2 == 0) ? 0xAA : 0x55;
    msgWrite.byte(4) = writeByte;

    // Enter extended session (required for 0x2E write service)
    output(msgExtSession);
    testWaitForMessage(kDIAG_RES_ID, kTIMEOUT_MS);
    testWaitForTimeout(50);

    // Write DID 0xFD1E
    output(msgWrite);
    txStatus = testWaitForMessage(kDIAG_RES_ID, kTIMEOUT_MS);
    if (txStatus != 1)
    {
      TestStepFail("Write", "No ACK for Write 0xFD1E (cycle %d)", cycle);
      failCount++;
      continue;
    }
    TestStepPass("Write", "Write 0x%02X to DID 0xFD1E accepted", writeByte);

    // Hard reset to commit NVM and prove data survives reboot
    output(msgReset);
    testWaitForMessage(kDIAG_RES_ID, kTIMEOUT_MS);
    testWaitForTimeout(kBOOT_WAIT_MS);

    // Re-enter extended session after boot
    output(msgExtSession);
    testWaitForMessage(kDIAG_RES_ID, kTIMEOUT_MS);
    testWaitForTimeout(50);

    // Read back DID 0xFD1E
    output(msgRead);
    rxStatus = testWaitForMessage(kDIAG_RES_ID, kTIMEOUT_MS);
    if (rxStatus == 1)
    {
      testGetWaitEventMsgData(rxMsg);
      readByte = rxMsg.byte(4);
      if (readByte == writeByte)
      {
        TestStepPass("Verify", "DID 0xFD1E: 0x%02X matches written value", readByte);
      }
      else
      {
        TestStepFail("Verify", "NVM corruption: wrote 0x%02X, read 0x%02X",
                     writeByte, readByte);
        failCount++;
      }
    }
    else
    {
      TestStepFail("Read", "No response to Read DID 0xFD1E (cycle %d)", cycle);
      failCount++;
    }

    // Periodic power cycle
    if (gNVM_PsPortOpen == 1 && powerCycleInterval > 0 &&
        (cycle % powerCycleInterval == 0))
    {
      TestStep("PowerCycle", "Inserting power cycle at cycle %d", cycle);
      NVM_PowerCycle(3000, kBOOT_WAIT_MS + 3000);
    }
  }

  NVM_PS_Close();

  if (failCount == 0)
    TestStepPass("Summary", "PASS: All %d NVM cycles completed without errors.", cycles);
  else
    TestStepFail("Summary", "FAIL: %d errors in %d NVM cycles.", failCount, cycles);
}

/* ============================================================================
   TEST CASE: tc_NVM_Stress_BrownOut
   Write NVM at nominal voltage, then ramp voltage down/up while reading back.
   Detects NVM / ECU instability under power-supply brownout conditions.
   Parameter: cycles – number of full brownout sweep iterations.
============================================================================ */
export testcase tc_NVM_Stress_BrownOut(int cycles)
{
  int     cycle;
  int     failCount;
  long    txStatus;
  long    rxStatus;
  byte    writeByte;
  float   v;
  char    stepStr[48];
  message 0x7E0 msgExtSession;
  message 0x7E0 msgWrite;
  message 0x7E0 msgRead;
  message 0x7E8 rxMsg;

  TestCaseTitle("tc_NVM_Stress_BrownOut",
                "NVM Stress with Brownout Voltage Ramp");
  TestCaseDescription("Writes to DID 0xFD1E at nominal voltage, then ramps the "
                      "supply from 12 V down to 7 V and back up, issuing read "
                      "requests at each step. Final read-back after recovery "
                      "verifies NVM data survived the brownout.");

  msgExtSession.id      = kDIAG_REQ_ID; msgExtSession.dlc = 8;
  msgExtSession.byte(0) = 0x02; msgExtSession.byte(1) = 0x10;
  msgExtSession.byte(2) = 0x03; msgExtSession.byte(3) = 0x00;
  msgExtSession.byte(4) = 0x00; msgExtSession.byte(5) = 0x00;
  msgExtSession.byte(6) = 0x00; msgExtSession.byte(7) = 0x00;

  msgWrite.id      = kDIAG_REQ_ID; msgWrite.dlc = 8;
  msgWrite.byte(0) = 0x05; msgWrite.byte(1) = 0x2E;
  msgWrite.byte(2) = 0xFD; msgWrite.byte(3) = 0x1E;
  msgWrite.byte(4) = 0xAA;
  msgWrite.byte(5) = 0x00; msgWrite.byte(6) = 0x00; msgWrite.byte(7) = 0x00;

  msgRead.id      = kDIAG_REQ_ID; msgRead.dlc = 8;
  msgRead.byte(0) = 0x03; msgRead.byte(1) = 0x22;
  msgRead.byte(2) = 0xFD; msgRead.byte(3) = 0x1E;
  msgRead.byte(4) = 0x00; msgRead.byte(5) = 0x00;
  msgRead.byte(6) = 0x00; msgRead.byte(7) = 0x00;

  failCount = 0;

  if (NVM_PS_Open() == 0)
  {
    TestStepFail("Setup",
                 "Power supply not available – brownout test requires power control");
    return;
  }

  NVM_PS_SetVoltage(gNVM_VoltageNormal);
  NVM_PS_OutputOn();
  testWaitForTimeout(2000);

  for (cycle = 1; cycle <= cycles; cycle++)
  {
    snprintf(stepStr, elcount(stepStr), "Brownout cycle %d of %d", cycle, cycles);
    TestStep("BrownOut", stepStr);

    // Alternate write payload each cycle
    writeByte = (cycle % 2 == 0) ? 0xC3 : 0x3C;
    msgWrite.byte(4) = writeByte;

    // Write at nominal voltage
    output(msgExtSession);
    testWaitForMessage(kDIAG_RES_ID, kTIMEOUT_MS);
    testWaitForTimeout(50);

    output(msgWrite);
    txStatus = testWaitForMessage(kDIAG_RES_ID, kTIMEOUT_MS);
    if (txStatus != 1)
    {
      TestStepFail("Write",
                   "Write failed at nominal voltage (cycle %d)", cycle);
      failCount++;
      NVM_PS_SetVoltage(gNVM_VoltageNormal);
      continue;
    }
    TestStepPass("Write", "DID 0xFD1E write 0x%02X accepted at %.1f V",
                 writeByte, gNVM_VoltageNormal);

    // Ramp DOWN 12 V → 7 V in 0.5 V steps, reading back at each step
    TestStep("Ramp_Down", "Ramping voltage down to 7.0 V");
    for (v = gNVM_VoltageNormal; v >= 7.0; v -= 0.5)
    {
      NVM_PS_SetVoltage(v);
      testWaitForTimeout(500);

      output(msgExtSession);
      testWaitForMessage(kDIAG_RES_ID, 1000);
      testWaitForTimeout(50);

      output(msgRead);
      rxStatus = testWaitForMessage(kDIAG_RES_ID, 1000);
      if (rxStatus == 1)
      {
        testGetWaitEventMsgData(rxMsg);
        if (rxMsg.byte(4) != writeByte)
        {
          TestStepFail("BrownOut_Read",
                       "NVM mismatch at %.1f V: wrote 0x%02X, read 0x%02X",
                       v, writeByte, rxMsg.byte(4));
          failCount++;
        }
      }
      // No response during deep brownout is acceptable – ECU may have reset
    }

    // Ramp back UP 7 V → 12 V
    TestStep("Ramp_Up", "Ramping voltage back to %.1f V", gNVM_VoltageNormal);
    for (v = 7.0; v <= gNVM_VoltageNormal; v += 0.5)
    {
      NVM_PS_SetVoltage(v);
      testWaitForTimeout(300);
    }
    NVM_PS_SetVoltage(gNVM_VoltageNormal);
    testWaitForTimeout(kBOOT_WAIT_MS);

    // Final verification after recovery
    output(msgExtSession);
    testWaitForMessage(kDIAG_RES_ID, kTIMEOUT_MS);
    testWaitForTimeout(50);

    output(msgRead);
    rxStatus = testWaitForMessage(kDIAG_RES_ID, kTIMEOUT_MS);
    if (rxStatus == 1)
    {
      testGetWaitEventMsgData(rxMsg);
      if (rxMsg.byte(4) == writeByte)
        TestStepPass("Recovery",
                     "NVM intact after brownout: 0x%02X", rxMsg.byte(4));
      else
      {
        TestStepFail("Recovery",
                     "NVM corrupted after brownout: wrote 0x%02X, read 0x%02X",
                     writeByte, rxMsg.byte(4));
        failCount++;
      }
    }
    else
    {
      TestStepFail("Recovery",
                   "No UDS response after brownout recovery (cycle %d)", cycle);
      failCount++;
    }
  }

  NVM_PS_SetVoltage(gNVM_VoltageNormal);
  NVM_PS_Close();

  if (failCount == 0)
    TestStepPass("Summary",
                 "PASS: %d brownout cycles completed – no NVM errors.", cycles);
  else
    TestStepFail("Summary",
                 "FAIL: %d NVM errors in %d brownout cycles.", failCount, cycles);
}

/* ============================================================================
   TEST CASE: tc_NVM_Stress_MultiDID_Soak
   Stress three adjacent NVM DIDs (0xFD1E, 0xFD1F, 0xFD20) with rotating
   payloads, hard resets, and periodic power cycles.
   Parameter: cycles – total iterations over all three DIDs.
============================================================================ */
export testcase tc_NVM_Stress_MultiDID_Soak(int cycles)
{
  int     cycle;
  int     d;
  int     failCount;
  long    rxStatus;
  byte    writeVals[3];
  word    dids[3];
  char    didStr[16];
  message 0x7E0 msgExtSession;
  message 0x7E0 msgWrite;
  message 0x7E0 msgRead;
  message 0x7E0 msgReset;
  message 0x7E8 rxMsg;

  TestCaseTitle("tc_NVM_Stress_MultiDID_Soak",
                "Multi-DID NVM Soak Test with Power Cycles");
  TestCaseDescription("Writes unique rotating byte patterns to DID 0xFD1E, 0xFD1F, "
                      "and 0xFD20. Issues a UDS Hard Reset (11 01) after each write "
                      "group, then reads back all three DIDs to verify integrity. "
                      "A full power cycle is inserted every 50 iterations.");

  dids[0] = 0xFD1E;
  dids[1] = 0xFD1F;
  dids[2] = 0xFD20;

  msgExtSession.id      = kDIAG_REQ_ID; msgExtSession.dlc = 8;
  msgExtSession.byte(0) = 0x02; msgExtSession.byte(1) = 0x10;
  msgExtSession.byte(2) = 0x03; msgExtSession.byte(3) = 0x00;
  msgExtSession.byte(4) = 0x00; msgExtSession.byte(5) = 0x00;
  msgExtSession.byte(6) = 0x00; msgExtSession.byte(7) = 0x00;

  msgWrite.id      = kDIAG_REQ_ID; msgWrite.dlc = 8;
  msgWrite.byte(0) = 0x05; msgWrite.byte(1) = 0x2E;
  msgWrite.byte(5) = 0x00; msgWrite.byte(6) = 0x00; msgWrite.byte(7) = 0x00;

  msgRead.id      = kDIAG_REQ_ID; msgRead.dlc = 8;
  msgRead.byte(0) = 0x03; msgRead.byte(1) = 0x22;
  msgRead.byte(4) = 0x00; msgRead.byte(5) = 0x00;
  msgRead.byte(6) = 0x00; msgRead.byte(7) = 0x00;

  msgReset.id      = kDIAG_REQ_ID; msgReset.dlc = 8;
  msgReset.byte(0) = 0x02; msgReset.byte(1) = 0x11;
  msgReset.byte(2) = 0x01; msgReset.byte(3) = 0x00;
  msgReset.byte(4) = 0x00; msgReset.byte(5) = 0x00;
  msgReset.byte(6) = 0x00; msgReset.byte(7) = 0x00;

  failCount = 0;

  if (NVM_PS_Open() == 1)
  {
    NVM_PS_SetVoltage(gNVM_VoltageNormal);
    NVM_PS_OutputOn();
    testWaitForTimeout(2000);
  }

  for (cycle = 1; cycle <= cycles; cycle++)
  {
    TestStep("Iteration", "Multi-DID soak cycle %d of %d", cycle, cycles);

    // Rotating test patterns – maximise flash wear and inter-DID crosstalk stress
    writeVals[0] = (byte)(0xA0 + (cycle % 16));
    writeVals[1] = (byte)(0xB0 + (cycle % 16));
    writeVals[2] = (byte)(0xC0 + (cycle % 16));

    // Write all three DIDs
    for (d = 0; d < 3; d++)
    {
      output(msgExtSession);
      testWaitForMessage(kDIAG_RES_ID, kTIMEOUT_MS);
      testWaitForTimeout(50);

      msgWrite.byte(2) = (byte)(dids[d] >> 8);
      msgWrite.byte(3) = (byte)(dids[d] & 0xFF);
      msgWrite.byte(4) = writeVals[d];

      output(msgWrite);
      if (testWaitForMessage(kDIAG_RES_ID, kTIMEOUT_MS) != 1)
      {
        snprintf(didStr, elcount(didStr), "0x%04X", dids[d]);
        TestStepFail("Write",
                     "Write failed for DID %s (cycle %d)", didStr, cycle);
        failCount++;
      }
    }

    // Hard reset to commit NVM
    output(msgReset);
    testWaitForMessage(kDIAG_RES_ID, kTIMEOUT_MS);
    testWaitForTimeout(kBOOT_WAIT_MS);

    // Read back and verify all three DIDs
    for (d = 0; d < 3; d++)
    {
      output(msgExtSession);
      testWaitForMessage(kDIAG_RES_ID, kTIMEOUT_MS);
      testWaitForTimeout(50);

      msgRead.byte(2) = (byte)(dids[d] >> 8);
      msgRead.byte(3) = (byte)(dids[d] & 0xFF);

      output(msgRead);
      rxStatus = testWaitForMessage(kDIAG_RES_ID, kTIMEOUT_MS);
      snprintf(didStr, elcount(didStr), "0x%04X", dids[d]);

      if (rxStatus == 1)
      {
        testGetWaitEventMsgData(rxMsg);
        if (rxMsg.byte(4) == writeVals[d])
        {
          TestStepPass("Verify",
                       "DID %s: 0x%02X OK", didStr, writeVals[d]);
        }
        else
        {
          TestStepFail("Verify",
                       "DID %s corrupt: wrote 0x%02X, read 0x%02X",
                       didStr, writeVals[d], rxMsg.byte(4));
          failCount++;
        }
      }
      else
      {
        TestStepFail("Read",
                     "No response for DID %s read (cycle %d)", didStr, cycle);
        failCount++;
      }
    }

    // Power cycle every 50 iterations
    if (gNVM_PsPortOpen == 1 && (cycle % 50 == 0))
    {
      TestStep("PowerCycle", "Inserting power cycle at cycle %d", cycle);
      NVM_PowerCycle(3000, kBOOT_WAIT_MS + 3000);
    }
  }

  NVM_PS_Close();

  if (failCount == 0)
    TestStepPass("Summary",
                 "PASS: %d multi-DID soak cycles completed without errors.", cycles);
  else
    TestStepFail("Summary",
                 "FAIL: %d errors in %d multi-DID soak cycles.", failCount, cycles);
}

/* ============================================================================
   TEST CASE: tc_NVM_Stress_LongDuration
   Continuous overnight / multi-hour NVM stress test.
   Combines write -> hard-reset -> read-verify with a periodic power cycle.
   All results are appended to NVM_LongDuration_Log.txt in the project folder.
   Parameters:
     totalCycles        – total write/verify iterations
     powerCycleInterval – full power cycle every N cycles (0 = disabled)
============================================================================ */
export testcase tc_NVM_Stress_LongDuration(int totalCycles, int powerCycleInterval)
{
  int     cycle;
  int     passCount;
  int     failCount;
  long    rxStatus;
  byte    wByte;
  char    logMsg[128];
  char    logPath[256];
  dword   logHandle;
  message 0x7E0 msgExtSession;
  message 0x7E0 msgWrite;
  message 0x7E0 msgRead;
  message 0x7E0 msgReset;
  message 0x7E8 rxMsg;

  TestCaseTitle("tc_NVM_Stress_LongDuration",
                "Long-Duration NVM Stress (Write / Reset / Read / Power Cycle)");
  TestCaseDescription("Continuous stress designed for overnight bench runs. "
                      "Cycles through four payload values (0xAA, 0x55, 0xFF, 0x00) "
                      "on DID 0xFD1E with a UDS Hard Reset after every write. "
                      "Power cycles inserted at the configured interval. "
                      "Results logged to NVM_LongDuration_Log.txt.");

  msgExtSession.id      = kDIAG_REQ_ID; msgExtSession.dlc = 8;
  msgExtSession.byte(0) = 0x02; msgExtSession.byte(1) = 0x10;
  msgExtSession.byte(2) = 0x03; msgExtSession.byte(3) = 0x00;
  msgExtSession.byte(4) = 0x00; msgExtSession.byte(5) = 0x00;
  msgExtSession.byte(6) = 0x00; msgExtSession.byte(7) = 0x00;

  msgWrite.id      = kDIAG_REQ_ID; msgWrite.dlc = 8;
  msgWrite.byte(0) = 0x05; msgWrite.byte(1) = 0x2E;
  msgWrite.byte(2) = 0xFD; msgWrite.byte(3) = 0x1E;
  msgWrite.byte(5) = 0x00; msgWrite.byte(6) = 0x00; msgWrite.byte(7) = 0x00;

  msgRead.id      = kDIAG_REQ_ID; msgRead.dlc = 8;
  msgRead.byte(0) = 0x03; msgRead.byte(1) = 0x22;
  msgRead.byte(2) = 0xFD; msgRead.byte(3) = 0x1E;
  msgRead.byte(4) = 0x00; msgRead.byte(5) = 0x00;
  msgRead.byte(6) = 0x00; msgRead.byte(7) = 0x00;

  msgReset.id      = kDIAG_REQ_ID; msgReset.dlc = 8;
  msgReset.byte(0) = 0x02; msgReset.byte(1) = 0x11;
  msgReset.byte(2) = 0x01; msgReset.byte(3) = 0x00;
  msgReset.byte(4) = 0x00; msgReset.byte(5) = 0x00;
  msgReset.byte(6) = 0x00; msgReset.byte(7) = 0x00;

  passCount = 0;
  failCount = 0;

  // Open log file for the entire long-duration run
  getAbsFilePath("", logPath, elcount(logPath));
  strncat(logPath, "NVM_LongDuration_Log.txt",
          elcount(logPath) - strlen(logPath) - 1);
  logHandle = openFileWrite(logPath, 1); // append mode
  if (logHandle != 0)
  {
    filePutString("=== NVM Long Duration Stress Log ===\n", 37, logHandle);
    snprintf(logMsg, elcount(logMsg),
             "Target: %d cycles, power-cycle every %d\n",
             totalCycles, powerCycleInterval);
    filePutString(logMsg, strlen(logMsg), logHandle);
  }

  if (NVM_PS_Open() == 1)
  {
    NVM_PS_SetVoltage(gNVM_VoltageNormal);
    NVM_PS_OutputOn();
    testWaitForTimeout(2000);
    TestStep("Setup", "Power supply ready at %.1f V", gNVM_VoltageNormal);
  }
  else
  {
    TestStep("Setup",
             "WARNING: No power supply – proceeding without power cycling");
  }

  write("NVM Long Duration: starting %d cycles (power cycle interval: %d)",
        totalCycles, powerCycleInterval);

  for (cycle = 1; cycle <= totalCycles; cycle++)
  {
    // Four-pattern rotation maximises flash-cell wear
    if      (cycle % 4 == 1) wByte = 0xAA;
    else if (cycle % 4 == 2) wByte = 0x55;
    else if (cycle % 4 == 3) wByte = 0xFF;
    else                     wByte = 0x00;

    msgWrite.byte(4) = wByte;

    // Enter extended session
    output(msgExtSession);
    testWaitForMessage(kDIAG_RES_ID, kTIMEOUT_MS);
    testWaitForTimeout(50);

    // Write
    output(msgWrite);
    if (testWaitForMessage(kDIAG_RES_ID, kTIMEOUT_MS) != 1)
    {
      TestStepFail("Write", "No ACK for write (cycle %d)", cycle);
      failCount++;
      if (logHandle != 0)
      {
        snprintf(logMsg, elcount(logMsg), "FAIL Write cycle %d\n", cycle);
        filePutString(logMsg, strlen(logMsg), logHandle);
      }
      continue;
    }

    // Hard reset
    output(msgReset);
    testWaitForMessage(kDIAG_RES_ID, kTIMEOUT_MS);
    testWaitForTimeout(kBOOT_WAIT_MS);

    // Re-enter extended session after boot
    output(msgExtSession);
    testWaitForMessage(kDIAG_RES_ID, kTIMEOUT_MS);
    testWaitForTimeout(50);

    // Read back and verify
    output(msgRead);
    rxStatus = testWaitForMessage(kDIAG_RES_ID, kTIMEOUT_MS);
    if (rxStatus == 1)
    {
      testGetWaitEventMsgData(rxMsg);
      if (rxMsg.byte(4) == wByte)
      {
        passCount++;
        // Log progress every 100 cycles to keep the log manageable
        if (cycle % 100 == 0)
        {
          TestStepPass("Progress",
                       "Cycle %d/%d – pass=%d, fail=%d",
                       cycle, totalCycles, passCount, failCount);
          if (logHandle != 0)
          {
            snprintf(logMsg, elcount(logMsg),
                     "Progress cycle %d: pass=%d fail=%d\n",
                     cycle, passCount, failCount);
            filePutString(logMsg, strlen(logMsg), logHandle);
          }
        }
      }
      else
      {
        TestStepFail("Verify",
                     "Cycle %d: wrote 0x%02X, read 0x%02X",
                     cycle, wByte, rxMsg.byte(4));
        failCount++;
        if (logHandle != 0)
        {
          snprintf(logMsg, elcount(logMsg),
                   "FAIL Verify cycle %d: wrote %02X read %02X\n",
                   cycle, wByte, rxMsg.byte(4));
          filePutString(logMsg, strlen(logMsg), logHandle);
        }
      }
    }
    else
    {
      TestStepFail("Read", "No response after reset (cycle %d)", cycle);
      failCount++;
    }

    // Periodic power cycle
    if (gNVM_PsPortOpen == 1 && powerCycleInterval > 0 &&
        (cycle % powerCycleInterval == 0))
    {
      TestStep("PowerCycle", "Inserting power cycle at cycle %d", cycle);
      NVM_PowerCycle(3000, kBOOT_WAIT_MS + 3000);
      if (logHandle != 0)
      {
        snprintf(logMsg, elcount(logMsg),
                 "POWER CYCLE at cycle %d\n", cycle);
        filePutString(logMsg, strlen(logMsg), logHandle);
      }
    }
  }

  NVM_PS_Close();

  if (logHandle != 0)
  {
    snprintf(logMsg, elcount(logMsg),
             "=== FINAL: pass=%d, fail=%d of %d cycles ===\n",
             passCount, failCount, totalCycles);
    filePutString(logMsg, strlen(logMsg), logHandle);
    fileClose(logHandle);
  }

  if (failCount == 0)
    TestStepPass("Final",
                 "PASS: All %d long-duration cycles completed. pass=%d",
                 totalCycles, passCount);
  else
    TestStepFail("Final",
                 "FAIL: %d errors in %d cycles. pass=%d, fail=%d",
                 failCount, totalCycles, passCount, failCount);
}