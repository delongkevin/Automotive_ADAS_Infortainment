/*@!Encoding:1252*/

includes
{
  #include "..\..\AutomationDependent\ProjectSpecific\GenLib_Includes.cin"
  #include "..\..\AutomationDependent\PowerSupply_libraries\Power_ctrl.can"
  #include "../../config.cin"
}

variables
{
  char chTestDescription[500];
  char chActionText[500];
  char chExpectedText[500];
  char chTestTitle[100];
  char canIdValue[256];
  int result;
  char searchString[256];
  char command[256];
  byte CANA_Wakeup[8] =  {0x08,0x00,0x00,0x00,0x00,0x00,0x00,0x01};
}

testcase Verify_that_the_GetHWIO_b_BatConnectionStatus_function_returns_0_when_the_battery_is_connected_voltage_is_in_the_normal_range()
{
  /***************************************************************************************************************/    
                                                // Variable Definition
  /***************************************************************************************************************/ 
  

  
  /***************************************************************************************************************/    
                                               // Local Values
  /***************************************************************************************************************/ 
  

  
  /***************************************************************************************************************/    
                                              // Test Case Info
  /***************************************************************************************************************/
  setWriteDbgLevel(DebugOff);
  snprintf( chTestTitle, elCount(chTestTitle), "Verify_that_the_GetHWIO_b_BatConnectionStatus_function_returns_0_when_the_battery_is_connected_voltage_is_in_the_normal_range" );
  snprintf( chTestDescription, elCount(chTestDescription), "Purpose:To check the GetHWIO_b_BatConnectionStatus interface  ");
  TestCaseAddInfo( chTestTitle, "TC_L30SW_Q-36548409", chTestDescription );

  /***************************************************************************************************************/    
                                              // Start of Test Case
  /***************************************************************************************************************/
  
  /***************************************************************************************************************/    
                                              // Test Step 0 PRECONDITIONS
  /***************************************************************************************************************/
   snprintf( chActionText, elCount(chActionText), "Flash the Software and ECU is running "); 
  snprintf( chExpectedText, elCount(chExpectedText), "Ecu is should be in running state"); 
  TestStepAddActionExpected( chActionText, chExpectedText );
  
  A_DBGR_BreakpointDeleteAll();
  A_DBGR_R();
   
  A_DBGR_Go();
  /***************************************************************************************************************/    
                                              // Test Step 1 Run the Software and capture UART log using python
  /***************************************************************************************************************/
  result = SysExec("powershell", "-ExecutionPolicy Bypass -File ./serial_logging.ps1", automation_root);

  A_GENERIC_SetTimeout(3000,"waiting for UART log");
  A_DBGR_Go();
  A_GENERIC_SetTimeout(3000,"waiting for UART log");
  write("result %d",result);
  /***************************************************************************************************************/    
    // Test Step 2 verify battConnectionStatus is having 0.
  /***************************************************************************************************************/ 
  strncpy(searchString,"test_battconnstatus_hwio:battConnectionStatus = 0",256);
  
  A_GENERIC_SetTimeout(25000,"waiting for UART log");
  
  snprintf(chActionText, elCount(chActionText), "Run Python script to check battConnectionStatus in log file");
  snprintf(chExpectedText, elCount(chExpectedText), "Python script should execute successfully");
  result =iFcnt_READFILE_SearchKeywordInFile(teraterm,searchString,"string is present");
  
  if(result == 1)
  {
    testStepPass("0","string is present");
  }
  else
  {
    testStepFail("1","string is not present");
  }
  
}
testcase Verify_that_the_GetHWIO_b_BatConnectionStatus_function_returns_1_when_the_battery_is_disconnected()
{
    /***************************************************************************************************************/    
                                                // Variable Definition
  /***************************************************************************************************************/ 
  

  
  /***************************************************************************************************************/    
                                               // Local Values
  /***************************************************************************************************************/ 
  

  
  /***************************************************************************************************************/    
                                              // Test Case Info
  /***************************************************************************************************************/
  setWriteDbgLevel(DebugOff);
  snprintf( chTestTitle, elCount(chTestTitle), "Verify_that_the_GetHWIO_b_BatConnectionStatus_function_returns_1_when_the_battery_is_disconnected" );
  snprintf( chTestDescription, elCount(chTestDescription), "Purpose:To check the GetHWIO_b_BatConnectionStatus interface  ");
  TestCaseAddInfo( chTestTitle, "TC_L30SW_Q-36548410", chTestDescription );

  /***************************************************************************************************************/    
                                              // Start of Test Case
  /***************************************************************************************************************/
  
  /***************************************************************************************************************/    
                                              // Test Step 0 PRECONDITIONS
  /***************************************************************************************************************/
  snprintf( chActionText, elCount(chActionText), "Flash the Software and ECU is running "); 
  snprintf( chExpectedText, elCount(chExpectedText), "Ecu is should be in running state"); 
  TestStepAddActionExpected( chActionText, chExpectedText );
  A_DBGR_BreakpointDeleteAll();
  
  snprintf( chActionText, elCount(chActionText), "Flash the Software and ECU is running "); 
  snprintf( chExpectedText, elCount(chExpectedText), "Ecu is should be in running state"); 
  
  A_DBGR_R();
  A_DBGR_Go_Safe();
  /***************************************************************************************************************/    
                                              // Test Step 1 Run the Software and capture UART log using python
  /***************************************************************************************************************/
  
  result = SysExec("powershell", "-ExecutionPolicy Bypass -File ./serial_logging.ps1", automation_root);
  A_GENERIC_SetTimeout(3000,"waiting for UART log");
  snprintf( chActionText, elCount(chActionText), "Flash the Software and ECU is running "); 
  snprintf( chExpectedText, elCount(chExpectedText), "Ecu is should be in running state"); 
  //TestStepAddActionExpected( chActionText, chExpectedText );
  A_DBGR_Go();
  /***************************************************************************************************************/
                                              // Test Step 2 Disconnect the Battery and verify battery is disconnected
  /***************************************************************************************************************/
  Power_OFF_ON(powersupply_port,0);
  A_GENERIC_SetTimeout(2000,"waiting for battery disconnect");
  
  /***************************************************************************************************************/    
                                              // Test Step 3 Reconnect the battery power and set the supply voltage to 12V.
  /***************************************************************************************************************/
  Power_OFF_ON(powersupply_port,1);
  
  /***************************************************************************************************************/    
    // Test Step 4 verify battConnectionStatus is having 1.
  /***************************************************************************************************************/ 
  strncpy(searchString,"test_battconnstatus_hwio:battConnectionStatus = 1",256);
  A_GENERIC_SetTimeout(25000,"waiting for UART log");
  
  snprintf(chActionText, elCount(chActionText), "Run Python script to check battConnectionStatus in log file");
  snprintf(chExpectedText, elCount(chExpectedText), "Python script should execute successfully");
  result =iFcnt_READFILE_SearchKeywordInFile(teraterm,searchString,"string is present");
  
  if(result == 1)
  {
    testStepPass("0","string is present");
  }
  else
  {
    testStepFail("1","string is not present");
  }
}

testcase Verify_that_the_BATTERY_DISCONNECT_status_is_retained_over_all_conditions_unless_cleared_by_the_ClrHWIO_BatConnectionStatus()
{
    /***************************************************************************************************************/    
                                                // Variable Definition
  /***************************************************************************************************************/ 
  

  
  /***************************************************************************************************************/    
                                               // Local Values
  /***************************************************************************************************************/ 
  

  
  /***************************************************************************************************************/    
                                              // Test Case Info
  /***************************************************************************************************************/
  setWriteDbgLevel(DebugOff);
  snprintf( chTestTitle, elCount(chTestTitle), "Verify_that_the_BATTERY_DISCONNECT_status_is_retained_over_all_conditions_unless_cleared_by_the_ClrHWIO_BatConnectionStatus" );
  snprintf( chTestDescription, elCount(chTestDescription), "Purpose:To check the GetHWIO_b_BatConnectionStatus interface  ");
  TestCaseAddInfo( chTestTitle, "TC_L30SW_Q-36548411", chTestDescription );

  /***************************************************************************************************************/    
                                              // Start of Test Case
  /***************************************************************************************************************/
  
  /***************************************************************************************************************/    
                                              // Test Step 0 PRECONDITIONS
  /***************************************************************************************************************/
  A_DBGR_BreakpointDeleteAll();
  A_DBGR_R();
  /***************************************************************************************************************/
                                              // Test Step 1 Disconnect the Battery
  /***************************************************************************************************************/
  Power_OFF_ON(powersupply_port,0);
  A_GENERIC_SetTimeout(2000,"waiting for battery disconnect");
  
  /***************************************************************************************************************/    
                                              // Test Step 2 Run the Software and capture UART log using python
  /***************************************************************************************************************/
  
  result = SysExec("powershell", "-ExecutionPolicy Bypass -File ./serial_logging.ps1", automation_root);
  A_GENERIC_SetTimeout(3000,"waiting for UART log");
  
  /***************************************************************************************************************/    
                              // Test Step 3 Reconnect the battery power and set the supply voltage to 12V.
  /***************************************************************************************************************/
  Power_OFF_ON(powersupply_port,1);
  
  /***************************************************************************************************************/    
                          // Test Step 4 verify test_battconnstatus_hwio:Clear Battery Connection Status
  /***************************************************************************************************************/ 
  strncpy(searchString,"test_battconnstatus_hwio:Clear Battery Connection Status",256);
  A_GENERIC_SetTimeout(25000,"waiting for UART log");
  
  snprintf(chActionText, elCount(chActionText), "Run Python script to check battConnectionStatus in log file");
  snprintf(chExpectedText, elCount(chExpectedText), "Python script should execute successfully");
  result =iFcnt_READFILE_SearchKeywordInFile(teraterm,searchString,"string is present");
  
  if(result == 1)
  {
    testStepPass("0","string is present");
  }
  else
  {
    testStepFail("1","string is not present");
  }
  
  /***************************************************************************************************************/    
                          // Test Step 5 verify test_battconnstatus_hwio:battConnectionStatus = 0 after Clear Battery Connection Status invoked
  /***************************************************************************************************************/ 
  
  strncpy(searchString,"test_battconnstatus_hwio:battConnectionStatus = 0",256);
  
  snprintf(chActionText, elCount(chActionText), "Run Python script to check battConnectionStatus in log file");
  snprintf(chExpectedText, elCount(chExpectedText), "Python script should execute successfully");
  result =iFcnt_READFILE_SearchKeywordInFile(teraterm,searchString,"string is present");
  
  if(result == 1)
  {
    testStepPass("0","string is present");
  }
  else
  {
    testStepFail("1","string is not present");
  }
}

testcase Verify_that_the_GetHWIO_b_BatConnectionStatus_function_returns_1_when_the_system_wakes_up_due_to_a_low_voltage_transient()
{
    /***************************************************************************************************************/    
                                                // Variable Definition
  /***************************************************************************************************************/ 
  

  
  /***************************************************************************************************************/    
                                               // Local Values
  /***************************************************************************************************************/ 
  

  
  /***************************************************************************************************************/    
                                              // Test Case Info
  /***************************************************************************************************************/
  setWriteDbgLevel(DebugOff);
  snprintf( chTestTitle, elCount(chTestTitle), "Verify_that_the_GetHWIO_b_BatConnectionStatus_function_returns_1_when_the_system_wakes_up_due_to_a_low_voltage_transient" );
  snprintf( chTestDescription, elCount(chTestDescription), "Purpose:To check the GetHWIO_b_BatConnectionStatus interface  ");
  TestCaseAddInfo( chTestTitle, "TC_L30SW_Q-36548412", chTestDescription );

  /***************************************************************************************************************/    
                                              // Start of Test Case
  /***************************************************************************************************************/
  
  /***************************************************************************************************************/    
                                              // Test Step 0 PRECONDITIONS
  /***************************************************************************************************************/
  snprintf( chActionText, elCount(chActionText), "Flash the Software and ECU is running "); 
  snprintf( chExpectedText, elCount(chExpectedText), "Ecu is should be in running state"); 
  //TestStepAddActionExpected( chActionText, chExpectedText );
  A_DBGR_BreakpointDeleteAll();
  A_DBGR_R();
  A_DBGR_Go();
  snprintf( chActionText, elCount(chActionText), "Flash the Software and ECU is running "); 
  snprintf( chExpectedText, elCount(chExpectedText), "Ecu is should be in running state"); 
  //TestStepAddActionExpected( chActionText, chExpectedText );
  A_DBGR_Go();
  /***************************************************************************************************************/    
                                              // Test Step 1 Set the power supply voltage to a value less than 3.7V to simulate a voltage level where MCU turns off.
  /***************************************************************************************************************/
  Set_voltage(powersupply_port,3.3);
  A_GENERIC_SetTimeout(2000,"waiting for battery disconnect");
  
  /***************************************************************************************************************/    
                                              // Test Step 2 Run the Software and capture UART log using python
  /***************************************************************************************************************/
  
  result = SysExec("powershell", "-ExecutionPolicy Bypass -File ./serial_logging.ps1", automation_root);
  A_GENERIC_SetTimeout(3000,"waiting for UART log");
  
  /***************************************************************************************************************/    
                              // Test Step 3 set the supply voltage to 12V.
  /***************************************************************************************************************/
  Set_voltage(powersupply_port,12);
  
  /***************************************************************************************************************/    
                          // Test Step 4 verify Power ON wakeup event found in transceiver 0 and Power ON wakeup event found in transceiver 1.
  /***************************************************************************************************************/ 
  strncpy(searchString,"Power ON wakeup event found in transceiver 0",256);
  A_GENERIC_SetTimeout(25000,"waiting for UART log");
  
  snprintf(chActionText, elCount(chActionText), "Run Python script to check battConnectionStatus in log file");
  snprintf(chExpectedText, elCount(chExpectedText), "Python script should execute successfully");
  result =iFcnt_READFILE_SearchKeywordInFile(teraterm,searchString,"string is present");
  
  if(result == 1)
  {
    testStepPass("0","string is present");
  }
  else
  {
    testStepFail("1","string is not present");
  }
  
  strncpy(searchString,"Power ON wakeup event found in transceiver 1",256);
  
  snprintf(chActionText, elCount(chActionText), "Run Python script to check battConnectionStatus in log file");
  snprintf(chExpectedText, elCount(chExpectedText), "Python script should execute successfully");
  result =iFcnt_READFILE_SearchKeywordInFile(teraterm,searchString,"string is present");
  
  if(result == 1)
  {
    testStepPass("0","string is present");
  }
  else
  {
    testStepFail("1","string is not present");
  }
  
  /***************************************************************************************************************/    
                          // Test Step 5 verify test_battconnstatus_hwio:battConnectionStatus = 0 after Clear Battery Connection Status invoked
  /***************************************************************************************************************/ 
  
  strncpy(searchString,"test_battconnstatus_hwio:battConnectionStatus = 1",256);
  
  snprintf(chActionText, elCount(chActionText), "Run Python script to check battConnectionStatus in log file");
  snprintf(chExpectedText, elCount(chExpectedText), "Python script should execute successfully");
  result =iFcnt_READFILE_SearchKeywordInFile(teraterm,searchString,"string is present");
  
  if(result == 1)
  {
    testStepPass("0","string is present");
  }
  else
  {
    testStepFail("1","string is not present");
  }
}

testcase Verify_GetHWIO_b_BatConnectionStatus_returns_0_when_system_wakes_up_due_to_wakeup_signal_and_not_due_to_a_battery_disconnect()
{
  /***************************************************************************************************************/    
                                                // Variable Definition
  /***************************************************************************************************************/ 
  

  
  /***************************************************************************************************************/    
                                               // Local Values
  /***************************************************************************************************************/ 
  

  
  /***************************************************************************************************************/    
                                              // Test Case Info
  /***************************************************************************************************************/
  setWriteDbgLevel(DebugOff);
  snprintf( chTestTitle, elCount(chTestTitle), "Verify_GetHWIO_b_BatConnectionStatus_returns_0_when_system_wakes_up_due_to_wakeup_signal_and_not_due_to_a_battery_disconnect" );
  snprintf( chTestDescription, elCount(chTestDescription), "Purpose:To check the GetHWIO_b_BatConnectionStatus interface ");
  TestCaseAddInfo( chTestTitle, "TC_L30SW_Q-36548413", chTestDescription );

  /***************************************************************************************************************/    
                                              // Start of Test Case
  /***************************************************************************************************************/
  
  /***************************************************************************************************************/    
                                              // Test Step 0 PRECONDITIONS
  /***************************************************************************************************************/
  snprintf( chActionText, elCount(chActionText), "Flash the Software and ECU is running "); 
  snprintf( chExpectedText, elCount(chExpectedText), "ECU should be in running state"); 
  //TestStepAddActionExpected( chActionText, chExpectedText );
  
  A_DBGR_BreakpointDeleteAll();
  
  snprintf( chActionText, elCount(chActionText), "Flash the Software and ECU is running "); 
  snprintf( chExpectedText, elCount(chExpectedText), "ECU should be in running state"); 
 
  A_DBGR_R();
  A_DBGR_Go();
  /***************************************************************************************************************/    
                                              // Test Step 1 Call the function MngCNDD_CanTrcvInitialize to initialize the CAN transceiver.
  /***************************************************************************************************************/
  snprintf( chActionText, elCount(chActionText), "Set Breakpoint TestCanTrcv_Init callback function "); 
  snprintf( chExpectedText, elCount(chExpectedText), "Breakpoint is Set in TestCanTrcv_Init"); 
  //TestStepAddActionExpected( chActionText, chExpectedText );   
  A_DBGR_BreakpointSet("TestCanTrcv_Init");  
  A_DBGR_Go();
  
  snprintf( chActionText, elCount(chActionText), "Verify Breakpoint should hit in TestCanTrcv_Init "); 
  snprintf( chExpectedText, elCount(chExpectedText), "Breakpoint hit in TestCanTrcv_Init function"); 
  //TestStepAddActionExpected( chActionText, chExpectedText );  
  E_DBGR_BreakpointCheckForHalt("TestCanTrcv_Init");
  
  /***************************************************************************************************************/    
                                              // Test Step 2 Configure the values for the structure TsCNDD_CanTrcvCnfgType for CAN2 Channel.
  /***************************************************************************************************************/
  snprintf( chActionText, elCount(chActionText), "Set Breakpoint in TestCan_Init "); 
  snprintf( chExpectedText, elCount(chExpectedText), "Verify Breakpoint is Set in TestCan_Init"); 
  TestStepAddActionExpected( chActionText, chExpectedText );  
  A_DBGR_BreakpointSet("TestCan_Init");  
  A_DBGR_Go();
  
  snprintf( chActionText, elCount(chActionText), "Verify Breakpoint should hit in TestCan_Init "); 
  snprintf( chExpectedText, elCount(chExpectedText), "Breakpoint hit in TestCan_Init function"); 
 // TestStepAddActionExpected( chActionText, chExpectedText );  
  E_DBGR_BreakpointCheckForHalt("TestCan_Init");
  
  snprintf( chActionText, elCount(chActionText), "Configure CanTrcvPnFrameDataMaskIndex variable"); 
  snprintf( chExpectedText, elCount(chExpectedText), "Verify CanTrcvPnFrameDataMaskIndex is configured as 0"); 
  TestStepAddActionExpected( chActionText, chExpectedText );
  A_DBGR_VariableSet("VsCANR_PnFrameData1[0].CanTrcvPnFrameDataMaskIndex","0");
  E_DBGR_VariableCheck("VsCANR_PnFrameData1[0].CanTrcvPnFrameDataMaskIndex",0,Equal);
  
  snprintf( chActionText, elCount(chActionText), "Configure CanTrcvPnFrameDataMask variable"); 
  snprintf( chExpectedText, elCount(chExpectedText), "Verify CanTrcvPnFrameDataMask is configured as 1"); 
  TestStepAddActionExpected( chActionText, chExpectedText );
  A_DBGR_VariableSet("VsCANR_PnFrameData1[0].CanTrcvPnFrameDataMask","1");
  E_DBGR_VariableCheck("VsCANR_PnFrameData1[0].CanTrcvPnFrameDataMask",1,Equal);
  
  snprintf( chActionText, elCount(chActionText), "Configure CanTrcvPnFrameDataMaskIndex variable"); 
  snprintf( chExpectedText, elCount(chExpectedText), "Verify CanTrcvPnFrameDataMaskIndex is configured as 7"); 
  TestStepAddActionExpected( chActionText, chExpectedText );
  A_DBGR_VariableSet("VsCANR_PnFrameData1[7].CanTrcvPnFrameDataMaskIndex","7");
  E_DBGR_VariableCheck("VsCANR_PnFrameData1[7].CanTrcvPnFrameDataMaskIndex",7,Equal);
  
  snprintf( chActionText, elCount(chActionText), "Configure CanTrcvPnFrameDataMask variable"); 
  snprintf( chExpectedText, elCount(chExpectedText), "Verify CanTrcvPnFrameDataMask is configured as 8"); 
  TestStepAddActionExpected( chActionText, chExpectedText );
  A_DBGR_VariableSet("VsCANR_PnFrameData1[7].CanTrcvPnFrameDataMask","8");
  E_DBGR_VariableCheck("VsCANR_PnFrameData1[7].CanTrcvPnFrameDataMask",8,Equal);
  
  snprintf( chActionText, elCount(chActionText), "Configure CanTrcvPnFrameCanId variable"); 
  snprintf( chExpectedText, elCount(chExpectedText), "Verify CanTrcvPnFrameCanId is configured as 0x123"); 
  TestStepAddActionExpected( chActionText, chExpectedText );
  A_DBGR_VariableSet("VsCANR_PnConfig[0].CanTrcvPnFrameCanId","0x123");
  E_DBGR_VariableCheck("VsCANR_PnConfig[0].CanTrcvPnFrameCanId",0x123,Equal);
  
  snprintf( chActionText, elCount(chActionText), "Configure CanTrcvPnFrameCanIdMask variable"); 
  snprintf( chExpectedText, elCount(chExpectedText), "Verify CanTrcvPnFrameCanIdMask is configured as 0"); 
  TestStepAddActionExpected( chActionText, chExpectedText );
  A_DBGR_VariableSet("VsCANR_PnConfig[0].CanTrcvPnFrameCanIdMask","0");
  E_DBGR_VariableCheck("VsCANR_PnConfig[0].CanTrcvPnFrameCanIdMask",0,Equal);
  
  snprintf( chActionText, elCount(chActionText), "Configure CanTrcvPnFrameIdType variable"); 
  snprintf( chExpectedText, elCount(chExpectedText), "Verify CanTrcvPnFrameIdType is configured as 0"); 
  TestStepAddActionExpected( chActionText, chExpectedText );
  A_DBGR_VariableSet("VsCANR_PnConfig[0].CanTrcvPnFrameIdType","0");
  E_DBGR_VariableCheck("VsCANR_PnConfig[0].CanTrcvPnFrameIdType",0,Equal);
  
  snprintf( chActionText, elCount(chActionText), "Configure CanTrcvPnFrameDlc variable"); 
  snprintf( chExpectedText, elCount(chExpectedText), "Verify CanTrcvPnFrameDlc is configured as 8"); 
  TestStepAddActionExpected( chActionText, chExpectedText );
  A_DBGR_VariableSet("VsCANR_PnConfig[0].CanTrcvPnFrameDlc","8");
  E_DBGR_VariableCheck("VsCANR_PnConfig[0].CanTrcvPnFrameDlc",8,Equal);
  
  snprintf( chActionText, elCount(chActionText), "Configure CanTrcvPnEnabled variable"); 
  snprintf( chExpectedText, elCount(chExpectedText), "Verify CanTrcvPnEnabled is configured as 1"); 
  TestStepAddActionExpected( chActionText, chExpectedText );
  A_DBGR_VariableSet("VsCANR_PnConfig[0].CanTrcvPnEnabled","1");
  E_DBGR_VariableCheck("VsCANR_PnConfig[0].CanTrcvPnEnabled",1,Equal);
  
  snprintf( chActionText, elCount(chActionText), "Configure CanTrcvChannelId variable"); 
  snprintf( chExpectedText, elCount(chExpectedText), "Verify CanTrcvChannelId is configured as 0"); 
  TestStepAddActionExpected( chActionText, chExpectedText );
  A_DBGR_VariableSet("VsCANR_TrcvChannels[0].CanTrcvChannelId","0");
  E_DBGR_VariableCheck("VsCANR_TrcvChannels[0].CanTrcvChannelId",0,Equal);
  
  snprintf( chActionText, elCount(chActionText), "Configure CanTrcvChannelUsed variable"); 
  snprintf( chExpectedText, elCount(chExpectedText), "Verify CanTrcvChannelUsed is configured as 1"); 
  TestStepAddActionExpected( chActionText, chExpectedText );
  A_DBGR_VariableSet("VsCANR_TrcvChannels[0].CanTrcvChannelUsed","1");
  E_DBGR_VariableCheck("VsCANR_TrcvChannels[0].CanTrcvChannelUsed",1,Equal);
  
  snprintf( chActionText, elCount(chActionText), "Configure CanTrcvPinWakeupEnabled variable"); 
  snprintf( chExpectedText, elCount(chExpectedText), "Verify CanTrcvPinWakeupEnabled is configured as 0"); 
  TestStepAddActionExpected( chActionText, chExpectedText );
  A_DBGR_VariableSet("VsCANR_TrcvChannels[0].CanTrcvPinWakeupEnabled","0");
  E_DBGR_VariableCheck("VsCANR_TrcvChannels[0].CanTrcvPinWakeupEnabled",0,Equal);
  
  snprintf( chActionText, elCount(chActionText), "Configure CanTrcvNumberOfChannels variable"); 
  snprintf( chExpectedText, elCount(chExpectedText), "Verify CanTrcvNumberOfChannels is configured as 2"); 
  TestStepAddActionExpected( chActionText, chExpectedText );
  A_DBGR_VariableSet("VsCANR_CanTrcvConfig.CanTrcvNumberOfChannels","2");
  E_DBGR_VariableCheck("VsCANR_CanTrcvConfig.CanTrcvNumberOfChannels",2,Equal);
  
  snprintf( chActionText, elCount(chActionText), "Flash the Software and ECU is running "); 
  snprintf( chExpectedText, elCount(chExpectedText), "ECU should be in running state"); 
  TestStepAddActionExpected( chActionText, chExpectedText );
  A_DBGR_Go();
  
  /***************************************************************************************************************/    
                                              // Test Step 3  Call the function Test_SetHWIO_PowerDown by setting StartPowerDown to 1 then check transceiver is in the SLEEP mode and PMIC to STANDBY mode
  /***************************************************************************************************************/
  snprintf( chActionText, elCount(chActionText), "Configure StartPowerDown variable to invoke Test_SetHWIO_PowerDown interface"); 
  snprintf( chExpectedText, elCount(chExpectedText), "Verify StartPowerDown is configured as 1"); 
  //TestStepAddActionExpected( chActionText, chExpectedText );
  A_DBGR_VariableSet("StartPowerDown","1");
 // E_DBGR_VariableCheck("StartPowerDown",1,Equal);
  
  snprintf( chActionText, elCount(chActionText), "Check Trace32 is stopped"); 
  snprintf( chExpectedText, elCount(chExpectedText), "Verify Trace32 is stopped"); 
  //TestStepAddActionExpected( chActionText, chExpectedText );
  E_DBGR_CheckState(T32_State_Down);
  
   /***************************************************************************************************************/    
                                              // Test Step 4 Run the Software and capture UART log using python
  /***************************************************************************************************************/
  
  SysExec("powershell", "-ExecutionPolicy Bypass -File ./serial_logging.ps1", automation_root);
  
  snprintf( chActionText, elCount(chActionText), "waiting for UART log"); 
  snprintf( chExpectedText, elCount(chExpectedText), "waiting for UART log"); 
  TestStepAddActionExpected( chActionText, chExpectedText );
  A_GENERIC_SetTimeout(3000,"waiting for UART log");
 
  
  /***************************************************************************************************************/    
                                              // Test Step 5  This step involves sending a CAN wakeup frame with ID 0x123 and 8 bytes of data from Canoe.
  /***************************************************************************************************************/
  snprintf( chActionText, elCount(chActionText), "Transmit CAN message. ID:0x123"); 
  snprintf( chExpectedText, elCount(chExpectedText), "CAN message transmitted. ID:0x123"); 
  //TestStepAddActionExpected( chActionText, chExpectedText );
  A_CAN_SendMessage(0x123, CANA_Wakeup, 8, 1);
  A_CAN_SendMessage(0x123, CANA_Wakeup, 8, 1);
  
  /***************************************************************************************************************/    
                                              // Test Step 6  Verify Transceiver wakeUp or not.
  /***************************************************************************************************************/
  snprintf( chActionText, elCount(chActionText), "Transmit CAN message. ID:0x40000101, PDU info:0x01"); 
  snprintf( chExpectedText, elCount(chExpectedText), "CAN message transmitted. ID:0x40000101, PDU info:0x01"); 
  //TestStepAddActionExpected( chActionText, chExpectedText ); 
  
  E_CAN_WaitForMessageByID(0x00000101,10000,cc_eCAN_PRESENT,"CAN1");
  
  /***************************************************************************************************************/    
                          // Test Step 7 verify test_battconnstatus_hwio:battConnectionStatus = 0
  /***************************************************************************************************************/ 
  strncpy(searchString,"test_battconnstatus_hwio:battConnectionStatus = 0",256);
  
  snprintf( chActionText, elCount(chActionText), "waiting for UART log"); 
  snprintf( chExpectedText, elCount(chExpectedText), "waiting for UART log"); 
  TestStepAddActionExpected( chActionText, chExpectedText );
  A_GENERIC_SetTimeout(25000,"waiting for UART log");
  
  snprintf(chActionText, elCount(chActionText), "Run Python script to check battConnectionStatus in log file");
  snprintf(chExpectedText, elCount(chExpectedText), "Python script should execute successfully");
  result =iFcnt_READFILE_SearchKeywordInFile(teraterm,searchString,"string is present");
  
  if(result == 1)
  {
    testStepPass("0","string is present");
  }
  else
  {
    testStepFail("1","string is not present");
  }
  
}

testcase Verify_that_the_BATTERY_CONNECT_status_is_retained_over_all_conditions_unless_a_battery_disconnection_event_occurs()
{
   /***************************************************************************************************************/    
                                                // Variable Definition
  /***************************************************************************************************************/ 
  

  
  /***************************************************************************************************************/    
                                               // Local Values
  /***************************************************************************************************************/ 
  

  
  /***************************************************************************************************************/    
                                              // Test Case Info
  /***************************************************************************************************************/
  setWriteDbgLevel(DebugOff);
  snprintf( chTestTitle, elCount(chTestTitle), "Verify_that_the_BATTERY_CONNECT_status_is_retained_over_all_conditions_unless_a_battery_disconnection_event_occurs" );
  snprintf( chTestDescription, elCount(chTestDescription), "Purpose:To check the GetHWIO_b_BatConnectionStatus interface ");
  TestCaseAddInfo( chTestTitle, "TC_L30SW_Q-36548414", chTestDescription );

  /***************************************************************************************************************/    
                                              // Start of Test Case
  /***************************************************************************************************************/
  
  /***************************************************************************************************************/    
                                              // Test Step 0 PRECONDITIONS
  /***************************************************************************************************************/
  snprintf( chActionText, elCount(chActionText), "Flash the Software and ECU is running "); 
  snprintf( chExpectedText, elCount(chExpectedText), "ECU should be in running state"); 
  //TestStepAddActionExpected( chActionText, chExpectedText );
  
  A_DBGR_BreakpointDeleteAll();
  
  snprintf( chActionText, elCount(chActionText), "Flash the Software and ECU is running "); 
  snprintf( chExpectedText, elCount(chExpectedText), "ECU should be in running state"); 
 
  A_DBGR_R();
  A_DBGR_Go();
  /***************************************************************************************************************/    
                                              // Test Step 1 Call the function MngCNDD_CanTrcvInitialize to initialize the CAN transceiver.
  /***************************************************************************************************************/
  snprintf( chActionText, elCount(chActionText), "Set Breakpoint TestCanTrcv_Init callback function "); 
  snprintf( chExpectedText, elCount(chExpectedText), "Breakpoint is Set in TestCanTrcv_Init"); 
  //TestStepAddActionExpected( chActionText, chExpectedText );   
  A_DBGR_BreakpointSet("TestCanTrcv_Init");  
  A_DBGR_Go();
  
  snprintf( chActionText, elCount(chActionText), "Verify Breakpoint should hit in TestCanTrcv_Init "); 
  snprintf( chExpectedText, elCount(chExpectedText), "Breakpoint hit in TestCanTrcv_Init function"); 
  //TestStepAddActionExpected( chActionText, chExpectedText );  
  E_DBGR_BreakpointCheckForHalt("TestCanTrcv_Init");
  
  /***************************************************************************************************************/    
                                              // Test Step 2 Configure the values for the structure TsCNDD_CanTrcvCnfgType for CAN2 Channel.
  /***************************************************************************************************************/
  snprintf( chActionText, elCount(chActionText), "Set Breakpoint in TestCan_Init "); 
  snprintf( chExpectedText, elCount(chExpectedText), "Verify Breakpoint is Set in TestCan_Init"); 
  TestStepAddActionExpected( chActionText, chExpectedText );  
  A_DBGR_BreakpointSet("TestCan_Init");  
  A_DBGR_Go();
  
  snprintf( chActionText, elCount(chActionText), "Verify Breakpoint should hit in TestCan_Init "); 
  snprintf( chExpectedText, elCount(chExpectedText), "Breakpoint hit in TestCan_Init function"); 
 // TestStepAddActionExpected( chActionText, chExpectedText );  
  E_DBGR_BreakpointCheckForHalt("TestCan_Init");
  
  snprintf( chActionText, elCount(chActionText), "Configure CanTrcvPnFrameDataMaskIndex variable"); 
  snprintf( chExpectedText, elCount(chExpectedText), "Verify CanTrcvPnFrameDataMaskIndex is configured as 0"); 
  TestStepAddActionExpected( chActionText, chExpectedText );
  A_DBGR_VariableSet("VsCANR_PnFrameData1[0].CanTrcvPnFrameDataMaskIndex","0");
  E_DBGR_VariableCheck("VsCANR_PnFrameData1[0].CanTrcvPnFrameDataMaskIndex",0,Equal);
  
  snprintf( chActionText, elCount(chActionText), "Configure CanTrcvPnFrameDataMask variable"); 
  snprintf( chExpectedText, elCount(chExpectedText), "Verify CanTrcvPnFrameDataMask is configured as 1"); 
  TestStepAddActionExpected( chActionText, chExpectedText );
  A_DBGR_VariableSet("VsCANR_PnFrameData1[0].CanTrcvPnFrameDataMask","1");
  E_DBGR_VariableCheck("VsCANR_PnFrameData1[0].CanTrcvPnFrameDataMask",1,Equal);
  
  snprintf( chActionText, elCount(chActionText), "Configure CanTrcvPnFrameDataMaskIndex variable"); 
  snprintf( chExpectedText, elCount(chExpectedText), "Verify CanTrcvPnFrameDataMaskIndex is configured as 7"); 
  TestStepAddActionExpected( chActionText, chExpectedText );
  A_DBGR_VariableSet("VsCANR_PnFrameData1[7].CanTrcvPnFrameDataMaskIndex","7");
  E_DBGR_VariableCheck("VsCANR_PnFrameData1[7].CanTrcvPnFrameDataMaskIndex",7,Equal);
  
  snprintf( chActionText, elCount(chActionText), "Configure CanTrcvPnFrameDataMask variable"); 
  snprintf( chExpectedText, elCount(chExpectedText), "Verify CanTrcvPnFrameDataMask is configured as 8"); 
  TestStepAddActionExpected( chActionText, chExpectedText );
  A_DBGR_VariableSet("VsCANR_PnFrameData1[7].CanTrcvPnFrameDataMask","8");
  E_DBGR_VariableCheck("VsCANR_PnFrameData1[7].CanTrcvPnFrameDataMask",8,Equal);
  
  snprintf( chActionText, elCount(chActionText), "Configure CanTrcvPnFrameCanId variable"); 
  snprintf( chExpectedText, elCount(chExpectedText), "Verify CanTrcvPnFrameCanId is configured as 0x123"); 
  TestStepAddActionExpected( chActionText, chExpectedText );
  A_DBGR_VariableSet("VsCANR_PnConfig[0].CanTrcvPnFrameCanId","0x123");
  E_DBGR_VariableCheck("VsCANR_PnConfig[0].CanTrcvPnFrameCanId",0x123,Equal);
  
  snprintf( chActionText, elCount(chActionText), "Configure CanTrcvPnFrameCanIdMask variable"); 
  snprintf( chExpectedText, elCount(chExpectedText), "Verify CanTrcvPnFrameCanIdMask is configured as 0"); 
  TestStepAddActionExpected( chActionText, chExpectedText );
  A_DBGR_VariableSet("VsCANR_PnConfig[0].CanTrcvPnFrameCanIdMask","0");
  E_DBGR_VariableCheck("VsCANR_PnConfig[0].CanTrcvPnFrameCanIdMask",0,Equal);
  
  snprintf( chActionText, elCount(chActionText), "Configure CanTrcvPnFrameIdType variable"); 
  snprintf( chExpectedText, elCount(chExpectedText), "Verify CanTrcvPnFrameIdType is configured as 0"); 
  TestStepAddActionExpected( chActionText, chExpectedText );
  A_DBGR_VariableSet("VsCANR_PnConfig[0].CanTrcvPnFrameIdType","0");
  E_DBGR_VariableCheck("VsCANR_PnConfig[0].CanTrcvPnFrameIdType",0,Equal);
  
  snprintf( chActionText, elCount(chActionText), "Configure CanTrcvPnFrameDlc variable"); 
  snprintf( chExpectedText, elCount(chExpectedText), "Verify CanTrcvPnFrameDlc is configured as 8"); 
  TestStepAddActionExpected( chActionText, chExpectedText );
  A_DBGR_VariableSet("VsCANR_PnConfig[0].CanTrcvPnFrameDlc","8");
  E_DBGR_VariableCheck("VsCANR_PnConfig[0].CanTrcvPnFrameDlc",8,Equal);
  
  snprintf( chActionText, elCount(chActionText), "Configure CanTrcvPnEnabled variable"); 
  snprintf( chExpectedText, elCount(chExpectedText), "Verify CanTrcvPnEnabled is configured as 1"); 
  TestStepAddActionExpected( chActionText, chExpectedText );
  A_DBGR_VariableSet("VsCANR_PnConfig[0].CanTrcvPnEnabled","1");
  E_DBGR_VariableCheck("VsCANR_PnConfig[0].CanTrcvPnEnabled",1,Equal);
  
  snprintf( chActionText, elCount(chActionText), "Configure CanTrcvChannelId variable"); 
  snprintf( chExpectedText, elCount(chExpectedText), "Verify CanTrcvChannelId is configured as 0"); 
  TestStepAddActionExpected( chActionText, chExpectedText );
  A_DBGR_VariableSet("VsCANR_TrcvChannels[0].CanTrcvChannelId","0");
  E_DBGR_VariableCheck("VsCANR_TrcvChannels[0].CanTrcvChannelId",0,Equal);
  
  snprintf( chActionText, elCount(chActionText), "Configure CanTrcvChannelUsed variable"); 
  snprintf( chExpectedText, elCount(chExpectedText), "Verify CanTrcvChannelUsed is configured as 1"); 
  TestStepAddActionExpected( chActionText, chExpectedText );
  A_DBGR_VariableSet("VsCANR_TrcvChannels[0].CanTrcvChannelUsed","1");
  E_DBGR_VariableCheck("VsCANR_TrcvChannels[0].CanTrcvChannelUsed",1,Equal);
  
  snprintf( chActionText, elCount(chActionText), "Configure CanTrcvPinWakeupEnabled variable"); 
  snprintf( chExpectedText, elCount(chExpectedText), "Verify CanTrcvPinWakeupEnabled is configured as 0"); 
  TestStepAddActionExpected( chActionText, chExpectedText );
  A_DBGR_VariableSet("VsCANR_TrcvChannels[0].CanTrcvPinWakeupEnabled","0");
  E_DBGR_VariableCheck("VsCANR_TrcvChannels[0].CanTrcvPinWakeupEnabled",0,Equal);
  
  snprintf( chActionText, elCount(chActionText), "Configure CanTrcvNumberOfChannels variable"); 
  snprintf( chExpectedText, elCount(chExpectedText), "Verify CanTrcvNumberOfChannels is configured as 2"); 
  TestStepAddActionExpected( chActionText, chExpectedText );
  A_DBGR_VariableSet("VsCANR_CanTrcvConfig.CanTrcvNumberOfChannels","2");
  E_DBGR_VariableCheck("VsCANR_CanTrcvConfig.CanTrcvNumberOfChannels",2,Equal);
  
  snprintf( chActionText, elCount(chActionText), "Flash the Software and ECU is running "); 
  snprintf( chExpectedText, elCount(chExpectedText), "ECU should be in running state"); 
  TestStepAddActionExpected( chActionText, chExpectedText );
  A_DBGR_Go();
  
  /***************************************************************************************************************/    
                                              // Test Step 3  Call the function Test_SetHWIO_PowerDown by setting StartPowerDown to 1 then check transceiver is in the SLEEP mode and PMIC to STANDBY mode
  /***************************************************************************************************************/
  snprintf( chActionText, elCount(chActionText), "Configure StartPowerDown variable to invoke Test_SetHWIO_PowerDown interface"); 
  snprintf( chExpectedText, elCount(chExpectedText), "Verify StartPowerDown is configured as 1"); 
  //TestStepAddActionExpected( chActionText, chExpectedText );
  A_DBGR_VariableSet("StartPowerDown","1");
 // E_DBGR_VariableCheck("StartPowerDown",1,Equal);
  
  snprintf( chActionText, elCount(chActionText), "Check Trace32 is stopped"); 
  snprintf( chExpectedText, elCount(chExpectedText), "Verify Trace32 is stopped"); 
  //TestStepAddActionExpected( chActionText, chExpectedText );
  E_DBGR_CheckState(T32_State_Down);
  
   /***************************************************************************************************************/    
                                              // Test Step 4 Run the Software and capture UART log using python
  /***************************************************************************************************************/
  
  SysExec("powershell", "-ExecutionPolicy Bypass -File ./serial_logging.ps1", automation_root);
  
  snprintf( chActionText, elCount(chActionText), "waiting for UART log"); 
  snprintf( chExpectedText, elCount(chExpectedText), "waiting for UART log"); 
  TestStepAddActionExpected( chActionText, chExpectedText );
  A_GENERIC_SetTimeout(3000,"waiting for UART log");
 
  
  /***************************************************************************************************************/    
                                              // Test Step 5  This step involves sending a CAN wakeup frame with ID 0x123 and 8 bytes of data from Canoe.
  /***************************************************************************************************************/
  snprintf( chActionText, elCount(chActionText), "Transmit CAN message. ID:0x123"); 
  snprintf( chExpectedText, elCount(chExpectedText), "CAN message transmitted. ID:0x123"); 
  //TestStepAddActionExpected( chActionText, chExpectedText );
  A_CAN_SendMessage(0x123, CANA_Wakeup, 8, 1);
  A_CAN_SendMessage(0x123, CANA_Wakeup, 8, 1);
  
  /***************************************************************************************************************/    
                                              // Test Step 6  Verify Transceiver wakeUp or not.
  /***************************************************************************************************************/
  snprintf( chActionText, elCount(chActionText), "Transmit CAN message. ID:0x40000101, PDU info:0x01"); 
  snprintf( chExpectedText, elCount(chExpectedText), "CAN message transmitted. ID:0x40000101, PDU info:0x01"); 
  //TestStepAddActionExpected( chActionText, chExpectedText ); 
  
  E_CAN_WaitForMessageByID(0x00000101,10000,cc_eCAN_PRESENT,"CAN1");
  
  /***************************************************************************************************************/    
                          // Test Step 7 verify test_battconnstatus_hwio:battConnectionStatus = 0
  /***************************************************************************************************************/ 
  strncpy(searchString,"test_battconnstatus_hwio:battConnectionStatus = 0",256);
  
  snprintf( chActionText, elCount(chActionText), "waiting for UART log"); 
  snprintf( chExpectedText, elCount(chExpectedText), "waiting for UART log"); 
  TestStepAddActionExpected( chActionText, chExpectedText );
  A_GENERIC_SetTimeout(15000,"waiting for UART log");
  
  snprintf(chActionText, elCount(chActionText), "Run Python script to check battConnectionStatus in log file");
  snprintf(chExpectedText, elCount(chExpectedText), "Python script should execute successfully");
  result =iFcnt_READFILE_SearchKeywordInFile(teraterm,searchString,"string is present");
  
  if(result == 1)
  {
    testStepPass("0","string is present");
  }
  else
  {
    testStepFail("1","string is not present");
  }
  
    /***************************************************************************************************************/    
                                              // Test Step 8 Disconnect the Battery and verify battery is disconnected
  /***************************************************************************************************************/
  Power_OFF_ON(powersupply_port,0);
  A_GENERIC_SetTimeout(2000,"waiting for battery disconnect");
  
  /***************************************************************************************************************/    
                                              // Test Step 9 Run the Software and capture UART log using python
  /***************************************************************************************************************/
  
  result = SysExec("powershell", "-ExecutionPolicy Bypass -File ./serial_logging.ps1", automation_root);
  A_GENERIC_SetTimeout(3000,"waiting for UART log");
  
  /***************************************************************************************************************/    
                                              // Test Step 10 Reconnect the battery power and set the supply voltage to 12V.
  /***************************************************************************************************************/
  Power_OFF_ON(powersupply_port,1);
  //sysvar::PowGeneral_Variables::POWoff = 1;
  
  /***************************************************************************************************************/    
    // Test Step 11 verify battConnectionStatus is having 1.
  /***************************************************************************************************************/ 
  strncpy(searchString,"test_battconnstatus_hwio:battConnectionStatus = 1",256);
  A_GENERIC_SetTimeout(25000,"waiting for UART log");
  
  snprintf(chActionText, elCount(chActionText), "Run Python script to check battConnectionStatus in log file");
  snprintf(chExpectedText, elCount(chExpectedText), "Python script should execute successfully");
  result =iFcnt_READFILE_SearchKeywordInFile(teraterm,searchString,"string is present");
  
  if(result == 1)
  {
    testStepPass("0","string is present");
  }
  else
  {
    testStepFail("1","string is not present");
  }
}

testcase Verify_Controller_Reset_when_Battery_Voltage_is_between_3_3V_and_4_5V_for_250ms()
{
    /***************************************************************************************************************/    
                                                // Variable Definition
  /***************************************************************************************************************/ 
  

  
  /***************************************************************************************************************/    
                                               // Local Values
  /***************************************************************************************************************/ 
  

  
  /***************************************************************************************************************/    
                                              // Test Case Info
  /***************************************************************************************************************/
  setWriteDbgLevel(DebugOff);
  snprintf( chTestTitle, elCount(chTestTitle), "Verify_Controller_Reset_when_Battery_Voltage_is_between_3_3V_and_4_5V_for_250ms" );
  snprintf( chTestDescription, elCount(chTestDescription), "Purpose:To check the GetHWIO_b_BatConnectionStatus interface  ");
  TestCaseAddInfo( chTestTitle, "TC_L30SW_Q-37898694", chTestDescription );

  /***************************************************************************************************************/    
                                              // Start of Test Case
  /***************************************************************************************************************/
  
  /***************************************************************************************************************/    
                                              // Test Step 0 PRECONDITIONS
  /***************************************************************************************************************/
  snprintf( chActionText, elCount(chActionText), "Flash the Software and ECU is running "); 
  snprintf( chExpectedText, elCount(chExpectedText), "Ecu is should be in running state"); 
  //TestStepAddActionExpected( chActionText, chExpectedText );
  A_DBGR_BreakpointDeleteAll();
  
  snprintf( chActionText, elCount(chActionText), "Flash the Software and ECU is running "); 
  snprintf( chExpectedText, elCount(chExpectedText), "Ecu is should be in running state"); 
  
  A_DBGR_R();
  A_DBGR_Go();
  A_DBGR_Go();
  /***************************************************************************************************************/    
                                              // Test Step 1 Set the battery voltage to a value between 3.3 Volts and 4.5 Volts.
  /***************************************************************************************************************/
  Set_voltage(powersupply_port,4);
    /***************************************************************************************************************/    
    // Test Step 2  Maintain the battery voltage within this range for 250ms.
  /***************************************************************************************************************/ 

  A_GENERIC_SetTimeout(2500,"waiting for battery disconnect");
  

  Set_voltage(powersupply_port,12);
  /***************************************************************************************************************/    
    // Test Step 4 The ECU should reset
  /***************************************************************************************************************/ 
  E_DBGR_CheckState(T32_State_Stopped);
}

testcase Verify_Battery_Connection_Status_Update_as_1_BATTERY_DISCONNECT_when_Battery_Voltage_is_between_3_3V_and_4_5V()
{
   /***************************************************************************************************************/    
                                                // Variable Definition
  /***************************************************************************************************************/ 
  

  
  /***************************************************************************************************************/    
                                               // Local Values
  /***************************************************************************************************************/ 
  

  
  /***************************************************************************************************************/    
                                              // Test Case Info
  /***************************************************************************************************************/
  setWriteDbgLevel(DebugOff);
  snprintf( chTestTitle, elCount(chTestTitle), "Verify_Battery_Connection_Status_Update_as_1_BATTERY_DISCONNECT_when_Battery_Voltage_is_between_3_3V_and_4_5V" );
  snprintf( chTestDescription, elCount(chTestDescription), "Purpose:To check the GetHWIO_b_BatConnectionStatus interface  ");
  TestCaseAddInfo( chTestTitle, "TC_L30SW_Q-37898893", chTestDescription );

  /***************************************************************************************************************/    
                                              // Start of Test Case
  /***************************************************************************************************************/
  
  /***************************************************************************************************************/    
                                              // Test Step 0 PRECONDITIONS
  /***************************************************************************************************************/
  snprintf( chActionText, elCount(chActionText), "Flash the Software and ECU is running "); 
  snprintf( chExpectedText, elCount(chExpectedText), "Ecu is should be in running state"); 
  TestStepAddActionExpected( chActionText, chExpectedText );
  A_DBGR_BreakpointDeleteAll();
  
  snprintf( chActionText, elCount(chActionText), "Flash the Software and ECU is running "); 
  snprintf( chExpectedText, elCount(chExpectedText), "Ecu is should be in running state"); 
  
  A_DBGR_R();
  A_DBGR_Go();
  A_DBGR_Go();
  /***************************************************************************************************************/    
                                              // Test Step 1 Set the battery voltage to a value between 3.3 Volts and 4.5 Volts.
  /***************************************************************************************************************/
  Set_voltage(powersupply_port,4);
    /***************************************************************************************************************/    
    // Test Step 2  Maintain the battery voltage within this range for 250ms.
  /***************************************************************************************************************/ 

  A_GENERIC_SetTimeout(2500,"waiting for battery disconnect");
  

  Set_voltage(powersupply_port,12);
  /***************************************************************************************************************/    
    // Test Step 3 The ECU should reset
  /***************************************************************************************************************/ 
  E_DBGR_CheckState(T32_State_Stopped);
  
  /***************************************************************************************************************/    
                                              // Test Step 4 Run the Software and capture UART log using python
  /***************************************************************************************************************/
  result = SysExec("powershell", "-ExecutionPolicy Bypass -File ./serial_logging.ps1", automation_root);
  snprintf( chActionText, elCount(chActionText), "waiting for UART log "); 
  snprintf( chExpectedText, elCount(chExpectedText), "waiting for UART log"); 
  TestStepAddActionExpected( chActionText, chExpectedText );
  A_GENERIC_SetTimeout(3000,"waiting for UART log");
  snprintf( chActionText, elCount(chActionText), "Flash the Software and ECU is running "); 
  snprintf( chExpectedText, elCount(chExpectedText), "Ecu is should be in running state"); 
  //TestStepAddActionExpected( chActionText, chExpectedText );
  A_DBGR_Go();
  
    /***************************************************************************************************************/    
    // Test Step 5 verify battConnectionStatus is having 1.
  /***************************************************************************************************************/ 
  strncpy(searchString,"test_battconnstatus_hwio:battConnectionStatus = 1",256);
  A_GENERIC_SetTimeout(25000,"waiting for UART log");
  
  snprintf(chActionText, elCount(chActionText), "Run Python script to check battConnectionStatus in log file");
  snprintf(chExpectedText, elCount(chExpectedText), "Python script should execute successfully");
  result =iFcnt_READFILE_SearchKeywordInFile(teraterm,searchString,"string is present");
  
  if(result == 1)
  {
    testStepPass("0","string is present");
  }
  else
  {
    testStepFail("1","string is not present");
  }
}

