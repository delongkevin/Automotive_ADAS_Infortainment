/*@!Encoding:1252*/

includes
{
  
  #include "..\..\AutomationDependent\ProjectSpecific\GenLib_Includes.cin"
  #include "..\..\AutomationDependent\PowerSupply_libraries\Power_ctrl.can"
}

variables
{
  char chTestDescription[500];
  char chActionText[500];
  char chExpectedText[500];
  char chTestTitle[100];
  char canIdValue[256];
  int cnt =0;
  long coreID;
  char searchString[256];
  char command[256];
  byte CANA_Wakeup[8] =  {0x08,0x00,0x00,0x00,0x00,0x00,0x00,0x01};
  
}

testcase Verify_Hardware_CRC_Calculation_Reset_Initialization_Core_0()
{
  /***************************************************************************************************************/    
                                                // Variable Definition
  /***************************************************************************************************************/ 
  

  
  /***************************************************************************************************************/    
                                               // Local Values
  /***************************************************************************************************************/ 
  

  
  /***************************************************************************************************************/    
                                              // Test Case Info
  /***************************************************************************************************************/
  setWriteDbgLevel(DebugOff);
  snprintf( chTestTitle, elCount(chTestTitle), "Verify_Hardware_CRC_Calculation_Reset_Initialization_Core_0" );
  snprintf( chTestDescription, elCount(chTestDescription), "Purpose:To check the GetHWIO_e_CalcCRC_St(); interface  ");
  TestCaseAddInfo( chTestTitle, "TC_L30SW_Q-36924577", chTestDescription );

  /***************************************************************************************************************/    
                                              // Start of Test Case
  /***************************************************************************************************************/
  
  /***************************************************************************************************************/    
                                              // Test Step 0 PRECONDITIONS
  /***************************************************************************************************************/
  snprintf( chActionText, elCount(chActionText), "Flash the Software and ECU is running "); 
  snprintf( chExpectedText, elCount(chExpectedText), "Ecu is should be in running state"); 
  TestStepAddActionExpected( chActionText, chExpectedText );
  
  A_DBGR_BreakpointDeleteAll();
  A_DBGR_R();
  A_DBGR_Go();

  /***************************************************************************************************************/    
                                              // Test Step 1 Set breakpoint in line Test_hwcrc_llsi(); inside "TestApp_Core0_10ms_MainFunction" function and inside testapp.c file
  /***************************************************************************************************************/
  snprintf( chActionText, elCount(chActionText), "Set Breakpoint in Test_hwcrc_llsi(); "); 
  snprintf( chExpectedText, elCount(chExpectedText), "Verify Breakpoint is Set in Test_hwcrc_llsi();"); 
  //TestStepAddActionExpected( chActionText, chExpectedText );  
  A_DBGR_BreakpointSet("TestApp_Core0_10ms_MainFunction\\45");  

  A_DBGR_Go();
  
  snprintf( chActionText, elCount(chActionText), "Verify Breakpoint should hit in Test_hwcrc_llsi(); "); 
  snprintf( chExpectedText, elCount(chExpectedText), "Breakpoint hit in Test_hwcrc_llsi(); function"); 
  E_DBGR_BreakpointCheckForHalt("TestApp_Core0_10ms_MainFunction\\45");
  
  snprintf( chActionText, elCount(chActionText), "Delete all breakpoints "); 
  snprintf( chExpectedText, elCount(chExpectedText), "Breakpoints deleted"); 
  TestStepAddActionExpected( chActionText, chExpectedText );
  
  A_DBGR_BreakpointDeleteAll();
  
   
  /***************************************************************************************************************/    
  	                            // Test Step 2 Set a breakpoint at "v_coreId_u8 = (BYTE)GetCoreID();" inside "Test_hwcrc_llsi" function
  /***************************************************************************************************************/
  
  snprintf( chActionText, elCount(chActionText), "Set Breakpoint in v_coreId_u8 = (BYTE)GetCoreID(); "); 
  snprintf( chExpectedText, elCount(chExpectedText), "Verify Breakpoint is Set in v_coreId_u8 = (BYTE)GetCoreID();"); 
  //TestStepAddActionExpected( chActionText, chExpectedText );  
  A_DBGR_BreakpointSet("Test_hwcrc_llsi\\22");  

  A_DBGR_Go();
  
  snprintf( chActionText, elCount(chActionText), "Verify Breakpoint should hit in v_coreId_u8 = (BYTE)GetCoreID(); "); 
  snprintf( chExpectedText, elCount(chExpectedText), "Breakpoint hit in v_coreId_u8 = (BYTE)GetCoreID(); function"); 
  E_DBGR_BreakpointCheckForHalt("Test_hwcrc_llsi\\22");
  
  /***************************************************************************************************************/    
  	                            // Test Step 3 Verify v_coreId_u8 in trace32 watch window
  /***************************************************************************************************************/
  
   while(1)
  {
  if(cnt == 0)
  {
  snprintf( chActionText, elCount(chActionText), "Verify v_coreId_u8 is 1 "); 
  snprintf( chExpectedText, elCount(chExpectedText), "Verify Verify v_coreId_u8 is 1"); 
  
  TestStepAddActionExpected( chActionText, chExpectedText );  
  }
  
  A_DBGR_VariableRead("v_coreId_u8",coreID);
  if(coreID == 0)
  {
    break;
  }
  if(cnt == 0)
  {
  snprintf( chActionText, elCount(chActionText), "Run debugger "); 
  snprintf( chExpectedText, elCount(chExpectedText), "Run debugger "); 
  }
  A_DBGR_Go();
  cnt =cnt+1;
  }
  E_DBGR_VariableCheck("v_crcSts_u8",0,Equal);
  cnt =0;
  
}
testcase Verify_Hardware_CRC_Calculation_Reset_Initialization_Core_1()
{
  /***************************************************************************************************************/    
                                                // Variable Definition
  /***************************************************************************************************************/ 
  

  
  /***************************************************************************************************************/    
                                               // Local Values
  /***************************************************************************************************************/ 
  

  
  /***************************************************************************************************************/    
                                              // Test Case Info
  /***************************************************************************************************************/
  setWriteDbgLevel(DebugOff);
  snprintf( chTestTitle, elCount(chTestTitle), "Verify_Hardware_CRC_Calculation_Reset_Initialization_Core_1" );
  snprintf( chTestDescription, elCount(chTestDescription), "Purpose:To check the GetHWIO_e_CalcCRC_St(); interface  ");
  TestCaseAddInfo( chTestTitle, "TC_L30SW_Q-36983032", chTestDescription );

  /***************************************************************************************************************/    
                                              // Start of Test Case
  /***************************************************************************************************************/
  
  /***************************************************************************************************************/    
                                              // Test Step 0 PRECONDITIONS
  /***************************************************************************************************************/
  snprintf( chActionText, elCount(chActionText), "Flash the Software and ECU is running "); 
  snprintf( chExpectedText, elCount(chExpectedText), "Ecu is should be in running state"); 
  TestStepAddActionExpected( chActionText, chExpectedText );
  
  A_DBGR_BreakpointDeleteAll();
  A_DBGR_R();
  A_DBGR_Go();

  /***************************************************************************************************************/    
                                              // Test Step 1 Set breakpoint in line Test_hwcrc_llsi(); inside "TestApp_Core1_10ms_MainFunction" function and inside testapp.c file
  /***************************************************************************************************************/
  snprintf( chActionText, elCount(chActionText), "Set Breakpoint in Test_hwcrc_llsi(); "); 
  snprintf( chExpectedText, elCount(chExpectedText), "Verify Breakpoint is Set in Test_hwcrc_llsi();"); 
  //TestStepAddActionExpected( chActionText, chExpectedText );  
  A_DBGR_BreakpointSet("TestApp_Core1_10ms_MainFunction\\36");  

  A_DBGR_Go();
  
  snprintf( chActionText, elCount(chActionText), "Verify Breakpoint should hit in Test_hwcrc_llsi(); "); 
  snprintf( chExpectedText, elCount(chExpectedText), "Breakpoint hit in Test_hwcrc_llsi(); function"); 
  E_DBGR_BreakpointCheckForHalt("TestApp_Core1_10ms_MainFunction\\36");
  
  snprintf( chActionText, elCount(chActionText), "Delete all breakpoints "); 
  snprintf( chExpectedText, elCount(chExpectedText), "Breakpoints deleted"); 
  TestStepAddActionExpected( chActionText, chExpectedText );
  
  A_DBGR_BreakpointDeleteAll();
  
   
  /***************************************************************************************************************/    
  	                            // Test Step 2 Set a breakpoint at "v_crcSts_u8 = GetHWIO_e_CalcCRC_St();"" inside "Test_hwcrc_llsi" function
  /***************************************************************************************************************/
  
  snprintf( chActionText, elCount(chActionText), "Set Breakpoint in v_crcSts_u8 = GetHWIO_e_CalcCRC_St(); "); 
  snprintf( chExpectedText, elCount(chExpectedText), "Verify Breakpoint is Set in v_crcSts_u8 = GetHWIO_e_CalcCRC_St();"); 
  //TestStepAddActionExpected( chActionText, chExpectedText );  
  A_DBGR_BreakpointSet("Test_hwcrc_llsi\\22");  

  A_DBGR_Go();
  
  snprintf( chActionText, elCount(chActionText), "Verify Breakpoint should hit in v_crcSts_u8 = GetHWIO_e_CalcCRC_St(); "); 
  snprintf( chExpectedText, elCount(chExpectedText), "Breakpoint hit in v_crcSts_u8 = GetHWIO_e_CalcCRC_St(); function"); 
  E_DBGR_BreakpointCheckForHalt("Test_hwcrc_llsi\\22");
  
  /***************************************************************************************************************/    
  	                            // Test Step 3 Verify v_coreId_u8 in trace32 watch window
  /***************************************************************************************************************/
  
  while(1)
  {
  if(cnt == 0)
  {
  snprintf( chActionText, elCount(chActionText), "Verify v_coreId_u8 is 1 "); 
  snprintf( chExpectedText, elCount(chExpectedText), "Verify Verify v_coreId_u8 is 1"); 
  
  TestStepAddActionExpected( chActionText, chExpectedText );  
  }
  
  A_DBGR_VariableRead("v_coreId_u8",coreID);
  if(coreID == 1)
  {
    break;
  }
  if(cnt == 0)
  {
  snprintf( chActionText, elCount(chActionText), "Run debugger "); 
  snprintf( chExpectedText, elCount(chExpectedText), "Run debugger "); 
  }
  A_DBGR_Go();
  cnt =cnt+1;
  }
  E_DBGR_VariableCheck("v_crcSts_u8",0,Equal);
  cnt =0;
}

testcase Verify_Hardware_CRC_Calculation_Reset_Initialization_Core_2()
{
   /***************************************************************************************************************/    
                                                // Variable Definition
  /***************************************************************************************************************/ 
  

  
  /***************************************************************************************************************/    
                                               // Local Values
  /***************************************************************************************************************/ 
  

  
  /***************************************************************************************************************/    
                                              // Test Case Info
  /***************************************************************************************************************/
  setWriteDbgLevel(DebugOff);
  snprintf( chTestTitle, elCount(chTestTitle), "Verify_Hardware_CRC_Calculation_Reset_Initialization_Core_2" );
  snprintf( chTestDescription, elCount(chTestDescription), "Purpose:To check the GetHWIO_e_CalcCRC_St(); interface  ");
  TestCaseAddInfo( chTestTitle, "TC_L30SW_Q-36983047", chTestDescription );

  /***************************************************************************************************************/    
                                              // Start of Test Case
  /***************************************************************************************************************/
  
  /***************************************************************************************************************/    
                                              // Test Step 0 PRECONDITIONS
  /***************************************************************************************************************/
  snprintf( chActionText, elCount(chActionText), "Flash the Software and ECU is running "); 
  snprintf( chExpectedText, elCount(chExpectedText), "Ecu is should be in running state"); 
  TestStepAddActionExpected( chActionText, chExpectedText );
  
  A_DBGR_BreakpointDeleteAll();
  A_DBGR_R();
  A_DBGR_Go();
   

  /***************************************************************************************************************/    
                                              // Test Step 1 Set breakpoint in line Test_hwcrc_llsi(); inside "TestApp_Core2_10ms_MainFunction" function and inside testapp.c file
  /***************************************************************************************************************/
  snprintf( chActionText, elCount(chActionText), "Set Breakpoint in Test_hwcrc_llsi(); "); 
  snprintf( chExpectedText, elCount(chExpectedText), "Verify Breakpoint is Set in Test_hwcrc_llsi();"); 
  //TestStepAddActionExpected( chActionText, chExpectedText );  
  A_DBGR_BreakpointSet("TestApp_Core2_10ms_MainFunction\\36");  

  A_DBGR_Go();
  
  snprintf( chActionText, elCount(chActionText), "Verify Breakpoint should hit in Test_hwcrc_llsi(); "); 
  snprintf( chExpectedText, elCount(chExpectedText), "Breakpoint hit in Test_hwcrc_llsi(); function"); 
  E_DBGR_BreakpointCheckForHalt("TestApp_Core2_10ms_MainFunction\\36");
  
  snprintf( chActionText, elCount(chActionText), "Delete all breakpoints "); 
  snprintf( chExpectedText, elCount(chExpectedText), "Breakpoints deleted"); 
  TestStepAddActionExpected( chActionText, chExpectedText );
  
  A_DBGR_BreakpointDeleteAll();
  
   
  /***************************************************************************************************************/    
  	                            // Test Step 2 Set a breakpoint at "v_crcSts_u8 = GetHWIO_e_CalcCRC_St();"" inside "Test_hwcrc_llsi" function
  /***************************************************************************************************************/
  
  snprintf( chActionText, elCount(chActionText), "Set Breakpoint in v_crcSts_u8 = GetHWIO_e_CalcCRC_St(); "); 
  snprintf( chExpectedText, elCount(chExpectedText), "Verify Breakpoint is Set in v_crcSts_u8 = GetHWIO_e_CalcCRC_St();"); 
  //TestStepAddActionExpected( chActionText, chExpectedText );  
  A_DBGR_BreakpointSet("Test_hwcrc_llsi\\22");  

  A_DBGR_Go();
  
  snprintf( chActionText, elCount(chActionText), "Verify Breakpoint should hit in v_crcSts_u8 = GetHWIO_e_CalcCRC_St(); "); 
  snprintf( chExpectedText, elCount(chExpectedText), "Breakpoint hit in v_crcSts_u8 = GetHWIO_e_CalcCRC_St(); function"); 
  E_DBGR_BreakpointCheckForHalt("Test_hwcrc_llsi\\22");
  
  /***************************************************************************************************************/    
  	                            // Test Step 3 Verify v_coreId_u8 in trace32 watch window
  /***************************************************************************************************************/
  
  while(1)
  {
  if(cnt == 0)
  {
  snprintf( chActionText, elCount(chActionText), "Verify v_coreId_u8 is 2 "); 
  snprintf( chExpectedText, elCount(chExpectedText), "Verify Verify v_coreId_u8 is 2"); 
  
  TestStepAddActionExpected( chActionText, chExpectedText );  
  }
  
  A_DBGR_VariableRead("v_coreId_u8",coreID);
  if(coreID == 2)
  {
    write("core ID is : %d",coreID);
    break;
  }
  if(cnt == 0)
  {
  snprintf( chActionText, elCount(chActionText), "Run debugger "); 
  snprintf( chExpectedText, elCount(chExpectedText), "Run debugger "); 
  }
  A_DBGR_Go();
  cnt =cnt+1;
  }
  E_DBGR_VariableCheck("v_crcSts_u8",0,Equal);
  cnt =0;
  
}

testcase Verify_Hardware_CRC_Calculation_Reset_Initialization_Core_3()
{
  /***************************************************************************************************************/    
                                                // Variable Definition
  /***************************************************************************************************************/ 
  

  
  /***************************************************************************************************************/    
                                               // Local Values
  /***************************************************************************************************************/ 
  

  
  /***************************************************************************************************************/    
                                              // Test Case Info
  /***************************************************************************************************************/
  setWriteDbgLevel(DebugOff);
  snprintf( chTestTitle, elCount(chTestTitle), "Verify_Hardware_CRC_Calculation_Reset_Initialization_Core_3" );
  snprintf( chTestDescription, elCount(chTestDescription), "Purpose:To check the GetHWIO_e_CalcCRC_St(); interface  ");
  TestCaseAddInfo( chTestTitle, "TC_L30SW_Q-36983061", chTestDescription );

  /***************************************************************************************************************/    
                                              // Start of Test Case
  /***************************************************************************************************************/
  
  /***************************************************************************************************************/    
                                              // Test Step 0 PRECONDITIONS
  /***************************************************************************************************************/
  snprintf( chActionText, elCount(chActionText), "Flash the Software and ECU is running "); 
  snprintf( chExpectedText, elCount(chExpectedText), "Ecu is should be in running state"); 
  TestStepAddActionExpected( chActionText, chExpectedText );
  
  A_DBGR_BreakpointDeleteAll();
  A_DBGR_R();
  A_DBGR_Go();
   

  /***************************************************************************************************************/    
                                              // Test Step 1 Set breakpoint in line Test_hwcrc_llsi(); inside "TestApp_Core3_10ms_MainFunction" function and inside testapp.c file
  /***************************************************************************************************************/
  snprintf( chActionText, elCount(chActionText), "Set Breakpoint in Test_hwcrc_llsi(); "); 
  snprintf( chExpectedText, elCount(chExpectedText), "Verify Breakpoint is Set in Test_hwcrc_llsi();"); 
  //TestStepAddActionExpected( chActionText, chExpectedText );  
  A_DBGR_BreakpointSet("TestApp_Core3_10ms_MainFunction\\35");  

  A_DBGR_Go();
  
  snprintf( chActionText, elCount(chActionText), "Verify Breakpoint should hit in Test_hwcrc_llsi(); "); 
  snprintf( chExpectedText, elCount(chExpectedText), "Breakpoint hit in Test_hwcrc_llsi(); function"); 
  E_DBGR_BreakpointCheckForHalt("TestApp_Core3_10ms_MainFunction\\35");
  
  testWaitForTimeout(2000);
  
  snprintf( chActionText, elCount(chActionText), "Delete all breakpoints "); 
  snprintf( chExpectedText, elCount(chExpectedText), "Breakpoints deleted"); 
  TestStepAddActionExpected( chActionText, chExpectedText );
  
  A_DBGR_BreakpointDeleteAll();
  
   
  /***************************************************************************************************************/    
  	                            // Test Step 2 Set a breakpoint at "v_crcSts_u8 = GetHWIO_e_CalcCRC_St();"" inside "Test_hwcrc_llsi" function
  /***************************************************************************************************************/
  
  snprintf( chActionText, elCount(chActionText), "Set Breakpoint in v_crcSts_u8 = GetHWIO_e_CalcCRC_St(); "); 
  snprintf( chExpectedText, elCount(chExpectedText), "Verify Breakpoint is Set in v_crcSts_u8 = GetHWIO_e_CalcCRC_St();"); 
  //TestStepAddActionExpected( chActionText, chExpectedText );  
  A_DBGR_BreakpointSet("Test_hwcrc_llsi\\22");  

  A_DBGR_Go();
  
  snprintf( chActionText, elCount(chActionText), "Verify Breakpoint should hit in v_crcSts_u8 = GetHWIO_e_CalcCRC_St(); "); 
  snprintf( chExpectedText, elCount(chExpectedText), "Breakpoint hit in v_crcSts_u8 = GetHWIO_e_CalcCRC_St(); function"); 
  E_DBGR_BreakpointCheckForHalt("Test_hwcrc_llsi\\22");
  
  /***************************************************************************************************************/    
  	                            // Test Step 3 Verify v_coreId_u8 in trace32 watch window
  /***************************************************************************************************************/
  
 while(1)
  {
  if(cnt == 0)
  {
  snprintf( chActionText, elCount(chActionText), "Verify v_coreId_u8 is 3 "); 
  snprintf( chExpectedText, elCount(chExpectedText), "Verify Verify v_coreId_u8 is 3"); 
  
  TestStepAddActionExpected( chActionText, chExpectedText );  
  }
  
  A_DBGR_VariableRead("v_coreId_u8",coreID);
  if(coreID == 3)
  {
    write("core ID is : %d",coreID);
    break;
  }
  if(cnt == 0)
  {
  snprintf( chActionText, elCount(chActionText), "Run debugger "); 
  snprintf( chExpectedText, elCount(chExpectedText), "Run debugger "); 
  }
  A_DBGR_Go();
  cnt =cnt+1;
  }
  E_DBGR_VariableCheck("v_crcSts_u8",0,Equal);
  cnt =0;
}

testcase Verify_Hardware_CRC_Calculation_Reset_Initialization_Core_4()
{
  /***************************************************************************************************************/    
                                                // Variable Definition
  /***************************************************************************************************************/ 
  

  
  /***************************************************************************************************************/    
                                               // Local Values
  /***************************************************************************************************************/ 
  

  
  /***************************************************************************************************************/    
                                              // Test Case Info
  /***************************************************************************************************************/
  setWriteDbgLevel(DebugOff);
  snprintf( chTestTitle, elCount(chTestTitle), "Verify_Hardware_CRC_Calculation_Reset_Initialization_Core_4" );
  snprintf( chTestDescription, elCount(chTestDescription), "Purpose:To check the GetHWIO_e_CalcCRC_St(); interface  ");
  TestCaseAddInfo( chTestTitle, "TC_L30SW_Q-36983074", chTestDescription );

  /***************************************************************************************************************/    
                                              // Start of Test Case
  /***************************************************************************************************************/
  
  /***************************************************************************************************************/    
                                              // Test Step 0 PRECONDITIONS
  /***************************************************************************************************************/
  snprintf( chActionText, elCount(chActionText), "Flash the Software and ECU is running "); 
  snprintf( chExpectedText, elCount(chExpectedText), "Ecu is should be in running state"); 
  TestStepAddActionExpected( chActionText, chExpectedText );
  
  A_DBGR_BreakpointDeleteAll();
  A_DBGR_R();
  A_DBGR_Go();
   

  /***************************************************************************************************************/    
                                              // Test Step 1 Set breakpoint in line Test_hwcrc_llsi(); inside "TestApp_Core4_1000ms_MainFunction" function and inside testapp.c file
  /***************************************************************************************************************/
  snprintf( chActionText, elCount(chActionText), "Set Breakpoint in Test_hwcrc_llsi(); "); 
  snprintf( chExpectedText, elCount(chExpectedText), "Verify Breakpoint is Set in Test_hwcrc_llsi();"); 
  //TestStepAddActionExpected( chActionText, chExpectedText );  
  A_DBGR_BreakpointSet("TestApp_Core4_1000ms_MainFunction\\65");  

  A_DBGR_Go();
  
  snprintf( chActionText, elCount(chActionText), "Verify Breakpoint should hit in Test_hwcrc_llsi(); "); 
  snprintf( chExpectedText, elCount(chExpectedText), "Breakpoint hit in Test_hwcrc_llsi(); function"); 
  E_DBGR_BreakpointCheckForHalt("TestApp_Core4_1000ms_MainFunction\\65");
  
  testWaitForTimeout(2000);
  
  snprintf( chActionText, elCount(chActionText), "Delete all breakpoints "); 
  snprintf( chExpectedText, elCount(chExpectedText), "Breakpoints deleted"); 
  TestStepAddActionExpected( chActionText, chExpectedText );
  
  A_DBGR_BreakpointDeleteAll();
  
   
  /***************************************************************************************************************/    
  	                            // Test Step 2 Set a breakpoint at "v_crcSts_u8 = GetHWIO_e_CalcCRC_St();"" inside "Test_hwcrc_llsi" function
  /***************************************************************************************************************/
  
  snprintf( chActionText, elCount(chActionText), "Set Breakpoint in v_crcSts_u8 = GetHWIO_e_CalcCRC_St(); "); 
  snprintf( chExpectedText, elCount(chExpectedText), "Verify Breakpoint is Set in v_crcSts_u8 = GetHWIO_e_CalcCRC_St();"); 
  //TestStepAddActionExpected( chActionText, chExpectedText );  
  A_DBGR_BreakpointSet("Test_hwcrc_llsi\\22");  

  A_DBGR_Go();
  
  snprintf( chActionText, elCount(chActionText), "Verify Breakpoint should hit in v_crcSts_u8 = GetHWIO_e_CalcCRC_St(); "); 
  snprintf( chExpectedText, elCount(chExpectedText), "Breakpoint hit in v_crcSts_u8 = GetHWIO_e_CalcCRC_St(); function"); 
  E_DBGR_BreakpointCheckForHalt("Test_hwcrc_llsi\\22");
  
  /***************************************************************************************************************/    
  	                            // Test Step 3 Verify v_coreId_u8 in trace32 watch window
  /***************************************************************************************************************/
  
 while(1)
  {
  if(cnt == 0)
  {
  snprintf( chActionText, elCount(chActionText), "Verify v_coreId_u8 is 4 "); 
  snprintf( chExpectedText, elCount(chExpectedText), "Verify Verify v_coreId_u8 is 4"); 
  
  TestStepAddActionExpected( chActionText, chExpectedText );  
  }
  
  A_DBGR_VariableRead("v_coreId_u8",coreID);
  if(coreID == 4)
  {
    write("core ID is : %d",coreID);
    break;
  }
  if(cnt == 0)
  {
  snprintf( chActionText, elCount(chActionText), "Run debugger "); 
  snprintf( chExpectedText, elCount(chExpectedText), "Run debugger "); 
  }
  A_DBGR_Go();
  testWaitForTimeout(3000);
  if(cnt == 3)
  {
    testWaitForTimeout(60000);
  }
  cnt =cnt+1;
  }
  E_DBGR_VariableCheck("v_crcSts_u8",0,Equal);
  cnt =0;
}

testcase Verify_Hardware_CRC_Calculation_Reset_Initialization_Core_5()
{
  /***************************************************************************************************************/    
                                                // Variable Definition
  /***************************************************************************************************************/ 
  

  
  /***************************************************************************************************************/    
                                               // Local Values
  /***************************************************************************************************************/ 
  

  
  /***************************************************************************************************************/    
                                              // Test Case Info
  /***************************************************************************************************************/
  setWriteDbgLevel(DebugOff);
  snprintf( chTestTitle, elCount(chTestTitle), "Verify_Hardware_CRC_Calculation_Reset_Initialization_Core_5" );
  snprintf( chTestDescription, elCount(chTestDescription), "Purpose:To check the GetHWIO_e_CalcCRC_St(); interface  ");
  TestCaseAddInfo( chTestTitle, "TC_L30SW_Q-36983087", chTestDescription );

  /***************************************************************************************************************/    
                                              // Start of Test Case
  /***************************************************************************************************************/
  
  /***************************************************************************************************************/    
                                              // Test Step 0 PRECONDITIONS
  /***************************************************************************************************************/
  snprintf( chActionText, elCount(chActionText), "Flash the Software and ECU is running "); 
  snprintf( chExpectedText, elCount(chExpectedText), "Ecu is should be in running state"); 
  TestStepAddActionExpected( chActionText, chExpectedText );
  
  A_DBGR_BreakpointDeleteAll();
  A_DBGR_R();
  A_DBGR_Go();

  /***************************************************************************************************************/    
                                              // Test Step 1 Set breakpoint in line Test_hwcrc_llsi(); inside "TestApp_Core5_1000ms_MainFunction" function and inside testapp.c file
  /***************************************************************************************************************/
  snprintf( chActionText, elCount(chActionText), "Set Breakpoint in Test_hwcrc_llsi(); "); 
  snprintf( chExpectedText, elCount(chExpectedText), "Verify Breakpoint is Set in Test_hwcrc_llsi();"); 
  //TestStepAddActionExpected( chActionText, chExpectedText );  
  A_DBGR_BreakpointSet("TestApp_Core5_1000ms_MainFunction\\54");  

  A_DBGR_Go();
  
  snprintf( chActionText, elCount(chActionText), "Verify Breakpoint should hit in Test_hwcrc_llsi(); "); 
  snprintf( chExpectedText, elCount(chExpectedText), "Breakpoint hit in Test_hwcrc_llsi(); function"); 
  E_DBGR_BreakpointCheckForHalt("TestApp_Core5_1000ms_MainFunction\\54");
  
  testWaitForTimeout(2000);
  
  snprintf( chActionText, elCount(chActionText), "Delete all breakpoints "); 
  snprintf( chExpectedText, elCount(chExpectedText), "Breakpoints deleted"); 
  TestStepAddActionExpected( chActionText, chExpectedText );
  
  A_DBGR_BreakpointDeleteAll();
  
   
  /***************************************************************************************************************/    
  	                            // Test Step 2 Set a breakpoint at "v_crcSts_u8 = GetHWIO_e_CalcCRC_St();"" inside "Test_hwcrc_llsi" function
  /***************************************************************************************************************/
  
  snprintf( chActionText, elCount(chActionText), "Set Breakpoint in v_crcSts_u8 = GetHWIO_e_CalcCRC_St(); "); 
  snprintf( chExpectedText, elCount(chExpectedText), "Verify Breakpoint is Set in v_crcSts_u8 = GetHWIO_e_CalcCRC_St();"); 
  //TestStepAddActionExpected( chActionText, chExpectedText );  
  A_DBGR_BreakpointSet("Test_hwcrc_llsi\\22");  

  A_DBGR_Go();
  
  snprintf( chActionText, elCount(chActionText), "Verify Breakpoint should hit in v_crcSts_u8 = GetHWIO_e_CalcCRC_St(); "); 
  snprintf( chExpectedText, elCount(chExpectedText), "Breakpoint hit in v_crcSts_u8 = GetHWIO_e_CalcCRC_St(); function"); 
  E_DBGR_BreakpointCheckForHalt("Test_hwcrc_llsi\\22");
  
  /***************************************************************************************************************/    
  	                            // Test Step 3 Verify v_coreId_u8 in trace32 watch window
  /***************************************************************************************************************/
  
 while(1)
  {
  if(cnt == 0)
  {
  snprintf( chActionText, elCount(chActionText), "Verify v_coreId_u8 is 4 "); 
  snprintf( chExpectedText, elCount(chExpectedText), "Verify Verify v_coreId_u8 is 4"); 
  
  TestStepAddActionExpected( chActionText, chExpectedText );  
  }
  
  A_DBGR_VariableRead("v_coreId_u8",coreID);
  if(coreID == 5)
  {
    write("core ID is : %d",coreID);
    break;
  }
  if(cnt == 0)
  {
  snprintf( chActionText, elCount(chActionText), "Run debugger "); 
  snprintf( chExpectedText, elCount(chExpectedText), "Run debugger "); 
  }
  A_DBGR_Go();
  testWaitForTimeout(3000);
  if(cnt == 3)
  {
    testWaitForTimeout(60000);
  }
  cnt =cnt+1;
  }
  E_DBGR_VariableCheck("v_crcSts_u8",0,Equal);
  cnt =0;
}

testcase Verify_Hardware_CRC32_Calculation_Inprogress_Reporting_Core_0()
{
  /***************************************************************************************************************/    
                                                // Variable Definition
  /***************************************************************************************************************/ 
  

  
  /***************************************************************************************************************/    
                                               // Local Values
  /***************************************************************************************************************/ 
  

  
  /***************************************************************************************************************/    
                                              // Test Case Info
  /***************************************************************************************************************/
  setWriteDbgLevel(DebugOff);
  snprintf( chTestTitle, elCount(chTestTitle), "Verify_Hardware_CRC32_Calculation_Inprogress_Reporting_Core_0" );
  snprintf( chTestDescription, elCount(chTestDescription), "Purpose:To check the GetHWIO_e_CalcCRC_St(); interface  ");
  TestCaseAddInfo( chTestTitle, "TC_L30SW_Q-36924565", chTestDescription );

  /***************************************************************************************************************/    
                                              // Start of Test Case
  /***************************************************************************************************************/
  
  /***************************************************************************************************************/    
                                              // Test Step 0 PRECONDITIONS
  /***************************************************************************************************************/
  snprintf( chActionText, elCount(chActionText), "Flash the Software and ECU is running "); 
  snprintf( chExpectedText, elCount(chExpectedText), "Ecu is should be in running state"); 
  TestStepAddActionExpected( chActionText, chExpectedText );
  
  A_DBGR_BreakpointDeleteAll();
  A_DBGR_R();
  A_DBGR_Go();
   

  /***************************************************************************************************************/    
                                              // Test Step 1 Set breakpoint in line Test_hwcrc_llsi(); inside "TestApp_Core0_10ms_MainFunction" function and inside testapp.c file
  /***************************************************************************************************************/
  snprintf( chActionText, elCount(chActionText), "Set Breakpoint in Test_hwcrc_llsi(); "); 
  snprintf( chExpectedText, elCount(chExpectedText), "Verify Breakpoint is Set in Test_hwcrc_llsi();"); 
  //TestStepAddActionExpected( chActionText, chExpectedText );  
  A_DBGR_BreakpointSet("TestApp_Core0_10ms_MainFunction\\45");  

  A_DBGR_Go();
  
  snprintf( chActionText, elCount(chActionText), "Verify Breakpoint should hit in Test_hwcrc_llsi(); "); 
  snprintf( chExpectedText, elCount(chExpectedText), "Breakpoint hit in Test_hwcrc_llsi(); function"); 
  E_DBGR_BreakpointCheckForHalt("TestApp_Core0_10ms_MainFunction\\45");
  
  snprintf( chActionText, elCount(chActionText), "Delete all breakpoints "); 
  snprintf( chExpectedText, elCount(chExpectedText), "Breakpoints deleted"); 
  TestStepAddActionExpected( chActionText, chExpectedText );
  
  A_DBGR_BreakpointDeleteAll();
  
  
   
  /***************************************************************************************************************/    
  	                            // Test Step 2 Set a breakpoint at "v_crcSts_u8 = GetHWIO_e_CalcCRC_St();"" inside "Test_hwcrc_llsi" function
  /***************************************************************************************************************/
  
  snprintf( chActionText, elCount(chActionText), "Set Breakpoint in v_crcSts_u8 = GetHWIO_e_CalcCRC_St(); "); 
  snprintf( chExpectedText, elCount(chExpectedText), "Verify Breakpoint is Set in v_crcSts_u8 = GetHWIO_e_CalcCRC_St();"); 
  //TestStepAddActionExpected( chActionText, chExpectedText );  
  A_DBGR_BreakpointSet("Test_hwcrc_llsi\\1203");  

  A_DBGR_Go();
  
  snprintf( chActionText, elCount(chActionText), "Verify Breakpoint should hit in v_crcSts_u8 = GetHWIO_e_CalcCRC_St(); "); 
  snprintf( chExpectedText, elCount(chExpectedText), "Breakpoint hit in v_crcSts_u8 = GetHWIO_e_CalcCRC_St(); function"); 
  E_DBGR_BreakpointCheckForHalt("Test_hwcrc_llsi\\1203");
  
  /***************************************************************************************************************/    
  	                            // Test Step 3 Verify v_coreId_u8 in trace32 watch window
  /***************************************************************************************************************/
  
 while(1)
  {
  if(cnt == 0)
  {
  snprintf( chActionText, elCount(chActionText), "Verify v_coreId_u8 is 0 "); 
  snprintf( chExpectedText, elCount(chExpectedText), "Verify Verify v_coreId_u8 is 0"); 
  
  TestStepAddActionExpected( chActionText, chExpectedText );  
  }
  
  A_DBGR_VariableRead("v_coreId_u8",coreID);
  if(coreID == 0)
  {
    write("core ID is : %d",coreID);
    break;
  }
  if(cnt == 0)
  {
  snprintf( chActionText, elCount(chActionText), "Run debugger "); 
  snprintf( chExpectedText, elCount(chExpectedText), "Run debugger "); 
  }
  A_DBGR_Go();
  cnt =cnt+1;
  testWaitForTimeout(1000);
  }
  E_DBGR_VariableCheck("v_crcSts_u8",0,Equal);
  cnt =0;
  
  snprintf( chActionText, elCount(chActionText), "Delete all breakpoints "); 
  snprintf( chExpectedText, elCount(chExpectedText), "Breakpoints deleted"); 
  TestStepAddActionExpected( chActionText, chExpectedText );
  
  A_DBGR_BreakpointDeleteAll();
  /***************************************************************************************************************/    
  	                            // Test Step 4 Set a breakpoint at line"PerfmHWIO_h_CalcCRC ((BYTE)test_HwCrc_CRC32_ethernet_E, v_seed_u32, v_startAddr_u8, v_endAddr_u8);"
  /***************************************************************************************************************/
  snprintf( chActionText, elCount(chActionText), "Set Breakpoint inPerfmHWIO_h_CalcCRC ((BYTE)test_HwCrc_CRC32_ethernet_E, v_seed_u32, v_startAddr_u8, v_endAddr_u8); "); 
  snprintf( chExpectedText, elCount(chExpectedText), "Verify Breakpoint is Set in PerfmHWIO_h_CalcCRC ((BYTE)test_HwCrc_CRC32_ethernet_E, v_seed_u32, v_startAddr_u8, v_endAddr_u8);"); 
  //TestStepAddActionExpected( chActionText, chExpectedText );  
  A_DBGR_BreakpointSet("Test_hwcrc_llsi\\1219");  

  A_DBGR_Go();
  
  snprintf( chActionText, elCount(chActionText), "Verify Breakpoint should hit in v_crcSts_u8 = GetHWIO_e_CalcCRC_St(); "); 
  snprintf( chExpectedText, elCount(chExpectedText), "Breakpoint hit in v_crcSts_u8 = GetHWIO_e_CalcCRC_St(); function"); 
  E_DBGR_BreakpointCheckForHalt("Test_hwcrc_llsi\\1219");
  
  snprintf( chActionText, elCount(chActionText), "Delete all breakpoints "); 
  snprintf( chExpectedText, elCount(chExpectedText), "Breakpoints deleted"); 
  TestStepAddActionExpected( chActionText, chExpectedText );  
  A_DBGR_BreakpointDeleteAll();
  
   /***************************************************************************************************************/    
  	                            // Test Step 5 Set a breakpoint at line"v_crcSts_u8 = GetHWIO_e_CalcCRC_St();"" inside Test_hwcrc_llsi"
  /***************************************************************************************************************/
  snprintf( chActionText, elCount(chActionText), "Set Breakpoint in v_crcSts_u8 = GetHWIO_e_CalcCRC_St();"" inside Test_hwcrc_llsi "); 
  snprintf( chExpectedText, elCount(chExpectedText), "Verify Breakpoint is Set in v_crcSts_u8 = GetHWIO_e_CalcCRC_St();"" inside Test_hwcrc_llsi"); 
//  TestStepAddActionExpected( chActionText, chExpectedText );  
  A_DBGR_BreakpointSet("Test_hwcrc_llsi\\1234");  

  A_DBGR_Go();
  
  snprintf( chActionText, elCount(chActionText), "Verify Breakpoint should hit in v_crcSts_u8 = GetHWIO_e_CalcCRC_St(); "); 
  snprintf( chExpectedText, elCount(chExpectedText), "Breakpoint hit in v_crcSts_u8 = GetHWIO_e_CalcCRC_St(); function"); 
  E_DBGR_BreakpointCheckForHalt("Test_hwcrc_llsi\\1234");
  
  /***************************************************************************************************************/    
  	                            // Test Step 6 Verify V_hwcrc_Test_Result[0].testResult[120] = 1 i.e; CRC calculation status is in Progress
  /***************************************************************************************************************/
  snprintf( chActionText, elCount(chActionText), " Verify V_hwcrc_Test_Result[0].testResult[120] = 1 "); 
  snprintf( chExpectedText, elCount(chExpectedText), " V_hwcrc_Test_Result[0].testResult[120] is 1"); 
  TestStepAddActionExpected( chActionText, chExpectedText );
  E_DBGR_VariableCheck("V_hwcrc_Test_Result[0].testResult[120]",1,Equal);
}

testcase Verify_Hardware_CRC16_Calculation_Inprogress_Reporting_Core_0()
{
  /***************************************************************************************************************/    
                                                // Variable Definition
  /***************************************************************************************************************/ 
  

  
  /***************************************************************************************************************/    
                                               // Local Values
  /***************************************************************************************************************/ 
  

  
  /***************************************************************************************************************/    
                                              // Test Case Info
  /***************************************************************************************************************/
  setWriteDbgLevel(DebugOff);
  snprintf( chTestTitle, elCount(chTestTitle), "Verify_Hardware_CRC16_Calculation_Inprogress_Reporting_Core_0" );
  snprintf( chTestDescription, elCount(chTestDescription), "Purpose:To check the GetHWIO_e_CalcCRC_St(); interface  ");
  TestCaseAddInfo( chTestTitle, "TC_L30SW_Q-36925175", chTestDescription );

  /***************************************************************************************************************/    
                                              // Start of Test Case
  /***************************************************************************************************************/
  
  /***************************************************************************************************************/    
                                              // Test Step 0 PRECONDITIONS
  /***************************************************************************************************************/
  snprintf( chActionText, elCount(chActionText), "Flash the Software and ECU is running "); 
  snprintf( chExpectedText, elCount(chExpectedText), "Ecu is should be in running state"); 
  TestStepAddActionExpected( chActionText, chExpectedText );
  
  A_DBGR_BreakpointDeleteAll();
  A_DBGR_R();
  A_DBGR_Go();
   

  /***************************************************************************************************************/    
                                              // Test Step 1 Set breakpoint in line Test_hwcrc_llsi(); inside "TestApp_Core0_10ms_MainFunction" function and inside testapp.c file
  /***************************************************************************************************************/
  snprintf( chActionText, elCount(chActionText), "Set Breakpoint in Test_hwcrc_llsi(); "); 
  snprintf( chExpectedText, elCount(chExpectedText), "Verify Breakpoint is Set in Test_hwcrc_llsi();"); 
  //TestStepAddActionExpected( chActionText, chExpectedText );  
  A_DBGR_BreakpointSet("TestApp_Core0_10ms_MainFunction\\45");  

  A_DBGR_Go();
  
  snprintf( chActionText, elCount(chActionText), "Verify Breakpoint should hit in Test_hwcrc_llsi(); "); 
  snprintf( chExpectedText, elCount(chExpectedText), "Breakpoint hit in Test_hwcrc_llsi(); function"); 
  E_DBGR_BreakpointCheckForHalt("TestApp_Core0_10ms_MainFunction\\45");
  
  snprintf( chActionText, elCount(chActionText), "Delete all breakpoints "); 
  snprintf( chExpectedText, elCount(chExpectedText), "Breakpoints deleted"); 
  TestStepAddActionExpected( chActionText, chExpectedText );
  
  A_DBGR_BreakpointDeleteAll();
  
  
   
  /***************************************************************************************************************/    
  	                            // Test Step 2 Set a breakpoint at "v_crcSts_u8 = GetHWIO_e_CalcCRC_St();"" inside "Test_hwcrc_llsi" function
  /***************************************************************************************************************/
  
  snprintf( chActionText, elCount(chActionText), "Set Breakpoint in v_crcSts_u8 = GetHWIO_e_CalcCRC_St(); "); 
  snprintf( chExpectedText, elCount(chExpectedText), "Verify Breakpoint is Set in v_crcSts_u8 = GetHWIO_e_CalcCRC_St();"); 
  //TestStepAddActionExpected( chActionText, chExpectedText );  
  A_DBGR_BreakpointSet("Test_hwcrc_llsi\\1120");  

  A_DBGR_Go();
  
  snprintf( chActionText, elCount(chActionText), "Verify Breakpoint should hit in v_crcSts_u8 = GetHWIO_e_CalcCRC_St(); "); 
  snprintf( chExpectedText, elCount(chExpectedText), "Breakpoint hit in v_crcSts_u8 = GetHWIO_e_CalcCRC_St(); function"); 
  E_DBGR_BreakpointCheckForHalt("Test_hwcrc_llsi\\1120");
  
  /***************************************************************************************************************/    
  	                            // Test Step 3 Verify v_coreId_u8 in trace32 watch window
  /***************************************************************************************************************/
  
 while(1)
  {
  if(cnt == 0)
  {
  snprintf( chActionText, elCount(chActionText), "Verify v_coreId_u8 is 0 "); 
  snprintf( chExpectedText, elCount(chExpectedText), "Verify Verify v_coreId_u8 is 0"); 
  
  TestStepAddActionExpected( chActionText, chExpectedText );  
  }
  
  A_DBGR_VariableRead("v_coreId_u8",coreID);
  if(coreID == 0)
  {
    write("core ID is : %d",coreID);
    break;
  }
  if(cnt == 0)
  {
  snprintf( chActionText, elCount(chActionText), "Run debugger "); 
  snprintf( chExpectedText, elCount(chExpectedText), "Run debugger "); 
  }
  A_DBGR_Go();
  cnt =cnt+1;
  testWaitForTimeout(1000);
  }
  E_DBGR_VariableCheck("v_crcSts_u8",0,Equal);
  cnt =0;
  
  snprintf( chActionText, elCount(chActionText), "Delete all breakpoints "); 
  snprintf( chExpectedText, elCount(chExpectedText), "Breakpoints deleted"); 
  TestStepAddActionExpected( chActionText, chExpectedText );
  
  A_DBGR_BreakpointDeleteAll();
  /***************************************************************************************************************/    
  	                            // Test Step 4 Set a breakpoint at line"PerfmHWIO_h_CalcCRC ((BYTE)test_HwCrc_CRC32_ethernet_E, v_seed_u32, v_startAddr_u8, v_endAddr_u8);"
  /***************************************************************************************************************/
  snprintf( chActionText, elCount(chActionText), "Set Breakpoint inPerfmHWIO_h_CalcCRC ((BYTE)test_HwCrc_CRC32_ethernet_E, v_seed_u32, v_startAddr_u8, v_endAddr_u8); "); 
  snprintf( chExpectedText, elCount(chExpectedText), "Verify Breakpoint is Set in PerfmHWIO_h_CalcCRC ((BYTE)test_HwCrc_CRC32_ethernet_E, v_seed_u32, v_startAddr_u8, v_endAddr_u8);"); 
  //TestStepAddActionExpected( chActionText, chExpectedText );  
  A_DBGR_BreakpointSet("Test_hwcrc_llsi\\1137");  

  A_DBGR_Go();
  
  snprintf( chActionText, elCount(chActionText), "Verify Breakpoint should hit in v_crcSts_u8 = GetHWIO_e_CalcCRC_St(); "); 
  snprintf( chExpectedText, elCount(chExpectedText), "Breakpoint hit in v_crcSts_u8 = GetHWIO_e_CalcCRC_St(); function"); 
  E_DBGR_BreakpointCheckForHalt("Test_hwcrc_llsi\\1137");
  
  snprintf( chActionText, elCount(chActionText), "Delete all breakpoints "); 
  snprintf( chExpectedText, elCount(chExpectedText), "Breakpoints deleted"); 
  TestStepAddActionExpected( chActionText, chExpectedText );  
  A_DBGR_BreakpointDeleteAll();
  
   /***************************************************************************************************************/    
  	                            // Test Step 5 Set a breakpoint at line"v_crcSts_u8 = GetHWIO_e_CalcCRC_St();"" inside "Test_hwcrc_llsi" function
  /***************************************************************************************************************/ 
  snprintf( chActionText, elCount(chActionText), "Set Breakpoint in v_crcSts_u8 = GetHWIO_e_CalcCRC_St();"" inside Test_hwcrc_llsi "); 
  snprintf( chExpectedText, elCount(chExpectedText), "Verify Breakpoint is Set in PerfmHWIO_h_CalcCRC ((BYTE)test_HwCrc_CRC32_ethernet_E, v_seed_u32, v_startAddr_u8, v_endAddr_u8);"); 
//  TestStepAddActionExpected( chActionText, chExpectedText );  
  A_DBGR_BreakpointSet("Test_hwcrc_llsi\\1158");  

  A_DBGR_Go();
  
  snprintf( chActionText, elCount(chActionText), "Verify Breakpoint should hit in v_crcSts_u8 = GetHWIO_e_CalcCRC_St(); "); 
  snprintf( chExpectedText, elCount(chExpectedText), "Breakpoint hit in v_crcSts_u8 = GetHWIO_e_CalcCRC_St(); function"); 
  E_DBGR_BreakpointCheckForHalt("Test_hwcrc_llsi\\1158");
  
  /***************************************************************************************************************/    
  	                            // Test Step 6 Verify V_hwcrc_Test_Result[0].testResult[120] = 1 i.e; CRC calculation status is in Progress
  /***************************************************************************************************************/
  snprintf( chActionText, elCount(chActionText), " Verify V_hwcrc_Test_Result[0].testResult[120] = 1 "); 
  snprintf( chExpectedText, elCount(chExpectedText), " V_hwcrc_Test_Result[0].testResult[120] is 1"); 
  TestStepAddActionExpected( chActionText, chExpectedText );
  E_DBGR_VariableCheck("V_hwcrc_Test_Result[0].testResult[116]",1,Equal);
}

testcase Verify_Hardware_CRC8_Calculation_Inprogress_Reporting_Core_0()
{
  /***************************************************************************************************************/    
                                                // Variable Definition
  /***************************************************************************************************************/ 
  

  
  /***************************************************************************************************************/    
                                               // Local Values
  /***************************************************************************************************************/ 
  

  
  /***************************************************************************************************************/    
                                              // Test Case Info
  /***************************************************************************************************************/
  setWriteDbgLevel(DebugOff);
  snprintf( chTestTitle, elCount(chTestTitle), "Verify_Hardware_CRC8_Calculation_Inprogress_Reporting_Core_0" );
  snprintf( chTestDescription, elCount(chTestDescription), "Purpose:To check the GetHWIO_e_CalcCRC_St(); interface  ");
  TestCaseAddInfo( chTestTitle, "TC_L30SW_Q-36925178", chTestDescription );

  /***************************************************************************************************************/    
                                              // Start of Test Case
  /***************************************************************************************************************/
  
  /***************************************************************************************************************/    
                                              // Test Step 0 PRECONDITIONS
  /***************************************************************************************************************/
  snprintf( chActionText, elCount(chActionText), "Flash the Software and ECU is running "); 
  snprintf( chExpectedText, elCount(chExpectedText), "Ecu is should be in running state"); 
  TestStepAddActionExpected( chActionText, chExpectedText );
  
  A_DBGR_BreakpointDeleteAll();
  A_DBGR_R();
  A_DBGR_Go();
   

  /***************************************************************************************************************/    
                                              // Test Step 1 Set breakpoint in line Test_hwcrc_llsi(); inside "TestApp_Core0_10ms_MainFunction" function and inside testapp.c file
  /***************************************************************************************************************/
  snprintf( chActionText, elCount(chActionText), "Set Breakpoint in Test_hwcrc_llsi(); "); 
  snprintf( chExpectedText, elCount(chExpectedText), "Verify Breakpoint is Set in Test_hwcrc_llsi();"); 
  //TestStepAddActionExpected( chActionText, chExpectedText );  
  A_DBGR_BreakpointSet("TestApp_Core0_10ms_MainFunction\\45");  

  A_DBGR_Go();
  
  snprintf( chActionText, elCount(chActionText), "Verify Breakpoint should hit in Test_hwcrc_llsi(); "); 
  snprintf( chExpectedText, elCount(chExpectedText), "Breakpoint hit in Test_hwcrc_llsi(); function"); 
  E_DBGR_BreakpointCheckForHalt("TestApp_Core0_10ms_MainFunction\\45");
  
  snprintf( chActionText, elCount(chActionText), "Delete all breakpoints "); 
  snprintf( chExpectedText, elCount(chExpectedText), "Breakpoints deleted"); 
  TestStepAddActionExpected( chActionText, chExpectedText );
  
  A_DBGR_BreakpointDeleteAll();
  
  
   
  /***************************************************************************************************************/    
  	                            // Test Step 2 Set a breakpoint at "v_crcSts_u8 = GetHWIO_e_CalcCRC_St();"" inside "Test_hwcrc_llsi" function
  /***************************************************************************************************************/
  
  snprintf( chActionText, elCount(chActionText), "Set Breakpoint in v_crcSts_u8 = GetHWIO_e_CalcCRC_St(); "); 
  snprintf( chExpectedText, elCount(chExpectedText), "Verify Breakpoint is Set in v_crcSts_u8 = GetHWIO_e_CalcCRC_St();"); 
  //TestStepAddActionExpected( chActionText, chExpectedText );  
  A_DBGR_BreakpointSet("Test_hwcrc_llsi\\1039");  

  A_DBGR_Go();
  
  snprintf( chActionText, elCount(chActionText), "Verify Breakpoint should hit in v_crcSts_u8 = GetHWIO_e_CalcCRC_St(); "); 
  snprintf( chExpectedText, elCount(chExpectedText), "Breakpoint hit in v_crcSts_u8 = GetHWIO_e_CalcCRC_St(); function"); 
  E_DBGR_BreakpointCheckForHalt("Test_hwcrc_llsi\\1039");
  
  /***************************************************************************************************************/    
  	                            // Test Step 3 Verify v_coreId_u8 in trace32 watch window
  /***************************************************************************************************************/
  
 while(1)
  {
  if(cnt == 0)
  {
  snprintf( chActionText, elCount(chActionText), "Verify v_coreId_u8 is 0 "); 
  snprintf( chExpectedText, elCount(chExpectedText), "Verify Verify v_coreId_u8 is 0"); 
  
  TestStepAddActionExpected( chActionText, chExpectedText );  
  }
  
  A_DBGR_VariableRead("v_coreId_u8",coreID);
  if(coreID == 0)
  {
    write("core ID is : %d",coreID);
    break;
  }
  if(cnt == 0)
  {
  snprintf( chActionText, elCount(chActionText), "Run debugger "); 
  snprintf( chExpectedText, elCount(chExpectedText), "Run debugger "); 
  }
  A_DBGR_Go();
  cnt =cnt+1;
  testWaitForTimeout(1000);
  }
  E_DBGR_VariableCheck("v_crcSts_u8",0,Equal);
  cnt =0;
  
  snprintf( chActionText, elCount(chActionText), "Delete all breakpoints "); 
  snprintf( chExpectedText, elCount(chExpectedText), "Breakpoints deleted"); 
  TestStepAddActionExpected( chActionText, chExpectedText );
  
  A_DBGR_BreakpointDeleteAll();
  /***************************************************************************************************************/    
  	                            // Test Step 4 Set a breakpoint at line"PerfmHWIO_h_CalcCRC ((BYTE)test_HwCrc_CRC32_ethernet_E, v_seed_u32, v_startAddr_u8, v_endAddr_u8);"
  /***************************************************************************************************************/
  snprintf( chActionText, elCount(chActionText), "Set Breakpoint inPerfmHWIO_h_CalcCRC ((BYTE)test_HwCrc_CRC32_ethernet_E, v_seed_u32, v_startAddr_u8, v_endAddr_u8); "); 
  snprintf( chExpectedText, elCount(chExpectedText), "Verify Breakpoint is Set in PerfmHWIO_h_CalcCRC ((BYTE)test_HwCrc_CRC32_ethernet_E, v_seed_u32, v_startAddr_u8, v_endAddr_u8);"); 
  //TestStepAddActionExpected( chActionText, chExpectedText );  
  A_DBGR_BreakpointSet("Test_hwcrc_llsi\\1054");  

  A_DBGR_Go();
  
  snprintf( chActionText, elCount(chActionText), "Verify Breakpoint should hit in v_crcSts_u8 = GetHWIO_e_CalcCRC_St(); "); 
  snprintf( chExpectedText, elCount(chExpectedText), "Breakpoint hit in v_crcSts_u8 = GetHWIO_e_CalcCRC_St(); function"); 
  E_DBGR_BreakpointCheckForHalt("Test_hwcrc_llsi\\1054");
  
  snprintf( chActionText, elCount(chActionText), "Delete all breakpoints "); 
  snprintf( chExpectedText, elCount(chExpectedText), "Breakpoints deleted"); 
  TestStepAddActionExpected( chActionText, chExpectedText );  
  A_DBGR_BreakpointDeleteAll();
  
   /***************************************************************************************************************/    
  	                            // Test Step 5 Set a breakpoint at line"v_crcSts_u8 = GetHWIO_e_CalcCRC_St();"" inside "Test_hwcrc_llsi" function
  /***************************************************************************************************************/
  snprintf( chActionText, elCount(chActionText), "Set Breakpoint in v_crcSts_u8 = GetHWIO_e_CalcCRC_St();"" inside Test_hwcrc_llsi "); 
  snprintf( chExpectedText, elCount(chExpectedText), "Verify Breakpoint is Set in v_crcSts_u8 = GetHWIO_e_CalcCRC_St();"" inside Test_hwcrc_llsi"); 
//  TestStepAddActionExpected( chActionText, chExpectedText );  
  A_DBGR_BreakpointSet("Test_hwcrc_llsi\\1075");  

  A_DBGR_Go();
  
  snprintf( chActionText, elCount(chActionText), "Verify Breakpoint should hit in v_crcSts_u8 = GetHWIO_e_CalcCRC_St(); "); 
  snprintf( chExpectedText, elCount(chExpectedText), "Breakpoint hit in v_crcSts_u8 = GetHWIO_e_CalcCRC_St(); function"); 
  E_DBGR_BreakpointCheckForHalt("Test_hwcrc_llsi\\1075");
  
  /***************************************************************************************************************/    
  	                            // Test Step 6 Verify V_hwcrc_Test_Result[0].testResult[120] = 1 i.e; CRC calculation status is in Progress
  /***************************************************************************************************************/
  snprintf( chActionText, elCount(chActionText), " Verify V_hwcrc_Test_Result[0].testResult[112] = 1 "); 
  snprintf( chExpectedText, elCount(chExpectedText), " V_hwcrc_Test_Result[0].testResult[112] is 1"); 
  TestStepAddActionExpected( chActionText, chExpectedText );
  E_DBGR_VariableCheck("V_hwcrc_Test_Result[0].testResult[112]",1,Equal);
}

testcase Verify_Hardware_CRC32_Calculation_Inprogress_Reporting_Core_1()
{
  /***************************************************************************************************************/    
                                                // Variable Definition
  /***************************************************************************************************************/ 
  

  
  /***************************************************************************************************************/    
                                               // Local Values
  /***************************************************************************************************************/ 
  

  
  /***************************************************************************************************************/    
                                              // Test Case Info
  /***************************************************************************************************************/
  setWriteDbgLevel(DebugOff);
  snprintf( chTestTitle, elCount(chTestTitle), "Verify_Hardware_CRC32_Calculation_Inprogress_Reporting_Core_1" );
  snprintf( chTestDescription, elCount(chTestDescription), "Purpose:To check the GetHWIO_e_CalcCRC_St(); interface  ");
  TestCaseAddInfo( chTestTitle, "TC_L30SW_Q-37079838", chTestDescription );

  /***************************************************************************************************************/    
                                              // Start of Test Case
  /***************************************************************************************************************/
  
  /***************************************************************************************************************/    
                                              // Test Step 0 PRECONDITIONS
  /***************************************************************************************************************/
  snprintf( chActionText, elCount(chActionText), "Flash the Software and ECU is running "); 
  snprintf( chExpectedText, elCount(chExpectedText), "Ecu is should be in running state"); 
  TestStepAddActionExpected( chActionText, chExpectedText );
  
  A_DBGR_BreakpointDeleteAll();
  A_DBGR_R();
  A_DBGR_Go();
   

  /***************************************************************************************************************/    
                                              // Test Step 1 Set breakpoint in line Test_hwcrc_llsi(); inside "TestApp_Core1_10ms_MainFunction" function and inside testapp.c file
  /***************************************************************************************************************/
  snprintf( chActionText, elCount(chActionText), "Set Breakpoint in Test_hwcrc_llsi(); "); 
  snprintf( chExpectedText, elCount(chExpectedText), "Verify Breakpoint is Set in Test_hwcrc_llsi();"); 
  //TestStepAddActionExpected( chActionText, chExpectedText );  
  A_DBGR_BreakpointSet("TestApp_Core1_10ms_MainFunction\\36");  

  A_DBGR_Go();
  
  snprintf( chActionText, elCount(chActionText), "Verify Breakpoint should hit in Test_hwcrc_llsi(); "); 
  snprintf( chExpectedText, elCount(chExpectedText), "Breakpoint hit in Test_hwcrc_llsi(); function"); 
  E_DBGR_BreakpointCheckForHalt("TestApp_Core1_10ms_MainFunction\\36");
  
  snprintf( chActionText, elCount(chActionText), "Delete all breakpoints "); 
  snprintf( chExpectedText, elCount(chExpectedText), "Breakpoints deleted"); 
  TestStepAddActionExpected( chActionText, chExpectedText );
  
  A_DBGR_BreakpointDeleteAll();
  
  
   
  /***************************************************************************************************************/    
  	                            // Test Step 2 Set a breakpoint at "v_crcSts_u8 = GetHWIO_e_CalcCRC_St();"" inside "Test_hwcrc_llsi" function
  /***************************************************************************************************************/
  
  snprintf( chActionText, elCount(chActionText), "Set Breakpoint in v_crcSts_u8 = GetHWIO_e_CalcCRC_St(); "); 
  snprintf( chExpectedText, elCount(chExpectedText), "Verify Breakpoint is Set in v_crcSts_u8 = GetHWIO_e_CalcCRC_St();"); 
  //TestStepAddActionExpected( chActionText, chExpectedText );  
  A_DBGR_BreakpointSet("Test_hwcrc_llsi\\1203");  

  A_DBGR_Go();
  
  snprintf( chActionText, elCount(chActionText), "Verify Breakpoint should hit in v_crcSts_u8 = GetHWIO_e_CalcCRC_St(); "); 
  snprintf( chExpectedText, elCount(chExpectedText), "Breakpoint hit in v_crcSts_u8 = GetHWIO_e_CalcCRC_St(); function"); 
  E_DBGR_BreakpointCheckForHalt("Test_hwcrc_llsi\\1203");
  
  /***************************************************************************************************************/    
  	                            // Test Step 3 Verify v_coreId_u8 in trace32 watch window
  /***************************************************************************************************************/
  
 while(1)
  {
  if(cnt == 0)
  {
  snprintf( chActionText, elCount(chActionText), "Verify v_coreId_u8 is 1 "); 
  snprintf( chExpectedText, elCount(chExpectedText), "Verify Verify v_coreId_u8 is 1"); 
  
  TestStepAddActionExpected( chActionText, chExpectedText );  
  }
  
  A_DBGR_VariableRead("v_coreId_u8",coreID);
  if(coreID == 1)
  {
    write("core ID is : %d",coreID);
    break;
  }
  if(cnt == 0)
  {
  snprintf( chActionText, elCount(chActionText), "Run debugger "); 
  snprintf( chExpectedText, elCount(chExpectedText), "Run debugger "); 
  }
  A_DBGR_Go();
  cnt =cnt+1;
  testWaitForTimeout(1000);
  }
  E_DBGR_VariableCheck("v_crcSts_u8",0,Equal);
  cnt =0;
  
  snprintf( chActionText, elCount(chActionText), "Delete all breakpoints "); 
  snprintf( chExpectedText, elCount(chExpectedText), "Breakpoints deleted"); 
  TestStepAddActionExpected( chActionText, chExpectedText );
  
  A_DBGR_BreakpointDeleteAll();
  /***************************************************************************************************************/    
  	                            // Test Step 4 Set a breakpoint at line"PerfmHWIO_h_CalcCRC ((BYTE)test_HwCrc_CRC32_ethernet_E, v_seed_u32, v_startAddr_u8, v_endAddr_u8);"
  /***************************************************************************************************************/
  snprintf( chActionText, elCount(chActionText), "Set Breakpoint inPerfmHWIO_h_CalcCRC ((BYTE)test_HwCrc_CRC32_ethernet_E, v_seed_u32, v_startAddr_u8, v_endAddr_u8); "); 
  snprintf( chExpectedText, elCount(chExpectedText), "Verify Breakpoint is Set in PerfmHWIO_h_CalcCRC ((BYTE)test_HwCrc_CRC32_ethernet_E, v_seed_u32, v_startAddr_u8, v_endAddr_u8);"); 
  //TestStepAddActionExpected( chActionText, chExpectedText );  
  A_DBGR_BreakpointSet("Test_hwcrc_llsi\\1219");  

  A_DBGR_Go();
  
  snprintf( chActionText, elCount(chActionText), "Verify Breakpoint should hit in v_crcSts_u8 = GetHWIO_e_CalcCRC_St(); "); 
  snprintf( chExpectedText, elCount(chExpectedText), "Breakpoint hit in v_crcSts_u8 = GetHWIO_e_CalcCRC_St(); function"); 
  E_DBGR_BreakpointCheckForHalt("Test_hwcrc_llsi\\1219");
  
  snprintf( chActionText, elCount(chActionText), "Delete all breakpoints "); 
  snprintf( chExpectedText, elCount(chExpectedText), "Breakpoints deleted"); 
  TestStepAddActionExpected( chActionText, chExpectedText );  
  A_DBGR_BreakpointDeleteAll();
  
   /***************************************************************************************************************/    
  	                            // Test Step 5 Set a breakpoint at line"v_crcSts_u8 = GetHWIO_e_CalcCRC_St();"" inside Test_hwcrc_llsi"
  /***************************************************************************************************************/
  snprintf( chActionText, elCount(chActionText), "Set Breakpoint in v_crcSts_u8 = GetHWIO_e_CalcCRC_St();"" inside Test_hwcrc_llsi "); 
  snprintf( chExpectedText, elCount(chExpectedText), "Verify Breakpoint is Set in v_crcSts_u8 = GetHWIO_e_CalcCRC_St();"" inside Test_hwcrc_llsi"); 
//  TestStepAddActionExpected( chActionText, chExpectedText );  
  A_DBGR_BreakpointSet("Test_hwcrc_llsi\\1234");  

  A_DBGR_Go();
  
  snprintf( chActionText, elCount(chActionText), "Verify Breakpoint should hit in v_crcSts_u8 = GetHWIO_e_CalcCRC_St(); "); 
  snprintf( chExpectedText, elCount(chExpectedText), "Breakpoint hit in v_crcSts_u8 = GetHWIO_e_CalcCRC_St(); function"); 
  E_DBGR_BreakpointCheckForHalt("Test_hwcrc_llsi\\1234");
  
  /***************************************************************************************************************/    
  	                            // Test Step 6 Verify V_hwcrc_Test_Result[0].testResult[120] = 1 i.e; CRC calculation status is in Progress
  /***************************************************************************************************************/
  snprintf( chActionText, elCount(chActionText), " Verify V_hwcrc_Test_Result[1].testResult[120] = 1 "); 
  snprintf( chExpectedText, elCount(chExpectedText), " V_hwcrc_Test_Result[1].testResult[120] is 1"); 
  TestStepAddActionExpected( chActionText, chExpectedText );
  E_DBGR_VariableCheck("V_hwcrc_Test_Result[1].testResult[120]",1,Equal);
}

testcase Verify_Hardware_CRC32_Calculation_Inprogress_Reporting_Core_2()
{
  /***************************************************************************************************************/    
                                                // Variable Definition
  /***************************************************************************************************************/ 
  

  
  /***************************************************************************************************************/    
                                               // Local Values
  /***************************************************************************************************************/ 
  

  
  /***************************************************************************************************************/    
                                              // Test Case Info
  /***************************************************************************************************************/
  setWriteDbgLevel(DebugOff);
  snprintf( chTestTitle, elCount(chTestTitle), "Verify_Hardware_CRC32_Calculation_Inprogress_Reporting_Core_2" );
  snprintf( chTestDescription, elCount(chTestDescription), "Purpose:To check the GetHWIO_e_CalcCRC_St(); interface  ");
  TestCaseAddInfo( chTestTitle, "TC_L30SW_Q-37079844", chTestDescription );

  /***************************************************************************************************************/    
                                              // Start of Test Case
  /***************************************************************************************************************/
  
  /***************************************************************************************************************/    
                                              // Test Step 0 PRECONDITIONS
  /***************************************************************************************************************/
  snprintf( chActionText, elCount(chActionText), "Flash the Software and ECU is running "); 
  snprintf( chExpectedText, elCount(chExpectedText), "Ecu is should be in running state"); 
  TestStepAddActionExpected( chActionText, chExpectedText );
  
  A_DBGR_BreakpointDeleteAll();
  A_DBGR_R();
  A_DBGR_Go();
   

  /***************************************************************************************************************/    
                                              // Test Step 1 Set breakpoint in line Test_hwcrc_llsi(); inside "TestApp_Core2_10ms_MainFunction" function and inside testapp.c file
  /***************************************************************************************************************/
  snprintf( chActionText, elCount(chActionText), "Set Breakpoint in Test_hwcrc_llsi(); "); 
  snprintf( chExpectedText, elCount(chExpectedText), "Verify Breakpoint is Set in Test_hwcrc_llsi();"); 
  //TestStepAddActionExpected( chActionText, chExpectedText );  
  A_DBGR_BreakpointSet("TestApp_Core2_10ms_MainFunction\\36");  

  A_DBGR_Go();
  
  snprintf( chActionText, elCount(chActionText), "Verify Breakpoint should hit in Test_hwcrc_llsi(); "); 
  snprintf( chExpectedText, elCount(chExpectedText), "Breakpoint hit in Test_hwcrc_llsi(); function"); 
  E_DBGR_BreakpointCheckForHalt("TestApp_Core2_10ms_MainFunction\\36");
  
  snprintf( chActionText, elCount(chActionText), "Delete all breakpoints "); 
  snprintf( chExpectedText, elCount(chExpectedText), "Breakpoints deleted"); 
  TestStepAddActionExpected( chActionText, chExpectedText );
  
  A_DBGR_BreakpointDeleteAll();
  
  
   
  /***************************************************************************************************************/    
  	                            // Test Step 2 Set a breakpoint at "v_crcSts_u8 = GetHWIO_e_CalcCRC_St();"" inside "Test_hwcrc_llsi" function
  /***************************************************************************************************************/
  
  snprintf( chActionText, elCount(chActionText), "Set Breakpoint in v_crcSts_u8 = GetHWIO_e_CalcCRC_St(); "); 
  snprintf( chExpectedText, elCount(chExpectedText), "Verify Breakpoint is Set in v_crcSts_u8 = GetHWIO_e_CalcCRC_St();"); 
  //TestStepAddActionExpected( chActionText, chExpectedText );  
  A_DBGR_BreakpointSet("Test_hwcrc_llsi\\1203");  

  A_DBGR_Go();
  
  snprintf( chActionText, elCount(chActionText), "Verify Breakpoint should hit in v_crcSts_u8 = GetHWIO_e_CalcCRC_St(); "); 
  snprintf( chExpectedText, elCount(chExpectedText), "Breakpoint hit in v_crcSts_u8 = GetHWIO_e_CalcCRC_St(); function"); 
  E_DBGR_BreakpointCheckForHalt("Test_hwcrc_llsi\\1203");
  
  /***************************************************************************************************************/    
  	                            // Test Step 3 Verify v_coreId_u8 in trace32 watch window
  /***************************************************************************************************************/
  
 while(1)
  {
  if(cnt == 0)
  {
  snprintf( chActionText, elCount(chActionText), "Verify v_coreId_u8 is 2 "); 
  snprintf( chExpectedText, elCount(chExpectedText), "Verify Verify v_coreId_u8 is 2"); 
  
  TestStepAddActionExpected( chActionText, chExpectedText );  
  }
  
  A_DBGR_VariableRead("v_coreId_u8",coreID);
  if(coreID == 2)
  {
    write("core ID is : %d",coreID);
    break;
  }
  if(cnt == 0)
  {
  snprintf( chActionText, elCount(chActionText), "Run debugger "); 
  snprintf( chExpectedText, elCount(chExpectedText), "Run debugger "); 
  }
  A_DBGR_Go();
  cnt =cnt+1;
  testWaitForTimeout(1000);
  }
  E_DBGR_VariableCheck("v_crcSts_u8",0,Equal);
  cnt =0;
  
  snprintf( chActionText, elCount(chActionText), "Delete all breakpoints "); 
  snprintf( chExpectedText, elCount(chExpectedText), "Breakpoints deleted"); 
  TestStepAddActionExpected( chActionText, chExpectedText );
  
  A_DBGR_BreakpointDeleteAll();
  /***************************************************************************************************************/    
  	                            // Test Step 4 Set a breakpoint at line"PerfmHWIO_h_CalcCRC ((BYTE)test_HwCrc_CRC32_ethernet_E, v_seed_u32, v_startAddr_u8, v_endAddr_u8);"
  /***************************************************************************************************************/
  snprintf( chActionText, elCount(chActionText), "Set Breakpoint inPerfmHWIO_h_CalcCRC ((BYTE)test_HwCrc_CRC32_ethernet_E, v_seed_u32, v_startAddr_u8, v_endAddr_u8); "); 
  snprintf( chExpectedText, elCount(chExpectedText), "Verify Breakpoint is Set in PerfmHWIO_h_CalcCRC ((BYTE)test_HwCrc_CRC32_ethernet_E, v_seed_u32, v_startAddr_u8, v_endAddr_u8);"); 
  //TestStepAddActionExpected( chActionText, chExpectedText );  
  A_DBGR_BreakpointSet("Test_hwcrc_llsi\\1219");  

  A_DBGR_Go();
  
  snprintf( chActionText, elCount(chActionText), "Verify Breakpoint should hit in v_crcSts_u8 = GetHWIO_e_CalcCRC_St(); "); 
  snprintf( chExpectedText, elCount(chExpectedText), "Breakpoint hit in v_crcSts_u8 = GetHWIO_e_CalcCRC_St(); function"); 
  E_DBGR_BreakpointCheckForHalt("Test_hwcrc_llsi\\1219");
  
  snprintf( chActionText, elCount(chActionText), "Delete all breakpoints "); 
  snprintf( chExpectedText, elCount(chExpectedText), "Breakpoints deleted"); 
  TestStepAddActionExpected( chActionText, chExpectedText );  
  A_DBGR_BreakpointDeleteAll();
  
   /***************************************************************************************************************/    
  	                            // Test Step 5 Set a breakpoint at line"v_crcSts_u8 = GetHWIO_e_CalcCRC_St();"" inside Test_hwcrc_llsi"
  /***************************************************************************************************************/
  snprintf( chActionText, elCount(chActionText), "Set Breakpoint in v_crcSts_u8 = GetHWIO_e_CalcCRC_St();"" inside Test_hwcrc_llsi "); 
  snprintf( chExpectedText, elCount(chExpectedText), "Verify Breakpoint is Set in v_crcSts_u8 = GetHWIO_e_CalcCRC_St();"" inside Test_hwcrc_llsi"); 
//  TestStepAddActionExpected( chActionText, chExpectedText );  
  A_DBGR_BreakpointSet("Test_hwcrc_llsi\\1234");  

  A_DBGR_Go();
  
  snprintf( chActionText, elCount(chActionText), "Verify Breakpoint should hit in v_crcSts_u8 = GetHWIO_e_CalcCRC_St(); "); 
  snprintf( chExpectedText, elCount(chExpectedText), "Breakpoint hit in v_crcSts_u8 = GetHWIO_e_CalcCRC_St(); function"); 
  E_DBGR_BreakpointCheckForHalt("Test_hwcrc_llsi\\1234");
  
  /***************************************************************************************************************/    
  	                            // Test Step 6 Verify V_hwcrc_Test_Result[0].testResult[120] = 1 i.e; CRC calculation status is in Progress
  /***************************************************************************************************************/
  snprintf( chActionText, elCount(chActionText), " Verify V_hwcrc_Test_Result[2].testResult[120] = 1 "); 
  snprintf( chExpectedText, elCount(chExpectedText), " V_hwcrc_Test_Result[2].testResult[120] is 1"); 
  TestStepAddActionExpected( chActionText, chExpectedText );
  E_DBGR_VariableCheck("V_hwcrc_Test_Result[2].testResult[120]",1,Equal);
}

testcase Verify_Hardware_CRC32_Calculation_Inprogress_Reporting_Core_3()
{
  /***************************************************************************************************************/    
                                                // Variable Definition
  /***************************************************************************************************************/ 
  

  
  /***************************************************************************************************************/    
                                               // Local Values
  /***************************************************************************************************************/ 
  

  
  /***************************************************************************************************************/    
                                              // Test Case Info
  /***************************************************************************************************************/
  setWriteDbgLevel(DebugOff);
  snprintf( chTestTitle, elCount(chTestTitle), "Verify_Hardware_CRC32_Calculation_Inprogress_Reporting_Core_3" );
  snprintf( chTestDescription, elCount(chTestDescription), "Purpose:To check the GetHWIO_e_CalcCRC_St(); interface  ");
  TestCaseAddInfo( chTestTitle, "TC_L30SW_Q-37079849", chTestDescription );

  /***************************************************************************************************************/    
                                              // Start of Test Case
  /***************************************************************************************************************/
  
  /***************************************************************************************************************/    
                                              // Test Step 0 PRECONDITIONS
  /***************************************************************************************************************/
  snprintf( chActionText, elCount(chActionText), "Flash the Software and ECU is running "); 
  snprintf( chExpectedText, elCount(chExpectedText), "Ecu is should be in running state"); 
  TestStepAddActionExpected( chActionText, chExpectedText );
  
  A_DBGR_BreakpointDeleteAll();
  A_DBGR_R();
  A_DBGR_Go();
   

   /***************************************************************************************************************/    
                                              // Test Step 1 Set breakpoint in line Test_hwcrc_llsi(); inside "TestApp_Core3_10ms_MainFunction" function and inside testapp.c file
  /***************************************************************************************************************/
  snprintf( chActionText, elCount(chActionText), "Set Breakpoint in Test_hwcrc_llsi(); "); 
  snprintf( chExpectedText, elCount(chExpectedText), "Verify Breakpoint is Set in Test_hwcrc_llsi();"); 
  //TestStepAddActionExpected( chActionText, chExpectedText );  
  A_DBGR_BreakpointSet("TestApp_Core3_10ms_MainFunction\\35");  

  A_DBGR_Go();
  
  snprintf( chActionText, elCount(chActionText), "Verify Breakpoint should hit in Test_hwcrc_llsi(); "); 
  snprintf( chExpectedText, elCount(chExpectedText), "Breakpoint hit in Test_hwcrc_llsi(); function"); 
  E_DBGR_BreakpointCheckForHalt("TestApp_Core3_10ms_MainFunction\\35");
  
  testWaitForTimeout(2000);
  
  snprintf( chActionText, elCount(chActionText), "Delete all breakpoints "); 
  snprintf( chExpectedText, elCount(chExpectedText), "Breakpoints deleted"); 
  TestStepAddActionExpected( chActionText, chExpectedText );
  
  A_DBGR_BreakpointDeleteAll();
  
  
  
   
  /***************************************************************************************************************/    
  	                            // Test Step 2 Set a breakpoint at "v_crcSts_u8 = GetHWIO_e_CalcCRC_St();"" inside "Test_hwcrc_llsi" function
  /***************************************************************************************************************/
  
  snprintf( chActionText, elCount(chActionText), "Set Breakpoint in v_crcSts_u8 = GetHWIO_e_CalcCRC_St(); "); 
  snprintf( chExpectedText, elCount(chExpectedText), "Verify Breakpoint is Set in v_crcSts_u8 = GetHWIO_e_CalcCRC_St();"); 
  //TestStepAddActionExpected( chActionText, chExpectedText );  
  A_DBGR_BreakpointSet("Test_hwcrc_llsi\\1203");  

  A_DBGR_Go();
  
  snprintf( chActionText, elCount(chActionText), "Verify Breakpoint should hit in v_crcSts_u8 = GetHWIO_e_CalcCRC_St(); "); 
  snprintf( chExpectedText, elCount(chExpectedText), "Breakpoint hit in v_crcSts_u8 = GetHWIO_e_CalcCRC_St(); function"); 
  E_DBGR_BreakpointCheckForHalt("Test_hwcrc_llsi\\1203");
  
  /***************************************************************************************************************/    
  	                            // Test Step 3 Verify v_coreId_u8 in trace32 watch window
  /***************************************************************************************************************/
  
 while(1)
  {
  if(cnt == 0)
  {
  snprintf( chActionText, elCount(chActionText), "Verify v_coreId_u8 is 3 "); 
  snprintf( chExpectedText, elCount(chExpectedText), "Verify Verify v_coreId_u8 is 3"); 
  
  TestStepAddActionExpected( chActionText, chExpectedText );  
  }
  
  A_DBGR_VariableRead("v_coreId_u8",coreID);
  if(coreID == 3)
  {
    write("core ID is : %d",coreID);
    break;
  }
  if(cnt == 0)
  {
  snprintf( chActionText, elCount(chActionText), "Run debugger "); 
  snprintf( chExpectedText, elCount(chExpectedText), "Run debugger "); 
  }
  A_DBGR_Go();
  cnt =cnt+1;
  testWaitForTimeout(1000);
  }
  E_DBGR_VariableCheck("v_crcSts_u8",0,Equal);
  cnt =0;
  
  snprintf( chActionText, elCount(chActionText), "Delete all breakpoints "); 
  snprintf( chExpectedText, elCount(chExpectedText), "Breakpoints deleted"); 
  TestStepAddActionExpected( chActionText, chExpectedText );
  
  A_DBGR_BreakpointDeleteAll();
  /***************************************************************************************************************/    
  	                            // Test Step 4 Set a breakpoint at line"PerfmHWIO_h_CalcCRC ((BYTE)test_HwCrc_CRC32_ethernet_E, v_seed_u32, v_startAddr_u8, v_endAddr_u8);"
  /***************************************************************************************************************/
  snprintf( chActionText, elCount(chActionText), "Set Breakpoint inPerfmHWIO_h_CalcCRC ((BYTE)test_HwCrc_CRC32_ethernet_E, v_seed_u32, v_startAddr_u8, v_endAddr_u8); "); 
  snprintf( chExpectedText, elCount(chExpectedText), "Verify Breakpoint is Set in PerfmHWIO_h_CalcCRC ((BYTE)test_HwCrc_CRC32_ethernet_E, v_seed_u32, v_startAddr_u8, v_endAddr_u8);"); 
  //TestStepAddActionExpected( chActionText, chExpectedText );  
  A_DBGR_BreakpointSet("Test_hwcrc_llsi\\1219");  

  A_DBGR_Go();
  
  snprintf( chActionText, elCount(chActionText), "Verify Breakpoint should hit in v_crcSts_u8 = GetHWIO_e_CalcCRC_St(); "); 
  snprintf( chExpectedText, elCount(chExpectedText), "Breakpoint hit in v_crcSts_u8 = GetHWIO_e_CalcCRC_St(); function"); 
  E_DBGR_BreakpointCheckForHalt("Test_hwcrc_llsi\\1219");
  
  
  
  while(1)
  {
  if(cnt == 0)
  {
  snprintf( chActionText, elCount(chActionText), "Verify v_coreId_u8 is 3 "); 
  snprintf( chExpectedText, elCount(chExpectedText), "Verify Verify v_coreId_u8 is 3"); 
  
  TestStepAddActionExpected( chActionText, chExpectedText );  
  }
  
  A_DBGR_VariableRead("v_coreId_u8",coreID);
  if(coreID == 3)
  {
    write("core ID is : %d",coreID);
    break;
  }
  if(cnt == 0)
  {
  snprintf( chActionText, elCount(chActionText), "Run debugger "); 
  snprintf( chExpectedText, elCount(chExpectedText), "Run debugger "); 
  }
  A_DBGR_Go();
  cnt =cnt+1;
  testWaitForTimeout(1000);
  }
  snprintf( chActionText, elCount(chActionText), "Delete all breakpoints "); 
  snprintf( chExpectedText, elCount(chExpectedText), "Breakpoints deleted"); 
  //TestStepAddActionExpected( chActionText, chExpectedText );  
  A_DBGR_BreakpointDeleteAll();
  cnt =0;
  
   /***************************************************************************************************************/    
  	                            // Test Step 5 Set a breakpoint at line"v_crcSts_u8 = GetHWIO_e_CalcCRC_St();"" inside Test_hwcrc_llsi"
  /***************************************************************************************************************/
  snprintf( chActionText, elCount(chActionText), "Set Breakpoint in v_crcSts_u8 = GetHWIO_e_CalcCRC_St();"" inside Test_hwcrc_llsi "); 
  snprintf( chExpectedText, elCount(chExpectedText), "Verify Breakpoint is Set in v_crcSts_u8 = GetHWIO_e_CalcCRC_St();"" inside Test_hwcrc_llsi"); 
// TestStepAddActionExpected( chActionText, chExpectedText );  
  A_DBGR_BreakpointSet("Test_hwcrc_llsi\\1234");  

  A_DBGR_Go();
  
  snprintf( chActionText, elCount(chActionText), "Verify Breakpoint should hit in v_crcSts_u8 = GetHWIO_e_CalcCRC_St(); "); 
  snprintf( chExpectedText, elCount(chExpectedText), "Breakpoint hit in v_crcSts_u8 = GetHWIO_e_CalcCRC_St(); function"); 
  E_DBGR_BreakpointCheckForHalt("Test_hwcrc_llsi\\1234");
  
  /***************************************************************************************************************/    
  	                            // Test Step 6 Verify V_hwcrc_Test_Result[0].testResult[120] = 1 i.e; CRC calculation status is in Progress
  /***************************************************************************************************************/
  snprintf( chActionText, elCount(chActionText), " Verify V_hwcrc_Test_Result[3].testResult[120] = 1 "); 
  snprintf( chExpectedText, elCount(chExpectedText), " V_hwcrc_Test_Result[3].testResult[120] is 1"); 
  TestStepAddActionExpected( chActionText, chExpectedText );
  E_DBGR_VariableCheck("V_hwcrc_Test_Result[3].testResult[120]",1,Equal);
}

testcase Verify_Hardware_CRC32_Calculation_Inprogress_Reporting_Core_4()
{
  /***************************************************************************************************************/    
                                                // Variable Definition
  /***************************************************************************************************************/ 
  

  
  /***************************************************************************************************************/    
                                               // Local Values
  /***************************************************************************************************************/ 
  

  
  /***************************************************************************************************************/    
                                              // Test Case Info
  /***************************************************************************************************************/
  setWriteDbgLevel(DebugOff);
  snprintf( chTestTitle, elCount(chTestTitle), "Verify_Hardware_CRC32_Calculation_Inprogress_Reporting_Core_4" );
  snprintf( chTestDescription, elCount(chTestDescription), "Purpose:To check the GetHWIO_e_CalcCRC_St(); interface  ");
  TestCaseAddInfo( chTestTitle, "TC_L30SW_Q-37079854", chTestDescription );

  /***************************************************************************************************************/    
                                              // Start of Test Case
  /***************************************************************************************************************/
  
  /***************************************************************************************************************/    
                                              // Test Step 0 PRECONDITIONS
  /***************************************************************************************************************/
  snprintf( chActionText, elCount(chActionText), "Flash the Software and ECU is running "); 
  snprintf( chExpectedText, elCount(chExpectedText), "Ecu is should be in running state"); 
  TestStepAddActionExpected( chActionText, chExpectedText );
  
  A_DBGR_BreakpointDeleteAll();
  A_DBGR_R();
  A_DBGR_Go();
   

   /***************************************************************************************************************/    
                                              // Test Step 1 Set breakpoint in line Test_hwcrc_llsi(); inside "TestApp_Core4_1000ms_MainFunction" function and inside testapp.c file
  /***************************************************************************************************************/
  snprintf( chActionText, elCount(chActionText), "Set Breakpoint in Test_hwcrc_llsi(); "); 
  snprintf( chExpectedText, elCount(chExpectedText), "Verify Breakpoint is Set in Test_hwcrc_llsi();"); 
  //TestStepAddActionExpected( chActionText, chExpectedText );  
  A_DBGR_BreakpointSet("TestApp_Core4_1000ms_MainFunction\\65");  

  A_DBGR_Go();
  
  snprintf( chActionText, elCount(chActionText), "Verify Breakpoint should hit in Test_hwcrc_llsi(); "); 
  snprintf( chExpectedText, elCount(chExpectedText), "Breakpoint hit in Test_hwcrc_llsi(); function"); 
  E_DBGR_BreakpointCheckForHalt("TestApp_Core4_1000ms_MainFunction\\65");
  
  testWaitForTimeout(2000);
  
  snprintf( chActionText, elCount(chActionText), "Delete all breakpoints "); 
  snprintf( chExpectedText, elCount(chExpectedText), "Breakpoints deleted"); 
  TestStepAddActionExpected( chActionText, chExpectedText );
  
  A_DBGR_BreakpointDeleteAll();
  

  /***************************************************************************************************************/    
  	                            // Test Step 2 Set a breakpoint at "v_crcSts_u8 = GetHWIO_e_CalcCRC_St();"" inside "Test_hwcrc_llsi" function
  /***************************************************************************************************************/
  
  snprintf( chActionText, elCount(chActionText), "Set Breakpoint in v_crcSts_u8 = GetHWIO_e_CalcCRC_St(); "); 
  snprintf( chExpectedText, elCount(chExpectedText), "Verify Breakpoint is Set in v_crcSts_u8 = GetHWIO_e_CalcCRC_St();"); 
  //TestStepAddActionExpected( chActionText, chExpectedText );  
  A_DBGR_BreakpointSet("Test_hwcrc_llsi\\1203");  

  A_DBGR_Go();
  
  snprintf( chActionText, elCount(chActionText), "Verify Breakpoint should hit in v_crcSts_u8 = GetHWIO_e_CalcCRC_St(); "); 
  snprintf( chExpectedText, elCount(chExpectedText), "Breakpoint hit in v_crcSts_u8 = GetHWIO_e_CalcCRC_St(); function"); 
  E_DBGR_BreakpointCheckForHalt("Test_hwcrc_llsi\\1203");
  
  /***************************************************************************************************************/    
  	                            // Test Step 3 Verify v_coreId_u8 in trace32 watch window
  /***************************************************************************************************************/
  
while(1)
  {
  if(cnt == 0)
  {
  snprintf( chActionText, elCount(chActionText), "Verify v_coreId_u8 is 4 "); 
  snprintf( chExpectedText, elCount(chExpectedText), "Verify Verify v_coreId_u8 is 4"); 
  
  TestStepAddActionExpected( chActionText, chExpectedText );  
  }
  
  A_DBGR_VariableRead("v_coreId_u8",coreID);
  
  if(coreID == 4)
  {
    write("core ID is : %d",coreID);
    break;
  }
  if(cnt == 0)
  {
  snprintf( chActionText, elCount(chActionText), "Run debugger "); 
  snprintf( chExpectedText, elCount(chExpectedText), "Run debugger "); 
  }
  A_DBGR_Go();
  testWaitForTimeout(50000);
  
  cnt =cnt+1;
 
  }
  E_DBGR_VariableCheck("v_crcSts_u8",0,Equal);
  cnt =0;
  
  snprintf( chActionText, elCount(chActionText), "Delete all breakpoints "); 
  snprintf( chExpectedText, elCount(chExpectedText), "Breakpoints deleted"); 
  TestStepAddActionExpected( chActionText, chExpectedText );
  
  A_DBGR_BreakpointDeleteAll();
  /***************************************************************************************************************/    
  	                            // Test Step 4 Set a breakpoint at line"PerfmHWIO_h_CalcCRC ((BYTE)test_HwCrc_CRC32_ethernet_E, v_seed_u32, v_startAddr_u8, v_endAddr_u8);"
  /***************************************************************************************************************/
  snprintf( chActionText, elCount(chActionText), "Set Breakpoint inPerfmHWIO_h_CalcCRC ((BYTE)test_HwCrc_CRC32_ethernet_E, v_seed_u32, v_startAddr_u8, v_endAddr_u8); "); 
  snprintf( chExpectedText, elCount(chExpectedText), "Verify Breakpoint is Set in PerfmHWIO_h_CalcCRC ((BYTE)test_HwCrc_CRC32_ethernet_E, v_seed_u32, v_startAddr_u8, v_endAddr_u8);"); 
  //TestStepAddActionExpected( chActionText, chExpectedText );  
  A_DBGR_BreakpointSet("Test_hwcrc_llsi\\1219");  

  A_DBGR_Go();
  
  snprintf( chActionText, elCount(chActionText), "Verify Breakpoint should hit in v_crcSts_u8 = GetHWIO_e_CalcCRC_St(); "); 
  snprintf( chExpectedText, elCount(chExpectedText), "Breakpoint hit in v_crcSts_u8 = GetHWIO_e_CalcCRC_St(); function"); 
  E_DBGR_BreakpointCheckForHalt("Test_hwcrc_llsi\\1219");
  
  while(1)
  {
  if(cnt == 0)
  {
  snprintf( chActionText, elCount(chActionText), "Verify v_coreId_u8 is 4 "); 
  snprintf( chExpectedText, elCount(chExpectedText), "Verify Verify v_coreId_u8 is 4"); 
  
  TestStepAddActionExpected( chActionText, chExpectedText );  
  }
  
  A_DBGR_VariableRead("v_coreId_u8",coreID);
  if(coreID == 4)
  {
    write("core ID is : %d",coreID);
    break;
  }
  if(cnt == 0)
  {
  snprintf( chActionText, elCount(chActionText), "Run debugger "); 
  snprintf( chExpectedText, elCount(chExpectedText), "Run debugger "); 
  }
  testWaitForTimeout(1000);
  A_DBGR_Go();
  cnt =cnt+1;
 
  }
  E_DBGR_VariableCheck("v_crcSts_u8",0,Equal);
  cnt =0;
  snprintf( chActionText, elCount(chActionText), "Delete all breakpoints "); 
  snprintf( chExpectedText, elCount(chExpectedText), "Breakpoints deleted"); 
  TestStepAddActionExpected( chActionText, chExpectedText );  
  A_DBGR_BreakpointDeleteAll();
  
   /***************************************************************************************************************/    
  	                            // Test Step 5 Set a breakpoint at line"v_crcSts_u8 = GetHWIO_e_CalcCRC_St();"" inside Test_hwcrc_llsi"
  /***************************************************************************************************************/
  snprintf( chActionText, elCount(chActionText), "Set Breakpoint in v_crcSts_u8 = GetHWIO_e_CalcCRC_St();"" inside Test_hwcrc_llsi "); 
  snprintf( chExpectedText, elCount(chExpectedText), "Verify Breakpoint is Set in v_crcSts_u8 = GetHWIO_e_CalcCRC_St();"" inside Test_hwcrc_llsi"); 
// TestStepAddActionExpected( chActionText, chExpectedText );  
  A_DBGR_BreakpointSet("Test_hwcrc_llsi\\1224");  

  A_DBGR_Go();
  
  snprintf( chActionText, elCount(chActionText), "Verify Breakpoint should hit in v_crcSts_u8 = GetHWIO_e_CalcCRC_St(); "); 
  snprintf( chExpectedText, elCount(chExpectedText), "Breakpoint hit in v_crcSts_u8 = GetHWIO_e_CalcCRC_St(); function"); 
  E_DBGR_BreakpointCheckForHalt("Test_hwcrc_llsi\\1224");
  
   while(1)
  {
  if(cnt == 0)
  {
  snprintf( chActionText, elCount(chActionText), "Verify v_coreId_u8 is 3 "); 
  snprintf( chExpectedText, elCount(chExpectedText), "Verify Verify v_coreId_u8 is 3"); 
  
  TestStepAddActionExpected( chActionText, chExpectedText );  
  }
  
  A_DBGR_VariableRead("v_coreId_u8",coreID);
  if(coreID == 4)
  {
    write("core ID is : %d",coreID);
    break;
  }
  if(cnt == 0)
  {
  snprintf( chActionText, elCount(chActionText), "Run debugger "); 
  snprintf( chExpectedText, elCount(chExpectedText), "Run debugger "); 
  }
  A_DBGR_Go();
  cnt =cnt+1;
  testWaitForTimeout(1000);
  }
  
  cnt =0;
  
  A_DBGR_Go();
  /***************************************************************************************************************/    
  	                            // Test Step 6 Verify V_hwcrc_Test_Result[0].testResult[120] = 1 i.e; CRC calculation status is in Progress
  /***************************************************************************************************************/
  snprintf( chActionText, elCount(chActionText), " Verify V_hwcrc_Test_Result[4].testResult[120] = 1 "); 
  snprintf( chExpectedText, elCount(chExpectedText), " V_hwcrc_Test_Result[4].testResult[120] is 1"); 
  //TestStepAddActionExpected( chActionText, chExpectedText );
  E_DBGR_VariableCheck("V_hwcrc_Test_Result[4].testResult[120]",1,Equal);
}

testcase Verify_Hardware_CRC32_Calculation_Inprogress_Reporting_Core_5()
{
  /***************************************************************************************************************/    
                                                // Variable Definition
  /***************************************************************************************************************/ 
  

  
  /***************************************************************************************************************/    
                                               // Local Values
  /***************************************************************************************************************/ 
  

  
  /***************************************************************************************************************/    
                                              // Test Case Info
  /***************************************************************************************************************/
  setWriteDbgLevel(DebugOff);
  snprintf( chTestTitle, elCount(chTestTitle), "Verify_Hardware_CRC32_Calculation_Inprogress_Reporting_Core_5" );
  snprintf( chTestDescription, elCount(chTestDescription), "Purpose:To check the GetHWIO_e_CalcCRC_St(); interface  ");
  TestCaseAddInfo( chTestTitle, "TC_L30SW_Q-37079859", chTestDescription );

  /***************************************************************************************************************/    
                                              // Start of Test Case
  /***************************************************************************************************************/
  
  /***************************************************************************************************************/    
                                              // Test Step 0 PRECONDITIONS
  /***************************************************************************************************************/
  snprintf( chActionText, elCount(chActionText), "Flash the Software and ECU is running "); 
  snprintf( chExpectedText, elCount(chExpectedText), "Ecu is should be in running state"); 
  TestStepAddActionExpected( chActionText, chExpectedText );
  
  A_DBGR_BreakpointDeleteAll();
  A_DBGR_R();
  A_DBGR_Go();
   

   /***************************************************************************************************************/    
                                              // Test Step 1 Set breakpoint in line Test_hwcrc_llsi(); inside "TestApp_Core5_1000ms_MainFunction" function and inside testapp.c file
  /***************************************************************************************************************/
  snprintf( chActionText, elCount(chActionText), "Set Breakpoint in Test_hwcrc_llsi(); "); 
  snprintf( chExpectedText, elCount(chExpectedText), "Verify Breakpoint is Set in Test_hwcrc_llsi();"); 
  //TestStepAddActionExpected( chActionText, chExpectedText );  
  A_DBGR_BreakpointSet("TestApp_Core5_1000ms_MainFunction\\54");  

  A_DBGR_Go();
  
  snprintf( chActionText, elCount(chActionText), "Verify Breakpoint should hit in Test_hwcrc_llsi(); "); 
  snprintf( chExpectedText, elCount(chExpectedText), "Breakpoint hit in Test_hwcrc_llsi(); function"); 
  E_DBGR_BreakpointCheckForHalt("TestApp_Core5_1000ms_MainFunction\\54");
  
  testWaitForTimeout(2000);
  
  snprintf( chActionText, elCount(chActionText), "Delete all breakpoints "); 
  snprintf( chExpectedText, elCount(chExpectedText), "Breakpoints deleted"); 
  TestStepAddActionExpected( chActionText, chExpectedText );
  
  A_DBGR_BreakpointDeleteAll();
  /***************************************************************************************************************/    
  	                            // Test Step 2 Set a breakpoint at "v_crcSts_u8 = GetHWIO_e_CalcCRC_St();"" inside "Test_hwcrc_llsi" function
  /***************************************************************************************************************/
  
  snprintf( chActionText, elCount(chActionText), "Set Breakpoint in v_crcSts_u8 = GetHWIO_e_CalcCRC_St(); "); 
  snprintf( chExpectedText, elCount(chExpectedText), "Verify Breakpoint is Set in v_crcSts_u8 = GetHWIO_e_CalcCRC_St();"); 
  //TestStepAddActionExpected( chActionText, chExpectedText );  
  A_DBGR_BreakpointSet("Test_hwcrc_llsi\\1203");  

  A_DBGR_Go();
  
  snprintf( chActionText, elCount(chActionText), "Verify Breakpoint should hit in v_crcSts_u8 = GetHWIO_e_CalcCRC_St(); "); 
  snprintf( chExpectedText, elCount(chExpectedText), "Breakpoint hit in v_crcSts_u8 = GetHWIO_e_CalcCRC_St(); function"); 
  E_DBGR_BreakpointCheckForHalt("Test_hwcrc_llsi\\1203");
  
  /***************************************************************************************************************/    
  	                            // Test Step 3 Verify v_coreId_u8 in trace32 watch window
  /***************************************************************************************************************/
  
while(1)
  {
  if(cnt == 0)
  {
  snprintf( chActionText, elCount(chActionText), "Verify v_coreId_u8 is 5 "); 
  snprintf( chExpectedText, elCount(chExpectedText), "Verify Verify v_coreId_u8 is 5"); 
  
  TestStepAddActionExpected( chActionText, chExpectedText );  
  }
  
  A_DBGR_VariableRead("v_coreId_u8",coreID);
  
  if(coreID == 5)
  {
    write("core ID is : %d",coreID);
    break;
  }
  if(cnt == 0)
  {
  snprintf( chActionText, elCount(chActionText), "Run debugger "); 
  snprintf( chExpectedText, elCount(chExpectedText), "Run debugger "); 
  }
  
  A_DBGR_Go();
  testWaitForTimeout(3000);
  if(cnt == 3)
  {
    testWaitForTimeout(60000);
  }
 
  //A_DBGR_Go();
  cnt =cnt+1;
  testWaitForTimeout(1000);
  }
  E_DBGR_VariableCheck("v_crcSts_u8",0,Equal);
  cnt =0;
  
  snprintf( chActionText, elCount(chActionText), "Delete all breakpoints "); 
  snprintf( chExpectedText, elCount(chExpectedText), "Breakpoints deleted"); 
  TestStepAddActionExpected( chActionText, chExpectedText );
  
  A_DBGR_BreakpointDeleteAll();
  /***************************************************************************************************************/    
  	                            // Test Step 4 Set a breakpoint at line"PerfmHWIO_h_CalcCRC ((BYTE)test_HwCrc_CRC32_ethernet_E, v_seed_u32, v_startAddr_u8, v_endAddr_u8);"
  /***************************************************************************************************************/
  snprintf( chActionText, elCount(chActionText), "Set Breakpoint inPerfmHWIO_h_CalcCRC ((BYTE)test_HwCrc_CRC32_ethernet_E, v_seed_u32, v_startAddr_u8, v_endAddr_u8); "); 
  snprintf( chExpectedText, elCount(chExpectedText), "Verify Breakpoint is Set in PerfmHWIO_h_CalcCRC ((BYTE)test_HwCrc_CRC32_ethernet_E, v_seed_u32, v_startAddr_u8, v_endAddr_u8);"); 
  //TestStepAddActionExpected( chActionText, chExpectedText );  
  A_DBGR_BreakpointSet("Test_hwcrc_llsi\\1219");  

  A_DBGR_Go();
  
  snprintf( chActionText, elCount(chActionText), "Verify Breakpoint should hit in v_crcSts_u8 = GetHWIO_e_CalcCRC_St(); "); 
  snprintf( chExpectedText, elCount(chExpectedText), "Breakpoint hit in v_crcSts_u8 = GetHWIO_e_CalcCRC_St(); function"); 
  E_DBGR_BreakpointCheckForHalt("Test_hwcrc_llsi\\1219");
  
  while(1)
  {
  if(cnt == 0)
  {
  snprintf( chActionText, elCount(chActionText), "Verify v_coreId_u8 is 4 "); 
  snprintf( chExpectedText, elCount(chExpectedText), "Verify Verify v_coreId_u8 is 4"); 
  
  TestStepAddActionExpected( chActionText, chExpectedText );  
  }
  
  A_DBGR_VariableRead("v_coreId_u8",coreID);
  if(coreID == 5)
  {
    write("core ID is : %d",coreID);
    break;
  }
  if(cnt == 0)
  {
  snprintf( chActionText, elCount(chActionText), "Run debugger "); 
  snprintf( chExpectedText, elCount(chExpectedText), "Run debugger "); 
  }
  testWaitForTimeout(1000);
  A_DBGR_Go();
  cnt =cnt+1;
 
  }
  E_DBGR_VariableCheck("v_crcSts_u8",0,Equal);
  cnt =0;
  snprintf( chActionText, elCount(chActionText), "Delete all breakpoints "); 
  snprintf( chExpectedText, elCount(chExpectedText), "Breakpoints deleted"); 
  TestStepAddActionExpected( chActionText, chExpectedText );  
  A_DBGR_BreakpointDeleteAll();
  
   /***************************************************************************************************************/    
  	                            // Test Step 5 Set a breakpoint at line"v_crcSts_u8 = GetHWIO_e_CalcCRC_St();"" inside Test_hwcrc_llsi"
  /***************************************************************************************************************/
  snprintf( chActionText, elCount(chActionText), "Set Breakpoint in v_crcSts_u8 = GetHWIO_e_CalcCRC_St();"" inside Test_hwcrc_llsi "); 
  snprintf( chExpectedText, elCount(chExpectedText), "Verify Breakpoint is Set in v_crcSts_u8 = GetHWIO_e_CalcCRC_St();"" inside Test_hwcrc_llsi"); 
// TestStepAddActionExpected( chActionText, chExpectedText );  
  A_DBGR_BreakpointSet("Test_hwcrc_llsi\\1224");  

  A_DBGR_Go();
  
  snprintf( chActionText, elCount(chActionText), "Verify Breakpoint should hit in v_crcSts_u8 = GetHWIO_e_CalcCRC_St(); "); 
  snprintf( chExpectedText, elCount(chExpectedText), "Breakpoint hit in v_crcSts_u8 = GetHWIO_e_CalcCRC_St(); function"); 
  E_DBGR_BreakpointCheckForHalt("Test_hwcrc_llsi\\1224");
  
   while(1)
  {
  if(cnt == 0)
  {
  snprintf( chActionText, elCount(chActionText), "Verify v_coreId_u8 is 5 "); 
  snprintf( chExpectedText, elCount(chExpectedText), "Verify Verify v_coreId_u8 is 5"); 
  
  TestStepAddActionExpected( chActionText, chExpectedText );  
  }
  
  A_DBGR_VariableRead("v_coreId_u8",coreID);
  if(coreID == 5)
  {
    write("core ID is : %d",coreID);
    break;
  }
  if(cnt == 0)
  {
  snprintf( chActionText, elCount(chActionText), "Run debugger "); 
  snprintf( chExpectedText, elCount(chExpectedText), "Run debugger "); 
  }
  A_DBGR_Go();
  cnt =cnt+1;
  testWaitForTimeout(1000);
  }
  
  cnt =0;
  
  A_DBGR_Go();
  /***************************************************************************************************************/    
  	                            // Test Step 6 Verify V_hwcrc_Test_Result[0].testResult[120] = 1 i.e; CRC calculation status is in Progress
  /***************************************************************************************************************/
  snprintf( chActionText, elCount(chActionText), " Verify V_hwcrc_Test_Result[4].testResult[120] = 1 "); 
  snprintf( chExpectedText, elCount(chExpectedText), " V_hwcrc_Test_Result[4].testResult[120] is 1"); 
  //TestStepAddActionExpected( chActionText, chExpectedText );
  E_DBGR_VariableCheck("V_hwcrc_Test_Result[5].testResult[120]",1,Equal);
}

testcase Verify_Hardware_CRC32_Calculation_SignatureAvail_Reporting_Core_0()
{
  /***************************************************************************************************************/    
                                                // Variable Definition
  /***************************************************************************************************************/ 
  

  
  /***************************************************************************************************************/    
                                               // Local Values
  /***************************************************************************************************************/ 
  

  
  /***************************************************************************************************************/    
                                              // Test Case Info
  /***************************************************************************************************************/
  setWriteDbgLevel(DebugOff);
  snprintf( chTestTitle, elCount(chTestTitle), "Verify_Hardware_CRC32_Calculation_SignatureAvail_Reporting_Core_0" );
  snprintf( chTestDescription, elCount(chTestDescription), "Purpose:To check the GetHWIO_e_CalcCRC_St(); interface  ");
  TestCaseAddInfo( chTestTitle, "TC_L30SW_Q-36925278", chTestDescription );

  /***************************************************************************************************************/    
                                              // Start of Test Case
  /***************************************************************************************************************/
  
  /***************************************************************************************************************/    
                                              // Test Step 0 PRECONDITIONS
  /***************************************************************************************************************/
  snprintf( chActionText, elCount(chActionText), "Flash the Software and ECU is running "); 
  snprintf( chExpectedText, elCount(chExpectedText), "Ecu is should be in running state"); 
  TestStepAddActionExpected( chActionText, chExpectedText );
  
  A_DBGR_BreakpointDeleteAll();
  A_DBGR_R();
  A_DBGR_Go();
   

  /***************************************************************************************************************/    
                                              // Test Step 1 Set breakpoint in line Test_hwcrc_llsi(); inside "TestApp_Core0_10ms_MainFunction" function and inside testapp.c file
  /***************************************************************************************************************/
  snprintf( chActionText, elCount(chActionText), "Set Breakpoint in Test_hwcrc_llsi(); "); 
  snprintf( chExpectedText, elCount(chExpectedText), "Verify Breakpoint is Set in Test_hwcrc_llsi();"); 
  //TestStepAddActionExpected( chActionText, chExpectedText );  
  A_DBGR_BreakpointSet("TestApp_Core0_10ms_MainFunction\\45");  

  A_DBGR_Go();
  
  snprintf( chActionText, elCount(chActionText), "Verify Breakpoint should hit in Test_hwcrc_llsi(); "); 
  snprintf( chExpectedText, elCount(chExpectedText), "Breakpoint hit in Test_hwcrc_llsi(); function"); 
  E_DBGR_BreakpointCheckForHalt("TestApp_Core0_10ms_MainFunction\\45");
  
  snprintf( chActionText, elCount(chActionText), "Delete all breakpoints "); 
  snprintf( chExpectedText, elCount(chExpectedText), "Breakpoints deleted"); 
  TestStepAddActionExpected( chActionText, chExpectedText );
  
  A_DBGR_BreakpointDeleteAll();
  
   
  /***************************************************************************************************************/    
  	                            // Test Step 2 Set a breakpoint at "v_coreId_u8 = (BYTE)GetCoreID();" inside "Test_hwcrc_llsi" function
  /***************************************************************************************************************/
  
  snprintf( chActionText, elCount(chActionText), "Set Breakpoint in v_coreId_u8 = (BYTE)GetCoreID(); "); 
  snprintf( chExpectedText, elCount(chExpectedText), "Verify Breakpoint is Set in v_coreId_u8 = (BYTE)GetCoreID();"); 
  //TestStepAddActionExpected( chActionText, chExpectedText );  
  A_DBGR_BreakpointSet("Test_hwcrc_llsi\\227");  

  A_DBGR_Go();
  
  snprintf( chActionText, elCount(chActionText), "Verify Breakpoint should hit in v_coreId_u8 = (BYTE)GetCoreID(); "); 
  snprintf( chExpectedText, elCount(chExpectedText), "Breakpoint hit in v_coreId_u8 = (BYTE)GetCoreID(); function"); 
  E_DBGR_BreakpointCheckForHalt("Test_hwcrc_llsi\\227");
  
  /***************************************************************************************************************/    
  	                            // Test Step 3 Verify v_coreId_u8 in trace32 watch window
  /***************************************************************************************************************/
  
   while(1)
  {
  if(cnt == 0)
  {
  snprintf( chActionText, elCount(chActionText), "Verify v_coreId_u8 is 0 "); 
  snprintf( chExpectedText, elCount(chExpectedText), "Verify Verify v_coreId_u8 is 0"); 
  
  TestStepAddActionExpected( chActionText, chExpectedText );  
  }
  
  A_DBGR_VariableRead("v_coreId_u8",coreID);
  if(coreID == 0)
  {
    break;
  }
  if(cnt == 0)
  {
  snprintf( chActionText, elCount(chActionText), "Run debugger "); 
  snprintf( chExpectedText, elCount(chExpectedText), "Run debugger "); 
  }
  A_DBGR_Go();
  cnt =cnt+1;
  }
  E_DBGR_VariableCheck("v_crcSts_u8",0,Equal);
  cnt =0;
  snprintf( chActionText, elCount(chActionText), "delete all breakpoints "); 
  snprintf( chExpectedText, elCount(chExpectedText), "delete all breakpoints "); 
  TestStepAddActionExpected( chActionText, chExpectedText );
  A_DBGR_BreakpointDeleteAll();
  /***************************************************************************************************************/    
  	                            // Test Step 4 Set a breakpoint at line"PerfmHWIO_h_CalcCRC ((BYTE)test_HwCrc_CRC32_ethernet_E, v_seed_u32, v_startAddr_u8, v_endAddr_u8);"
  /***************************************************************************************************************/
  snprintf( chActionText, elCount(chActionText), "Set Breakpoint inPerfmHWIO_h_CalcCRC ((BYTE)test_HwCrc_CRC32_ethernet_E, v_seed_u32, v_startAddr_u8, v_endAddr_u8); "); 
  snprintf( chExpectedText, elCount(chExpectedText), "Verify Breakpoint is Set in PerfmHWIO_h_CalcCRC ((BYTE)test_HwCrc_CRC32_ethernet_E, v_seed_u32, v_startAddr_u8, v_endAddr_u8);"); 
  //TestStepAddActionExpected( chActionText, chExpectedText );  
  A_DBGR_BreakpointSet("Test_hwcrc_llsi\\253");  

  A_DBGR_Go();
  
  snprintf( chActionText, elCount(chActionText), "Verify Breakpoint should hit in v_crcSts_u8 = GetHWIO_e_CalcCRC_St(); "); 
  snprintf( chExpectedText, elCount(chExpectedText), "Breakpoint hit in v_crcSts_u8 = GetHWIO_e_CalcCRC_St(); function"); 
  E_DBGR_BreakpointCheckForHalt("Test_hwcrc_llsi\\253");
  
  while(1)
  {
  if(cnt == 0)
  {
  snprintf( chActionText, elCount(chActionText), "Verify v_coreId_u8 is 0 "); 
  snprintf( chExpectedText, elCount(chExpectedText), "Verify Verify v_coreId_u8 is 0"); 
  
  TestStepAddActionExpected( chActionText, chExpectedText );  
  }
  
  A_DBGR_VariableRead("v_coreId_u8",coreID);
  if(coreID == 0)
  {
    write("core ID is : %d",coreID);
    break;
  }
  if(cnt == 0)
  {
  snprintf( chActionText, elCount(chActionText), "Run debugger "); 
  snprintf( chExpectedText, elCount(chExpectedText), "Run debugger "); 
  }
  testWaitForTimeout(1000);
  A_DBGR_Go();
  cnt =cnt+1;
 
  }
  cnt =0;
  A_DBGR_BreakpointDeleteAll();
  
   /***************************************************************************************************************/    
  	                            // Test Step 5 Set a breakpoint at line"v_crcSts_u8 = GetHWIO_e_CalcCRC_St();"" inside Test_hwcrc_llsi"
  /***************************************************************************************************************/
  snprintf( chActionText, elCount(chActionText), "Set Breakpoint in v_crcSts_u8 = GetHWIO_e_CalcCRC_St();"" inside Test_hwcrc_llsi "); 
  snprintf( chExpectedText, elCount(chExpectedText), "Verify Breakpoint is Set in v_crcSts_u8 = GetHWIO_e_CalcCRC_St();"" inside Test_hwcrc_llsi"); 
//  TestStepAddActionExpected( chActionText, chExpectedText );  
  A_DBGR_BreakpointSet("Test_hwcrc_llsi\\255");  

  A_DBGR_Go();
  
  snprintf( chActionText, elCount(chActionText), "Verify Breakpoint should hit in v_crcSts_u8 = GetHWIO_e_CalcCRC_St(); "); 
  snprintf( chExpectedText, elCount(chExpectedText), "Breakpoint hit in v_crcSts_u8 = GetHWIO_e_CalcCRC_St(); function"); 
  E_DBGR_BreakpointCheckForHalt("Test_hwcrc_llsi\\255");
  while(1)
  {
  if(cnt == 0)
  {
  snprintf( chActionText, elCount(chActionText), "Verify v_coreId_u8 is 0 "); 
  snprintf( chExpectedText, elCount(chExpectedText), "Verify Verify v_coreId_u8 is 0"); 
  
  TestStepAddActionExpected( chActionText, chExpectedText );  
  }
  
  A_DBGR_VariableRead("v_coreId_u8",coreID);
  if(coreID == 0)
  {
    write("core ID is : %d",coreID);
    break;
  }
  if(cnt == 0)
  {
  snprintf( chActionText, elCount(chActionText), "Run debugger "); 
  snprintf( chExpectedText, elCount(chExpectedText), "Run debugger "); 
  }
  testWaitForTimeout(1000);
  A_DBGR_Go();
  cnt =cnt+1;
 
  }
  cnt =0;
  E_DBGR_VariableCheck("v_crcSts_u8",2,Equal);
  
  snprintf( chActionText, elCount(chActionText), "Delete all breakpoints "); 
  snprintf( chExpectedText, elCount(chExpectedText), "Breakpoints deleted"); 
  TestStepAddActionExpected( chActionText, chExpectedText );
  A_DBGR_BreakpointDeleteAll();
  /***************************************************************************************************************/    
  	                            // Test Step 6 Set a breakpoint after the line"v_sigVal_u32 = GetHWIO_g_CalcCRC_Sig();"
  /***************************************************************************************************************/
  snprintf( chActionText, elCount(chActionText), "Set Breakpoint in v_crcSts_u8 = GetHWIO_e_CalcCRC_St();"" inside Test_hwcrc_llsi "); 
  snprintf( chExpectedText, elCount(chExpectedText), "Verify Breakpoint is Set in v_crcSts_u8 = GetHWIO_e_CalcCRC_St();"" inside Test_hwcrc_llsi"); 
//  TestStepAddActionExpected( chActionText, chExpectedText );  
  A_DBGR_BreakpointSet("Test_hwcrc_llsi\\292");  

  A_DBGR_Go();
  
  snprintf( chActionText, elCount(chActionText), "Verify Breakpoint should hit in v_crcSts_u8 = GetHWIO_e_CalcCRC_St(); "); 
  snprintf( chExpectedText, elCount(chExpectedText), "Breakpoint hit in v_crcSts_u8 = GetHWIO_e_CalcCRC_St(); function"); 
  E_DBGR_BreakpointCheckForHalt("Test_hwcrc_llsi\\292");
  while(1)
  {
  if(cnt == 0)
  {
  snprintf( chActionText, elCount(chActionText), "Verify v_coreId_u8 is 0 "); 
  snprintf( chExpectedText, elCount(chExpectedText), "Verify Verify v_coreId_u8 is 0"); 
  
  TestStepAddActionExpected( chActionText, chExpectedText );  
  }
  
  A_DBGR_VariableRead("v_coreId_u8",coreID);
  if(coreID == 0)
  {
    write("core ID is : %d",coreID);
    break;
  }
  if(cnt == 0)
  {
  snprintf( chActionText, elCount(chActionText), "Run debugger "); 
  snprintf( chExpectedText, elCount(chExpectedText), "Run debugger "); 
  }
  testWaitForTimeout(1000);
  A_DBGR_Go();
  cnt =cnt+1;
 
  }
  cnt =0;
  E_DBGR_VariableCheck("v_sigVal_u32",0x45D8EE73,Equal);
  snprintf( chActionText, elCount(chActionText), "Delete all breakpoints "); 
  snprintf( chExpectedText, elCount(chExpectedText), "Breakpoints deleted"); 
  TestStepAddActionExpected( chActionText, chExpectedText );
  A_DBGR_BreakpointDeleteAll();
  /***************************************************************************************************************/    
  	                            // Test Step 7 Set a breakpoint at line"v_crcSts_u8 = GetHWIO_e_CalcCRC_St();"" inside Test_hwcrc_llsi"
  /***************************************************************************************************************/
  snprintf( chActionText, elCount(chActionText), "Set Breakpoint in v_crcSts_u8 = GetHWIO_e_CalcCRC_St();"" inside Test_hwcrc_llsi "); 
  snprintf( chExpectedText, elCount(chExpectedText), "Verify Breakpoint is Set in v_crcSts_u8 = GetHWIO_e_CalcCRC_St();"" inside Test_hwcrc_llsi"); 
//  TestStepAddActionExpected( chActionText, chExpectedText );  
  A_DBGR_BreakpointSet("Test_hwcrc_llsi\\308");  

  A_DBGR_Go();
  
  snprintf( chActionText, elCount(chActionText), "Verify Breakpoint should hit in v_crcSts_u8 = GetHWIO_e_CalcCRC_St(); "); 
  snprintf( chExpectedText, elCount(chExpectedText), "Breakpoint hit in v_crcSts_u8 = GetHWIO_e_CalcCRC_St(); function"); 
  E_DBGR_BreakpointCheckForHalt("Test_hwcrc_llsi\\308");
  while(1)
  {
  if(cnt == 0)
  {
  snprintf( chActionText, elCount(chActionText), "Verify v_coreId_u8 is 0 "); 
  snprintf( chExpectedText, elCount(chExpectedText), "Verify Verify v_coreId_u8 is 0"); 
  
  TestStepAddActionExpected( chActionText, chExpectedText );  
  }
  
  A_DBGR_VariableRead("v_coreId_u8",coreID);
  if(coreID == 0)
  {
    write("core ID is : %d",coreID);
    break;
  }
  if(cnt == 0)
  {
  snprintf( chActionText, elCount(chActionText), "Run debugger "); 
  snprintf( chExpectedText, elCount(chExpectedText), "Run debugger "); 
  }
  testWaitForTimeout(1000);
  A_DBGR_Go();
  cnt =cnt+1;
 
  }
  cnt =0;
  E_DBGR_VariableCheck("v_crcSts_u8",0,Equal);
}

testcase Verify_Hardware_CRC16_Calculation_SignatureAvail_Reporting_Core_0()
{
  /***************************************************************************************************************/    
                                                // Variable Definition
  /***************************************************************************************************************/ 
  

  
  /***************************************************************************************************************/    
                                               // Local Values
  /***************************************************************************************************************/ 
  

  
  /***************************************************************************************************************/    
                                              // Test Case Info
  /***************************************************************************************************************/
  setWriteDbgLevel(DebugOff);
  snprintf( chTestTitle, elCount(chTestTitle), "Verify_Hardware_CRC16_Calculation_SignatureAvail_Reporting_Core_0" );
  snprintf( chTestDescription, elCount(chTestDescription), "Purpose:To check the GetHWIO_e_CalcCRC_St(); interface  ");
  TestCaseAddInfo( chTestTitle, "TC_L30SW_Q-36925300", chTestDescription );

  /***************************************************************************************************************/    
                                              // Start of Test Case
  /***************************************************************************************************************/
  
  /***************************************************************************************************************/    
                                              // Test Step 0 PRECONDITIONS
  /***************************************************************************************************************/
  snprintf( chActionText, elCount(chActionText), "Flash the Software and ECU is running "); 
  snprintf( chExpectedText, elCount(chExpectedText), "Ecu is should be in running state"); 
  TestStepAddActionExpected( chActionText, chExpectedText );
  
  A_DBGR_BreakpointDeleteAll();
  A_DBGR_R();
  A_DBGR_Go();
   

  /***************************************************************************************************************/    
                                              // Test Step 1 Set breakpoint in line Test_hwcrc_llsi(); inside "TestApp_Core0_10ms_MainFunction" function and inside testapp.c file
  /***************************************************************************************************************/
  snprintf( chActionText, elCount(chActionText), "Set Breakpoint in Test_hwcrc_llsi(); "); 
  snprintf( chExpectedText, elCount(chExpectedText), "Verify Breakpoint is Set in Test_hwcrc_llsi();"); 
  //TestStepAddActionExpected( chActionText, chExpectedText );  
  A_DBGR_BreakpointSet("TestApp_Core0_10ms_MainFunction\\45");  

  A_DBGR_Go();
  
  snprintf( chActionText, elCount(chActionText), "Verify Breakpoint should hit in Test_hwcrc_llsi(); "); 
  snprintf( chExpectedText, elCount(chExpectedText), "Breakpoint hit in Test_hwcrc_llsi(); function"); 
  E_DBGR_BreakpointCheckForHalt("TestApp_Core0_10ms_MainFunction\\45");
  
  snprintf( chActionText, elCount(chActionText), "Delete all breakpoints "); 
  snprintf( chExpectedText, elCount(chExpectedText), "Breakpoints deleted"); 
  TestStepAddActionExpected( chActionText, chExpectedText );
  
  A_DBGR_BreakpointDeleteAll();
  
   
  /***************************************************************************************************************/    
  	                            // Test Step 2 Set a breakpoint at "v_coreId_u8 = (BYTE)GetCoreID();" inside "Test_hwcrc_llsi" function
  /***************************************************************************************************************/
  
  snprintf( chActionText, elCount(chActionText), "Set Breakpoint in v_coreId_u8 = (BYTE)GetCoreID(); "); 
  snprintf( chExpectedText, elCount(chExpectedText), "Verify Breakpoint is Set in v_coreId_u8 = (BYTE)GetCoreID();"); 
  //TestStepAddActionExpected( chActionText, chExpectedText );  
  A_DBGR_BreakpointSet("Test_hwcrc_llsi\\120");  

  A_DBGR_Go();
  
  snprintf( chActionText, elCount(chActionText), "Verify Breakpoint should hit in v_coreId_u8 = (BYTE)GetCoreID(); "); 
  snprintf( chExpectedText, elCount(chExpectedText), "Breakpoint hit in v_coreId_u8 = (BYTE)GetCoreID(); function"); 
  E_DBGR_BreakpointCheckForHalt("Test_hwcrc_llsi\\120");
  
  /***************************************************************************************************************/    
  	                            // Test Step 3 Verify v_coreId_u8 in trace32 watch window
  /***************************************************************************************************************/
  
   while(1)
  {
  if(cnt == 0)
  {
  snprintf( chActionText, elCount(chActionText), "Verify v_coreId_u8 is 0 "); 
  snprintf( chExpectedText, elCount(chExpectedText), "Verify Verify v_coreId_u8 is 0"); 
  
  TestStepAddActionExpected( chActionText, chExpectedText );  
  }
  
  A_DBGR_VariableRead("v_coreId_u8",coreID);
  if(coreID == 0)
  {
    break;
  }
  if(cnt == 0)
  {
  snprintf( chActionText, elCount(chActionText), "Run debugger "); 
  snprintf( chExpectedText, elCount(chExpectedText), "Run debugger "); 
  }
  A_DBGR_Go();
  cnt =cnt+1;
  }
  E_DBGR_VariableCheck("v_crcSts_u8",0,Equal);
  cnt =0;
  snprintf( chActionText, elCount(chActionText), "delete all breakpoints "); 
  snprintf( chExpectedText, elCount(chExpectedText), "delete all breakpoints "); 
  TestStepAddActionExpected( chActionText, chExpectedText );
  A_DBGR_BreakpointDeleteAll();
  /***************************************************************************************************************/    
  	                            // Test Step 4 Set a breakpoint at line"PerfmHWIO_h_CalcCRC ((BYTE)test_HwCrc_CRC32_ethernet_E, v_seed_u32, v_startAddr_u8, v_endAddr_u8);"
  /***************************************************************************************************************/
  snprintf( chActionText, elCount(chActionText), "Set Breakpoint inPerfmHWIO_h_CalcCRC ((BYTE)test_HwCrc_CRC32_ethernet_E, v_seed_u32, v_startAddr_u8, v_endAddr_u8); "); 
  snprintf( chExpectedText, elCount(chExpectedText), "Verify Breakpoint is Set in PerfmHWIO_h_CalcCRC ((BYTE)test_HwCrc_CRC32_ethernet_E, v_seed_u32, v_startAddr_u8, v_endAddr_u8);"); 
  //TestStepAddActionExpected( chActionText, chExpectedText );  
  A_DBGR_BreakpointSet("Test_hwcrc_llsi\\148");  

  A_DBGR_Go();
  
  snprintf( chActionText, elCount(chActionText), "Verify Breakpoint should hit in v_crcSts_u8 = GetHWIO_e_CalcCRC_St(); "); 
  snprintf( chExpectedText, elCount(chExpectedText), "Breakpoint hit in v_crcSts_u8 = GetHWIO_e_CalcCRC_St(); function"); 
  E_DBGR_BreakpointCheckForHalt("Test_hwcrc_llsi\\148");
  
  while(1)
  {
  if(cnt == 0)
  {
  snprintf( chActionText, elCount(chActionText), "Verify v_coreId_u8 is 0 "); 
  snprintf( chExpectedText, elCount(chExpectedText), "Verify Verify v_coreId_u8 is 0"); 
  
  TestStepAddActionExpected( chActionText, chExpectedText );  
  }
  
  A_DBGR_VariableRead("v_coreId_u8",coreID);
  if(coreID == 0)
  {
    write("core ID is : %d",coreID);
    break;
  }
  if(cnt == 0)
  {
  snprintf( chActionText, elCount(chActionText), "Run debugger "); 
  snprintf( chExpectedText, elCount(chExpectedText), "Run debugger "); 
  }
  testWaitForTimeout(1000);
  A_DBGR_Go();
  cnt =cnt+1;
 
  }
  cnt =0;
  A_DBGR_BreakpointDeleteAll();
  
   /***************************************************************************************************************/    
  	                            // Test Step 5 Set a breakpoint at line"v_crcSts_u8 = GetHWIO_e_CalcCRC_St();"" inside Test_hwcrc_llsi"
  /***************************************************************************************************************/
  snprintf( chActionText, elCount(chActionText), "Set Breakpoint in v_crcSts_u8 = GetHWIO_e_CalcCRC_St();"" inside Test_hwcrc_llsi "); 
  snprintf( chExpectedText, elCount(chExpectedText), "Verify Breakpoint is Set in v_crcSts_u8 = GetHWIO_e_CalcCRC_St();"" inside Test_hwcrc_llsi"); 
//  TestStepAddActionExpected( chActionText, chExpectedText );  
  A_DBGR_BreakpointSet("Test_hwcrc_llsi\\150");  

  A_DBGR_Go();
  
  snprintf( chActionText, elCount(chActionText), "Verify Breakpoint should hit in v_crcSts_u8 = GetHWIO_e_CalcCRC_St(); "); 
  snprintf( chExpectedText, elCount(chExpectedText), "Breakpoint hit in v_crcSts_u8 = GetHWIO_e_CalcCRC_St(); function"); 
  E_DBGR_BreakpointCheckForHalt("Test_hwcrc_llsi\\150");
  while(1)
  {
  if(cnt == 0)
  {
  snprintf( chActionText, elCount(chActionText), "Verify v_coreId_u8 is 0 "); 
  snprintf( chExpectedText, elCount(chExpectedText), "Verify Verify v_coreId_u8 is 0"); 
  
  TestStepAddActionExpected( chActionText, chExpectedText );  
  }
  
  A_DBGR_VariableRead("v_coreId_u8",coreID);
  if(coreID == 0)
  {
    write("core ID is : %d",coreID);
    break;
  }
  if(cnt == 0)
  {
  snprintf( chActionText, elCount(chActionText), "Run debugger "); 
  snprintf( chExpectedText, elCount(chExpectedText), "Run debugger "); 
  }
  testWaitForTimeout(1000);
  A_DBGR_Go();
  cnt =cnt+1;
 
  }
  cnt =0;
  E_DBGR_VariableCheck("v_crcSts_u8",2,Equal);
  
  snprintf( chActionText, elCount(chActionText), "Delete all breakpoints "); 
  snprintf( chExpectedText, elCount(chExpectedText), "Breakpoints deleted"); 
  TestStepAddActionExpected( chActionText, chExpectedText );
  A_DBGR_BreakpointDeleteAll();
  /***************************************************************************************************************/    
  	                            // Test Step 6 Set a breakpoint after the line"v_sigVal_u32 = GetHWIO_g_CalcCRC_Sig();"
  /***************************************************************************************************************/
  snprintf( chActionText, elCount(chActionText), "Set Breakpoint in v_crcSts_u8 = GetHWIO_e_CalcCRC_St();"" inside Test_hwcrc_llsi "); 
  snprintf( chExpectedText, elCount(chExpectedText), "Verify Breakpoint is Set in v_crcSts_u8 = GetHWIO_e_CalcCRC_St();"" inside Test_hwcrc_llsi"); 
//  TestStepAddActionExpected( chActionText, chExpectedText );  
  A_DBGR_BreakpointSet("Test_hwcrc_llsi\\203");  

  A_DBGR_Go();
  
  snprintf( chActionText, elCount(chActionText), "Verify Breakpoint should hit in v_crcSts_u8 = GetHWIO_e_CalcCRC_St(); "); 
  snprintf( chExpectedText, elCount(chExpectedText), "Breakpoint hit in v_crcSts_u8 = GetHWIO_e_CalcCRC_St(); function"); 
  E_DBGR_BreakpointCheckForHalt("Test_hwcrc_llsi\\203");
  while(1)
  {
  if(cnt == 0)
  {
  snprintf( chActionText, elCount(chActionText), "Verify v_coreId_u8 is 0 "); 
  snprintf( chExpectedText, elCount(chExpectedText), "Verify Verify v_coreId_u8 is 0"); 
  
  TestStepAddActionExpected( chActionText, chExpectedText );  
  }
  
  A_DBGR_VariableRead("v_coreId_u8",coreID);
  if(coreID == 0)
  {
    write("core ID is : %d",coreID);
    break;
  }
  if(cnt == 0)
  {
  snprintf( chActionText, elCount(chActionText), "Run debugger "); 
  snprintf( chExpectedText, elCount(chExpectedText), "Run debugger "); 
  }
  testWaitForTimeout(1000);
  A_DBGR_Go();
  cnt =cnt+1;
 
  }
  cnt =0;
  E_DBGR_VariableCheck("v_sigVal_u32",0x6810,Equal);
  snprintf( chActionText, elCount(chActionText), "Delete all breakpoints "); 
  snprintf( chExpectedText, elCount(chExpectedText), "Breakpoints deleted"); 
  TestStepAddActionExpected( chActionText, chExpectedText );
  A_DBGR_BreakpointDeleteAll();
  /***************************************************************************************************************/    
  	                            // Test Step 7 Set a breakpoint at line"v_crcSts_u8 = GetHWIO_e_CalcCRC_St();"" inside Test_hwcrc_llsi"
  /***************************************************************************************************************/
  snprintf( chActionText, elCount(chActionText), "Set Breakpoint in v_crcSts_u8 = GetHWIO_e_CalcCRC_St();"" inside Test_hwcrc_llsi "); 
  snprintf( chExpectedText, elCount(chExpectedText), "Verify Breakpoint is Set in v_crcSts_u8 = GetHWIO_e_CalcCRC_St();"" inside Test_hwcrc_llsi"); 
//  TestStepAddActionExpected( chActionText, chExpectedText );  
  A_DBGR_BreakpointSet("Test_hwcrc_llsi\\227");  

  A_DBGR_Go();
  
  snprintf( chActionText, elCount(chActionText), "Verify Breakpoint should hit in v_crcSts_u8 = GetHWIO_e_CalcCRC_St(); "); 
  snprintf( chExpectedText, elCount(chExpectedText), "Breakpoint hit in v_crcSts_u8 = GetHWIO_e_CalcCRC_St(); function"); 
  E_DBGR_BreakpointCheckForHalt("Test_hwcrc_llsi\\227");
  while(1)
  {
  if(cnt == 0)
  {
  snprintf( chActionText, elCount(chActionText), "Verify v_coreId_u8 is 0 "); 
  snprintf( chExpectedText, elCount(chExpectedText), "Verify Verify v_coreId_u8 is 0"); 
  
  TestStepAddActionExpected( chActionText, chExpectedText );  
  }
  
  A_DBGR_VariableRead("v_coreId_u8",coreID);
  if(coreID == 0)
  {
    write("core ID is : %d",coreID);
    break;
  }
  if(cnt == 0)
  {
  snprintf( chActionText, elCount(chActionText), "Run debugger "); 
  snprintf( chExpectedText, elCount(chExpectedText), "Run debugger "); 
  }
  testWaitForTimeout(1000);
  A_DBGR_Go();
  cnt =cnt+1;
 
  }
  cnt =0;
  E_DBGR_VariableCheck("v_crcSts_u8",0,Equal);
}

testcase Verify_Hardware_CRC8_Calculation_SignatureAvail_Reporting_Core_0()
{
  /***************************************************************************************************************/    
                                                // Variable Definition
  /***************************************************************************************************************/ 
  

  
  /***************************************************************************************************************/    
                                               // Local Values
  /***************************************************************************************************************/ 
  

  
  /***************************************************************************************************************/    
                                              // Test Case Info
  /***************************************************************************************************************/
  setWriteDbgLevel(DebugOff);
  snprintf( chTestTitle, elCount(chTestTitle), "Verify_Hardware_CRC8_Calculation_SignatureAvail_Reporting_Core_0" );
  snprintf( chTestDescription, elCount(chTestDescription), "Purpose:To check the GetHWIO_e_CalcCRC_St(); interface  ");
  TestCaseAddInfo( chTestTitle, "TC_L30SW_Q-36925304", chTestDescription );

  /***************************************************************************************************************/    
                                              // Start of Test Case
  /***************************************************************************************************************/
  
  /***************************************************************************************************************/    
                                              // Test Step 0 PRECONDITIONS
  /***************************************************************************************************************/
  snprintf( chActionText, elCount(chActionText), "Flash the Software and ECU is running "); 
  snprintf( chExpectedText, elCount(chExpectedText), "Ecu is should be in running state"); 
  TestStepAddActionExpected( chActionText, chExpectedText );
  
  A_DBGR_BreakpointDeleteAll();
  A_DBGR_R();
  A_DBGR_Go();
   

  /***************************************************************************************************************/    
                                              // Test Step 1 Set breakpoint in line Test_hwcrc_llsi(); inside "TestApp_Core0_10ms_MainFunction" function and inside testapp.c file
  /***************************************************************************************************************/
  snprintf( chActionText, elCount(chActionText), "Set Breakpoint in Test_hwcrc_llsi(); "); 
  snprintf( chExpectedText, elCount(chExpectedText), "Verify Breakpoint is Set in Test_hwcrc_llsi();"); 
  //TestStepAddActionExpected( chActionText, chExpectedText );  
  A_DBGR_BreakpointSet("TestApp_Core0_10ms_MainFunction\\45");  

  A_DBGR_Go();
  
  snprintf( chActionText, elCount(chActionText), "Verify Breakpoint should hit in Test_hwcrc_llsi(); "); 
  snprintf( chExpectedText, elCount(chExpectedText), "Breakpoint hit in Test_hwcrc_llsi(); function"); 
  E_DBGR_BreakpointCheckForHalt("TestApp_Core0_10ms_MainFunction\\45");
  
  snprintf( chActionText, elCount(chActionText), "Delete all breakpoints "); 
  snprintf( chExpectedText, elCount(chExpectedText), "Breakpoints deleted"); 
  TestStepAddActionExpected( chActionText, chExpectedText );
  
  A_DBGR_BreakpointDeleteAll();
  
   
  /***************************************************************************************************************/    
  	                            // Test Step 2 Set a breakpoint at "v_coreId_u8 = (BYTE)GetCoreID();" inside "Test_hwcrc_llsi" function
  /***************************************************************************************************************/
  
  snprintf( chActionText, elCount(chActionText), "Set Breakpoint in v_coreId_u8 = (BYTE)GetCoreID(); "); 
  snprintf( chExpectedText, elCount(chExpectedText), "Verify Breakpoint is Set in v_coreId_u8 = (BYTE)GetCoreID();"); 
  //TestStepAddActionExpected( chActionText, chExpectedText );  
  A_DBGR_BreakpointSet("Test_hwcrc_llsi\\22");  

  A_DBGR_Go();
  
  snprintf( chActionText, elCount(chActionText), "Verify Breakpoint should hit in v_coreId_u8 = (BYTE)GetCoreID(); "); 
  snprintf( chExpectedText, elCount(chExpectedText), "Breakpoint hit in v_coreId_u8 = (BYTE)GetCoreID(); function"); 
  E_DBGR_BreakpointCheckForHalt("Test_hwcrc_llsi\\22");
  
  /***************************************************************************************************************/    
  	                            // Test Step 3 Verify v_coreId_u8 in trace32 watch window
  /***************************************************************************************************************/
  
   while(1)
  {
  if(cnt == 0)
  {
  snprintf( chActionText, elCount(chActionText), "Verify v_coreId_u8 is 0 "); 
  snprintf( chExpectedText, elCount(chExpectedText), "Verify Verify v_coreId_u8 is 0"); 
  
  TestStepAddActionExpected( chActionText, chExpectedText );  
  }
  
  A_DBGR_VariableRead("v_coreId_u8",coreID);
  if(coreID == 0)
  {
    break;
  }
  if(cnt == 0)
  {
  snprintf( chActionText, elCount(chActionText), "Run debugger "); 
  snprintf( chExpectedText, elCount(chExpectedText), "Run debugger "); 
  }
  A_DBGR_Go();
  cnt =cnt+1;
  }
  E_DBGR_VariableCheck("v_crcSts_u8",0,Equal);
  cnt =0;
  snprintf( chActionText, elCount(chActionText), "delete all breakpoints "); 
  snprintf( chExpectedText, elCount(chExpectedText), "delete all breakpoints "); 
  TestStepAddActionExpected( chActionText, chExpectedText );
  A_DBGR_BreakpointDeleteAll();
  /***************************************************************************************************************/    
  	                            // Test Step 4 Set a breakpoint at line"PerfmHWIO_h_CalcCRC ((BYTE)test_HwCrc_CRC32_ethernet_E, v_seed_u32, v_startAddr_u8, v_endAddr_u8);"
  /***************************************************************************************************************/
  snprintf( chActionText, elCount(chActionText), "Set Breakpoint inPerfmHWIO_h_CalcCRC ((BYTE)test_HwCrc_CRC32_ethernet_E, v_seed_u32, v_startAddr_u8, v_endAddr_u8); "); 
  snprintf( chExpectedText, elCount(chExpectedText), "Verify Breakpoint is Set in PerfmHWIO_h_CalcCRC ((BYTE)test_HwCrc_CRC32_ethernet_E, v_seed_u32, v_startAddr_u8, v_endAddr_u8);"); 
  //TestStepAddActionExpected( chActionText, chExpectedText );  
  A_DBGR_BreakpointSet("Test_hwcrc_llsi\\42");  

  A_DBGR_Go();
  
  snprintf( chActionText, elCount(chActionText), "Verify Breakpoint should hit in v_crcSts_u8 = GetHWIO_e_CalcCRC_St(); "); 
  snprintf( chExpectedText, elCount(chExpectedText), "Breakpoint hit in v_crcSts_u8 = GetHWIO_e_CalcCRC_St(); function"); 
  E_DBGR_BreakpointCheckForHalt("Test_hwcrc_llsi\\42");
  
  while(1)
  {
  if(cnt == 0)
  {
  snprintf( chActionText, elCount(chActionText), "Verify v_coreId_u8 is 0 "); 
  snprintf( chExpectedText, elCount(chExpectedText), "Verify Verify v_coreId_u8 is 0"); 
  
  TestStepAddActionExpected( chActionText, chExpectedText );  
  }
  
  A_DBGR_VariableRead("v_coreId_u8",coreID);
  if(coreID == 0)
  {
    write("core ID is : %d",coreID);
    break;
  }
  if(cnt == 0)
  {
  snprintf( chActionText, elCount(chActionText), "Run debugger "); 
  snprintf( chExpectedText, elCount(chExpectedText), "Run debugger "); 
  }
  testWaitForTimeout(1000);
  A_DBGR_Go();
  cnt =cnt+1;
 
  }
  cnt =0;
  A_DBGR_BreakpointDeleteAll();
  
   /***************************************************************************************************************/    
  	                            // Test Step 5 Set a breakpoint at line"v_crcSts_u8 = GetHWIO_e_CalcCRC_St();"" inside Test_hwcrc_llsi"
  /***************************************************************************************************************/
  snprintf( chActionText, elCount(chActionText), "Set Breakpoint in v_crcSts_u8 = GetHWIO_e_CalcCRC_St();"" inside Test_hwcrc_llsi "); 
  snprintf( chExpectedText, elCount(chExpectedText), "Verify Breakpoint is Set in v_crcSts_u8 = GetHWIO_e_CalcCRC_St();"" inside Test_hwcrc_llsi"); 
//  TestStepAddActionExpected( chActionText, chExpectedText );  
  A_DBGR_BreakpointSet("Test_hwcrc_llsi\\150");  

  A_DBGR_Go();
  
  snprintf( chActionText, elCount(chActionText), "Verify Breakpoint should hit in v_crcSts_u8 = GetHWIO_e_CalcCRC_St(); "); 
  snprintf( chExpectedText, elCount(chExpectedText), "Breakpoint hit in v_crcSts_u8 = GetHWIO_e_CalcCRC_St(); function"); 
  E_DBGR_BreakpointCheckForHalt("Test_hwcrc_llsi\\150");
  while(1)
  {
  if(cnt == 0)
  {
  snprintf( chActionText, elCount(chActionText), "Verify v_coreId_u8 is 0 "); 
  snprintf( chExpectedText, elCount(chExpectedText), "Verify Verify v_coreId_u8 is 0"); 
  
  TestStepAddActionExpected( chActionText, chExpectedText );  
  }
  
  A_DBGR_VariableRead("v_coreId_u8",coreID);
  if(coreID == 0)
  {
    write("core ID is : %d",coreID);
    break;
  }
  if(cnt == 0)
  {
  snprintf( chActionText, elCount(chActionText), "Run debugger "); 
  snprintf( chExpectedText, elCount(chExpectedText), "Run debugger "); 
  }
  testWaitForTimeout(1000);
  A_DBGR_Go();
  cnt =cnt+1;
 
  }
  cnt =0;
  E_DBGR_VariableCheck("v_crcSts_u8",2,Equal);
  
  snprintf( chActionText, elCount(chActionText), "Delete all breakpoints "); 
  snprintf( chExpectedText, elCount(chExpectedText), "Breakpoints deleted"); 
  TestStepAddActionExpected( chActionText, chExpectedText );
  A_DBGR_BreakpointDeleteAll();
  /***************************************************************************************************************/    
  	                            // Test Step 6 Set a breakpoint after the line"v_sigVal_u32 = GetHWIO_g_CalcCRC_Sig();"
  /***************************************************************************************************************/
  snprintf( chActionText, elCount(chActionText), "Set Breakpoint in v_crcSts_u8 = GetHWIO_e_CalcCRC_St();"" inside Test_hwcrc_llsi "); 
  snprintf( chExpectedText, elCount(chExpectedText), "Verify Breakpoint is Set in v_crcSts_u8 = GetHWIO_e_CalcCRC_St();"" inside Test_hwcrc_llsi"); 
//  TestStepAddActionExpected( chActionText, chExpectedText );  
  A_DBGR_BreakpointSet("Test_hwcrc_llsi\\96");  

  A_DBGR_Go();
  
  snprintf( chActionText, elCount(chActionText), "Verify Breakpoint should hit in v_crcSts_u8 = GetHWIO_e_CalcCRC_St(); "); 
  snprintf( chExpectedText, elCount(chExpectedText), "Breakpoint hit in v_crcSts_u8 = GetHWIO_e_CalcCRC_St(); function"); 
  E_DBGR_BreakpointCheckForHalt("Test_hwcrc_llsi\\96");
  while(1)
  {
  if(cnt == 0)
  {
  snprintf( chActionText, elCount(chActionText), "Verify v_coreId_u8 is 0 "); 
  snprintf( chExpectedText, elCount(chExpectedText), "Verify Verify v_coreId_u8 is 0"); 
  
  TestStepAddActionExpected( chActionText, chExpectedText );  
  }
  
  A_DBGR_VariableRead("v_coreId_u8",coreID);
  if(coreID == 0)
  {
    write("core ID is : %d",coreID);
    break;
  }
  if(cnt == 0)
  {
  snprintf( chActionText, elCount(chActionText), "Run debugger "); 
  snprintf( chExpectedText, elCount(chExpectedText), "Run debugger "); 
  }
  testWaitForTimeout(1000);
  A_DBGR_Go();
  cnt =cnt+1;
 
  }
  cnt =0;
  E_DBGR_VariableCheck("v_sigVal_u32",0xA0,Equal);
  snprintf( chActionText, elCount(chActionText), "Delete all breakpoints "); 
  snprintf( chExpectedText, elCount(chExpectedText), "Breakpoints deleted"); 
  TestStepAddActionExpected( chActionText, chExpectedText );
  A_DBGR_BreakpointDeleteAll();
  /***************************************************************************************************************/    
  	                            // Test Step 7 Set a breakpoint at line"v_crcSts_u8 = GetHWIO_e_CalcCRC_St();"" inside Test_hwcrc_llsi"
  /***************************************************************************************************************/
  snprintf( chActionText, elCount(chActionText), "Set Breakpoint in v_crcSts_u8 = GetHWIO_e_CalcCRC_St();"" inside Test_hwcrc_llsi "); 
  snprintf( chExpectedText, elCount(chExpectedText), "Verify Breakpoint is Set in v_crcSts_u8 = GetHWIO_e_CalcCRC_St();"" inside Test_hwcrc_llsi"); 
//  TestStepAddActionExpected( chActionText, chExpectedText );  
  A_DBGR_BreakpointSet("Test_hwcrc_llsi\\120");  

  A_DBGR_Go();
  
  snprintf( chActionText, elCount(chActionText), "Verify Breakpoint should hit in v_crcSts_u8 = GetHWIO_e_CalcCRC_St(); "); 
  snprintf( chExpectedText, elCount(chExpectedText), "Breakpoint hit in v_crcSts_u8 = GetHWIO_e_CalcCRC_St(); function"); 
  E_DBGR_BreakpointCheckForHalt("Test_hwcrc_llsi\\120");
  while(1)
  {
  if(cnt == 0)
  {
  snprintf( chActionText, elCount(chActionText), "Verify v_coreId_u8 is 0 "); 
  snprintf( chExpectedText, elCount(chExpectedText), "Verify Verify v_coreId_u8 is 0"); 
  
  TestStepAddActionExpected( chActionText, chExpectedText );  
  }
  
  A_DBGR_VariableRead("v_coreId_u8",coreID);
  if(coreID == 0)
  {
    write("core ID is : %d",coreID);
    break;
  }
  if(cnt == 0)
  {
  snprintf( chActionText, elCount(chActionText), "Run debugger "); 
  snprintf( chExpectedText, elCount(chExpectedText), "Run debugger "); 
  }
  testWaitForTimeout(1000);
  A_DBGR_Go();
  cnt =cnt+1;
 
  }
  cnt =0;
  E_DBGR_VariableCheck("v_crcSts_u8",0,Equal);
}

testcase Verify_Hardware_CRC32_Calculation_SignatureAvail_Reporting_Core_1()
{
  /***************************************************************************************************************/    
                                                // Variable Definition
  /***************************************************************************************************************/ 
  

  
  /***************************************************************************************************************/    
                                               // Local Values
  /***************************************************************************************************************/ 
  

  
  /***************************************************************************************************************/    
                                              // Test Case Info
  /***************************************************************************************************************/
  setWriteDbgLevel(DebugOff);
  snprintf( chTestTitle, elCount(chTestTitle), "Verify_Hardware_CRC32_Calculation_SignatureAvail_Reporting_Core_1" );
  snprintf( chTestDescription, elCount(chTestDescription), "Purpose:To check the GetHWIO_e_CalcCRC_St(); interface  ");
  TestCaseAddInfo( chTestTitle, "TC_L30SW_Q-37079839", chTestDescription );

  /***************************************************************************************************************/    
                                              // Start of Test Case
  /***************************************************************************************************************/
  
  /***************************************************************************************************************/    
                                              // Test Step 0 PRECONDITIONS
  /***************************************************************************************************************/
  snprintf( chActionText, elCount(chActionText), "Flash the Software and ECU is running "); 
  snprintf( chExpectedText, elCount(chExpectedText), "Ecu is should be in running state"); 
  TestStepAddActionExpected( chActionText, chExpectedText );
  
  A_DBGR_BreakpointDeleteAll();
  A_DBGR_R();
  A_DBGR_Go();
   

  /***************************************************************************************************************/    
                                              // Test Step 1 Set breakpoint in line Test_hwcrc_llsi(); inside "TestApp_Core1_10ms_MainFunction" function and inside testapp.c file
  /***************************************************************************************************************/
  snprintf( chActionText, elCount(chActionText), "Set Breakpoint in Test_hwcrc_llsi(); "); 
  snprintf( chExpectedText, elCount(chExpectedText), "Verify Breakpoint is Set in Test_hwcrc_llsi();"); 
  //TestStepAddActionExpected( chActionText, chExpectedText );  
  A_DBGR_BreakpointSet("TestApp_Core1_10ms_MainFunction\\36");  

  A_DBGR_Go();
  
  snprintf( chActionText, elCount(chActionText), "Verify Breakpoint should hit in Test_hwcrc_llsi(); "); 
  snprintf( chExpectedText, elCount(chExpectedText), "Breakpoint hit in Test_hwcrc_llsi(); function"); 
  E_DBGR_BreakpointCheckForHalt("TestApp_Core1_10ms_MainFunction\\36");
  
  snprintf( chActionText, elCount(chActionText), "Delete all breakpoints "); 
  snprintf( chExpectedText, elCount(chExpectedText), "Breakpoints deleted"); 
  TestStepAddActionExpected( chActionText, chExpectedText );
  
  A_DBGR_BreakpointDeleteAll();
   
  /***************************************************************************************************************/    
  	                            // Test Step 2 Set a breakpoint at "v_coreId_u8 = (BYTE)GetCoreID();" inside "Test_hwcrc_llsi" function
  /***************************************************************************************************************/
  
  snprintf( chActionText, elCount(chActionText), "Set Breakpoint in v_coreId_u8 = (BYTE)GetCoreID(); "); 
  snprintf( chExpectedText, elCount(chExpectedText), "Verify Breakpoint is Set in v_coreId_u8 = (BYTE)GetCoreID();"); 
  //TestStepAddActionExpected( chActionText, chExpectedText );  
  A_DBGR_BreakpointSet("Test_hwcrc_llsi\\227");  

  A_DBGR_Go();
  
  snprintf( chActionText, elCount(chActionText), "Verify Breakpoint should hit in v_coreId_u8 = (BYTE)GetCoreID(); "); 
  snprintf( chExpectedText, elCount(chExpectedText), "Breakpoint hit in v_coreId_u8 = (BYTE)GetCoreID(); function"); 
  E_DBGR_BreakpointCheckForHalt("Test_hwcrc_llsi\\227");
  
  /***************************************************************************************************************/    
  	                            // Test Step 3 Verify v_coreId_u8 in trace32 watch window
  /***************************************************************************************************************/
  
   while(1)
  {
  if(cnt == 0)
  {
  snprintf( chActionText, elCount(chActionText), "Verify v_coreId_u8 is 0 "); 
  snprintf( chExpectedText, elCount(chExpectedText), "Verify Verify v_coreId_u8 is 0"); 
  
  TestStepAddActionExpected( chActionText, chExpectedText );  
  }
  
  A_DBGR_VariableRead("v_coreId_u8",coreID);
  if(coreID == 0)
  {
    break;
  }
  if(cnt == 0)
  {
  snprintf( chActionText, elCount(chActionText), "Run debugger "); 
  snprintf( chExpectedText, elCount(chExpectedText), "Run debugger "); 
  }
  A_DBGR_Go();
  //testWaitForTimeout(1000);
  cnt =cnt+1;
  }
  E_DBGR_VariableCheck("v_crcSts_u8",0,Equal);
  cnt =0;
  snprintf( chActionText, elCount(chActionText), "delete all breakpoints "); 
  snprintf( chExpectedText, elCount(chExpectedText), "delete all breakpoints "); 
  TestStepAddActionExpected( chActionText, chExpectedText );
  A_DBGR_BreakpointDeleteAll();
  /***************************************************************************************************************/    
  	                            // Test Step 4 Set a breakpoint at line"PerfmHWIO_h_CalcCRC ((BYTE)test_HwCrc_CRC32_ethernet_E, v_seed_u32, v_startAddr_u8, v_endAddr_u8);"
  /***************************************************************************************************************/
  snprintf( chActionText, elCount(chActionText), "Set Breakpoint inPerfmHWIO_h_CalcCRC ((BYTE)test_HwCrc_CRC32_ethernet_E, v_seed_u32, v_startAddr_u8, v_endAddr_u8); "); 
  snprintf( chExpectedText, elCount(chExpectedText), "Verify Breakpoint is Set in PerfmHWIO_h_CalcCRC ((BYTE)test_HwCrc_CRC32_ethernet_E, v_seed_u32, v_startAddr_u8, v_endAddr_u8);"); 
  //TestStepAddActionExpected( chActionText, chExpectedText );  
  A_DBGR_BreakpointSet("Test_hwcrc_llsi\\253");  

  A_DBGR_Go();
  
  snprintf( chActionText, elCount(chActionText), "Verify Breakpoint should hit in v_crcSts_u8 = GetHWIO_e_CalcCRC_St(); "); 
  snprintf( chExpectedText, elCount(chExpectedText), "Breakpoint hit in v_crcSts_u8 = GetHWIO_e_CalcCRC_St(); function"); 
  E_DBGR_BreakpointCheckForHalt("Test_hwcrc_llsi\\253");
  
  while(1)
  {
  if(cnt == 0)
  {
  snprintf( chActionText, elCount(chActionText), "Verify v_coreId_u8 is 1 "); 
  snprintf( chExpectedText, elCount(chExpectedText), "Verify Verify v_coreId_u8 is 1"); 
  
  TestStepAddActionExpected( chActionText, chExpectedText );  
  }
  
  A_DBGR_VariableRead("v_coreId_u8",coreID);
  if(coreID == 1)
  {
    write("core ID is : %d",coreID);
    break;
  }
  if(cnt == 0)
  {
  snprintf( chActionText, elCount(chActionText), "Run debugger "); 
  snprintf( chExpectedText, elCount(chExpectedText), "Run debugger "); 
  }
  testWaitForTimeout(1000);
  A_DBGR_Go();
  cnt =cnt+1;
 
  }
  cnt =0;
  A_DBGR_BreakpointDeleteAll();
  
   /***************************************************************************************************************/    
  	                            // Test Step 5 Set a breakpoint at line"v_crcSts_u8 = GetHWIO_e_CalcCRC_St();"" inside Test_hwcrc_llsi"
  /***************************************************************************************************************/
  snprintf( chActionText, elCount(chActionText), "Set Breakpoint in v_crcSts_u8 = GetHWIO_e_CalcCRC_St();"" inside Test_hwcrc_llsi "); 
  snprintf( chExpectedText, elCount(chExpectedText), "Verify Breakpoint is Set in v_crcSts_u8 = GetHWIO_e_CalcCRC_St();"" inside Test_hwcrc_llsi"); 
//  TestStepAddActionExpected( chActionText, chExpectedText );  
  A_DBGR_BreakpointSet("Test_hwcrc_llsi\\255");  

  A_DBGR_Go();
  
  snprintf( chActionText, elCount(chActionText), "Verify Breakpoint should hit in v_crcSts_u8 = GetHWIO_e_CalcCRC_St(); "); 
  snprintf( chExpectedText, elCount(chExpectedText), "Breakpoint hit in v_crcSts_u8 = GetHWIO_e_CalcCRC_St(); function"); 
  E_DBGR_BreakpointCheckForHalt("Test_hwcrc_llsi\\255");
  while(1)
  {
  if(cnt == 0)
  {
  snprintf( chActionText, elCount(chActionText), "Verify v_coreId_u8 is 1 "); 
  snprintf( chExpectedText, elCount(chExpectedText), "Verify Verify v_coreId_u8 is 1"); 
  
  TestStepAddActionExpected( chActionText, chExpectedText );  
  }
  
  A_DBGR_VariableRead("v_coreId_u8",coreID);
  if(coreID == 1)
  {
    write("core ID is : %d",coreID);
    break;
  }
  if(cnt == 0)
  {
  snprintf( chActionText, elCount(chActionText), "Run debugger "); 
  snprintf( chExpectedText, elCount(chExpectedText), "Run debugger "); 
  }
  testWaitForTimeout(1000);
  A_DBGR_Go();
  cnt =cnt+1;
 
  }
  cnt =0;
  E_DBGR_VariableCheck("v_crcSts_u8",2,Equal);
  
  snprintf( chActionText, elCount(chActionText), "Delete all breakpoints "); 
  snprintf( chExpectedText, elCount(chExpectedText), "Breakpoints deleted"); 
  TestStepAddActionExpected( chActionText, chExpectedText );
  A_DBGR_BreakpointDeleteAll();
  /***************************************************************************************************************/    
  	                            // Test Step 6 Set a breakpoint after the line"v_sigVal_u32 = GetHWIO_g_CalcCRC_Sig();"
  /***************************************************************************************************************/
  snprintf( chActionText, elCount(chActionText), "Set Breakpoint in v_crcSts_u8 = GetHWIO_e_CalcCRC_St();"" inside Test_hwcrc_llsi "); 
  snprintf( chExpectedText, elCount(chExpectedText), "Verify Breakpoint is Set in v_crcSts_u8 = GetHWIO_e_CalcCRC_St();"" inside Test_hwcrc_llsi"); 
//  TestStepAddActionExpected( chActionText, chExpectedText );  
  A_DBGR_BreakpointSet("Test_hwcrc_llsi\\292");  

  A_DBGR_Go();
  
  snprintf( chActionText, elCount(chActionText), "Verify Breakpoint should hit in v_crcSts_u8 = GetHWIO_e_CalcCRC_St(); "); 
  snprintf( chExpectedText, elCount(chExpectedText), "Breakpoint hit in v_crcSts_u8 = GetHWIO_e_CalcCRC_St(); function"); 
  E_DBGR_BreakpointCheckForHalt("Test_hwcrc_llsi\\292");
  while(1)
  {
  if(cnt == 0)
  {
  snprintf( chActionText, elCount(chActionText), "Verify v_coreId_u8 is 1 "); 
  snprintf( chExpectedText, elCount(chExpectedText), "Verify Verify v_coreId_u8 is 1"); 
  
  TestStepAddActionExpected( chActionText, chExpectedText );  
  }
  
  A_DBGR_VariableRead("v_coreId_u8",coreID);
  if(coreID == 1)
  {
    write("core ID is : %d",coreID);
    break;
  }
  if(cnt == 0)
  {
  snprintf( chActionText, elCount(chActionText), "Run debugger "); 
  snprintf( chExpectedText, elCount(chExpectedText), "Run debugger "); 
  }
  testWaitForTimeout(1000);
  A_DBGR_Go();
  cnt =cnt+1;
 
  }
  cnt =0;
  E_DBGR_VariableCheck("v_sigVal_u32",0x45D8EE73,Equal);
  snprintf( chActionText, elCount(chActionText), "Delete all breakpoints "); 
  snprintf( chExpectedText, elCount(chExpectedText), "Breakpoints deleted"); 
  TestStepAddActionExpected( chActionText, chExpectedText );
  A_DBGR_BreakpointDeleteAll();
  /***************************************************************************************************************/    
  	                            // Test Step 7 Set a breakpoint at line"v_crcSts_u8 = GetHWIO_e_CalcCRC_St();"" inside Test_hwcrc_llsi"
  /***************************************************************************************************************/
  snprintf( chActionText, elCount(chActionText), "Set Breakpoint in v_crcSts_u8 = GetHWIO_e_CalcCRC_St();"" inside Test_hwcrc_llsi "); 
  snprintf( chExpectedText, elCount(chExpectedText), "Verify Breakpoint is Set in v_crcSts_u8 = GetHWIO_e_CalcCRC_St();"" inside Test_hwcrc_llsi"); 
//  TestStepAddActionExpected( chActionText, chExpectedText );  
  A_DBGR_BreakpointSet("Test_hwcrc_llsi\\308");  

  A_DBGR_Go();
  
  snprintf( chActionText, elCount(chActionText), "Verify Breakpoint should hit in v_crcSts_u8 = GetHWIO_e_CalcCRC_St(); "); 
  snprintf( chExpectedText, elCount(chExpectedText), "Breakpoint hit in v_crcSts_u8 = GetHWIO_e_CalcCRC_St(); function"); 
  E_DBGR_BreakpointCheckForHalt("Test_hwcrc_llsi\\308");
  while(1)
  {
  if(cnt == 0)
  {
  snprintf( chActionText, elCount(chActionText), "Verify v_coreId_u8 is 1 "); 
  snprintf( chExpectedText, elCount(chExpectedText), "Verify Verify v_coreId_u8 is 1"); 
  
  TestStepAddActionExpected( chActionText, chExpectedText );  
  }
  
  A_DBGR_VariableRead("v_coreId_u8",coreID);
  if(coreID == 1)
  {
    write("core ID is : %d",coreID);
    break;
  }
  if(cnt == 0)
  {
  snprintf( chActionText, elCount(chActionText), "Run debugger "); 
  snprintf( chExpectedText, elCount(chExpectedText), "Run debugger "); 
  }
  testWaitForTimeout(1000);
  A_DBGR_Go();
  cnt =cnt+1;
 
  }
  cnt =0;
  E_DBGR_VariableCheck("v_crcSts_u8",0,Equal);
}

testcase Verify_Hardware_CRC32_Calculation_SignatureAvail_Reporting_Core_2()
{
  /***************************************************************************************************************/    
                                                // Variable Definition
  /***************************************************************************************************************/ 
  

  
  /***************************************************************************************************************/    
                                               // Local Values
  /***************************************************************************************************************/ 
  

  
  /***************************************************************************************************************/    
                                              // Test Case Info
  /***************************************************************************************************************/
  setWriteDbgLevel(DebugOff);
  snprintf( chTestTitle, elCount(chTestTitle), "Verify_Hardware_CRC32_Calculation_SignatureAvail_Reporting_Core_2" );
  snprintf( chTestDescription, elCount(chTestDescription), "Purpose:To check the GetHWIO_e_CalcCRC_St(); interface  ");
  TestCaseAddInfo( chTestTitle, "TC_L30SW_Q-37079845", chTestDescription );

  /***************************************************************************************************************/    
                                              // Start of Test Case
  /***************************************************************************************************************/
  
  /***************************************************************************************************************/    
                                              // Test Step 0 PRECONDITIONS
  /***************************************************************************************************************/
  snprintf( chActionText, elCount(chActionText), "Flash the Software and ECU is running "); 
  snprintf( chExpectedText, elCount(chExpectedText), "Ecu is should be in running state"); 
  TestStepAddActionExpected( chActionText, chExpectedText );
  
  A_DBGR_BreakpointDeleteAll();
  A_DBGR_R();
  A_DBGR_Go();
   
  /***************************************************************************************************************/    
                                              // Test Step 1 Set breakpoint in line Test_hwcrc_llsi(); inside "TestApp_Core2_10ms_MainFunction" function and inside testapp.c file
  /***************************************************************************************************************/
  snprintf( chActionText, elCount(chActionText), "Set Breakpoint in Test_hwcrc_llsi(); "); 
  snprintf( chExpectedText, elCount(chExpectedText), "Verify Breakpoint is Set in Test_hwcrc_llsi();"); 
  //TestStepAddActionExpected( chActionText, chExpectedText );  
  A_DBGR_BreakpointSet("TestApp_Core2_10ms_MainFunction\\36");  

  A_DBGR_Go();
  
  snprintf( chActionText, elCount(chActionText), "Verify Breakpoint should hit in Test_hwcrc_llsi(); "); 
  snprintf( chExpectedText, elCount(chExpectedText), "Breakpoint hit in Test_hwcrc_llsi(); function"); 
  E_DBGR_BreakpointCheckForHalt("TestApp_Core2_10ms_MainFunction\\36");
  
  snprintf( chActionText, elCount(chActionText), "Delete all breakpoints "); 
  snprintf( chExpectedText, elCount(chExpectedText), "Breakpoints deleted"); 
  TestStepAddActionExpected( chActionText, chExpectedText );
  
  A_DBGR_BreakpointDeleteAll();
  
   
  /***************************************************************************************************************/    
  	                            // Test Step 2 Set a breakpoint at "v_coreId_u8 = (BYTE)GetCoreID();" inside "Test_hwcrc_llsi" function
  /***************************************************************************************************************/
  
  snprintf( chActionText, elCount(chActionText), "Set Breakpoint in v_coreId_u8 = (BYTE)GetCoreID(); "); 
  snprintf( chExpectedText, elCount(chExpectedText), "Verify Breakpoint is Set in v_coreId_u8 = (BYTE)GetCoreID();"); 
  //TestStepAddActionExpected( chActionText, chExpectedText );  
  A_DBGR_BreakpointSet("Test_hwcrc_llsi\\227");  

  A_DBGR_Go();
  
  snprintf( chActionText, elCount(chActionText), "Verify Breakpoint should hit in v_coreId_u8 = (BYTE)GetCoreID(); "); 
  snprintf( chExpectedText, elCount(chExpectedText), "Breakpoint hit in v_coreId_u8 = (BYTE)GetCoreID(); function"); 
  E_DBGR_BreakpointCheckForHalt("Test_hwcrc_llsi\\227");
  
  /***************************************************************************************************************/    
  	                            // Test Step 3 Verify v_coreId_u8 in trace32 watch window
  /***************************************************************************************************************/
  
  while(1)
  {
  if(cnt == 0)
  {
  snprintf( chActionText, elCount(chActionText), "Verify v_coreId_u8 is 0 "); 
  snprintf( chExpectedText, elCount(chExpectedText), "Verify Verify v_coreId_u8 is 0"); 
  
  TestStepAddActionExpected( chActionText, chExpectedText );  
  }
  
  A_DBGR_VariableRead("v_coreId_u8",coreID);
  if(coreID == 0)
  {
    break;
  }
  if(cnt == 0)
  {
  snprintf( chActionText, elCount(chActionText), "Run debugger "); 
  snprintf( chExpectedText, elCount(chExpectedText), "Run debugger "); 
  }
  A_DBGR_Go();
  //testWaitForTimeout(1000);
  cnt =cnt+1;
  }
  E_DBGR_VariableCheck("v_crcSts_u8",0,Equal);
  cnt =0;
  snprintf( chActionText, elCount(chActionText), "delete all breakpoints "); 
  snprintf( chExpectedText, elCount(chExpectedText), "delete all breakpoints "); 
  TestStepAddActionExpected( chActionText, chExpectedText );
  A_DBGR_BreakpointDeleteAll();
  /***************************************************************************************************************/    
  	                            // Test Step 4 Set a breakpoint at line"PerfmHWIO_h_CalcCRC ((BYTE)test_HwCrc_CRC32_ethernet_E, v_seed_u32, v_startAddr_u8, v_endAddr_u8);"
  /***************************************************************************************************************/
  snprintf( chActionText, elCount(chActionText), "Set Breakpoint inPerfmHWIO_h_CalcCRC ((BYTE)test_HwCrc_CRC32_ethernet_E, v_seed_u32, v_startAddr_u8, v_endAddr_u8); "); 
  snprintf( chExpectedText, elCount(chExpectedText), "Verify Breakpoint is Set in PerfmHWIO_h_CalcCRC ((BYTE)test_HwCrc_CRC32_ethernet_E, v_seed_u32, v_startAddr_u8, v_endAddr_u8);"); 
  //TestStepAddActionExpected( chActionText, chExpectedText );  
  A_DBGR_BreakpointSet("Test_hwcrc_llsi\\253");  

  A_DBGR_Go();
  
  snprintf( chActionText, elCount(chActionText), "Verify Breakpoint should hit in v_crcSts_u8 = GetHWIO_e_CalcCRC_St(); "); 
  snprintf( chExpectedText, elCount(chExpectedText), "Breakpoint hit in v_crcSts_u8 = GetHWIO_e_CalcCRC_St(); function"); 
  E_DBGR_BreakpointCheckForHalt("Test_hwcrc_llsi\\253");
  
  while(1)
  {
  if(cnt == 0)
  {
  snprintf( chActionText, elCount(chActionText), "Verify v_coreId_u8 is 2 "); 
  snprintf( chExpectedText, elCount(chExpectedText), "Verify Verify v_coreId_u8 is 2"); 
  
  TestStepAddActionExpected( chActionText, chExpectedText );  
  }
  
  A_DBGR_VariableRead("v_coreId_u8",coreID);
  if(coreID == 2)
  {
    write("core ID is : %d",coreID);
    break;
  }
  if(cnt == 0)
  {
  snprintf( chActionText, elCount(chActionText), "Run debugger "); 
  snprintf( chExpectedText, elCount(chExpectedText), "Run debugger "); 
  }
  testWaitForTimeout(1000);
  A_DBGR_Go();
  cnt =cnt+1;
 
  }
  cnt =0;
  A_DBGR_BreakpointDeleteAll();
  
   /***************************************************************************************************************/    
  	                            // Test Step 5 Set a breakpoint at line"v_crcSts_u8 = GetHWIO_e_CalcCRC_St();"" inside Test_hwcrc_llsi"
  /***************************************************************************************************************/
  snprintf( chActionText, elCount(chActionText), "Set Breakpoint in v_crcSts_u8 = GetHWIO_e_CalcCRC_St();"" inside Test_hwcrc_llsi "); 
  snprintf( chExpectedText, elCount(chExpectedText), "Verify Breakpoint is Set in v_crcSts_u8 = GetHWIO_e_CalcCRC_St();"" inside Test_hwcrc_llsi"); 
//  TestStepAddActionExpected( chActionText, chExpectedText );  
  A_DBGR_BreakpointSet("Test_hwcrc_llsi\\255");  

  A_DBGR_Go();
  
  snprintf( chActionText, elCount(chActionText), "Verify Breakpoint should hit in v_crcSts_u8 = GetHWIO_e_CalcCRC_St(); "); 
  snprintf( chExpectedText, elCount(chExpectedText), "Breakpoint hit in v_crcSts_u8 = GetHWIO_e_CalcCRC_St(); function"); 
  E_DBGR_BreakpointCheckForHalt("Test_hwcrc_llsi\\255");
  while(1)
  {
  if(cnt == 0)
  {
  snprintf( chActionText, elCount(chActionText), "Verify v_coreId_u8 is 2 "); 
  snprintf( chExpectedText, elCount(chExpectedText), "Verify Verify v_coreId_u8 is 2"); 
  
  TestStepAddActionExpected( chActionText, chExpectedText );  
  }
  
  A_DBGR_VariableRead("v_coreId_u8",coreID);
  if(coreID == 2)
  {
    write("core ID is : %d",coreID);
    break;
  }
  if(cnt == 0)
  {
  snprintf( chActionText, elCount(chActionText), "Run debugger "); 
  snprintf( chExpectedText, elCount(chExpectedText), "Run debugger "); 
  }
  testWaitForTimeout(1000);
  A_DBGR_Go();
  cnt =cnt+1;
 
  }
  cnt =0;
  E_DBGR_VariableCheck("v_crcSts_u8",2,Equal);
  
  snprintf( chActionText, elCount(chActionText), "Delete all breakpoints "); 
  snprintf( chExpectedText, elCount(chExpectedText), "Breakpoints deleted"); 
  TestStepAddActionExpected( chActionText, chExpectedText );
  A_DBGR_BreakpointDeleteAll();
  /***************************************************************************************************************/    
  	                            // Test Step 6 Set a breakpoint after the line"v_sigVal_u32 = GetHWIO_g_CalcCRC_Sig();"
  /***************************************************************************************************************/
  snprintf( chActionText, elCount(chActionText), "Set Breakpoint in v_crcSts_u8 = GetHWIO_e_CalcCRC_St();"" inside Test_hwcrc_llsi "); 
  snprintf( chExpectedText, elCount(chExpectedText), "Verify Breakpoint is Set in v_crcSts_u8 = GetHWIO_e_CalcCRC_St();"" inside Test_hwcrc_llsi"); 
//  TestStepAddActionExpected( chActionText, chExpectedText );  
  A_DBGR_BreakpointSet("Test_hwcrc_llsi\\292");  

  A_DBGR_Go();
  
  snprintf( chActionText, elCount(chActionText), "Verify Breakpoint should hit in v_crcSts_u8 = GetHWIO_e_CalcCRC_St(); "); 
  snprintf( chExpectedText, elCount(chExpectedText), "Breakpoint hit in v_crcSts_u8 = GetHWIO_e_CalcCRC_St(); function"); 
  E_DBGR_BreakpointCheckForHalt("Test_hwcrc_llsi\\292");
  while(1)
  {
  if(cnt == 0)
  {
  snprintf( chActionText, elCount(chActionText), "Verify v_coreId_u8 is 2 "); 
  snprintf( chExpectedText, elCount(chExpectedText), "Verify Verify v_coreId_u8 is 2"); 
  
  TestStepAddActionExpected( chActionText, chExpectedText );  
  }
  
  A_DBGR_VariableRead("v_coreId_u8",coreID);
  if(coreID == 2)
  {
    write("core ID is : %d",coreID);
    break;
  }
  if(cnt == 0)
  {
  snprintf( chActionText, elCount(chActionText), "Run debugger "); 
  snprintf( chExpectedText, elCount(chExpectedText), "Run debugger "); 
  }
  testWaitForTimeout(1000);
  A_DBGR_Go();
  cnt =cnt+1;
 
  }
  cnt =0;
  E_DBGR_VariableCheck("v_sigVal_u32",0x45D8EE73,Equal);
  snprintf( chActionText, elCount(chActionText), "Delete all breakpoints "); 
  snprintf( chExpectedText, elCount(chExpectedText), "Breakpoints deleted"); 
  TestStepAddActionExpected( chActionText, chExpectedText );
  A_DBGR_BreakpointDeleteAll();
  /***************************************************************************************************************/    
  	                            // Test Step 7 Set a breakpoint at line"v_crcSts_u8 = GetHWIO_e_CalcCRC_St();"" inside Test_hwcrc_llsi"
  /***************************************************************************************************************/
  snprintf( chActionText, elCount(chActionText), "Set Breakpoint in v_crcSts_u8 = GetHWIO_e_CalcCRC_St();"" inside Test_hwcrc_llsi "); 
  snprintf( chExpectedText, elCount(chExpectedText), "Verify Breakpoint is Set in v_crcSts_u8 = GetHWIO_e_CalcCRC_St();"" inside Test_hwcrc_llsi"); 
//  TestStepAddActionExpected( chActionText, chExpectedText );  
  A_DBGR_BreakpointSet("Test_hwcrc_llsi\\308");  

  A_DBGR_Go();
  
  snprintf( chActionText, elCount(chActionText), "Verify Breakpoint should hit in v_crcSts_u8 = GetHWIO_e_CalcCRC_St(); "); 
  snprintf( chExpectedText, elCount(chExpectedText), "Breakpoint hit in v_crcSts_u8 = GetHWIO_e_CalcCRC_St(); function"); 
  E_DBGR_BreakpointCheckForHalt("Test_hwcrc_llsi\\308");
  while(1)
  {
  if(cnt == 0)
  {
  snprintf( chActionText, elCount(chActionText), "Verify v_coreId_u8 is 2 "); 
  snprintf( chExpectedText, elCount(chExpectedText), "Verify Verify v_coreId_u8 is 2"); 
  
  TestStepAddActionExpected( chActionText, chExpectedText );  
  }
  
  A_DBGR_VariableRead("v_coreId_u8",coreID);
  if(coreID == 2)
  {
    write("core ID is : %d",coreID);
    break;
  }
  if(cnt == 0)
  {
  snprintf( chActionText, elCount(chActionText), "Run debugger "); 
  snprintf( chExpectedText, elCount(chExpectedText), "Run debugger "); 
  }
  testWaitForTimeout(1000);
  A_DBGR_Go();
  cnt =cnt+1;
 
  }
  cnt =0;
  E_DBGR_VariableCheck("v_crcSts_u8",0,Equal);
}

testcase Verify_Hardware_CRC32_Calculation_SignatureAvail_Reporting_Core_3()
{
  /***************************************************************************************************************/    
                                                // Variable Definition
  /***************************************************************************************************************/ 
  

  
  /***************************************************************************************************************/    
                                               // Local Values
  /***************************************************************************************************************/ 
  

  
  /***************************************************************************************************************/    
                                              // Test Case Info
  /***************************************************************************************************************/
  setWriteDbgLevel(DebugOff);
  snprintf( chTestTitle, elCount(chTestTitle), "Verify_Hardware_CRC32_Calculation_SignatureAvail_Reporting_Core_3" );
  snprintf( chTestDescription, elCount(chTestDescription), "Purpose:To check the GetHWIO_e_CalcCRC_St(); interface  ");
  TestCaseAddInfo( chTestTitle, "TC_L30SW_Q-37079850", chTestDescription );

  /***************************************************************************************************************/    
                                              // Start of Test Case
  /***************************************************************************************************************/
  
  /***************************************************************************************************************/    
                                              // Test Step 0 PRECONDITIONS
  /***************************************************************************************************************/
  snprintf( chActionText, elCount(chActionText), "Flash the Software and ECU is running "); 
  snprintf( chExpectedText, elCount(chExpectedText), "Ecu is should be in running state"); 
  TestStepAddActionExpected( chActionText, chExpectedText );
  
  A_DBGR_BreakpointDeleteAll();
  A_DBGR_R();
  A_DBGR_Go();
   
  /***************************************************************************************************************/    
                                              // Test Step 1 Set breakpoint in line Test_hwcrc_llsi(); inside "TestApp_Core3_10ms_MainFunction" function and inside testapp.c file
  /***************************************************************************************************************/
  snprintf( chActionText, elCount(chActionText), "Set Breakpoint in Test_hwcrc_llsi(); "); 
  snprintf( chExpectedText, elCount(chExpectedText), "Verify Breakpoint is Set in Test_hwcrc_llsi();"); 
  //TestStepAddActionExpected( chActionText, chExpectedText );  
  A_DBGR_BreakpointSet("TestApp_Core3_10ms_MainFunction\\35");  

  A_DBGR_Go();
  
  snprintf( chActionText, elCount(chActionText), "Verify Breakpoint should hit in Test_hwcrc_llsi(); "); 
  snprintf( chExpectedText, elCount(chExpectedText), "Breakpoint hit in Test_hwcrc_llsi(); function"); 
  E_DBGR_BreakpointCheckForHalt("TestApp_Core3_10ms_MainFunction\\35");
  
  testWaitForTimeout(2000);
  
  snprintf( chActionText, elCount(chActionText), "Delete all breakpoints "); 
  snprintf( chExpectedText, elCount(chExpectedText), "Breakpoints deleted"); 
  TestStepAddActionExpected( chActionText, chExpectedText );
  
  A_DBGR_BreakpointDeleteAll();
  
  
   
  /***************************************************************************************************************/    
  	                            // Test Step 2 Set a breakpoint at "v_coreId_u8 = (BYTE)GetCoreID();" inside "Test_hwcrc_llsi" function
  /***************************************************************************************************************/
  
  snprintf( chActionText, elCount(chActionText), "Set Breakpoint in v_coreId_u8 = (BYTE)GetCoreID(); "); 
  snprintf( chExpectedText, elCount(chExpectedText), "Verify Breakpoint is Set in v_coreId_u8 = (BYTE)GetCoreID();"); 
  //TestStepAddActionExpected( chActionText, chExpectedText );  
  A_DBGR_BreakpointSet("Test_hwcrc_llsi\\227");  

  A_DBGR_Go();
  
  snprintf( chActionText, elCount(chActionText), "Verify Breakpoint should hit in v_coreId_u8 = (BYTE)GetCoreID(); "); 
  snprintf( chExpectedText, elCount(chExpectedText), "Breakpoint hit in v_coreId_u8 = (BYTE)GetCoreID(); function"); 
  E_DBGR_BreakpointCheckForHalt("Test_hwcrc_llsi\\227");
  
  /***************************************************************************************************************/    
  	                            // Test Step 3 Verify v_coreId_u8 in trace32 watch window
  /***************************************************************************************************************/
  
   while(1)
  {
  if(cnt == 0)
  {
  snprintf( chActionText, elCount(chActionText), "Verify v_coreId_u8 is 0 "); 
  snprintf( chExpectedText, elCount(chExpectedText), "Verify Verify v_coreId_u8 is 0"); 
  
  TestStepAddActionExpected( chActionText, chExpectedText );  
  }
  
  A_DBGR_VariableRead("v_coreId_u8",coreID);
  if(coreID == 0)
  {
    break;
  }
  if(cnt == 0)
  {
  snprintf( chActionText, elCount(chActionText), "Run debugger "); 
  snprintf( chExpectedText, elCount(chExpectedText), "Run debugger "); 
  }
  A_DBGR_Go();
  //testWaitForTimeout(1000);
  cnt =cnt+1;
  }
  E_DBGR_VariableCheck("v_crcSts_u8",0,Equal);
  cnt =0;
  snprintf( chActionText, elCount(chActionText), "delete all breakpoints "); 
  snprintf( chExpectedText, elCount(chExpectedText), "delete all breakpoints "); 
  TestStepAddActionExpected( chActionText, chExpectedText );
  A_DBGR_BreakpointDeleteAll();
  /***************************************************************************************************************/    
  	                            // Test Step 4 Set a breakpoint at line"PerfmHWIO_h_CalcCRC ((BYTE)test_HwCrc_CRC32_ethernet_E, v_seed_u32, v_startAddr_u8, v_endAddr_u8);"
  /***************************************************************************************************************/
  snprintf( chActionText, elCount(chActionText), "Set Breakpoint inPerfmHWIO_h_CalcCRC ((BYTE)test_HwCrc_CRC32_ethernet_E, v_seed_u32, v_startAddr_u8, v_endAddr_u8); "); 
  snprintf( chExpectedText, elCount(chExpectedText), "Verify Breakpoint is Set in PerfmHWIO_h_CalcCRC ((BYTE)test_HwCrc_CRC32_ethernet_E, v_seed_u32, v_startAddr_u8, v_endAddr_u8);"); 
  //TestStepAddActionExpected( chActionText, chExpectedText );  
  A_DBGR_BreakpointSet("Test_hwcrc_llsi\\253");  

  A_DBGR_Go();
  
  snprintf( chActionText, elCount(chActionText), "Verify Breakpoint should hit in v_crcSts_u8 = GetHWIO_e_CalcCRC_St(); "); 
  snprintf( chExpectedText, elCount(chExpectedText), "Breakpoint hit in v_crcSts_u8 = GetHWIO_e_CalcCRC_St(); function"); 
  E_DBGR_BreakpointCheckForHalt("Test_hwcrc_llsi\\253");
  
  while(1)
  {
  if(cnt == 0)
  {
  snprintf( chActionText, elCount(chActionText), "Verify v_coreId_u8 is 3 "); 
  snprintf( chExpectedText, elCount(chExpectedText), "Verify Verify v_coreId_u8 is 3"); 
  
  TestStepAddActionExpected( chActionText, chExpectedText );  
  }
  
  A_DBGR_VariableRead("v_coreId_u8",coreID);
  if(coreID == 3)
  {
    write("core ID is : %d",coreID);
    break;
  }
  if(cnt == 0)
  {
  snprintf( chActionText, elCount(chActionText), "Run debugger "); 
  snprintf( chExpectedText, elCount(chExpectedText), "Run debugger "); 
  }
  testWaitForTimeout(1000);
  A_DBGR_Go();
  cnt =cnt+1;
 
  }
  cnt =0;
  A_DBGR_BreakpointDeleteAll();
  
   /***************************************************************************************************************/    
  	                            // Test Step 5 Set a breakpoint at line"v_crcSts_u8 = GetHWIO_e_CalcCRC_St();"" inside Test_hwcrc_llsi"
  /***************************************************************************************************************/
  snprintf( chActionText, elCount(chActionText), "Set Breakpoint in v_crcSts_u8 = GetHWIO_e_CalcCRC_St();"" inside Test_hwcrc_llsi "); 
  snprintf( chExpectedText, elCount(chExpectedText), "Verify Breakpoint is Set in v_crcSts_u8 = GetHWIO_e_CalcCRC_St();"" inside Test_hwcrc_llsi"); 
//  TestStepAddActionExpected( chActionText, chExpectedText );  
  A_DBGR_BreakpointSet("Test_hwcrc_llsi\\255");  

  A_DBGR_Go();
  
  snprintf( chActionText, elCount(chActionText), "Verify Breakpoint should hit in v_crcSts_u8 = GetHWIO_e_CalcCRC_St(); "); 
  snprintf( chExpectedText, elCount(chExpectedText), "Breakpoint hit in v_crcSts_u8 = GetHWIO_e_CalcCRC_St(); function"); 
  E_DBGR_BreakpointCheckForHalt("Test_hwcrc_llsi\\255");
  while(1)
  {
  if(cnt == 0)
  {
  snprintf( chActionText, elCount(chActionText), "Verify v_coreId_u8 is 3 "); 
  snprintf( chExpectedText, elCount(chExpectedText), "Verify Verify v_coreId_u8 is 3"); 
  
  TestStepAddActionExpected( chActionText, chExpectedText );  
  }
  
  A_DBGR_VariableRead("v_coreId_u8",coreID);
  if(coreID == 3)
  {
    write("core ID is : %d",coreID);
    break;
  }
  if(cnt == 0)
  {
  snprintf( chActionText, elCount(chActionText), "Run debugger "); 
  snprintf( chExpectedText, elCount(chExpectedText), "Run debugger "); 
  }
  testWaitForTimeout(1000);
  A_DBGR_Go();
  cnt =cnt+1;
 
  }
  cnt =0;
  E_DBGR_VariableCheck("v_crcSts_u8",2,Equal);
  
  snprintf( chActionText, elCount(chActionText), "Delete all breakpoints "); 
  snprintf( chExpectedText, elCount(chExpectedText), "Breakpoints deleted"); 
  TestStepAddActionExpected( chActionText, chExpectedText );
  A_DBGR_BreakpointDeleteAll();
  /***************************************************************************************************************/    
  	                            // Test Step 6 Set a breakpoint after the line"v_sigVal_u32 = GetHWIO_g_CalcCRC_Sig();"
  /***************************************************************************************************************/
  snprintf( chActionText, elCount(chActionText), "Set Breakpoint in v_crcSts_u8 = GetHWIO_e_CalcCRC_St();"" inside Test_hwcrc_llsi "); 
  snprintf( chExpectedText, elCount(chExpectedText), "Verify Breakpoint is Set in v_crcSts_u8 = GetHWIO_e_CalcCRC_St();"" inside Test_hwcrc_llsi"); 
//  TestStepAddActionExpected( chActionText, chExpectedText );  
  A_DBGR_BreakpointSet("Test_hwcrc_llsi\\292");  

  A_DBGR_Go();
  
  snprintf( chActionText, elCount(chActionText), "Verify Breakpoint should hit in v_crcSts_u8 = GetHWIO_e_CalcCRC_St(); "); 
  snprintf( chExpectedText, elCount(chExpectedText), "Breakpoint hit in v_crcSts_u8 = GetHWIO_e_CalcCRC_St(); function"); 
  E_DBGR_BreakpointCheckForHalt("Test_hwcrc_llsi\\292");
  while(1)
  {
  if(cnt == 0)
  {
  snprintf( chActionText, elCount(chActionText), "Verify v_coreId_u8 is 3 "); 
  snprintf( chExpectedText, elCount(chExpectedText), "Verify Verify v_coreId_u8 is 3"); 
  
  TestStepAddActionExpected( chActionText, chExpectedText );  
  }
  
  A_DBGR_VariableRead("v_coreId_u8",coreID);
  if(coreID == 3)
  {
    write("core ID is : %d",coreID);
    break;
  }
  if(cnt == 0)
  {
  snprintf( chActionText, elCount(chActionText), "Run debugger "); 
  snprintf( chExpectedText, elCount(chExpectedText), "Run debugger "); 
  }
  testWaitForTimeout(1000);
  A_DBGR_Go();
  cnt =cnt+1;
 
  }
  cnt =0;
  E_DBGR_VariableCheck("v_sigVal_u32",0x45D8EE73,Equal);
  snprintf( chActionText, elCount(chActionText), "Delete all breakpoints "); 
  snprintf( chExpectedText, elCount(chExpectedText), "Breakpoints deleted"); 
  TestStepAddActionExpected( chActionText, chExpectedText );
  A_DBGR_BreakpointDeleteAll();
  /***************************************************************************************************************/    
  	                            // Test Step 7 Set a breakpoint at line"v_crcSts_u8 = GetHWIO_e_CalcCRC_St();"" inside Test_hwcrc_llsi"
  /***************************************************************************************************************/
  snprintf( chActionText, elCount(chActionText), "Set Breakpoint in v_crcSts_u8 = GetHWIO_e_CalcCRC_St();"" inside Test_hwcrc_llsi "); 
  snprintf( chExpectedText, elCount(chExpectedText), "Verify Breakpoint is Set in v_crcSts_u8 = GetHWIO_e_CalcCRC_St();"" inside Test_hwcrc_llsi"); 
//  TestStepAddActionExpected( chActionText, chExpectedText );  
  A_DBGR_BreakpointSet("Test_hwcrc_llsi\\308");  

  A_DBGR_Go();
  
  snprintf( chActionText, elCount(chActionText), "Verify Breakpoint should hit in v_crcSts_u8 = GetHWIO_e_CalcCRC_St(); "); 
  snprintf( chExpectedText, elCount(chExpectedText), "Breakpoint hit in v_crcSts_u8 = GetHWIO_e_CalcCRC_St(); function"); 
  E_DBGR_BreakpointCheckForHalt("Test_hwcrc_llsi\\308");
  while(1)
  {
  if(cnt == 0)
  {
  snprintf( chActionText, elCount(chActionText), "Verify v_coreId_u8 is 3 "); 
  snprintf( chExpectedText, elCount(chExpectedText), "Verify Verify v_coreId_u8 is 3"); 
  
  TestStepAddActionExpected( chActionText, chExpectedText );  
  }
  
  A_DBGR_VariableRead("v_coreId_u8",coreID);
  if(coreID == 3)
  {
    write("core ID is : %d",coreID);
    break;
  }
  if(cnt == 0)
  {
  snprintf( chActionText, elCount(chActionText), "Run debugger "); 
  snprintf( chExpectedText, elCount(chExpectedText), "Run debugger "); 
  }
  testWaitForTimeout(1000);
  A_DBGR_Go();
  cnt =cnt+1;
 
  }
  cnt =0;
  E_DBGR_VariableCheck("v_crcSts_u8",0,Equal);
}

testcase Verify_Hardware_CRC32_Calculation_SignatureAvail_Reporting_Core_4()
{
  /***************************************************************************************************************/    
                                                // Variable Definition
  /***************************************************************************************************************/ 
  

  
  /***************************************************************************************************************/    
                                               // Local Values
  /***************************************************************************************************************/ 
  

  
  /***************************************************************************************************************/    
                                              // Test Case Info
  /***************************************************************************************************************/
  setWriteDbgLevel(DebugOff);
  snprintf( chTestTitle, elCount(chTestTitle), "Verify_Hardware_CRC32_Calculation_SignatureAvail_Reporting_Core_4" );
  snprintf( chTestDescription, elCount(chTestDescription), "Purpose:To check the GetHWIO_e_CalcCRC_St(); interface  ");
  TestCaseAddInfo( chTestTitle, "TC_L30SW_Q-37079855", chTestDescription );

  /***************************************************************************************************************/    
                                              // Start of Test Case
  /***************************************************************************************************************/
  
  /***************************************************************************************************************/    
                                              // Test Step 0 PRECONDITIONS
  /***************************************************************************************************************/
  snprintf( chActionText, elCount(chActionText), "Flash the Software and ECU is running "); 
  snprintf( chExpectedText, elCount(chExpectedText), "Ecu is should be in running state"); 
  TestStepAddActionExpected( chActionText, chExpectedText );
  
  A_DBGR_BreakpointDeleteAll();
  A_DBGR_R();
  A_DBGR_Go();
   
  /***************************************************************************************************************/    
                                              // Test Step 1 Set breakpoint in line Test_hwcrc_llsi(); inside "TestApp_Core4_1000ms_MainFunction" function and inside testapp.c file
  /***************************************************************************************************************/
  snprintf( chActionText, elCount(chActionText), "Set Breakpoint in Test_hwcrc_llsi(); "); 
  snprintf( chExpectedText, elCount(chExpectedText), "Verify Breakpoint is Set in Test_hwcrc_llsi();"); 
  //TestStepAddActionExpected( chActionText, chExpectedText );  
  A_DBGR_BreakpointSet("TestApp_Core4_1000ms_MainFunction\\65");  

  A_DBGR_Go();
  
  snprintf( chActionText, elCount(chActionText), "Verify Breakpoint should hit in Test_hwcrc_llsi(); "); 
  snprintf( chExpectedText, elCount(chExpectedText), "Breakpoint hit in Test_hwcrc_llsi(); function"); 
  E_DBGR_BreakpointCheckForHalt("TestApp_Core4_1000ms_MainFunction\\65");
  
  testWaitForTimeout(2000);
  
  snprintf( chActionText, elCount(chActionText), "Delete all breakpoints "); 
  snprintf( chExpectedText, elCount(chExpectedText), "Breakpoints deleted"); 
  TestStepAddActionExpected( chActionText, chExpectedText );
  
  A_DBGR_BreakpointDeleteAll();
  
   
  /***************************************************************************************************************/    
  	                            // Test Step 2 Set a breakpoint at "v_coreId_u8 = (BYTE)GetCoreID();" inside "Test_hwcrc_llsi" function
  /***************************************************************************************************************/
  
  snprintf( chActionText, elCount(chActionText), "Set Breakpoint in v_coreId_u8 = (BYTE)GetCoreID(); "); 
  snprintf( chExpectedText, elCount(chExpectedText), "Verify Breakpoint is Set in v_coreId_u8 = (BYTE)GetCoreID();"); 
  //TestStepAddActionExpected( chActionText, chExpectedText );  
  A_DBGR_BreakpointSet("Test_hwcrc_llsi\\227");  

  A_DBGR_Go();
  
  snprintf( chActionText, elCount(chActionText), "Verify Breakpoint should hit in v_coreId_u8 = (BYTE)GetCoreID(); "); 
  snprintf( chExpectedText, elCount(chExpectedText), "Breakpoint hit in v_coreId_u8 = (BYTE)GetCoreID(); function"); 
  E_DBGR_BreakpointCheckForHalt("Test_hwcrc_llsi\\227");
  
  /***************************************************************************************************************/    
  	                            // Test Step 3 Verify v_coreId_u8 in trace32 watch window
  /***************************************************************************************************************/
  
   while(1)
  {
  if(cnt == 0)
  {
  snprintf( chActionText, elCount(chActionText), "Verify v_coreId_u8 is 0 "); 
  snprintf( chExpectedText, elCount(chExpectedText), "Verify Verify v_coreId_u8 is 0"); 
  
  TestStepAddActionExpected( chActionText, chExpectedText );  
  }
  
  A_DBGR_VariableRead("v_coreId_u8",coreID);
  if(coreID == 0)
  {
    break;
  }
  if(cnt == 0)
  {
  snprintf( chActionText, elCount(chActionText), "Run debugger "); 
  snprintf( chExpectedText, elCount(chExpectedText), "Run debugger "); 
  }
  A_DBGR_Go();
  testWaitForTimeout(3000);
  if(cnt == 3)
  {
    testWaitForTimeout(30000);
  }
  cnt =cnt+1;
  }
  E_DBGR_VariableCheck("v_crcSts_u8",0,Equal);
  cnt =0;
  snprintf( chActionText, elCount(chActionText), "delete all breakpoints "); 
  snprintf( chExpectedText, elCount(chExpectedText), "delete all breakpoints "); 
  TestStepAddActionExpected( chActionText, chExpectedText );
  A_DBGR_BreakpointDeleteAll();
  /***************************************************************************************************************/    
  	                            // Test Step 4 Set a breakpoint at line"PerfmHWIO_h_CalcCRC ((BYTE)test_HwCrc_CRC32_ethernet_E, v_seed_u32, v_startAddr_u8, v_endAddr_u8);"
  /***************************************************************************************************************/
  snprintf( chActionText, elCount(chActionText), "Set Breakpoint inPerfmHWIO_h_CalcCRC ((BYTE)test_HwCrc_CRC32_ethernet_E, v_seed_u32, v_startAddr_u8, v_endAddr_u8); "); 
  snprintf( chExpectedText, elCount(chExpectedText), "Verify Breakpoint is Set in PerfmHWIO_h_CalcCRC ((BYTE)test_HwCrc_CRC32_ethernet_E, v_seed_u32, v_startAddr_u8, v_endAddr_u8);"); 
  //TestStepAddActionExpected( chActionText, chExpectedText );  
  A_DBGR_BreakpointSet("Test_hwcrc_llsi\\253");  

  A_DBGR_Go();
  
  snprintf( chActionText, elCount(chActionText), "Verify Breakpoint should hit in v_crcSts_u8 = GetHWIO_e_CalcCRC_St(); "); 
  snprintf( chExpectedText, elCount(chExpectedText), "Breakpoint hit in v_crcSts_u8 = GetHWIO_e_CalcCRC_St(); function"); 
  E_DBGR_BreakpointCheckForHalt("Test_hwcrc_llsi\\253");
  
  while(1)
  {
  if(cnt == 0)
  {
  snprintf( chActionText, elCount(chActionText), "Verify v_coreId_u8 is 4 "); 
  snprintf( chExpectedText, elCount(chExpectedText), "Verify Verify v_coreId_u8 is 4"); 
  
  TestStepAddActionExpected( chActionText, chExpectedText );  
  }
  
  A_DBGR_VariableRead("v_coreId_u8",coreID);
  if(coreID == 4)
  {
    write("core ID is : %d",coreID);
    break;
  }
  if(cnt == 0)
  {
  snprintf( chActionText, elCount(chActionText), "Run debugger "); 
  snprintf( chExpectedText, elCount(chExpectedText), "Run debugger "); 
  }
  
  A_DBGR_Go();
  testWaitForTimeout(3000);
  
  cnt =cnt+1;
 
  }
  cnt =0;
  A_DBGR_BreakpointDeleteAll();
  
   /***************************************************************************************************************/    
  	                            // Test Step 5 Set a breakpoint at line"v_crcSts_u8 = GetHWIO_e_CalcCRC_St();"" inside Test_hwcrc_llsi"
  /***************************************************************************************************************/
  snprintf( chActionText, elCount(chActionText), "Set Breakpoint in v_crcSts_u8 = GetHWIO_e_CalcCRC_St();"" inside Test_hwcrc_llsi "); 
  snprintf( chExpectedText, elCount(chExpectedText), "Verify Breakpoint is Set in v_crcSts_u8 = GetHWIO_e_CalcCRC_St();"" inside Test_hwcrc_llsi"); 
//  TestStepAddActionExpected( chActionText, chExpectedText );  
  A_DBGR_BreakpointSet("Test_hwcrc_llsi\\255");  

  A_DBGR_Go();
  
  snprintf( chActionText, elCount(chActionText), "Verify Breakpoint should hit in v_crcSts_u8 = GetHWIO_e_CalcCRC_St(); "); 
  snprintf( chExpectedText, elCount(chExpectedText), "Breakpoint hit in v_crcSts_u8 = GetHWIO_e_CalcCRC_St(); function"); 
  E_DBGR_BreakpointCheckForHalt("Test_hwcrc_llsi\\255");
  while(1)
  {
  if(cnt == 0)
  {
  snprintf( chActionText, elCount(chActionText), "Verify v_coreId_u8 is 4 "); 
  snprintf( chExpectedText, elCount(chExpectedText), "Verify Verify v_coreId_u8 is 4"); 
  
  TestStepAddActionExpected( chActionText, chExpectedText );  
  }
  
  A_DBGR_VariableRead("v_coreId_u8",coreID);
  if(coreID == 4)
  {
    write("core ID is : %d",coreID);
    break;
  }
  if(cnt == 0)
  {
  snprintf( chActionText, elCount(chActionText), "Run debugger "); 
  snprintf( chExpectedText, elCount(chExpectedText), "Run debugger "); 
  }
  testWaitForTimeout(1000);
  A_DBGR_Go();
  cnt =cnt+1;
 
  }
  cnt =0;
  E_DBGR_VariableCheck("v_crcSts_u8",2,Equal);
  
  snprintf( chActionText, elCount(chActionText), "Delete all breakpoints "); 
  snprintf( chExpectedText, elCount(chExpectedText), "Breakpoints deleted"); 
  TestStepAddActionExpected( chActionText, chExpectedText );
  A_DBGR_BreakpointDeleteAll();
  /***************************************************************************************************************/    
  	                            // Test Step 6 Set a breakpoint after the line"v_sigVal_u32 = GetHWIO_g_CalcCRC_Sig();"
  /***************************************************************************************************************/
  snprintf( chActionText, elCount(chActionText), "Set Breakpoint in v_crcSts_u8 = GetHWIO_e_CalcCRC_St();"" inside Test_hwcrc_llsi "); 
  snprintf( chExpectedText, elCount(chExpectedText), "Verify Breakpoint is Set in v_crcSts_u8 = GetHWIO_e_CalcCRC_St();"" inside Test_hwcrc_llsi"); 
//  TestStepAddActionExpected( chActionText, chExpectedText );  
  A_DBGR_BreakpointSet("Test_hwcrc_llsi\\292");  

  A_DBGR_Go();
  
  snprintf( chActionText, elCount(chActionText), "Verify Breakpoint should hit in v_crcSts_u8 = GetHWIO_e_CalcCRC_St(); "); 
  snprintf( chExpectedText, elCount(chExpectedText), "Breakpoint hit in v_crcSts_u8 = GetHWIO_e_CalcCRC_St(); function"); 
  E_DBGR_BreakpointCheckForHalt("Test_hwcrc_llsi\\292");
  while(1)
  {
  if(cnt == 0)
  {
  snprintf( chActionText, elCount(chActionText), "Verify v_coreId_u8 is 4 "); 
  snprintf( chExpectedText, elCount(chExpectedText), "Verify Verify v_coreId_u8 is 4"); 
  
  TestStepAddActionExpected( chActionText, chExpectedText );  
  }
  
  A_DBGR_VariableRead("v_coreId_u8",coreID);
  if(coreID == 4)
  {
    write("core ID is : %d",coreID);
    break;
  }
  if(cnt == 0)
  {
  snprintf( chActionText, elCount(chActionText), "Run debugger "); 
  snprintf( chExpectedText, elCount(chExpectedText), "Run debugger "); 
  }
  testWaitForTimeout(1000);
  A_DBGR_Go();
  cnt =cnt+1;
 
  }
  cnt =0;
  E_DBGR_VariableCheck("v_sigVal_u32",0x45D8EE73,Equal);
  snprintf( chActionText, elCount(chActionText), "Delete all breakpoints "); 
  snprintf( chExpectedText, elCount(chExpectedText), "Breakpoints deleted"); 
  TestStepAddActionExpected( chActionText, chExpectedText );
  A_DBGR_BreakpointDeleteAll();
  /***************************************************************************************************************/    
  	                            // Test Step 7 Set a breakpoint at line"v_crcSts_u8 = GetHWIO_e_CalcCRC_St();"" inside Test_hwcrc_llsi"
  /***************************************************************************************************************/
  snprintf( chActionText, elCount(chActionText), "Set Breakpoint in v_crcSts_u8 = GetHWIO_e_CalcCRC_St();"" inside Test_hwcrc_llsi "); 
  snprintf( chExpectedText, elCount(chExpectedText), "Verify Breakpoint is Set in v_crcSts_u8 = GetHWIO_e_CalcCRC_St();"" inside Test_hwcrc_llsi"); 
//  TestStepAddActionExpected( chActionText, chExpectedText );  
  A_DBGR_BreakpointSet("Test_hwcrc_llsi\\308");  

  A_DBGR_Go();
  
  snprintf( chActionText, elCount(chActionText), "Verify Breakpoint should hit in v_crcSts_u8 = GetHWIO_e_CalcCRC_St(); "); 
  snprintf( chExpectedText, elCount(chExpectedText), "Breakpoint hit in v_crcSts_u8 = GetHWIO_e_CalcCRC_St(); function"); 
  E_DBGR_BreakpointCheckForHalt("Test_hwcrc_llsi\\308");
  while(1)
  {
  if(cnt == 0)
  {
  snprintf( chActionText, elCount(chActionText), "Verify v_coreId_u8 is 4 "); 
  snprintf( chExpectedText, elCount(chExpectedText), "Verify Verify v_coreId_u8 is 4"); 
  
  TestStepAddActionExpected( chActionText, chExpectedText );  
  }
  
  A_DBGR_VariableRead("v_coreId_u8",coreID);
  if(coreID == 4)
  {
    write("core ID is : %d",coreID);
    break;
  }
  if(cnt == 0)
  {
  snprintf( chActionText, elCount(chActionText), "Run debugger "); 
  snprintf( chExpectedText, elCount(chExpectedText), "Run debugger "); 
  }
  testWaitForTimeout(1000);
  A_DBGR_Go();
  cnt =cnt+1;
 
  }
  cnt =0;
  E_DBGR_VariableCheck("v_crcSts_u8",0,Equal);
}


testcase Verify_Hardware_CRC32_Calculation_SignatureAvail_Reporting_Core_5()
{
  /***************************************************************************************************************/    
                                                // Variable Definition
  /***************************************************************************************************************/ 
  

  
  /***************************************************************************************************************/    
                                               // Local Values
  /***************************************************************************************************************/ 
  

  
  /***************************************************************************************************************/    
                                              // Test Case Info
  /***************************************************************************************************************/
  setWriteDbgLevel(DebugOff);
  snprintf( chTestTitle, elCount(chTestTitle), "Verify_Hardware_CRC32_Calculation_SignatureAvail_Reporting_Core_5" );
  snprintf( chTestDescription, elCount(chTestDescription), "Purpose:To check the GetHWIO_e_CalcCRC_St(); interface  ");
  TestCaseAddInfo( chTestTitle, "TC_L30SW_Q-37079860", chTestDescription );

  /***************************************************************************************************************/    
                                              // Start of Test Case
  /***************************************************************************************************************/
  
  /***************************************************************************************************************/    
                                              // Test Step 0 PRECONDITIONS
  /***************************************************************************************************************/
  snprintf( chActionText, elCount(chActionText), "Flash the Software and ECU is running "); 
  snprintf( chExpectedText, elCount(chExpectedText), "Ecu is should be in running state"); 
  TestStepAddActionExpected( chActionText, chExpectedText );
  
  A_DBGR_BreakpointDeleteAll();
  A_DBGR_R();
  A_DBGR_Go();
   
  /***************************************************************************************************************/    
                                              // Test Step 1 Set breakpoint in line Test_hwcrc_llsi(); inside "TestApp_Core5_1000ms_MainFunction" function and inside testapp.c file
  /***************************************************************************************************************/
  snprintf( chActionText, elCount(chActionText), "Set Breakpoint in Test_hwcrc_llsi(); "); 
  snprintf( chExpectedText, elCount(chExpectedText), "Verify Breakpoint is Set in Test_hwcrc_llsi();"); 
  //TestStepAddActionExpected( chActionText, chExpectedText );  
  A_DBGR_BreakpointSet("TestApp_Core5_1000ms_MainFunction\\54");  

  A_DBGR_Go();
  
  snprintf( chActionText, elCount(chActionText), "Verify Breakpoint should hit in Test_hwcrc_llsi(); "); 
  snprintf( chExpectedText, elCount(chExpectedText), "Breakpoint hit in Test_hwcrc_llsi(); function"); 
  E_DBGR_BreakpointCheckForHalt("TestApp_Core5_1000ms_MainFunction\\54");
  
  testWaitForTimeout(2000);
  
  snprintf( chActionText, elCount(chActionText), "Delete all breakpoints "); 
  snprintf( chExpectedText, elCount(chExpectedText), "Breakpoints deleted"); 
  TestStepAddActionExpected( chActionText, chExpectedText );
  
  A_DBGR_BreakpointDeleteAll();  
  /***************************************************************************************************************/    
  	                            // Test Step 2 Set a breakpoint at "v_coreId_u8 = (BYTE)GetCoreID();" inside "Test_hwcrc_llsi" function
  /***************************************************************************************************************/
  
  snprintf( chActionText, elCount(chActionText), "Set Breakpoint in v_coreId_u8 = (BYTE)GetCoreID(); "); 
  snprintf( chExpectedText, elCount(chExpectedText), "Verify Breakpoint is Set in v_coreId_u8 = (BYTE)GetCoreID();"); 
  //TestStepAddActionExpected( chActionText, chExpectedText );  
  A_DBGR_BreakpointSet("Test_hwcrc_llsi\\227");  

  A_DBGR_Go();
  
  snprintf( chActionText, elCount(chActionText), "Verify Breakpoint should hit in v_coreId_u8 = (BYTE)GetCoreID(); "); 
  snprintf( chExpectedText, elCount(chExpectedText), "Breakpoint hit in v_coreId_u8 = (BYTE)GetCoreID(); function"); 
  E_DBGR_BreakpointCheckForHalt("Test_hwcrc_llsi\\227");
  
  /***************************************************************************************************************/    
  	                            // Test Step 3 Verify v_coreId_u8 in trace32 watch window
  /***************************************************************************************************************/
  
   while(1)
  {
  if(cnt == 0)
  {
  snprintf( chActionText, elCount(chActionText), "Verify v_coreId_u8 is 0 "); 
  snprintf( chExpectedText, elCount(chExpectedText), "Verify Verify v_coreId_u8 is 0"); 
  
  TestStepAddActionExpected( chActionText, chExpectedText );  
  }
  
  A_DBGR_VariableRead("v_coreId_u8",coreID);
  if(coreID == 0)
  {
    break;
  }
  if(cnt == 0)
  {
  snprintf( chActionText, elCount(chActionText), "Run debugger "); 
  snprintf( chExpectedText, elCount(chExpectedText), "Run debugger "); 
  }
  A_DBGR_Go();
  testWaitForTimeout(3000);
  if(cnt == 3)
  {
    testWaitForTimeout(30000);
  }cnt =cnt+1;
  }
  E_DBGR_VariableCheck("v_crcSts_u8",0,Equal);
  cnt =0;
  snprintf( chActionText, elCount(chActionText), "delete all breakpoints "); 
  snprintf( chExpectedText, elCount(chExpectedText), "delete all breakpoints "); 
  TestStepAddActionExpected( chActionText, chExpectedText );
  A_DBGR_BreakpointDeleteAll();
  /***************************************************************************************************************/    
  	                            // Test Step 4 Set a breakpoint at line"PerfmHWIO_h_CalcCRC ((BYTE)test_HwCrc_CRC32_ethernet_E, v_seed_u32, v_startAddr_u8, v_endAddr_u8);"
  /***************************************************************************************************************/
  snprintf( chActionText, elCount(chActionText), "Set Breakpoint inPerfmHWIO_h_CalcCRC ((BYTE)test_HwCrc_CRC32_ethernet_E, v_seed_u32, v_startAddr_u8, v_endAddr_u8); "); 
  snprintf( chExpectedText, elCount(chExpectedText), "Verify Breakpoint is Set in PerfmHWIO_h_CalcCRC ((BYTE)test_HwCrc_CRC32_ethernet_E, v_seed_u32, v_startAddr_u8, v_endAddr_u8);"); 
  //TestStepAddActionExpected( chActionText, chExpectedText );  
  A_DBGR_BreakpointSet("Test_hwcrc_llsi\\253");  

  A_DBGR_Go();
  
  snprintf( chActionText, elCount(chActionText), "Verify Breakpoint should hit in v_crcSts_u8 = GetHWIO_e_CalcCRC_St(); "); 
  snprintf( chExpectedText, elCount(chExpectedText), "Breakpoint hit in v_crcSts_u8 = GetHWIO_e_CalcCRC_St(); function"); 
  E_DBGR_BreakpointCheckForHalt("Test_hwcrc_llsi\\253");
  
  while(1)
  {
  if(cnt == 0)
  {
  snprintf( chActionText, elCount(chActionText), "Verify v_coreId_u8 is 4 "); 
  snprintf( chExpectedText, elCount(chExpectedText), "Verify Verify v_coreId_u8 is 4"); 
  
  TestStepAddActionExpected( chActionText, chExpectedText );  
  }
  
  A_DBGR_VariableRead("v_coreId_u8",coreID);
  if(coreID == 4)
  {
    write("core ID is : %d",coreID);
    break;
  }
  if(cnt == 0)
  {
  snprintf( chActionText, elCount(chActionText), "Run debugger "); 
  snprintf( chExpectedText, elCount(chExpectedText), "Run debugger "); 
  }
  A_DBGR_Go();
  testWaitForTimeout(3000);

  cnt =cnt+1;
 
  }
  cnt =0;
  A_DBGR_BreakpointDeleteAll();
  
   /***************************************************************************************************************/    
  	                            // Test Step 5 Set a breakpoint at line"v_crcSts_u8 = GetHWIO_e_CalcCRC_St();"" inside Test_hwcrc_llsi"
  /***************************************************************************************************************/
  snprintf( chActionText, elCount(chActionText), "Set Breakpoint in v_crcSts_u8 = GetHWIO_e_CalcCRC_St();"" inside Test_hwcrc_llsi "); 
  snprintf( chExpectedText, elCount(chExpectedText), "Verify Breakpoint is Set in v_crcSts_u8 = GetHWIO_e_CalcCRC_St();"" inside Test_hwcrc_llsi"); 
//  TestStepAddActionExpected( chActionText, chExpectedText );  
  A_DBGR_BreakpointSet("Test_hwcrc_llsi\\255");  

  A_DBGR_Go();
  
  snprintf( chActionText, elCount(chActionText), "Verify Breakpoint should hit in v_crcSts_u8 = GetHWIO_e_CalcCRC_St(); "); 
  snprintf( chExpectedText, elCount(chExpectedText), "Breakpoint hit in v_crcSts_u8 = GetHWIO_e_CalcCRC_St(); function"); 
  E_DBGR_BreakpointCheckForHalt("Test_hwcrc_llsi\\255");
  while(1)
  {
  if(cnt == 0)
  {
  snprintf( chActionText, elCount(chActionText), "Verify v_coreId_u8 is 5 "); 
  snprintf( chExpectedText, elCount(chExpectedText), "Verify Verify v_coreId_u8 is 5"); 
  
  TestStepAddActionExpected( chActionText, chExpectedText );  
  }
  
  A_DBGR_VariableRead("v_coreId_u8",coreID);
  if(coreID == 5)
  {
    write("core ID is : %d",coreID);
    break;
  }
  if(cnt == 0)
  {
  snprintf( chActionText, elCount(chActionText), "Run debugger "); 
  snprintf( chExpectedText, elCount(chExpectedText), "Run debugger "); 
  }
  testWaitForTimeout(1000);
  A_DBGR_Go();
  cnt =cnt+1;
 
  }
  cnt =0;
  E_DBGR_VariableCheck("v_crcSts_u8",2,Equal);
  
  snprintf( chActionText, elCount(chActionText), "Delete all breakpoints "); 
  snprintf( chExpectedText, elCount(chExpectedText), "Breakpoints deleted"); 
  TestStepAddActionExpected( chActionText, chExpectedText );
  A_DBGR_BreakpointDeleteAll();
  /***************************************************************************************************************/    
  	                            // Test Step 6 Set a breakpoint after the line"v_sigVal_u32 = GetHWIO_g_CalcCRC_Sig();"
  /***************************************************************************************************************/
  snprintf( chActionText, elCount(chActionText), "Set Breakpoint in v_crcSts_u8 = GetHWIO_e_CalcCRC_St();"" inside Test_hwcrc_llsi "); 
  snprintf( chExpectedText, elCount(chExpectedText), "Verify Breakpoint is Set in v_crcSts_u8 = GetHWIO_e_CalcCRC_St();"" inside Test_hwcrc_llsi"); 
//  TestStepAddActionExpected( chActionText, chExpectedText );  
  A_DBGR_BreakpointSet("Test_hwcrc_llsi\\292");  

  A_DBGR_Go();
  
  snprintf( chActionText, elCount(chActionText), "Verify Breakpoint should hit in v_crcSts_u8 = GetHWIO_e_CalcCRC_St(); "); 
  snprintf( chExpectedText, elCount(chExpectedText), "Breakpoint hit in v_crcSts_u8 = GetHWIO_e_CalcCRC_St(); function"); 
  E_DBGR_BreakpointCheckForHalt("Test_hwcrc_llsi\\292");
  while(1)
  {
  if(cnt == 0)
  {
  snprintf( chActionText, elCount(chActionText), "Verify v_coreId_u8 is 5 "); 
  snprintf( chExpectedText, elCount(chExpectedText), "Verify Verify v_coreId_u8 is 5"); 
  
  TestStepAddActionExpected( chActionText, chExpectedText );  
  }
  
  A_DBGR_VariableRead("v_coreId_u8",coreID);
  if(coreID == 5)
  {
    write("core ID is : %d",coreID);
    break;
  }
  if(cnt == 0)
  {
  snprintf( chActionText, elCount(chActionText), "Run debugger "); 
  snprintf( chExpectedText, elCount(chExpectedText), "Run debugger "); 
  }
  testWaitForTimeout(1000);
  A_DBGR_Go();
  cnt =cnt+1;
 
  }
  cnt =0;
  E_DBGR_VariableCheck("v_sigVal_u32",0x45D8EE73,Equal);
  snprintf( chActionText, elCount(chActionText), "Delete all breakpoints "); 
  snprintf( chExpectedText, elCount(chExpectedText), "Breakpoints deleted"); 
  TestStepAddActionExpected( chActionText, chExpectedText );
  A_DBGR_BreakpointDeleteAll();
  /***************************************************************************************************************/    
  	                            // Test Step 7 Set a breakpoint at line"v_crcSts_u8 = GetHWIO_e_CalcCRC_St();"" inside Test_hwcrc_llsi"
  /***************************************************************************************************************/
  snprintf( chActionText, elCount(chActionText), "Set Breakpoint in v_crcSts_u8 = GetHWIO_e_CalcCRC_St();"" inside Test_hwcrc_llsi "); 
  snprintf( chExpectedText, elCount(chExpectedText), "Verify Breakpoint is Set in v_crcSts_u8 = GetHWIO_e_CalcCRC_St();"" inside Test_hwcrc_llsi"); 
//  TestStepAddActionExpected( chActionText, chExpectedText );  
  A_DBGR_BreakpointSet("Test_hwcrc_llsi\\308");  

  A_DBGR_Go();
  
  snprintf( chActionText, elCount(chActionText), "Verify Breakpoint should hit in v_crcSts_u8 = GetHWIO_e_CalcCRC_St(); "); 
  snprintf( chExpectedText, elCount(chExpectedText), "Breakpoint hit in v_crcSts_u8 = GetHWIO_e_CalcCRC_St(); function"); 
  E_DBGR_BreakpointCheckForHalt("Test_hwcrc_llsi\\308");
  while(1)
  {
  if(cnt == 0)
  {
  snprintf( chActionText, elCount(chActionText), "Verify v_coreId_u8 is 5 "); 
  snprintf( chExpectedText, elCount(chExpectedText), "Verify Verify v_coreId_u8 is 5"); 
  
  TestStepAddActionExpected( chActionText, chExpectedText );  
  }
  
  A_DBGR_VariableRead("v_coreId_u8",coreID);
  if(coreID == 5)
  {
    write("core ID is : %d",coreID);
    break;
  }
  if(cnt == 0)
  {
  snprintf( chActionText, elCount(chActionText), "Run debugger "); 
  snprintf( chExpectedText, elCount(chExpectedText), "Run debugger "); 
  }
  testWaitForTimeout(1000);
  A_DBGR_Go();
  cnt =cnt+1;
 
  }
  cnt =0;
  E_DBGR_VariableCheck("v_crcSts_u8",0,Equal);
}
testcase Verify_Hardware_CRC_Calculation_Invalid_algorithm_Failure_Reporting_Core_3()
{
  /***************************************************************************************************************/    
                                                // Variable Definition
  /***************************************************************************************************************/ 
  

  
  /***************************************************************************************************************/    
                                               // Local Values
  /***************************************************************************************************************/ 
  

  
  /***************************************************************************************************************/    
                                              // Test Case Info
  /***************************************************************************************************************/
  setWriteDbgLevel(DebugOff);
  snprintf( chTestTitle, elCount(chTestTitle), "Verify_Hardware_CRC_Calculation_Invalid_algorithm_Failure_Reporting_Core_3" );
  snprintf( chTestDescription, elCount(chTestDescription), "Purpose:To check the GetHWIO_e_CalcCRC_St(); interface  ");
  TestCaseAddInfo( chTestTitle, "TC_L30SW_Q-37079851", chTestDescription );

  /***************************************************************************************************************/    
                                              // Start of Test Case
  /***************************************************************************************************************/
  
  /***************************************************************************************************************/    
                                              // Test Step 0 PRECONDITIONS
  /***************************************************************************************************************/
  snprintf( chActionText, elCount(chActionText), "Flash the Software and ECU is running "); 
  snprintf( chExpectedText, elCount(chExpectedText), "Ecu is should be in running state"); 
  TestStepAddActionExpected( chActionText, chExpectedText );
  
  A_DBGR_BreakpointDeleteAll();
  A_DBGR_R();
  A_DBGR_Go();
   
  /***************************************************************************************************************/    
                                              // Test Step 1 Set breakpoint in line Test_hwcrc_llsi(); inside "TestApp_Core3_10ms_MainFunction" function and inside testapp.c file
  /***************************************************************************************************************/
  snprintf( chActionText, elCount(chActionText), "Set Breakpoint in Test_hwcrc_llsi(); "); 
  snprintf( chExpectedText, elCount(chExpectedText), "Verify Breakpoint is Set in Test_hwcrc_llsi();"); 
  //TestStepAddActionExpected( chActionText, chExpectedText );  
  A_DBGR_BreakpointSet("TestApp_Core3_10ms_MainFunction\\35");  

  A_DBGR_Go();
  
  snprintf( chActionText, elCount(chActionText), "Verify Breakpoint should hit in Test_hwcrc_llsi(); "); 
  snprintf( chExpectedText, elCount(chExpectedText), "Breakpoint hit in Test_hwcrc_llsi(); function"); 
  E_DBGR_BreakpointCheckForHalt("TestApp_Core3_10ms_MainFunction\\35");
  
  testWaitForTimeout(2000);
  
  snprintf( chActionText, elCount(chActionText), "Delete all breakpoints "); 
  snprintf( chExpectedText, elCount(chExpectedText), "Breakpoints deleted"); 
  TestStepAddActionExpected( chActionText, chExpectedText );
  
  A_DBGR_BreakpointDeleteAll();
  
  
   
  /***************************************************************************************************************/    
  	                            // Test Step 2 Set a breakpoint at "v_coreId_u8 = (BYTE)GetCoreID();" inside "Test_hwcrc_llsi" function
  /***************************************************************************************************************/
  
  snprintf( chActionText, elCount(chActionText), "Set Breakpoint in v_coreId_u8 = (BYTE)GetCoreID(); "); 
  snprintf( chExpectedText, elCount(chExpectedText), "Verify Breakpoint is Set in v_coreId_u8 = (BYTE)GetCoreID();"); 
  //TestStepAddActionExpected( chActionText, chExpectedText );  
  A_DBGR_BreakpointSet("Test_hwcrc_llsi\\308");  

  A_DBGR_Go();
  
  snprintf( chActionText, elCount(chActionText), "Verify Breakpoint should hit in v_coreId_u8 = (BYTE)GetCoreID(); "); 
  snprintf( chExpectedText, elCount(chExpectedText), "Breakpoint hit in v_coreId_u8 = (BYTE)GetCoreID(); function"); 
  E_DBGR_BreakpointCheckForHalt("Test_hwcrc_llsi\\308");
  
  /***************************************************************************************************************/    
  	                            // Test Step 3 Verify v_coreId_u8 in trace32 watch window
  /***************************************************************************************************************/
  
   while(1)
  {
  if(cnt == 0)
  {
  snprintf( chActionText, elCount(chActionText), "Verify v_coreId_u8 is 3 "); 
  snprintf( chExpectedText, elCount(chExpectedText), "Verify Verify v_coreId_u8 is 3"); 
  
  TestStepAddActionExpected( chActionText, chExpectedText );  
  }
  
  A_DBGR_VariableRead("v_coreId_u8",coreID);
  if(coreID == 3)
  {
    break;
  }
  if(cnt == 0)
  {
  snprintf( chActionText, elCount(chActionText), "Run debugger "); 
  snprintf( chExpectedText, elCount(chExpectedText), "Run debugger "); 
  }
  A_DBGR_Go();
  testWaitForTimeout(1000);
  cnt =cnt+1;
  }
  E_DBGR_VariableCheck("v_crcSts_u8",0,Equal);
  cnt =0;
  snprintf( chActionText, elCount(chActionText), "delete all breakpoints "); 
  snprintf( chExpectedText, elCount(chExpectedText), "delete all breakpoints "); 
  TestStepAddActionExpected( chActionText, chExpectedText );
  A_DBGR_BreakpointDeleteAll();
  /***************************************************************************************************************/    
  	                            // Test Step 4 Set a breakpoint at line"PerfmHWIO_h_CalcCRC ((BYTE)test_HwCrc_CRC32_ethernet_E, v_seed_u32, v_startAddr_u8, v_endAddr_u8);"
  /***************************************************************************************************************/
  snprintf( chActionText, elCount(chActionText), "Set Breakpoint inPerfmHWIO_h_CalcCRC ((BYTE)test_HwCrc_CRC32_ethernet_E, v_seed_u32, v_startAddr_u8, v_endAddr_u8); "); 
  snprintf( chExpectedText, elCount(chExpectedText), "Verify Breakpoint is Set in PerfmHWIO_h_CalcCRC ((BYTE)test_HwCrc_CRC32_ethernet_E, v_seed_u32, v_startAddr_u8, v_endAddr_u8);"); 
  //TestStepAddActionExpected( chActionText, chExpectedText );  
  A_DBGR_BreakpointSet("Test_hwcrc_llsi\\327");  

  A_DBGR_Go();
  
  snprintf( chActionText, elCount(chActionText), "Verify Breakpoint should hit in v_crcSts_u8 = GetHWIO_e_CalcCRC_St(); "); 
  snprintf( chExpectedText, elCount(chExpectedText), "Breakpoint hit in v_crcSts_u8 = GetHWIO_e_CalcCRC_St(); function"); 
  E_DBGR_BreakpointCheckForHalt("Test_hwcrc_llsi\\327");
  
  while(1)
  {
  if(cnt == 0)
  {
  snprintf( chActionText, elCount(chActionText), "Verify v_coreId_u8 is 3 "); 
  snprintf( chExpectedText, elCount(chExpectedText), "Verify Verify v_coreId_u8 is 3"); 
  
  TestStepAddActionExpected( chActionText, chExpectedText );  
  }
  
  A_DBGR_VariableRead("v_coreId_u8",coreID);
  if(coreID == 3)
  {
    write("core ID is : %d",coreID);
    break;
  }
  if(cnt == 0)
  {
  snprintf( chActionText, elCount(chActionText), "Run debugger "); 
  snprintf( chExpectedText, elCount(chExpectedText), "Run debugger "); 
  }
  testWaitForTimeout(1000);
  A_DBGR_Go();
  cnt =cnt+1;
 
  }
  cnt =0;
  A_DBGR_BreakpointDeleteAll();
  
   /***************************************************************************************************************/    
  	                            // Test Step 5 Set a breakpoint at line"v_crcSts_u8 = GetHWIO_e_CalcCRC_St();"" inside Test_hwcrc_llsi"
  /***************************************************************************************************************/
  snprintf( chActionText, elCount(chActionText), "Set Breakpoint in v_crcSts_u8 = GetHWIO_e_CalcCRC_St();"" inside Test_hwcrc_llsi "); 
  snprintf( chExpectedText, elCount(chExpectedText), "Verify Breakpoint is Set in v_crcSts_u8 = GetHWIO_e_CalcCRC_St();"" inside Test_hwcrc_llsi"); 
//  TestStepAddActionExpected( chActionText, chExpectedText );  
  A_DBGR_BreakpointSet("Test_hwcrc_llsi\\329");  

  A_DBGR_Go();
  
  snprintf( chActionText, elCount(chActionText), "Verify Breakpoint should hit in v_crcSts_u8 = GetHWIO_e_CalcCRC_St(); "); 
  snprintf( chExpectedText, elCount(chExpectedText), "Breakpoint hit in v_crcSts_u8 = GetHWIO_e_CalcCRC_St(); function"); 
  E_DBGR_BreakpointCheckForHalt("Test_hwcrc_llsi\\329");
  while(1)
  {
  if(cnt == 0)
  {
  snprintf( chActionText, elCount(chActionText), "Verify v_coreId_u8 is 3 "); 
  snprintf( chExpectedText, elCount(chExpectedText), "Verify Verify v_coreId_u8 is 3"); 
  
  TestStepAddActionExpected( chActionText, chExpectedText );  
  }
  
  A_DBGR_VariableRead("v_coreId_u8",coreID);
  if(coreID == 3)
  {
    write("core ID is : %d",coreID);
    break;
  }
  if(cnt == 0)
  {
  snprintf( chActionText, elCount(chActionText), "Run debugger "); 
  snprintf( chExpectedText, elCount(chExpectedText), "Run debugger "); 
  }
  testWaitForTimeout(1000);
  A_DBGR_Go();
  cnt =cnt+1;
 
  }
  cnt =0;
  E_DBGR_VariableCheck("v_crcSts_u8",3,Equal);
  
  snprintf( chActionText, elCount(chActionText), "Delete all breakpoints "); 
  snprintf( chExpectedText, elCount(chExpectedText), "Breakpoints deleted"); 
  TestStepAddActionExpected( chActionText, chExpectedText );
  A_DBGR_BreakpointDeleteAll();
  /***************************************************************************************************************/    
  	                            // Test Step 6 Set a breakpoint after the line"v_sigVal_u32 = GetHWIO_g_CalcCRC_Sig();"
  /***************************************************************************************************************/
  snprintf( chActionText, elCount(chActionText), "Set Breakpoint in v_crcSts_u8 = GetHWIO_e_CalcCRC_St();"" inside Test_hwcrc_llsi "); 
  snprintf( chExpectedText, elCount(chExpectedText), "Verify Breakpoint is Set in v_crcSts_u8 = GetHWIO_e_CalcCRC_St();"" inside Test_hwcrc_llsi"); 
//  TestStepAddActionExpected( chActionText, chExpectedText );  
  A_DBGR_BreakpointSet("Test_hwcrc_llsi\\341");  

  A_DBGR_Go();
  
  snprintf( chActionText, elCount(chActionText), "Verify Breakpoint should hit in v_crcSts_u8 = GetHWIO_e_CalcCRC_St(); "); 
  snprintf( chExpectedText, elCount(chExpectedText), "Breakpoint hit in v_crcSts_u8 = GetHWIO_e_CalcCRC_St(); function"); 
  E_DBGR_BreakpointCheckForHalt("Test_hwcrc_llsi\\341");
  while(1)
  {
  if(cnt == 0)
  {
  snprintf( chActionText, elCount(chActionText), "Verify v_coreId_u8 is 3 "); 
  snprintf( chExpectedText, elCount(chExpectedText), "Verify Verify v_coreId_u8 is 3"); 
  
  TestStepAddActionExpected( chActionText, chExpectedText );  
  }
  
  A_DBGR_VariableRead("v_coreId_u8",coreID);
  if(coreID == 3)
  {
    write("core ID is : %d",coreID);
    break;
  }
  if(cnt == 0)
  {
  snprintf( chActionText, elCount(chActionText), "Run debugger "); 
  snprintf( chExpectedText, elCount(chExpectedText), "Run debugger "); 
  }
  testWaitForTimeout(1000);
  A_DBGR_Go();
  cnt =cnt+1;
 
  }
  cnt =0;
  E_DBGR_VariableCheck("v_sigVal_u32",0,Equal);
  snprintf( chActionText, elCount(chActionText), "Delete all breakpoints "); 
  snprintf( chExpectedText, elCount(chExpectedText), "Breakpoints deleted"); 
  TestStepAddActionExpected( chActionText, chExpectedText );
  A_DBGR_BreakpointDeleteAll();
  /***************************************************************************************************************/    
  	                            // Test Step 7 Set a breakpoint at line"v_crcSts_u8 = GetHWIO_e_CalcCRC_St();"" inside Test_hwcrc_llsi"
  /***************************************************************************************************************/
  snprintf( chActionText, elCount(chActionText), "Set Breakpoint in v_crcSts_u8 = GetHWIO_e_CalcCRC_St();"" inside Test_hwcrc_llsi "); 
  snprintf( chExpectedText, elCount(chExpectedText), "Verify Breakpoint is Set in v_crcSts_u8 = GetHWIO_e_CalcCRC_St();"" inside Test_hwcrc_llsi"); 
//  TestStepAddActionExpected( chActionText, chExpectedText );  
  A_DBGR_BreakpointSet("Test_hwcrc_llsi\\352");  

  A_DBGR_Go();
  
  snprintf( chActionText, elCount(chActionText), "Verify Breakpoint should hit in v_crcSts_u8 = GetHWIO_e_CalcCRC_St(); "); 
  snprintf( chExpectedText, elCount(chExpectedText), "Breakpoint hit in v_crcSts_u8 = GetHWIO_e_CalcCRC_St(); function"); 
  E_DBGR_BreakpointCheckForHalt("Test_hwcrc_llsi\\352");
  while(1)
  {
  if(cnt == 0)
  {
  snprintf( chActionText, elCount(chActionText), "Verify v_coreId_u8 is 3 "); 
  snprintf( chExpectedText, elCount(chExpectedText), "Verify Verify v_coreId_u8 is 3"); 
  
  TestStepAddActionExpected( chActionText, chExpectedText );  
  }
  
  A_DBGR_VariableRead("v_coreId_u8",coreID);
  if(coreID == 3)
  {
    write("core ID is : %d",coreID);
    break;
  }
  if(cnt == 0)
  {
  snprintf( chActionText, elCount(chActionText), "Run debugger "); 
  snprintf( chExpectedText, elCount(chExpectedText), "Run debugger "); 
  }
  testWaitForTimeout(1000);
  A_DBGR_Go();
  cnt =cnt+1;
 
  }
  cnt =0;
  E_DBGR_VariableCheck("v_crcSts_u8",0,Equal);
}


testcase Verify_Hardware_CRC_Calculation_Invalid_algorithm_Failure_Reporting_Core_0()
{
  /***************************************************************************************************************/    
                                                // Variable Definition
  /***************************************************************************************************************/ 
  

  
  /***************************************************************************************************************/    
                                               // Local Values
  /***************************************************************************************************************/ 
  

  
  /***************************************************************************************************************/    
                                              // Test Case Info
  /***************************************************************************************************************/
  setWriteDbgLevel(DebugOff);
  snprintf( chTestTitle, elCount(chTestTitle), "Verify_Hardware_CRC_Calculation_Invalid_algorithm_Failure_Reporting_Core_0" );
  snprintf( chTestDescription, elCount(chTestDescription), "Purpose:To check the GetHWIO_e_CalcCRC_St(); interface  ");
  TestCaseAddInfo( chTestTitle, "TC_L30SW_Q-36925329", chTestDescription );

  /***************************************************************************************************************/    
                                              // Start of Test Case
  /***************************************************************************************************************/
  
  /***************************************************************************************************************/    
                                              // Test Step 0 PRECONDITIONS
  /***************************************************************************************************************/
  snprintf( chActionText, elCount(chActionText), "Flash the Software and ECU is running "); 
  snprintf( chExpectedText, elCount(chExpectedText), "Ecu is should be in running state"); 
  TestStepAddActionExpected( chActionText, chExpectedText );
  
  A_DBGR_BreakpointDeleteAll();
  A_DBGR_R();
  A_DBGR_Go();
   
  /***************************************************************************************************************/    
                                              // Test Step 1 Set breakpoint in line Test_hwcrc_llsi(); inside "TestApp_Core0_10ms_MainFunction" function and inside testapp.c file
  /***************************************************************************************************************/
  snprintf( chActionText, elCount(chActionText), "Set Breakpoint in Test_hwcrc_llsi(); "); 
  snprintf( chExpectedText, elCount(chExpectedText), "Verify Breakpoint is Set in Test_hwcrc_llsi();"); 
  //TestStepAddActionExpected( chActionText, chExpectedText );  
  A_DBGR_BreakpointSet("TestApp_Core0_10ms_MainFunction\\45");  

  A_DBGR_Go();
  
  snprintf( chActionText, elCount(chActionText), "Verify Breakpoint should hit in Test_hwcrc_llsi(); "); 
  snprintf( chExpectedText, elCount(chExpectedText), "Breakpoint hit in Test_hwcrc_llsi(); function"); 
  E_DBGR_BreakpointCheckForHalt("TestApp_Core0_10ms_MainFunction\\45");
  
  snprintf( chActionText, elCount(chActionText), "Delete all breakpoints "); 
  snprintf( chExpectedText, elCount(chExpectedText), "Breakpoints deleted"); 
  TestStepAddActionExpected( chActionText, chExpectedText );
  
  A_DBGR_BreakpointDeleteAll();
  
   
  /***************************************************************************************************************/    
  	                            // Test Step 2 Set a breakpoint at "v_coreId_u8 = (BYTE)GetCoreID();" inside "Test_hwcrc_llsi" function
  /***************************************************************************************************************/
  
  snprintf( chActionText, elCount(chActionText), "Set Breakpoint in v_coreId_u8 = (BYTE)GetCoreID(); "); 
  snprintf( chExpectedText, elCount(chExpectedText), "Verify Breakpoint is Set in v_coreId_u8 = (BYTE)GetCoreID();"); 
  //TestStepAddActionExpected( chActionText, chExpectedText );  
  A_DBGR_BreakpointSet("Test_hwcrc_llsi\\308");  

  A_DBGR_Go();
  
  snprintf( chActionText, elCount(chActionText), "Verify Breakpoint should hit in v_coreId_u8 = (BYTE)GetCoreID(); "); 
  snprintf( chExpectedText, elCount(chExpectedText), "Breakpoint hit in v_coreId_u8 = (BYTE)GetCoreID(); function"); 
  E_DBGR_BreakpointCheckForHalt("Test_hwcrc_llsi\\308");
  
  /***************************************************************************************************************/    
  	                            // Test Step 3 Verify v_coreId_u8 in trace32 watch window
  /***************************************************************************************************************/
  
   while(1)
  {
  if(cnt == 0)
  {
  snprintf( chActionText, elCount(chActionText), "Verify v_coreId_u8 is 0 "); 
  snprintf( chExpectedText, elCount(chExpectedText), "Verify Verify v_coreId_u8 is 0"); 
  
  TestStepAddActionExpected( chActionText, chExpectedText );  
  }
  
  A_DBGR_VariableRead("v_coreId_u8",coreID);
  if(coreID == 0)
  {
    break;
  }
  if(cnt == 0)
  {
  snprintf( chActionText, elCount(chActionText), "Run debugger "); 
  snprintf( chExpectedText, elCount(chExpectedText), "Run debugger "); 
  }
  A_DBGR_Go();
  testWaitForTimeout(1000);
  cnt =cnt+1;
  }
  E_DBGR_VariableCheck("v_crcSts_u8",0,Equal);
  cnt =0;
  snprintf( chActionText, elCount(chActionText), "delete all breakpoints "); 
  snprintf( chExpectedText, elCount(chExpectedText), "delete all breakpoints "); 
  TestStepAddActionExpected( chActionText, chExpectedText );
  A_DBGR_BreakpointDeleteAll();
  /***************************************************************************************************************/    
  	                            // Test Step 4 Set a breakpoint at line"PerfmHWIO_h_CalcCRC ((BYTE)test_HwCrc_CRC32_ethernet_E, v_seed_u32, v_startAddr_u8, v_endAddr_u8);"
  /***************************************************************************************************************/
  snprintf( chActionText, elCount(chActionText), "Set Breakpoint inPerfmHWIO_h_CalcCRC ((BYTE)test_HwCrc_CRC32_ethernet_E, v_seed_u32, v_startAddr_u8, v_endAddr_u8); "); 
  snprintf( chExpectedText, elCount(chExpectedText), "Verify Breakpoint is Set in PerfmHWIO_h_CalcCRC ((BYTE)test_HwCrc_CRC32_ethernet_E, v_seed_u32, v_startAddr_u8, v_endAddr_u8);"); 
  //TestStepAddActionExpected( chActionText, chExpectedText );  
  A_DBGR_BreakpointSet("Test_hwcrc_llsi\\327");  

  A_DBGR_Go();
  
  snprintf( chActionText, elCount(chActionText), "Verify Breakpoint should hit in v_crcSts_u8 = GetHWIO_e_CalcCRC_St(); "); 
  snprintf( chExpectedText, elCount(chExpectedText), "Breakpoint hit in v_crcSts_u8 = GetHWIO_e_CalcCRC_St(); function"); 
  E_DBGR_BreakpointCheckForHalt("Test_hwcrc_llsi\\327");
  
  while(1)
  {
  if(cnt == 0)
  {
  snprintf( chActionText, elCount(chActionText), "Verify v_coreId_u8 is 0 "); 
  snprintf( chExpectedText, elCount(chExpectedText), "Verify Verify v_coreId_u8 is 0"); 
  
  TestStepAddActionExpected( chActionText, chExpectedText );  
  }
  
  A_DBGR_VariableRead("v_coreId_u8",coreID);
  if(coreID == 0)
  {
    write("core ID is : %d",coreID);
    break;
  }
  if(cnt == 0)
  {
  snprintf( chActionText, elCount(chActionText), "Run debugger "); 
  snprintf( chExpectedText, elCount(chExpectedText), "Run debugger "); 
  }
  testWaitForTimeout(1000);
  A_DBGR_Go();
  cnt =cnt+1;
 
  }
  cnt =0;
  A_DBGR_BreakpointDeleteAll();
  
   /***************************************************************************************************************/    
  	                            // Test Step 5 Set a breakpoint at line"v_crcSts_u8 = GetHWIO_e_CalcCRC_St();"" inside Test_hwcrc_llsi"
  /***************************************************************************************************************/
  snprintf( chActionText, elCount(chActionText), "Set Breakpoint in v_crcSts_u8 = GetHWIO_e_CalcCRC_St();"" inside Test_hwcrc_llsi "); 
  snprintf( chExpectedText, elCount(chExpectedText), "Verify Breakpoint is Set in v_crcSts_u8 = GetHWIO_e_CalcCRC_St();"" inside Test_hwcrc_llsi"); 
//  TestStepAddActionExpected( chActionText, chExpectedText );  
  A_DBGR_BreakpointSet("Test_hwcrc_llsi\\329");  

  A_DBGR_Go();
  
  snprintf( chActionText, elCount(chActionText), "Verify Breakpoint should hit in v_crcSts_u8 = GetHWIO_e_CalcCRC_St(); "); 
  snprintf( chExpectedText, elCount(chExpectedText), "Breakpoint hit in v_crcSts_u8 = GetHWIO_e_CalcCRC_St(); function"); 
  E_DBGR_BreakpointCheckForHalt("Test_hwcrc_llsi\\329");
  while(1)
  {
  if(cnt == 0)
  {
  snprintf( chActionText, elCount(chActionText), "Verify v_coreId_u8 is 0 "); 
  snprintf( chExpectedText, elCount(chExpectedText), "Verify Verify v_coreId_u8 is 0"); 
  
  TestStepAddActionExpected( chActionText, chExpectedText );  
  }
  
  A_DBGR_VariableRead("v_coreId_u8",coreID);
  if(coreID == 0)
  {
    write("core ID is : %d",coreID);
    break;
  }
  if(cnt == 0)
  {
  snprintf( chActionText, elCount(chActionText), "Run debugger "); 
  snprintf( chExpectedText, elCount(chExpectedText), "Run debugger "); 
  }
  testWaitForTimeout(1000);
  A_DBGR_Go();
  cnt =cnt+1;
 
  }
  cnt =0;
  E_DBGR_VariableCheck("v_crcSts_u8",3,Equal);
  
  snprintf( chActionText, elCount(chActionText), "Delete all breakpoints "); 
  snprintf( chExpectedText, elCount(chExpectedText), "Breakpoints deleted"); 
  TestStepAddActionExpected( chActionText, chExpectedText );
  A_DBGR_BreakpointDeleteAll();
  /***************************************************************************************************************/    
  	                            // Test Step 6 Set a breakpoint after the line"v_sigVal_u32 = GetHWIO_g_CalcCRC_Sig();"
  /***************************************************************************************************************/
  snprintf( chActionText, elCount(chActionText), "Set Breakpoint in v_crcSts_u8 = GetHWIO_e_CalcCRC_St();"" inside Test_hwcrc_llsi "); 
  snprintf( chExpectedText, elCount(chExpectedText), "Verify Breakpoint is Set in v_crcSts_u8 = GetHWIO_e_CalcCRC_St();"" inside Test_hwcrc_llsi"); 
//  TestStepAddActionExpected( chActionText, chExpectedText );  
  A_DBGR_BreakpointSet("Test_hwcrc_llsi\\341");  

  A_DBGR_Go();
  
  snprintf( chActionText, elCount(chActionText), "Verify Breakpoint should hit in v_crcSts_u8 = GetHWIO_e_CalcCRC_St(); "); 
  snprintf( chExpectedText, elCount(chExpectedText), "Breakpoint hit in v_crcSts_u8 = GetHWIO_e_CalcCRC_St(); function"); 
  E_DBGR_BreakpointCheckForHalt("Test_hwcrc_llsi\\341");
  while(1)
  {
  if(cnt == 0)
  {
  snprintf( chActionText, elCount(chActionText), "Verify v_coreId_u8 is 0 "); 
  snprintf( chExpectedText, elCount(chExpectedText), "Verify Verify v_coreId_u8 is 0"); 
  
  TestStepAddActionExpected( chActionText, chExpectedText );  
  }
  
  A_DBGR_VariableRead("v_coreId_u8",coreID);
  if(coreID == 0)
  {
    write("core ID is : %d",coreID);
    break;
  }
  if(cnt == 0)
  {
  snprintf( chActionText, elCount(chActionText), "Run debugger "); 
  snprintf( chExpectedText, elCount(chExpectedText), "Run debugger "); 
  }
  testWaitForTimeout(1000);
  A_DBGR_Go();
  cnt =cnt+1;
 
  }
  cnt =0;
  E_DBGR_VariableCheck("v_sigVal_u32",0,Equal);
  snprintf( chActionText, elCount(chActionText), "Delete all breakpoints "); 
  snprintf( chExpectedText, elCount(chExpectedText), "Breakpoints deleted"); 
  TestStepAddActionExpected( chActionText, chExpectedText );
  A_DBGR_BreakpointDeleteAll();
  /***************************************************************************************************************/    
  	                            // Test Step 7 Set a breakpoint at line"v_crcSts_u8 = GetHWIO_e_CalcCRC_St();"" inside Test_hwcrc_llsi"
  /***************************************************************************************************************/
  snprintf( chActionText, elCount(chActionText), "Set Breakpoint in v_crcSts_u8 = GetHWIO_e_CalcCRC_St();"" inside Test_hwcrc_llsi "); 
  snprintf( chExpectedText, elCount(chExpectedText), "Verify Breakpoint is Set in v_crcSts_u8 = GetHWIO_e_CalcCRC_St();"" inside Test_hwcrc_llsi"); 
//  TestStepAddActionExpected( chActionText, chExpectedText );  
  A_DBGR_BreakpointSet("Test_hwcrc_llsi\\352");  

  A_DBGR_Go();
  
  snprintf( chActionText, elCount(chActionText), "Verify Breakpoint should hit in v_crcSts_u8 = GetHWIO_e_CalcCRC_St(); "); 
  snprintf( chExpectedText, elCount(chExpectedText), "Breakpoint hit in v_crcSts_u8 = GetHWIO_e_CalcCRC_St(); function"); 
  E_DBGR_BreakpointCheckForHalt("Test_hwcrc_llsi\\352");
  while(1)
  {
  if(cnt == 0)
  {
  snprintf( chActionText, elCount(chActionText), "Verify v_coreId_u8 is 0 "); 
  snprintf( chExpectedText, elCount(chExpectedText), "Verify Verify v_coreId_u8 is 0"); 
  
  TestStepAddActionExpected( chActionText, chExpectedText );  
  }
  
  A_DBGR_VariableRead("v_coreId_u8",coreID);
  if(coreID == 0)
  {
    write("core ID is : %d",coreID);
    break;
  }
  if(cnt == 0)
  {
  snprintf( chActionText, elCount(chActionText), "Run debugger "); 
  snprintf( chExpectedText, elCount(chExpectedText), "Run debugger "); 
  }
  testWaitForTimeout(1000);
  A_DBGR_Go();
  cnt =cnt+1;
 
  }
  cnt =0;
  E_DBGR_VariableCheck("v_crcSts_u8",0,Equal);
}


testcase Verify_Hardware_CRC_Calculation_Invalid_algorithm_Failure_Reporting_Core_1()
{
  /***************************************************************************************************************/    
                                                // Variable Definition
  /***************************************************************************************************************/ 
  

  
  /***************************************************************************************************************/    
                                               // Local Values
  /***************************************************************************************************************/ 
  

  
  /***************************************************************************************************************/    
                                              // Test Case Info
  /***************************************************************************************************************/
  setWriteDbgLevel(DebugOff);
  snprintf( chTestTitle, elCount(chTestTitle), "Verify_Hardware_CRC_Calculation_Invalid_algorithm_Failure_Reporting_Core_0" );
  snprintf( chTestDescription, elCount(chTestDescription), "Purpose:To check the GetHWIO_e_CalcCRC_St(); interface  ");
  TestCaseAddInfo( chTestTitle, "TC_L30SW_Q-37079840", chTestDescription );

  /***************************************************************************************************************/    
                                              // Start of Test Case
  /***************************************************************************************************************/
  
  /***************************************************************************************************************/    
                                              // Test Step 0 PRECONDITIONS
  /***************************************************************************************************************/
  snprintf( chActionText, elCount(chActionText), "Flash the Software and ECU is running "); 
  snprintf( chExpectedText, elCount(chExpectedText), "Ecu is should be in running state"); 
  TestStepAddActionExpected( chActionText, chExpectedText );
  
  A_DBGR_BreakpointDeleteAll();
  A_DBGR_R();
  A_DBGR_Go();
   
  /***************************************************************************************************************/    
                                              // Test Step 1 Set breakpoint in line Test_hwcrc_llsi(); inside "TestApp_Core1_10ms_MainFunction" function and inside testapp.c file
  /***************************************************************************************************************/
  snprintf( chActionText, elCount(chActionText), "Set Breakpoint in Test_hwcrc_llsi(); "); 
  snprintf( chExpectedText, elCount(chExpectedText), "Verify Breakpoint is Set in Test_hwcrc_llsi();"); 
  //TestStepAddActionExpected( chActionText, chExpectedText );  
  A_DBGR_BreakpointSet("TestApp_Core1_10ms_MainFunction\\36");  

  A_DBGR_Go();
  
  snprintf( chActionText, elCount(chActionText), "Verify Breakpoint should hit in Test_hwcrc_llsi(); "); 
  snprintf( chExpectedText, elCount(chExpectedText), "Breakpoint hit in Test_hwcrc_llsi(); function"); 
  E_DBGR_BreakpointCheckForHalt("TestApp_Core1_10ms_MainFunction\\36");
  
  snprintf( chActionText, elCount(chActionText), "Delete all breakpoints "); 
  snprintf( chExpectedText, elCount(chExpectedText), "Breakpoints deleted"); 
  TestStepAddActionExpected( chActionText, chExpectedText );
  
  A_DBGR_BreakpointDeleteAll();
  
   
  /***************************************************************************************************************/    
  	                            // Test Step 2 Set a breakpoint at "v_coreId_u8 = (BYTE)GetCoreID();" inside "Test_hwcrc_llsi" function
  /***************************************************************************************************************/
  
  snprintf( chActionText, elCount(chActionText), "Set Breakpoint in v_coreId_u8 = (BYTE)GetCoreID(); "); 
  snprintf( chExpectedText, elCount(chExpectedText), "Verify Breakpoint is Set in v_coreId_u8 = (BYTE)GetCoreID();"); 
  //TestStepAddActionExpected( chActionText, chExpectedText );  
  A_DBGR_BreakpointSet("Test_hwcrc_llsi\\308");  

  A_DBGR_Go();
  
  snprintf( chActionText, elCount(chActionText), "Verify Breakpoint should hit in v_coreId_u8 = (BYTE)GetCoreID(); "); 
  snprintf( chExpectedText, elCount(chExpectedText), "Breakpoint hit in v_coreId_u8 = (BYTE)GetCoreID(); function"); 
  E_DBGR_BreakpointCheckForHalt("Test_hwcrc_llsi\\308");
  
  /***************************************************************************************************************/    
  	                            // Test Step 3 Verify v_coreId_u8 in trace32 watch window
  /***************************************************************************************************************/
  
   while(1)
  {
  if(cnt == 0)
  {
  snprintf( chActionText, elCount(chActionText), "Verify v_coreId_u8 is 1 "); 
  snprintf( chExpectedText, elCount(chExpectedText), "Verify Verify v_coreId_u8 is 1"); 
  
  TestStepAddActionExpected( chActionText, chExpectedText );  
  }
  
  A_DBGR_VariableRead("v_coreId_u8",coreID);
  if(coreID == 1)
  {
    break;
  }
  if(cnt == 0)
  {
  snprintf( chActionText, elCount(chActionText), "Run debugger "); 
  snprintf( chExpectedText, elCount(chExpectedText), "Run debugger "); 
  }
  A_DBGR_Go();
  testWaitForTimeout(1000);
  cnt =cnt+1;
  }
  E_DBGR_VariableCheck("v_crcSts_u8",0,Equal);
  cnt =0;
  snprintf( chActionText, elCount(chActionText), "delete all breakpoints "); 
  snprintf( chExpectedText, elCount(chExpectedText), "delete all breakpoints "); 
  TestStepAddActionExpected( chActionText, chExpectedText );
  A_DBGR_BreakpointDeleteAll();
  /***************************************************************************************************************/    
  	                            // Test Step 4 Set a breakpoint at line"PerfmHWIO_h_CalcCRC ((BYTE)test_HwCrc_CRC32_ethernet_E, v_seed_u32, v_startAddr_u8, v_endAddr_u8);"
  /***************************************************************************************************************/
  snprintf( chActionText, elCount(chActionText), "Set Breakpoint inPerfmHWIO_h_CalcCRC ((BYTE)test_HwCrc_CRC32_ethernet_E, v_seed_u32, v_startAddr_u8, v_endAddr_u8); "); 
  snprintf( chExpectedText, elCount(chExpectedText), "Verify Breakpoint is Set in PerfmHWIO_h_CalcCRC ((BYTE)test_HwCrc_CRC32_ethernet_E, v_seed_u32, v_startAddr_u8, v_endAddr_u8);"); 
  //TestStepAddActionExpected( chActionText, chExpectedText );  
  A_DBGR_BreakpointSet("Test_hwcrc_llsi\\327");  

  A_DBGR_Go();
  
  snprintf( chActionText, elCount(chActionText), "Verify Breakpoint should hit in v_crcSts_u8 = GetHWIO_e_CalcCRC_St(); "); 
  snprintf( chExpectedText, elCount(chExpectedText), "Breakpoint hit in v_crcSts_u8 = GetHWIO_e_CalcCRC_St(); function"); 
  E_DBGR_BreakpointCheckForHalt("Test_hwcrc_llsi\\327");
  
  while(1)
  {
  if(cnt == 0)
  {
  snprintf( chActionText, elCount(chActionText), "Verify v_coreId_u8 is 1 "); 
  snprintf( chExpectedText, elCount(chExpectedText), "Verify Verify v_coreId_u8 is 1"); 
  
  TestStepAddActionExpected( chActionText, chExpectedText );  
  }
  
  A_DBGR_VariableRead("v_coreId_u8",coreID);
  if(coreID == 1)
  {
    write("core ID is : %d",coreID);
    break;
  }
  if(cnt == 0)
  {
  snprintf( chActionText, elCount(chActionText), "Run debugger "); 
  snprintf( chExpectedText, elCount(chExpectedText), "Run debugger "); 
  }
  testWaitForTimeout(1000);
  A_DBGR_Go();
  cnt =cnt+1;
 
  }
  cnt =0;
  A_DBGR_BreakpointDeleteAll();
  
   /***************************************************************************************************************/    
  	                            // Test Step 5 Set a breakpoint at line"v_crcSts_u8 = GetHWIO_e_CalcCRC_St();"" inside Test_hwcrc_llsi"
  /***************************************************************************************************************/
  snprintf( chActionText, elCount(chActionText), "Set Breakpoint in v_crcSts_u8 = GetHWIO_e_CalcCRC_St();"" inside Test_hwcrc_llsi "); 
  snprintf( chExpectedText, elCount(chExpectedText), "Verify Breakpoint is Set in v_crcSts_u8 = GetHWIO_e_CalcCRC_St();"" inside Test_hwcrc_llsi"); 
//  TestStepAddActionExpected( chActionText, chExpectedText );  
  A_DBGR_BreakpointSet("Test_hwcrc_llsi\\329");  

  A_DBGR_Go();
  
  snprintf( chActionText, elCount(chActionText), "Verify Breakpoint should hit in v_crcSts_u8 = GetHWIO_e_CalcCRC_St(); "); 
  snprintf( chExpectedText, elCount(chExpectedText), "Breakpoint hit in v_crcSts_u8 = GetHWIO_e_CalcCRC_St(); function"); 
  E_DBGR_BreakpointCheckForHalt("Test_hwcrc_llsi\\329");
  while(1)
  {
  if(cnt == 0)
  {
  snprintf( chActionText, elCount(chActionText), "Verify v_coreId_u8 is 1 "); 
  snprintf( chExpectedText, elCount(chExpectedText), "Verify Verify v_coreId_u8 is 1"); 
  
  TestStepAddActionExpected( chActionText, chExpectedText );  
  }
  
  A_DBGR_VariableRead("v_coreId_u8",coreID);
  if(coreID == 1)
  {
    write("core ID is : %d",coreID);
    break;
  }
  if(cnt == 0)
  {
  snprintf( chActionText, elCount(chActionText), "Run debugger "); 
  snprintf( chExpectedText, elCount(chExpectedText), "Run debugger "); 
  }
  testWaitForTimeout(1000);
  A_DBGR_Go();
  cnt =cnt+1;
 
  }
  cnt =0;
  E_DBGR_VariableCheck("v_crcSts_u8",3,Equal);
  
  snprintf( chActionText, elCount(chActionText), "Delete all breakpoints "); 
  snprintf( chExpectedText, elCount(chExpectedText), "Breakpoints deleted"); 
  TestStepAddActionExpected( chActionText, chExpectedText );
  A_DBGR_BreakpointDeleteAll();
  /***************************************************************************************************************/    
  	                            // Test Step 6 Set a breakpoint after the line"v_sigVal_u32 = GetHWIO_g_CalcCRC_Sig();"
  /***************************************************************************************************************/
  snprintf( chActionText, elCount(chActionText), "Set Breakpoint in v_crcSts_u8 = GetHWIO_e_CalcCRC_St();"" inside Test_hwcrc_llsi "); 
  snprintf( chExpectedText, elCount(chExpectedText), "Verify Breakpoint is Set in v_crcSts_u8 = GetHWIO_e_CalcCRC_St();"" inside Test_hwcrc_llsi"); 
//  TestStepAddActionExpected( chActionText, chExpectedText );  
  A_DBGR_BreakpointSet("Test_hwcrc_llsi\\341");  

  A_DBGR_Go();
  
  snprintf( chActionText, elCount(chActionText), "Verify Breakpoint should hit in v_crcSts_u8 = GetHWIO_e_CalcCRC_St(); "); 
  snprintf( chExpectedText, elCount(chExpectedText), "Breakpoint hit in v_crcSts_u8 = GetHWIO_e_CalcCRC_St(); function"); 
  E_DBGR_BreakpointCheckForHalt("Test_hwcrc_llsi\\341");
  while(1)
  {
  if(cnt == 0)
  {
  snprintf( chActionText, elCount(chActionText), "Verify v_coreId_u8 is 1 "); 
  snprintf( chExpectedText, elCount(chExpectedText), "Verify Verify v_coreId_u8 is 1"); 
  
  TestStepAddActionExpected( chActionText, chExpectedText );  
  }
  
  A_DBGR_VariableRead("v_coreId_u8",coreID);
  if(coreID == 1)
  {
    write("core ID is : %d",coreID);
    break;
  }
  if(cnt == 0)
  {
  snprintf( chActionText, elCount(chActionText), "Run debugger "); 
  snprintf( chExpectedText, elCount(chExpectedText), "Run debugger "); 
  }
  testWaitForTimeout(1000);
  A_DBGR_Go();
  cnt =cnt+1;
 
  }
  cnt =0;
  E_DBGR_VariableCheck("v_sigVal_u32",0,Equal);
  snprintf( chActionText, elCount(chActionText), "Delete all breakpoints "); 
  snprintf( chExpectedText, elCount(chExpectedText), "Breakpoints deleted"); 
  TestStepAddActionExpected( chActionText, chExpectedText );
  A_DBGR_BreakpointDeleteAll();
  /***************************************************************************************************************/    
  	                            // Test Step 7 Set a breakpoint at line"v_crcSts_u8 = GetHWIO_e_CalcCRC_St();"" inside Test_hwcrc_llsi"
  /***************************************************************************************************************/
  snprintf( chActionText, elCount(chActionText), "Set Breakpoint in v_crcSts_u8 = GetHWIO_e_CalcCRC_St();"" inside Test_hwcrc_llsi "); 
  snprintf( chExpectedText, elCount(chExpectedText), "Verify Breakpoint is Set in v_crcSts_u8 = GetHWIO_e_CalcCRC_St();"" inside Test_hwcrc_llsi"); 
//  TestStepAddActionExpected( chActionText, chExpectedText );  
  A_DBGR_BreakpointSet("Test_hwcrc_llsi\\352");  

  A_DBGR_Go();
  
  snprintf( chActionText, elCount(chActionText), "Verify Breakpoint should hit in v_crcSts_u8 = GetHWIO_e_CalcCRC_St(); "); 
  snprintf( chExpectedText, elCount(chExpectedText), "Breakpoint hit in v_crcSts_u8 = GetHWIO_e_CalcCRC_St(); function"); 
  E_DBGR_BreakpointCheckForHalt("Test_hwcrc_llsi\\352");
  while(1)
  {
  if(cnt == 0)
  {
  snprintf( chActionText, elCount(chActionText), "Verify v_coreId_u8 is 1 "); 
  snprintf( chExpectedText, elCount(chExpectedText), "Verify Verify v_coreId_u8 is 1"); 
  
  TestStepAddActionExpected( chActionText, chExpectedText );  
  }
  
  A_DBGR_VariableRead("v_coreId_u8",coreID);
  if(coreID == 1)
  {
    write("core ID is : %d",coreID);
    break;
  }
  if(cnt == 0)
  {
  snprintf( chActionText, elCount(chActionText), "Run debugger "); 
  snprintf( chExpectedText, elCount(chExpectedText), "Run debugger "); 
  }
  testWaitForTimeout(1000);
  A_DBGR_Go();
  cnt =cnt+1;
 
  }
  cnt =0;
  E_DBGR_VariableCheck("v_crcSts_u8",0,Equal);
}


testcase Verify_Hardware_CRC_Calculation_Invalid_algorithm_Failure_Reporting_Core_2()
{
  /***************************************************************************************************************/    
                                                // Variable Definition
  /***************************************************************************************************************/ 
  

  
  /***************************************************************************************************************/    
                                               // Local Values
  /***************************************************************************************************************/ 
  

  
  /***************************************************************************************************************/    
                                              // Test Case Info
  /***************************************************************************************************************/
  setWriteDbgLevel(DebugOff);
  snprintf( chTestTitle, elCount(chTestTitle), "Verify_Hardware_CRC_Calculation_Invalid_algorithm_Failure_Reporting_Core_2" );
  snprintf( chTestDescription, elCount(chTestDescription), "Purpose:To check the GetHWIO_e_CalcCRC_St(); interface  ");
  TestCaseAddInfo( chTestTitle, "TC_L30SW_Q-37079846", chTestDescription );

  /***************************************************************************************************************/    
                                              // Start of Test Case
  /***************************************************************************************************************/
  
  /***************************************************************************************************************/    
                                              // Test Step 0 PRECONDITIONS
  /***************************************************************************************************************/
  snprintf( chActionText, elCount(chActionText), "Flash the Software and ECU is running "); 
  snprintf( chExpectedText, elCount(chExpectedText), "Ecu is should be in running state"); 
  TestStepAddActionExpected( chActionText, chExpectedText );
  
  A_DBGR_BreakpointDeleteAll();
  A_DBGR_R();
  A_DBGR_Go();
   
  /***************************************************************************************************************/    
                                              // Test Step 1 Set breakpoint in line Test_hwcrc_llsi(); inside "TestApp_Core2_10ms_MainFunction" function and inside testapp.c file
  /***************************************************************************************************************/
  snprintf( chActionText, elCount(chActionText), "Set Breakpoint in Test_hwcrc_llsi(); "); 
  snprintf( chExpectedText, elCount(chExpectedText), "Verify Breakpoint is Set in Test_hwcrc_llsi();"); 
  //TestStepAddActionExpected( chActionText, chExpectedText );  
  A_DBGR_BreakpointSet("TestApp_Core2_10ms_MainFunction\\36");  

  A_DBGR_Go();
  
  snprintf( chActionText, elCount(chActionText), "Verify Breakpoint should hit in Test_hwcrc_llsi(); "); 
  snprintf( chExpectedText, elCount(chExpectedText), "Breakpoint hit in Test_hwcrc_llsi(); function"); 
  E_DBGR_BreakpointCheckForHalt("TestApp_Core2_10ms_MainFunction\\36");
  
  snprintf( chActionText, elCount(chActionText), "Delete all breakpoints "); 
  snprintf( chExpectedText, elCount(chExpectedText), "Breakpoints deleted"); 
  TestStepAddActionExpected( chActionText, chExpectedText );
  
  A_DBGR_BreakpointDeleteAll();
  
   
  /***************************************************************************************************************/    
  	                            // Test Step 2 Set a breakpoint at "v_coreId_u8 = (BYTE)GetCoreID();" inside "Test_hwcrc_llsi" function
  /***************************************************************************************************************/
  
  snprintf( chActionText, elCount(chActionText), "Set Breakpoint in v_coreId_u8 = (BYTE)GetCoreID(); "); 
  snprintf( chExpectedText, elCount(chExpectedText), "Verify Breakpoint is Set in v_coreId_u8 = (BYTE)GetCoreID();"); 
  //TestStepAddActionExpected( chActionText, chExpectedText );  
  A_DBGR_BreakpointSet("Test_hwcrc_llsi\\308");  

  A_DBGR_Go();
  
  snprintf( chActionText, elCount(chActionText), "Verify Breakpoint should hit in v_coreId_u8 = (BYTE)GetCoreID(); "); 
  snprintf( chExpectedText, elCount(chExpectedText), "Breakpoint hit in v_coreId_u8 = (BYTE)GetCoreID(); function"); 
  E_DBGR_BreakpointCheckForHalt("Test_hwcrc_llsi\\308");
  
  /***************************************************************************************************************/    
  	                            // Test Step 3 Verify v_coreId_u8 in trace32 watch window
  /***************************************************************************************************************/
  
   while(1)
  {
  if(cnt == 0)
  {
  snprintf( chActionText, elCount(chActionText), "Verify v_coreId_u8 is 2 "); 
  snprintf( chExpectedText, elCount(chExpectedText), "Verify Verify v_coreId_u8 is 2"); 
  
  TestStepAddActionExpected( chActionText, chExpectedText );  
  }
  
  A_DBGR_VariableRead("v_coreId_u8",coreID);
  if(coreID == 2)
  {
    break;
  }
  if(cnt == 0)
  {
  snprintf( chActionText, elCount(chActionText), "Run debugger "); 
  snprintf( chExpectedText, elCount(chExpectedText), "Run debugger "); 
  }
  A_DBGR_Go();
  testWaitForTimeout(1000);
  cnt =cnt+1;
  }
  E_DBGR_VariableCheck("v_crcSts_u8",0,Equal);
  cnt =0;
  snprintf( chActionText, elCount(chActionText), "delete all breakpoints "); 
  snprintf( chExpectedText, elCount(chExpectedText), "delete all breakpoints "); 
  TestStepAddActionExpected( chActionText, chExpectedText );
  A_DBGR_BreakpointDeleteAll();
  /***************************************************************************************************************/    
  	                            // Test Step 4 Set a breakpoint at line"PerfmHWIO_h_CalcCRC ((BYTE)test_HwCrc_CRC32_ethernet_E, v_seed_u32, v_startAddr_u8, v_endAddr_u8);"
  /***************************************************************************************************************/
  snprintf( chActionText, elCount(chActionText), "Set Breakpoint inPerfmHWIO_h_CalcCRC ((BYTE)test_HwCrc_CRC32_ethernet_E, v_seed_u32, v_startAddr_u8, v_endAddr_u8); "); 
  snprintf( chExpectedText, elCount(chExpectedText), "Verify Breakpoint is Set in PerfmHWIO_h_CalcCRC ((BYTE)test_HwCrc_CRC32_ethernet_E, v_seed_u32, v_startAddr_u8, v_endAddr_u8);"); 
  //TestStepAddActionExpected( chActionText, chExpectedText );  
  A_DBGR_BreakpointSet("Test_hwcrc_llsi\\327");  

  A_DBGR_Go();
  
  snprintf( chActionText, elCount(chActionText), "Verify Breakpoint should hit in v_crcSts_u8 = GetHWIO_e_CalcCRC_St(); "); 
  snprintf( chExpectedText, elCount(chExpectedText), "Breakpoint hit in v_crcSts_u8 = GetHWIO_e_CalcCRC_St(); function"); 
  E_DBGR_BreakpointCheckForHalt("Test_hwcrc_llsi\\327");
  
  while(1)
  {
  if(cnt == 0)
  {
  snprintf( chActionText, elCount(chActionText), "Verify v_coreId_u8 is 2 "); 
  snprintf( chExpectedText, elCount(chExpectedText), "Verify Verify v_coreId_u8 is 2"); 
  
  TestStepAddActionExpected( chActionText, chExpectedText );  
  }
  
  A_DBGR_VariableRead("v_coreId_u8",coreID);
  if(coreID == 2)
  {
    write("core ID is : %d",coreID);
    break;
  }
  if(cnt == 0)
  {
  snprintf( chActionText, elCount(chActionText), "Run debugger "); 
  snprintf( chExpectedText, elCount(chExpectedText), "Run debugger "); 
  }
  testWaitForTimeout(1000);
  A_DBGR_Go();
  cnt =cnt+1;
 
  }
  cnt =0;
  A_DBGR_BreakpointDeleteAll();
  
   /***************************************************************************************************************/    
  	                            // Test Step 5 Set a breakpoint at line"v_crcSts_u8 = GetHWIO_e_CalcCRC_St();"" inside Test_hwcrc_llsi"
  /***************************************************************************************************************/
  snprintf( chActionText, elCount(chActionText), "Set Breakpoint in v_crcSts_u8 = GetHWIO_e_CalcCRC_St();"" inside Test_hwcrc_llsi "); 
  snprintf( chExpectedText, elCount(chExpectedText), "Verify Breakpoint is Set in v_crcSts_u8 = GetHWIO_e_CalcCRC_St();"" inside Test_hwcrc_llsi"); 
//  TestStepAddActionExpected( chActionText, chExpectedText );  
  A_DBGR_BreakpointSet("Test_hwcrc_llsi\\329");  

  A_DBGR_Go();
  
  snprintf( chActionText, elCount(chActionText), "Verify Breakpoint should hit in v_crcSts_u8 = GetHWIO_e_CalcCRC_St(); "); 
  snprintf( chExpectedText, elCount(chExpectedText), "Breakpoint hit in v_crcSts_u8 = GetHWIO_e_CalcCRC_St(); function"); 
  E_DBGR_BreakpointCheckForHalt("Test_hwcrc_llsi\\329");
  while(1)
  {
  if(cnt == 0)
  {
  snprintf( chActionText, elCount(chActionText), "Verify v_coreId_u8 is 2 "); 
  snprintf( chExpectedText, elCount(chExpectedText), "Verify Verify v_coreId_u8 is 2"); 
  
  TestStepAddActionExpected( chActionText, chExpectedText );  
  }
  
  A_DBGR_VariableRead("v_coreId_u8",coreID);
  if(coreID == 2)
  {
    write("core ID is : %d",coreID);
    break;
  }
  if(cnt == 0)
  {
  snprintf( chActionText, elCount(chActionText), "Run debugger "); 
  snprintf( chExpectedText, elCount(chExpectedText), "Run debugger "); 
  }
  testWaitForTimeout(1000);
  A_DBGR_Go();
  cnt =cnt+1;
 
  }
  cnt =0;
  E_DBGR_VariableCheck("v_crcSts_u8",3,Equal);
  
  snprintf( chActionText, elCount(chActionText), "Delete all breakpoints "); 
  snprintf( chExpectedText, elCount(chExpectedText), "Breakpoints deleted"); 
  TestStepAddActionExpected( chActionText, chExpectedText );
  A_DBGR_BreakpointDeleteAll();
  /***************************************************************************************************************/    
  	                            // Test Step 6 Set a breakpoint after the line"v_sigVal_u32 = GetHWIO_g_CalcCRC_Sig();"
  /***************************************************************************************************************/
  snprintf( chActionText, elCount(chActionText), "Set Breakpoint in v_crcSts_u8 = GetHWIO_e_CalcCRC_St();"" inside Test_hwcrc_llsi "); 
  snprintf( chExpectedText, elCount(chExpectedText), "Verify Breakpoint is Set in v_crcSts_u8 = GetHWIO_e_CalcCRC_St();"" inside Test_hwcrc_llsi"); 
//  TestStepAddActionExpected( chActionText, chExpectedText );  
  A_DBGR_BreakpointSet("Test_hwcrc_llsi\\341");  

  A_DBGR_Go();
  
  snprintf( chActionText, elCount(chActionText), "Verify Breakpoint should hit in v_crcSts_u8 = GetHWIO_e_CalcCRC_St(); "); 
  snprintf( chExpectedText, elCount(chExpectedText), "Breakpoint hit in v_crcSts_u8 = GetHWIO_e_CalcCRC_St(); function"); 
  E_DBGR_BreakpointCheckForHalt("Test_hwcrc_llsi\\341");
  while(1)
  {
  if(cnt == 0)
  {
  snprintf( chActionText, elCount(chActionText), "Verify v_coreId_u8 is 2 "); 
  snprintf( chExpectedText, elCount(chExpectedText), "Verify Verify v_coreId_u8 is 2"); 
  
  TestStepAddActionExpected( chActionText, chExpectedText );  
  }
  
  A_DBGR_VariableRead("v_coreId_u8",coreID);
  if(coreID == 2)
  {
    write("core ID is : %d",coreID);
    break;
  }
  if(cnt == 0)
  {
  snprintf( chActionText, elCount(chActionText), "Run debugger "); 
  snprintf( chExpectedText, elCount(chExpectedText), "Run debugger "); 
  }
  testWaitForTimeout(1000);
  A_DBGR_Go();
  cnt =cnt+1;
 
  }
  cnt =0;
  E_DBGR_VariableCheck("v_sigVal_u32",0,Equal);
  snprintf( chActionText, elCount(chActionText), "Delete all breakpoints "); 
  snprintf( chExpectedText, elCount(chExpectedText), "Breakpoints deleted"); 
  TestStepAddActionExpected( chActionText, chExpectedText );
  A_DBGR_BreakpointDeleteAll();
  /***************************************************************************************************************/    
  	                            // Test Step 7 Set a breakpoint at line"v_crcSts_u8 = GetHWIO_e_CalcCRC_St();"" inside Test_hwcrc_llsi"
  /***************************************************************************************************************/
  snprintf( chActionText, elCount(chActionText), "Set Breakpoint in v_crcSts_u8 = GetHWIO_e_CalcCRC_St();"" inside Test_hwcrc_llsi "); 
  snprintf( chExpectedText, elCount(chExpectedText), "Verify Breakpoint is Set in v_crcSts_u8 = GetHWIO_e_CalcCRC_St();"" inside Test_hwcrc_llsi"); 
//  TestStepAddActionExpected( chActionText, chExpectedText );  
  A_DBGR_BreakpointSet("Test_hwcrc_llsi\\352");  

  A_DBGR_Go();
  
  snprintf( chActionText, elCount(chActionText), "Verify Breakpoint should hit in v_crcSts_u8 = GetHWIO_e_CalcCRC_St(); "); 
  snprintf( chExpectedText, elCount(chExpectedText), "Breakpoint hit in v_crcSts_u8 = GetHWIO_e_CalcCRC_St(); function"); 
  E_DBGR_BreakpointCheckForHalt("Test_hwcrc_llsi\\352");
  while(1)
  {
  if(cnt == 0)
  {
  snprintf( chActionText, elCount(chActionText), "Verify v_coreId_u8 is 2 "); 
  snprintf( chExpectedText, elCount(chExpectedText), "Verify Verify v_coreId_u8 is 2"); 
  
  TestStepAddActionExpected( chActionText, chExpectedText );  
  }
  
  A_DBGR_VariableRead("v_coreId_u8",coreID);
  if(coreID == 2)
  {
    write("core ID is : %d",coreID);
    break;
  }
  if(cnt == 0)
  {
  snprintf( chActionText, elCount(chActionText), "Run debugger "); 
  snprintf( chExpectedText, elCount(chExpectedText), "Run debugger "); 
  }
  testWaitForTimeout(1000);
  A_DBGR_Go();
  cnt =cnt+1;
 
  }
  cnt =0;
  E_DBGR_VariableCheck("v_crcSts_u8",0,Equal);
}


testcase Verify_Hardware_CRC_Calculation_Invalid_algorithm_Failure_Reporting_Core_4()
{
  /***************************************************************************************************************/    
                                                // Variable Definition
  /***************************************************************************************************************/ 
  

  
  /***************************************************************************************************************/    
                                               // Local Values
  /***************************************************************************************************************/ 
  

  
  /***************************************************************************************************************/    
                                              // Test Case Info
  /***************************************************************************************************************/
  setWriteDbgLevel(DebugOff);
  snprintf( chTestTitle, elCount(chTestTitle), "Verify_Hardware_CRC_Calculation_Invalid_algorithm_Failure_Reporting_Core_4" );
  snprintf( chTestDescription, elCount(chTestDescription), "Purpose:To check the GetHWIO_e_CalcCRC_St(); interface  ");
  TestCaseAddInfo( chTestTitle, "TC_L30SW_Q-37079856", chTestDescription );

  /***************************************************************************************************************/    
                                              // Start of Test Case
  /***************************************************************************************************************/
  
  /***************************************************************************************************************/    
                                              // Test Step 0 PRECONDITIONS
  /***************************************************************************************************************/
  snprintf( chActionText, elCount(chActionText), "Flash the Software and ECU is running "); 
  snprintf( chExpectedText, elCount(chExpectedText), "Ecu is should be in running state"); 
  TestStepAddActionExpected( chActionText, chExpectedText );
  
  A_DBGR_BreakpointDeleteAll();
  A_DBGR_R();
  A_DBGR_Go();
  /***************************************************************************************************************/    
                                              // Test Step 1 Set breakpoint in line Test_hwcrc_llsi(); inside "TestApp_Core4_1000ms_MainFunction" function and inside testapp.c file
  /***************************************************************************************************************/
  snprintf( chActionText, elCount(chActionText), "Set Breakpoint in Test_hwcrc_llsi(); "); 
  snprintf( chExpectedText, elCount(chExpectedText), "Verify Breakpoint is Set in Test_hwcrc_llsi();"); 
  //TestStepAddActionExpected( chActionText, chExpectedText );  
  A_DBGR_BreakpointSet("TestApp_Core4_1000ms_MainFunction\\65");  

  A_DBGR_Go();
  
  snprintf( chActionText, elCount(chActionText), "Verify Breakpoint should hit in Test_hwcrc_llsi(); "); 
  snprintf( chExpectedText, elCount(chExpectedText), "Breakpoint hit in Test_hwcrc_llsi(); function"); 
  E_DBGR_BreakpointCheckForHalt("TestApp_Core4_1000ms_MainFunction\\65");
  
  testWaitForTimeout(2000);
  
  snprintf( chActionText, elCount(chActionText), "Delete all breakpoints "); 
  snprintf( chExpectedText, elCount(chExpectedText), "Breakpoints deleted"); 
  TestStepAddActionExpected( chActionText, chExpectedText );
  
  A_DBGR_BreakpointDeleteAll();
  
   
  /***************************************************************************************************************/    
  	                            // Test Step 2 Set a breakpoint at "v_coreId_u8 = (BYTE)GetCoreID();" inside "Test_hwcrc_llsi" function
  /***************************************************************************************************************/
  
  snprintf( chActionText, elCount(chActionText), "Set Breakpoint in v_coreId_u8 = (BYTE)GetCoreID(); "); 
  snprintf( chExpectedText, elCount(chExpectedText), "Verify Breakpoint is Set in v_coreId_u8 = (BYTE)GetCoreID();"); 
  //TestStepAddActionExpected( chActionText, chExpectedText );  
  A_DBGR_BreakpointSet("Test_hwcrc_llsi\\308");  

  A_DBGR_Go();
  
  snprintf( chActionText, elCount(chActionText), "Verify Breakpoint should hit in v_coreId_u8 = (BYTE)GetCoreID(); "); 
  snprintf( chExpectedText, elCount(chExpectedText), "Breakpoint hit in v_coreId_u8 = (BYTE)GetCoreID(); function"); 
  E_DBGR_BreakpointCheckForHalt("Test_hwcrc_llsi\\308");
  
  /***************************************************************************************************************/    
  	                            // Test Step 3 Verify v_coreId_u8 in trace32 watch window
  /***************************************************************************************************************/
  
   while(1)
  {
  if(cnt == 0)
  {
  snprintf( chActionText, elCount(chActionText), "Verify v_coreId_u8 is 4 "); 
  snprintf( chExpectedText, elCount(chExpectedText), "Verify Verify v_coreId_u8 is 4"); 
  
  TestStepAddActionExpected( chActionText, chExpectedText );  
  }
  
  A_DBGR_VariableRead("v_coreId_u8",coreID);
  if(coreID == 4)
  {
    break;
  }
  if(cnt == 0)
  {
  snprintf( chActionText, elCount(chActionText), "Run debugger "); 
  snprintf( chExpectedText, elCount(chExpectedText), "Run debugger "); 
  }
  A_DBGR_Go();
  testWaitForTimeout(3000);
  if(cnt == 3)
  {
    testWaitForTimeout(60000);
  }
  cnt =cnt+1;
  }
  E_DBGR_VariableCheck("v_crcSts_u8",0,Equal);
  cnt =0;
  snprintf( chActionText, elCount(chActionText), "delete all breakpoints "); 
  snprintf( chExpectedText, elCount(chExpectedText), "delete all breakpoints "); 
  TestStepAddActionExpected( chActionText, chExpectedText );
  A_DBGR_BreakpointDeleteAll();
  /***************************************************************************************************************/    
  	                            // Test Step 4 Set a breakpoint at line"PerfmHWIO_h_CalcCRC ((BYTE)test_HwCrc_CRC32_ethernet_E, v_seed_u32, v_startAddr_u8, v_endAddr_u8);"
  /***************************************************************************************************************/
  snprintf( chActionText, elCount(chActionText), "Set Breakpoint inPerfmHWIO_h_CalcCRC ((BYTE)test_HwCrc_CRC32_ethernet_E, v_seed_u32, v_startAddr_u8, v_endAddr_u8); "); 
  snprintf( chExpectedText, elCount(chExpectedText), "Verify Breakpoint is Set in PerfmHWIO_h_CalcCRC ((BYTE)test_HwCrc_CRC32_ethernet_E, v_seed_u32, v_startAddr_u8, v_endAddr_u8);"); 
  //TestStepAddActionExpected( chActionText, chExpectedText );  
  A_DBGR_BreakpointSet("Test_hwcrc_llsi\\327");  

  A_DBGR_Go();
  
  snprintf( chActionText, elCount(chActionText), "Verify Breakpoint should hit in v_crcSts_u8 = GetHWIO_e_CalcCRC_St(); "); 
  snprintf( chExpectedText, elCount(chExpectedText), "Breakpoint hit in v_crcSts_u8 = GetHWIO_e_CalcCRC_St(); function"); 
  E_DBGR_BreakpointCheckForHalt("Test_hwcrc_llsi\\327");
  
  while(1)
  {
  if(cnt == 0)
  {
  snprintf( chActionText, elCount(chActionText), "Verify v_coreId_u8 is 4 "); 
  snprintf( chExpectedText, elCount(chExpectedText), "Verify Verify v_coreId_u8 is 4"); 
  
  TestStepAddActionExpected( chActionText, chExpectedText );  
  }
  
  A_DBGR_VariableRead("v_coreId_u8",coreID);
  if(coreID == 4)
  {
    write("core ID is : %d",coreID);
    break;
  }
  if(cnt == 0)
  {
  snprintf( chActionText, elCount(chActionText), "Run debugger "); 
  snprintf( chExpectedText, elCount(chExpectedText), "Run debugger "); 
  }
  testWaitForTimeout(1000);
  A_DBGR_Go();
  cnt =cnt+1;
 
  }
  cnt =0;
  A_DBGR_BreakpointDeleteAll();
  
   /***************************************************************************************************************/    
  	                            // Test Step 5 Set a breakpoint at line"v_crcSts_u8 = GetHWIO_e_CalcCRC_St();"" inside Test_hwcrc_llsi"
  /***************************************************************************************************************/
  snprintf( chActionText, elCount(chActionText), "Set Breakpoint in v_crcSts_u8 = GetHWIO_e_CalcCRC_St();"" inside Test_hwcrc_llsi "); 
  snprintf( chExpectedText, elCount(chExpectedText), "Verify Breakpoint is Set in v_crcSts_u8 = GetHWIO_e_CalcCRC_St();"" inside Test_hwcrc_llsi"); 
//  TestStepAddActionExpected( chActionText, chExpectedText );  
  A_DBGR_BreakpointSet("Test_hwcrc_llsi\\329");  

  A_DBGR_Go();
  
  snprintf( chActionText, elCount(chActionText), "Verify Breakpoint should hit in v_crcSts_u8 = GetHWIO_e_CalcCRC_St(); "); 
  snprintf( chExpectedText, elCount(chExpectedText), "Breakpoint hit in v_crcSts_u8 = GetHWIO_e_CalcCRC_St(); function"); 
  E_DBGR_BreakpointCheckForHalt("Test_hwcrc_llsi\\329");
  while(1)
  {
  if(cnt == 0)
  {
  snprintf( chActionText, elCount(chActionText), "Verify v_coreId_u8 is 4 "); 
  snprintf( chExpectedText, elCount(chExpectedText), "Verify Verify v_coreId_u8 is 4"); 
  
  TestStepAddActionExpected( chActionText, chExpectedText );  
  }
  
  A_DBGR_VariableRead("v_coreId_u8",coreID);
  if(coreID == 4)
  {
    write("core ID is : %d",coreID);
    break;
  }
  if(cnt == 0)
  {
  snprintf( chActionText, elCount(chActionText), "Run debugger "); 
  snprintf( chExpectedText, elCount(chExpectedText), "Run debugger "); 
  }
  testWaitForTimeout(1000);
  A_DBGR_Go();
  cnt =cnt+1;
 
  }
  cnt =0;
  E_DBGR_VariableCheck("v_crcSts_u8",3,Equal);
  
  snprintf( chActionText, elCount(chActionText), "Delete all breakpoints "); 
  snprintf( chExpectedText, elCount(chExpectedText), "Breakpoints deleted"); 
  TestStepAddActionExpected( chActionText, chExpectedText );
  A_DBGR_BreakpointDeleteAll();
  /***************************************************************************************************************/    
  	                            // Test Step 6 Set a breakpoint after the line"v_sigVal_u32 = GetHWIO_g_CalcCRC_Sig();"
  /***************************************************************************************************************/
  snprintf( chActionText, elCount(chActionText), "Set Breakpoint in v_crcSts_u8 = GetHWIO_e_CalcCRC_St();"" inside Test_hwcrc_llsi "); 
  snprintf( chExpectedText, elCount(chExpectedText), "Verify Breakpoint is Set in v_crcSts_u8 = GetHWIO_e_CalcCRC_St();"" inside Test_hwcrc_llsi"); 
//  TestStepAddActionExpected( chActionText, chExpectedText );  
  A_DBGR_BreakpointSet("Test_hwcrc_llsi\\341");  

  A_DBGR_Go();
  
  snprintf( chActionText, elCount(chActionText), "Verify Breakpoint should hit in v_crcSts_u8 = GetHWIO_e_CalcCRC_St(); "); 
  snprintf( chExpectedText, elCount(chExpectedText), "Breakpoint hit in v_crcSts_u8 = GetHWIO_e_CalcCRC_St(); function"); 
  E_DBGR_BreakpointCheckForHalt("Test_hwcrc_llsi\\341");
  while(1)
  {
  if(cnt == 0)
  {
  snprintf( chActionText, elCount(chActionText), "Verify v_coreId_u8 is 4 "); 
  snprintf( chExpectedText, elCount(chExpectedText), "Verify Verify v_coreId_u8 is 4"); 
  
  TestStepAddActionExpected( chActionText, chExpectedText );  
  }
  
  A_DBGR_VariableRead("v_coreId_u8",coreID);
  if(coreID == 4)
  {
    write("core ID is : %d",coreID);
    break;
  }
  if(cnt == 0)
  {
  snprintf( chActionText, elCount(chActionText), "Run debugger "); 
  snprintf( chExpectedText, elCount(chExpectedText), "Run debugger "); 
  }
  testWaitForTimeout(1000);
  A_DBGR_Go();
  cnt =cnt+1;
 
  }
  cnt =0;
  E_DBGR_VariableCheck("v_sigVal_u32",0,Equal);
  snprintf( chActionText, elCount(chActionText), "Delete all breakpoints "); 
  snprintf( chExpectedText, elCount(chExpectedText), "Breakpoints deleted"); 
  TestStepAddActionExpected( chActionText, chExpectedText );
  A_DBGR_BreakpointDeleteAll();
  /***************************************************************************************************************/    
  	                            // Test Step 7 Set a breakpoint at line"v_crcSts_u8 = GetHWIO_e_CalcCRC_St();"" inside Test_hwcrc_llsi"
  /***************************************************************************************************************/
  snprintf( chActionText, elCount(chActionText), "Set Breakpoint in v_crcSts_u8 = GetHWIO_e_CalcCRC_St();"" inside Test_hwcrc_llsi "); 
  snprintf( chExpectedText, elCount(chExpectedText), "Verify Breakpoint is Set in v_crcSts_u8 = GetHWIO_e_CalcCRC_St();"" inside Test_hwcrc_llsi"); 
//  TestStepAddActionExpected( chActionText, chExpectedText );  
  A_DBGR_BreakpointSet("Test_hwcrc_llsi\\352");  

  A_DBGR_Go();
  
  snprintf( chActionText, elCount(chActionText), "Verify Breakpoint should hit in v_crcSts_u8 = GetHWIO_e_CalcCRC_St(); "); 
  snprintf( chExpectedText, elCount(chExpectedText), "Breakpoint hit in v_crcSts_u8 = GetHWIO_e_CalcCRC_St(); function"); 
  E_DBGR_BreakpointCheckForHalt("Test_hwcrc_llsi\\352");
  while(1)
  {
  if(cnt == 0)
  {
  snprintf( chActionText, elCount(chActionText), "Verify v_coreId_u8 is 4 "); 
  snprintf( chExpectedText, elCount(chExpectedText), "Verify Verify v_coreId_u8 is 4"); 
  
  TestStepAddActionExpected( chActionText, chExpectedText );  
  }
  
  A_DBGR_VariableRead("v_coreId_u8",coreID);
  if(coreID == 4)
  {
    write("core ID is : %d",coreID);
    break;
  }
  if(cnt == 0)
  {
  snprintf( chActionText, elCount(chActionText), "Run debugger "); 
  snprintf( chExpectedText, elCount(chExpectedText), "Run debugger "); 
  }
  testWaitForTimeout(1000);
  A_DBGR_Go();
  cnt =cnt+1;
 
  }
  cnt =0;
  E_DBGR_VariableCheck("v_crcSts_u8",0,Equal);
}

testcase Verify_Hardware_CRC_Calculation_Invalid_algorithm_Failure_Reporting_Core_5()
{
  /***************************************************************************************************************/    
                                                // Variable Definition
  /***************************************************************************************************************/ 
  

  
  /***************************************************************************************************************/    
                                               // Local Values
  /***************************************************************************************************************/ 
  

  
  /***************************************************************************************************************/    
                                              // Test Case Info
  /***************************************************************************************************************/
  setWriteDbgLevel(DebugOff);
  snprintf( chTestTitle, elCount(chTestTitle), "Verify_Hardware_CRC_Calculation_Invalid_algorithm_Failure_Reporting_Core_5" );
  snprintf( chTestDescription, elCount(chTestDescription), "Purpose:To check the GetHWIO_e_CalcCRC_St(); interface  ");
  TestCaseAddInfo( chTestTitle, "TC_L30SW_Q-37079861", chTestDescription );

  /***************************************************************************************************************/    
                                              // Start of Test Case
  /***************************************************************************************************************/
  
  /***************************************************************************************************************/    
                                              // Test Step 0 PRECONDITIONS
  /***************************************************************************************************************/
  snprintf( chActionText, elCount(chActionText), "Flash the Software and ECU is running "); 
  snprintf( chExpectedText, elCount(chExpectedText), "Ecu is should be in running state"); 
  TestStepAddActionExpected( chActionText, chExpectedText );
  
  A_DBGR_BreakpointDeleteAll();
  A_DBGR_R();
  A_DBGR_Go(); 
  /***************************************************************************************************************/    
                                              // Test Step 1 Set breakpoint in line Test_hwcrc_llsi(); inside "TestApp_Core5_1000ms_MainFunction" function and inside testapp.c file
  /***************************************************************************************************************/
  snprintf( chActionText, elCount(chActionText), "Set Breakpoint in Test_hwcrc_llsi(); "); 
  snprintf( chExpectedText, elCount(chExpectedText), "Verify Breakpoint is Set in Test_hwcrc_llsi();"); 
  //TestStepAddActionExpected( chActionText, chExpectedText );  
  A_DBGR_BreakpointSet("TestApp_Core5_1000ms_MainFunction\\54");  

  A_DBGR_Go();
  
  snprintf( chActionText, elCount(chActionText), "Verify Breakpoint should hit in Test_hwcrc_llsi(); "); 
  snprintf( chExpectedText, elCount(chExpectedText), "Breakpoint hit in Test_hwcrc_llsi(); function"); 
  E_DBGR_BreakpointCheckForHalt("TestApp_Core5_1000ms_MainFunction\\54");
  
  testWaitForTimeout(2000);
  
  snprintf( chActionText, elCount(chActionText), "Delete all breakpoints "); 
  snprintf( chExpectedText, elCount(chExpectedText), "Breakpoints deleted"); 
  TestStepAddActionExpected( chActionText, chExpectedText );
  
  A_DBGR_BreakpointDeleteAll();  
  
   
  /***************************************************************************************************************/    
  	                            // Test Step 2 Set a breakpoint at "v_coreId_u8 = (BYTE)GetCoreID();" inside "Test_hwcrc_llsi" function
  /***************************************************************************************************************/
  
  snprintf( chActionText, elCount(chActionText), "Set Breakpoint in v_coreId_u8 = (BYTE)GetCoreID(); "); 
  snprintf( chExpectedText, elCount(chExpectedText), "Verify Breakpoint is Set in v_coreId_u8 = (BYTE)GetCoreID();"); 
  //TestStepAddActionExpected( chActionText, chExpectedText );  
  A_DBGR_BreakpointSet("Test_hwcrc_llsi\\308");  

  A_DBGR_Go();
  
  snprintf( chActionText, elCount(chActionText), "Verify Breakpoint should hit in v_coreId_u8 = (BYTE)GetCoreID(); "); 
  snprintf( chExpectedText, elCount(chExpectedText), "Breakpoint hit in v_coreId_u8 = (BYTE)GetCoreID(); function"); 
  E_DBGR_BreakpointCheckForHalt("Test_hwcrc_llsi\\308");
  
  /***************************************************************************************************************/    
  	                            // Test Step 3 Verify v_coreId_u8 in trace32 watch window
  /***************************************************************************************************************/
  
   while(1)
  {
  if(cnt == 0)
  {
  snprintf( chActionText, elCount(chActionText), "Verify v_coreId_u8 is 5 "); 
  snprintf( chExpectedText, elCount(chExpectedText), "Verify Verify v_coreId_u8 is 5"); 
  
  TestStepAddActionExpected( chActionText, chExpectedText );  
  }
  
  A_DBGR_VariableRead("v_coreId_u8",coreID);
  if(coreID == 5)
  {
    break;
  }
  if(cnt == 0)
  {
  snprintf( chActionText, elCount(chActionText), "Run debugger "); 
  snprintf( chExpectedText, elCount(chExpectedText), "Run debugger "); 
  }
  A_DBGR_Go();
  testWaitForTimeout(3000);
  if(cnt == 4)
  {
    testWaitForTimeout(20000);
  }
  cnt =cnt+1;
  }
  E_DBGR_VariableCheck("v_crcSts_u8",0,Equal);
  cnt =0;
  snprintf( chActionText, elCount(chActionText), "delete all breakpoints "); 
  snprintf( chExpectedText, elCount(chExpectedText), "delete all breakpoints "); 
  TestStepAddActionExpected( chActionText, chExpectedText );
  A_DBGR_BreakpointDeleteAll();
  /***************************************************************************************************************/    
  	                            // Test Step 4 Set a breakpoint at line"PerfmHWIO_h_CalcCRC ((BYTE)test_HwCrc_CRC32_ethernet_E, v_seed_u32, v_startAddr_u8, v_endAddr_u8);"
  /***************************************************************************************************************/
  snprintf( chActionText, elCount(chActionText), "Set Breakpoint inPerfmHWIO_h_CalcCRC ((BYTE)test_HwCrc_CRC32_ethernet_E, v_seed_u32, v_startAddr_u8, v_endAddr_u8); "); 
  snprintf( chExpectedText, elCount(chExpectedText), "Verify Breakpoint is Set in PerfmHWIO_h_CalcCRC ((BYTE)test_HwCrc_CRC32_ethernet_E, v_seed_u32, v_startAddr_u8, v_endAddr_u8);"); 
  //TestStepAddActionExpected( chActionText, chExpectedText );  
  A_DBGR_BreakpointSet("Test_hwcrc_llsi\\327");  

  A_DBGR_Go();
  
  snprintf( chActionText, elCount(chActionText), "Verify Breakpoint should hit in v_crcSts_u8 = GetHWIO_e_CalcCRC_St(); "); 
  snprintf( chExpectedText, elCount(chExpectedText), "Breakpoint hit in v_crcSts_u8 = GetHWIO_e_CalcCRC_St(); function"); 
  E_DBGR_BreakpointCheckForHalt("Test_hwcrc_llsi\\327");
  
  while(1)
  {
  if(cnt == 0)
  {
  snprintf( chActionText, elCount(chActionText), "Verify v_coreId_u8 is 5 "); 
  snprintf( chExpectedText, elCount(chExpectedText), "Verify Verify v_coreId_u8 is 5"); 
  
  TestStepAddActionExpected( chActionText, chExpectedText );  
  }
  
  A_DBGR_VariableRead("v_coreId_u8",coreID);
  if(coreID == 5)
  {
    write("core ID is : %d",coreID);
    break;
  }
  if(cnt == 0)
  {
  snprintf( chActionText, elCount(chActionText), "Run debugger "); 
  snprintf( chExpectedText, elCount(chExpectedText), "Run debugger "); 
  }
  testWaitForTimeout(1000);
  A_DBGR_Go();
  cnt =cnt+1;
 
  }
  cnt =0;
  A_DBGR_BreakpointDeleteAll();
  
   /***************************************************************************************************************/    
  	                            // Test Step 5 Set a breakpoint at line"v_crcSts_u8 = GetHWIO_e_CalcCRC_St();"" inside Test_hwcrc_llsi"
  /***************************************************************************************************************/
  snprintf( chActionText, elCount(chActionText), "Set Breakpoint in v_crcSts_u8 = GetHWIO_e_CalcCRC_St();"" inside Test_hwcrc_llsi "); 
  snprintf( chExpectedText, elCount(chExpectedText), "Verify Breakpoint is Set in v_crcSts_u8 = GetHWIO_e_CalcCRC_St();"" inside Test_hwcrc_llsi"); 
//  TestStepAddActionExpected( chActionText, chExpectedText );  
  A_DBGR_BreakpointSet("Test_hwcrc_llsi\\329");  

  A_DBGR_Go();
  
  snprintf( chActionText, elCount(chActionText), "Verify Breakpoint should hit in v_crcSts_u8 = GetHWIO_e_CalcCRC_St(); "); 
  snprintf( chExpectedText, elCount(chExpectedText), "Breakpoint hit in v_crcSts_u8 = GetHWIO_e_CalcCRC_St(); function"); 
  E_DBGR_BreakpointCheckForHalt("Test_hwcrc_llsi\\329");
  while(1)
  {
  if(cnt == 0)
  {
  snprintf( chActionText, elCount(chActionText), "Verify v_coreId_u8 is 5 "); 
  snprintf( chExpectedText, elCount(chExpectedText), "Verify Verify v_coreId_u8 is 5"); 
  
  TestStepAddActionExpected( chActionText, chExpectedText );  
  }
  
  A_DBGR_VariableRead("v_coreId_u8",coreID);
  if(coreID == 5)
  {
    write("core ID is : %d",coreID);
    break;
  }
  if(cnt == 0)
  {
  snprintf( chActionText, elCount(chActionText), "Run debugger "); 
  snprintf( chExpectedText, elCount(chExpectedText), "Run debugger "); 
  }
  testWaitForTimeout(1000);
  A_DBGR_Go();
  cnt =cnt+1;
 
  }
  cnt =0;
  E_DBGR_VariableCheck("v_crcSts_u8",3,Equal);
  
  snprintf( chActionText, elCount(chActionText), "Delete all breakpoints "); 
  snprintf( chExpectedText, elCount(chExpectedText), "Breakpoints deleted"); 
  TestStepAddActionExpected( chActionText, chExpectedText );
  A_DBGR_BreakpointDeleteAll();
  /***************************************************************************************************************/    
  	                            // Test Step 6 Set a breakpoint after the line"v_sigVal_u32 = GetHWIO_g_CalcCRC_Sig();"
  /***************************************************************************************************************/
  snprintf( chActionText, elCount(chActionText), "Set Breakpoint in v_crcSts_u8 = GetHWIO_e_CalcCRC_St();"" inside Test_hwcrc_llsi "); 
  snprintf( chExpectedText, elCount(chExpectedText), "Verify Breakpoint is Set in v_crcSts_u8 = GetHWIO_e_CalcCRC_St();"" inside Test_hwcrc_llsi"); 
//  TestStepAddActionExpected( chActionText, chExpectedText );  
  A_DBGR_BreakpointSet("Test_hwcrc_llsi\\341");  

  A_DBGR_Go();
  
  snprintf( chActionText, elCount(chActionText), "Verify Breakpoint should hit in v_crcSts_u8 = GetHWIO_e_CalcCRC_St(); "); 
  snprintf( chExpectedText, elCount(chExpectedText), "Breakpoint hit in v_crcSts_u8 = GetHWIO_e_CalcCRC_St(); function"); 
  E_DBGR_BreakpointCheckForHalt("Test_hwcrc_llsi\\341");
  while(1)
  {
  if(cnt == 0)
  {
  snprintf( chActionText, elCount(chActionText), "Verify v_coreId_u8 is 5 "); 
  snprintf( chExpectedText, elCount(chExpectedText), "Verify Verify v_coreId_u8 is 5"); 
  
  TestStepAddActionExpected( chActionText, chExpectedText );  
  }
  
  A_DBGR_VariableRead("v_coreId_u8",coreID);
  if(coreID == 5)
  {
    write("core ID is : %d",coreID);
    break;
  }
  if(cnt == 0)
  {
  snprintf( chActionText, elCount(chActionText), "Run debugger "); 
  snprintf( chExpectedText, elCount(chExpectedText), "Run debugger "); 
  }
  testWaitForTimeout(1000);
  A_DBGR_Go();
  cnt =cnt+1;
 
  }
  cnt =0;
  E_DBGR_VariableCheck("v_sigVal_u32",0,Equal);
  snprintf( chActionText, elCount(chActionText), "Delete all breakpoints "); 
  snprintf( chExpectedText, elCount(chExpectedText), "Breakpoints deleted"); 
  TestStepAddActionExpected( chActionText, chExpectedText );
  A_DBGR_BreakpointDeleteAll();
  /***************************************************************************************************************/    
  	                            // Test Step 7 Set a breakpoint at line"v_crcSts_u8 = GetHWIO_e_CalcCRC_St();"" inside Test_hwcrc_llsi"
  /***************************************************************************************************************/
  snprintf( chActionText, elCount(chActionText), "Set Breakpoint in v_crcSts_u8 = GetHWIO_e_CalcCRC_St();"" inside Test_hwcrc_llsi "); 
  snprintf( chExpectedText, elCount(chExpectedText), "Verify Breakpoint is Set in v_crcSts_u8 = GetHWIO_e_CalcCRC_St();"" inside Test_hwcrc_llsi"); 
//  TestStepAddActionExpected( chActionText, chExpectedText );  
  A_DBGR_BreakpointSet("Test_hwcrc_llsi\\352");  

  A_DBGR_Go();
  
  snprintf( chActionText, elCount(chActionText), "Verify Breakpoint should hit in v_crcSts_u8 = GetHWIO_e_CalcCRC_St(); "); 
  snprintf( chExpectedText, elCount(chExpectedText), "Breakpoint hit in v_crcSts_u8 = GetHWIO_e_CalcCRC_St(); function"); 
  E_DBGR_BreakpointCheckForHalt("Test_hwcrc_llsi\\352");
  while(1)
  {
  if(cnt == 0)
  {
  snprintf( chActionText, elCount(chActionText), "Verify v_coreId_u8 is 5 "); 
  snprintf( chExpectedText, elCount(chExpectedText), "Verify Verify v_coreId_u8 is 5"); 
  
  TestStepAddActionExpected( chActionText, chExpectedText );  
  }
  
  A_DBGR_VariableRead("v_coreId_u8",coreID);
  if(coreID == 5)
  {
    write("core ID is : %d",coreID);
    break;
  }
  if(cnt == 0)
  {
  snprintf( chActionText, elCount(chActionText), "Run debugger "); 
  snprintf( chExpectedText, elCount(chExpectedText), "Run debugger "); 
  }
  testWaitForTimeout(1000);
  A_DBGR_Go();
  cnt =cnt+1;
 
  }
  cnt =0;
  E_DBGR_VariableCheck("v_crcSts_u8",0,Equal);
}



testcase Verify_Hardware_CRC32_Calculation_Invalid_Start_Address_Failure_Reporting_Core_0()
{
  /***************************************************************************************************************/    
                                                // Variable Definition
  /***************************************************************************************************************/ 
  

  
  /***************************************************************************************************************/    
                                               // Local Values
  /***************************************************************************************************************/ 
  

  
  /***************************************************************************************************************/    
                                              // Test Case Info
  /***************************************************************************************************************/
  setWriteDbgLevel(DebugOff);
  snprintf( chTestTitle, elCount(chTestTitle), "Verify_Hardware_CRC32_Calculation_Invalid_Start_Address_Failure_Reporting_Core_0" );
  snprintf( chTestDescription, elCount(chTestDescription), "Purpose:To check the GetHWIO_e_CalcCRC_St(); interface  ");
  TestCaseAddInfo( chTestTitle, "TC_L30SW_Q-36925406", chTestDescription );

  /***************************************************************************************************************/    
                                              // Start of Test Case
  /***************************************************************************************************************/
  
  /***************************************************************************************************************/    
                                              // Test Step 0 PRECONDITIONS
  /***************************************************************************************************************/
  snprintf( chActionText, elCount(chActionText), "Flash the Software and ECU is running "); 
  snprintf( chExpectedText, elCount(chExpectedText), "Ecu is should be in running state"); 
  TestStepAddActionExpected( chActionText, chExpectedText );
  
  A_DBGR_BreakpointDeleteAll();
  A_DBGR_R();
  A_DBGR_Go(); 

  /***************************************************************************************************************/    
                                              // Test Step 1 Set breakpoint in line Test_hwcrc_llsi(); inside "TestApp_Core0_10ms_MainFunction" function and inside testapp.c file
  /***************************************************************************************************************/
  snprintf( chActionText, elCount(chActionText), "Set Breakpoint in Test_hwcrc_llsi(); "); 
  snprintf( chExpectedText, elCount(chExpectedText), "Verify Breakpoint is Set in Test_hwcrc_llsi();"); 
  //TestStepAddActionExpected( chActionText, chExpectedText );  
  A_DBGR_BreakpointSet("TestApp_Core0_10ms_MainFunction\\45");  

  A_DBGR_Go();
  
  snprintf( chActionText, elCount(chActionText), "Verify Breakpoint should hit in Test_hwcrc_llsi(); "); 
  snprintf( chExpectedText, elCount(chExpectedText), "Breakpoint hit in Test_hwcrc_llsi(); function"); 
  E_DBGR_BreakpointCheckForHalt("TestApp_Core0_10ms_MainFunction\\45");
  
  snprintf( chActionText, elCount(chActionText), "Delete all breakpoints "); 
  snprintf( chExpectedText, elCount(chExpectedText), "Breakpoints deleted"); 
  TestStepAddActionExpected( chActionText, chExpectedText );
  
  A_DBGR_BreakpointDeleteAll();
  
   
  /***************************************************************************************************************/    
  	                            // Test Step 2 Set a breakpoint at "v_coreId_u8 = (BYTE)GetCoreID();" inside "Test_hwcrc_llsi" function
  /***************************************************************************************************************/
  
  snprintf( chActionText, elCount(chActionText), "Set Breakpoint in v_coreId_u8 = (BYTE)GetCoreID(); "); 
  snprintf( chExpectedText, elCount(chExpectedText), "Verify Breakpoint is Set in v_coreId_u8 = (BYTE)GetCoreID();"); 
  //TestStepAddActionExpected( chActionText, chExpectedText );  
  A_DBGR_BreakpointSet("Test_hwcrc_llsi\\352");  

  A_DBGR_Go();
  
  snprintf( chActionText, elCount(chActionText), "Verify Breakpoint should hit in v_coreId_u8 = (BYTE)GetCoreID(); "); 
  snprintf( chExpectedText, elCount(chExpectedText), "Breakpoint hit in v_coreId_u8 = (BYTE)GetCoreID(); function"); 
  E_DBGR_BreakpointCheckForHalt("Test_hwcrc_llsi\\352");
  
  /***************************************************************************************************************/    
  	                            // Test Step 3 Verify v_coreId_u8 in trace32 watch window
  /***************************************************************************************************************/
  
   while(1)
  {
  if(cnt == 0)
  {
  snprintf( chActionText, elCount(chActionText), "Verify v_coreId_u8 is 0 "); 
  snprintf( chExpectedText, elCount(chExpectedText), "Verify Verify v_coreId_u8 is 0"); 
  
  TestStepAddActionExpected( chActionText, chExpectedText );  
  }
  
  A_DBGR_VariableRead("v_coreId_u8",coreID);
  if(coreID == 0)
  {
    break;
  }
  if(cnt == 0)
  {
  snprintf( chActionText, elCount(chActionText), "Run debugger "); 
  snprintf( chExpectedText, elCount(chExpectedText), "Run debugger "); 
  }
  A_DBGR_Go();
  testWaitForTimeout(2000);
  cnt =cnt+1;
  }
  E_DBGR_VariableCheck("v_crcSts_u8",0,Equal);
  cnt =0;
  snprintf( chActionText, elCount(chActionText), "delete all breakpoints "); 
  snprintf( chExpectedText, elCount(chExpectedText), "delete all breakpoints "); 
  TestStepAddActionExpected( chActionText, chExpectedText );
  A_DBGR_BreakpointDeleteAll();
  /***************************************************************************************************************/    
  	                            // Test Step 4 Set a breakpoint at line"PerfmHWIO_h_CalcCRC ((BYTE)test_HwCrc_CRC32_ethernet_E, v_seed_u32, v_startAddr_u8, v_endAddr_u8);"
  /***************************************************************************************************************/
  snprintf( chActionText, elCount(chActionText), "Set Breakpoint inPerfmHWIO_h_CalcCRC ((BYTE)test_HwCrc_CRC32_ethernet_E, v_seed_u32, v_startAddr_u8, v_endAddr_u8); "); 
  snprintf( chExpectedText, elCount(chExpectedText), "Verify Breakpoint is Set in PerfmHWIO_h_CalcCRC ((BYTE)test_HwCrc_CRC32_ethernet_E, v_seed_u32, v_startAddr_u8, v_endAddr_u8);"); 
  //TestStepAddActionExpected( chActionText, chExpectedText );  
  A_DBGR_BreakpointSet("Test_hwcrc_llsi\\367");  

  A_DBGR_Go();
  
  snprintf( chActionText, elCount(chActionText), "Verify Breakpoint should hit in v_crcSts_u8 = GetHWIO_e_CalcCRC_St(); "); 
  snprintf( chExpectedText, elCount(chExpectedText), "Breakpoint hit in v_crcSts_u8 = GetHWIO_e_CalcCRC_St(); function"); 
  E_DBGR_BreakpointCheckForHalt("Test_hwcrc_llsi\\367");
  
  while(1)
  {
  if(cnt == 0)
  {
  snprintf( chActionText, elCount(chActionText), "Verify v_coreId_u8 is 0 "); 
  snprintf( chExpectedText, elCount(chExpectedText), "Verify Verify v_coreId_u8 is 0"); 
  
  TestStepAddActionExpected( chActionText, chExpectedText );  
  }
  
  A_DBGR_VariableRead("v_coreId_u8",coreID);
  if(coreID == 0)
  {
    write("core ID is : %d",coreID);
    break;
  }
  if(cnt == 0)
  {
  snprintf( chActionText, elCount(chActionText), "Run debugger "); 
  snprintf( chExpectedText, elCount(chExpectedText), "Run debugger "); 
  }
  testWaitForTimeout(1000);
  A_DBGR_Go();
  cnt =cnt+1;
 
  }
  cnt =0;
  A_DBGR_BreakpointDeleteAll();
  
   /***************************************************************************************************************/    
  	                            // Test Step 5 Set a breakpoint at line"v_crcSts_u8 = GetHWIO_e_CalcCRC_St();"" inside Test_hwcrc_llsi"
  /***************************************************************************************************************/
  snprintf( chActionText, elCount(chActionText), "Set Breakpoint in v_crcSts_u8 = GetHWIO_e_CalcCRC_St();"" inside Test_hwcrc_llsi "); 
  snprintf( chExpectedText, elCount(chExpectedText), "Verify Breakpoint is Set in v_crcSts_u8 = GetHWIO_e_CalcCRC_St();"" inside Test_hwcrc_llsi"); 
//  TestStepAddActionExpected( chActionText, chExpectedText );  
  A_DBGR_BreakpointSet("Test_hwcrc_llsi\\369");  

  A_DBGR_Go();
  
  snprintf( chActionText, elCount(chActionText), "Verify Breakpoint should hit in v_crcSts_u8 = GetHWIO_e_CalcCRC_St(); "); 
  snprintf( chExpectedText, elCount(chExpectedText), "Breakpoint hit in v_crcSts_u8 = GetHWIO_e_CalcCRC_St(); function"); 
  E_DBGR_BreakpointCheckForHalt("Test_hwcrc_llsi\\369");
  while(1)
  {
  if(cnt == 0)
  {
  snprintf( chActionText, elCount(chActionText), "Verify v_coreId_u8 is 0 "); 
  snprintf( chExpectedText, elCount(chExpectedText), "Verify Verify v_coreId_u8 is 0"); 
  
  TestStepAddActionExpected( chActionText, chExpectedText );  
  }
  
  A_DBGR_VariableRead("v_coreId_u8",coreID);
  if(coreID == 0)
  {
    write("core ID is : %d",coreID);
    break;
  }
  if(cnt == 0)
  {
  snprintf( chActionText, elCount(chActionText), "Run debugger "); 
  snprintf( chExpectedText, elCount(chExpectedText), "Run debugger "); 
  }
  testWaitForTimeout(1000);
  A_DBGR_Go();
  cnt =cnt+1;
 
  }
  cnt =0;
  E_DBGR_VariableCheck("v_crcSts_u8",3,Equal);
  
  snprintf( chActionText, elCount(chActionText), "Delete all breakpoints "); 
  snprintf( chExpectedText, elCount(chExpectedText), "Breakpoints deleted"); 
  TestStepAddActionExpected( chActionText, chExpectedText );
  A_DBGR_BreakpointDeleteAll();
  /***************************************************************************************************************/    
  	                            // Test Step 6 Set a breakpoint after the line"v_sigVal_u32 = GetHWIO_g_CalcCRC_Sig();"
  /***************************************************************************************************************/
  snprintf( chActionText, elCount(chActionText), "Set Breakpoint in v_crcSts_u8 = GetHWIO_e_CalcCRC_St();"" inside Test_hwcrc_llsi "); 
  snprintf( chExpectedText, elCount(chExpectedText), "Verify Breakpoint is Set in v_crcSts_u8 = GetHWIO_e_CalcCRC_St();"" inside Test_hwcrc_llsi"); 
//  TestStepAddActionExpected( chActionText, chExpectedText );  
  A_DBGR_BreakpointSet("Test_hwcrc_llsi\\381");  

  A_DBGR_Go();
  
  snprintf( chActionText, elCount(chActionText), "Verify Breakpoint should hit in v_crcSts_u8 = GetHWIO_e_CalcCRC_St(); "); 
  snprintf( chExpectedText, elCount(chExpectedText), "Breakpoint hit in v_crcSts_u8 = GetHWIO_e_CalcCRC_St(); function"); 
  E_DBGR_BreakpointCheckForHalt("Test_hwcrc_llsi\\381");
  while(1)
  {
  if(cnt == 0)
  {
  snprintf( chActionText, elCount(chActionText), "Verify v_coreId_u8 is 0 "); 
  snprintf( chExpectedText, elCount(chExpectedText), "Verify Verify v_coreId_u8 is 0"); 
  
  TestStepAddActionExpected( chActionText, chExpectedText );  
  }
  
  A_DBGR_VariableRead("v_coreId_u8",coreID);
  if(coreID == 0)
  {
    write("core ID is : %d",coreID);
    break;
  }
  if(cnt == 0)
  {
  snprintf( chActionText, elCount(chActionText), "Run debugger "); 
  snprintf( chExpectedText, elCount(chExpectedText), "Run debugger "); 
  }
  testWaitForTimeout(1000);
  A_DBGR_Go();
  cnt =cnt+1;
 
  }
  cnt =0;
  E_DBGR_VariableCheck("v_sigVal_u32",0,Equal);
  snprintf( chActionText, elCount(chActionText), "Delete all breakpoints "); 
  snprintf( chExpectedText, elCount(chExpectedText), "Breakpoints deleted"); 
  TestStepAddActionExpected( chActionText, chExpectedText );
  A_DBGR_BreakpointDeleteAll();
  /***************************************************************************************************************/    
  	                            // Test Step 7 Set a breakpoint at line"v_crcSts_u8 = GetHWIO_e_CalcCRC_St();"" inside Test_hwcrc_llsi"
  /***************************************************************************************************************/
  snprintf( chActionText, elCount(chActionText), "Set Breakpoint in v_crcSts_u8 = GetHWIO_e_CalcCRC_St();"" inside Test_hwcrc_llsi "); 
  snprintf( chExpectedText, elCount(chExpectedText), "Verify Breakpoint is Set in v_crcSts_u8 = GetHWIO_e_CalcCRC_St();"" inside Test_hwcrc_llsi"); 
//  TestStepAddActionExpected( chActionText, chExpectedText );  
  A_DBGR_BreakpointSet("Test_hwcrc_llsi\\392");  

  A_DBGR_Go();
  
  snprintf( chActionText, elCount(chActionText), "Verify Breakpoint should hit in v_crcSts_u8 = GetHWIO_e_CalcCRC_St(); "); 
  snprintf( chExpectedText, elCount(chExpectedText), "Breakpoint hit in v_crcSts_u8 = GetHWIO_e_CalcCRC_St(); function"); 
  E_DBGR_BreakpointCheckForHalt("Test_hwcrc_llsi\\392");
  while(1)
  {
  if(cnt == 0)
  {
  snprintf( chActionText, elCount(chActionText), "Verify v_coreId_u8 is 0 "); 
  snprintf( chExpectedText, elCount(chExpectedText), "Verify Verify v_coreId_u8 is 0"); 
  
  TestStepAddActionExpected( chActionText, chExpectedText );  
  }
  
  A_DBGR_VariableRead("v_coreId_u8",coreID);
  if(coreID == 0)
  {
    write("core ID is : %d",coreID);
    break;
  }
  if(cnt == 0)
  {
  snprintf( chActionText, elCount(chActionText), "Run debugger "); 
  snprintf( chExpectedText, elCount(chExpectedText), "Run debugger "); 
  }
  testWaitForTimeout(1000);
  A_DBGR_Go();
  cnt =cnt+1;
 
  }
  cnt =0;
  E_DBGR_VariableCheck("v_crcSts_u8",0,Equal);
}

testcase Verify_Hardware_CRC32_Calculation_Invalid_Start_Address_Failure_Reporting_Core_1()
{
   /***************************************************************************************************************/    
                                                // Variable Definition
  /***************************************************************************************************************/ 
  

  
  /***************************************************************************************************************/    
                                               // Local Values
  /***************************************************************************************************************/ 
  

  
  /***************************************************************************************************************/    
                                              // Test Case Info
  /***************************************************************************************************************/
  setWriteDbgLevel(DebugOff);
  snprintf( chTestTitle, elCount(chTestTitle), "Verify_Hardware_CRC32_Calculation_Invalid_Start_Address_Failure_Reporting_Core_1" );
  snprintf( chTestDescription, elCount(chTestDescription), "Purpose:To check the GetHWIO_e_CalcCRC_St(); interface  ");
  TestCaseAddInfo( chTestTitle, "TC_L30SW_Q-37079841", chTestDescription );

  /***************************************************************************************************************/    
                                              // Start of Test Case
  /***************************************************************************************************************/
  
  /***************************************************************************************************************/    
                                              // Test Step 0 PRECONDITIONS
  /***************************************************************************************************************/
  snprintf( chActionText, elCount(chActionText), "Flash the Software and ECU is running "); 
  snprintf( chExpectedText, elCount(chExpectedText), "Ecu is should be in running state"); 
  TestStepAddActionExpected( chActionText, chExpectedText );
  
  A_DBGR_BreakpointDeleteAll();
  A_DBGR_R();
  A_DBGR_Go(); 

  /***************************************************************************************************************/    
                                              // Test Step 1 Set breakpoint in line Test_hwcrc_llsi(); inside "TestApp_Core0_10ms_MainFunction" function and inside testapp.c file
  /***************************************************************************************************************/
  snprintf( chActionText, elCount(chActionText), "Set Breakpoint in Test_hwcrc_llsi(); "); 
  snprintf( chExpectedText, elCount(chExpectedText), "Verify Breakpoint is Set in Test_hwcrc_llsi();"); 
  //TestStepAddActionExpected( chActionText, chExpectedText );  
  A_DBGR_BreakpointSet("TestApp_Core0_10ms_MainFunction\\45");  

  A_DBGR_Go();
  
  snprintf( chActionText, elCount(chActionText), "Verify Breakpoint should hit in Test_hwcrc_llsi(); "); 
  snprintf( chExpectedText, elCount(chExpectedText), "Breakpoint hit in Test_hwcrc_llsi(); function"); 
  E_DBGR_BreakpointCheckForHalt("TestApp_Core0_10ms_MainFunction\\45");
  
  snprintf( chActionText, elCount(chActionText), "Delete all breakpoints "); 
  snprintf( chExpectedText, elCount(chExpectedText), "Breakpoints deleted"); 
  TestStepAddActionExpected( chActionText, chExpectedText );
  
  A_DBGR_BreakpointDeleteAll();
  
   
  /***************************************************************************************************************/    
  	                            // Test Step 2 Set a breakpoint at "v_coreId_u8 = (BYTE)GetCoreID();" inside "Test_hwcrc_llsi" function
  /***************************************************************************************************************/
  
  snprintf( chActionText, elCount(chActionText), "Set Breakpoint in v_coreId_u8 = (BYTE)GetCoreID(); "); 
  snprintf( chExpectedText, elCount(chExpectedText), "Verify Breakpoint is Set in v_coreId_u8 = (BYTE)GetCoreID();"); 
  //TestStepAddActionExpected( chActionText, chExpectedText );  
  A_DBGR_BreakpointSet("Test_hwcrc_llsi\\352");  

  A_DBGR_Go();
  
  snprintf( chActionText, elCount(chActionText), "Verify Breakpoint should hit in v_coreId_u8 = (BYTE)GetCoreID(); "); 
  snprintf( chExpectedText, elCount(chExpectedText), "Breakpoint hit in v_coreId_u8 = (BYTE)GetCoreID(); function"); 
  E_DBGR_BreakpointCheckForHalt("Test_hwcrc_llsi\\352");
  
  /***************************************************************************************************************/    
  	                            // Test Step 3 Verify v_coreId_u8 in trace32 watch window
  /***************************************************************************************************************/
  
   while(1)
  {
  if(cnt == 0)
  {
  snprintf( chActionText, elCount(chActionText), "Verify v_coreId_u8 is 1 "); 
  snprintf( chExpectedText, elCount(chExpectedText), "Verify Verify v_coreId_u8 is 1"); 
  
  TestStepAddActionExpected( chActionText, chExpectedText );  
  }
  
  A_DBGR_VariableRead("v_coreId_u8",coreID);
  if(coreID == 1)
  {
    break;
  }
  if(cnt == 0)
  {
  snprintf( chActionText, elCount(chActionText), "Run debugger "); 
  snprintf( chExpectedText, elCount(chExpectedText), "Run debugger "); 
  }
  A_DBGR_Go();
  testWaitForTimeout(2000);
  cnt =cnt+1;
  }
  E_DBGR_VariableCheck("v_crcSts_u8",0,Equal);
  cnt =0;
  snprintf( chActionText, elCount(chActionText), "delete all breakpoints "); 
  snprintf( chExpectedText, elCount(chExpectedText), "delete all breakpoints "); 
  TestStepAddActionExpected( chActionText, chExpectedText );
  A_DBGR_BreakpointDeleteAll();
  /***************************************************************************************************************/    
  	                            // Test Step 4 Set a breakpoint at line"PerfmHWIO_h_CalcCRC ((BYTE)test_HwCrc_CRC32_ethernet_E, v_seed_u32, v_startAddr_u8, v_endAddr_u8);"
  /***************************************************************************************************************/
  snprintf( chActionText, elCount(chActionText), "Set Breakpoint inPerfmHWIO_h_CalcCRC ((BYTE)test_HwCrc_CRC32_ethernet_E, v_seed_u32, v_startAddr_u8, v_endAddr_u8); "); 
  snprintf( chExpectedText, elCount(chExpectedText), "Verify Breakpoint is Set in PerfmHWIO_h_CalcCRC ((BYTE)test_HwCrc_CRC32_ethernet_E, v_seed_u32, v_startAddr_u8, v_endAddr_u8);"); 
  //TestStepAddActionExpected( chActionText, chExpectedText );  
  A_DBGR_BreakpointSet("Test_hwcrc_llsi\\367");  

  A_DBGR_Go();
  
  snprintf( chActionText, elCount(chActionText), "Verify Breakpoint should hit in v_crcSts_u8 = GetHWIO_e_CalcCRC_St(); "); 
  snprintf( chExpectedText, elCount(chExpectedText), "Breakpoint hit in v_crcSts_u8 = GetHWIO_e_CalcCRC_St(); function"); 
  E_DBGR_BreakpointCheckForHalt("Test_hwcrc_llsi\\367");
  
  while(1)
  {
  if(cnt == 0)
  {
  snprintf( chActionText, elCount(chActionText), "Verify v_coreId_u8 is 1 "); 
  snprintf( chExpectedText, elCount(chExpectedText), "Verify Verify v_coreId_u8 is 1"); 
  
  TestStepAddActionExpected( chActionText, chExpectedText );  
  }
  
  A_DBGR_VariableRead("v_coreId_u8",coreID);
  if(coreID == 1)
  {
    write("core ID is : %d",coreID);
    break;
  }
  if(cnt == 0)
  {
  snprintf( chActionText, elCount(chActionText), "Run debugger "); 
  snprintf( chExpectedText, elCount(chExpectedText), "Run debugger "); 
  }
  testWaitForTimeout(1000);
  A_DBGR_Go();
  cnt =cnt+1;
 
  }
  cnt =0;
  A_DBGR_BreakpointDeleteAll();
  
   /***************************************************************************************************************/    
  	                            // Test Step 5 Set a breakpoint at line"v_crcSts_u8 = GetHWIO_e_CalcCRC_St();"" inside Test_hwcrc_llsi"
  /***************************************************************************************************************/
  snprintf( chActionText, elCount(chActionText), "Set Breakpoint in v_crcSts_u8 = GetHWIO_e_CalcCRC_St();"" inside Test_hwcrc_llsi "); 
  snprintf( chExpectedText, elCount(chExpectedText), "Verify Breakpoint is Set in v_crcSts_u8 = GetHWIO_e_CalcCRC_St();"" inside Test_hwcrc_llsi"); 
//  TestStepAddActionExpected( chActionText, chExpectedText );  
  A_DBGR_BreakpointSet("Test_hwcrc_llsi\\369");  

  A_DBGR_Go();
  
  snprintf( chActionText, elCount(chActionText), "Verify Breakpoint should hit in v_crcSts_u8 = GetHWIO_e_CalcCRC_St(); "); 
  snprintf( chExpectedText, elCount(chExpectedText), "Breakpoint hit in v_crcSts_u8 = GetHWIO_e_CalcCRC_St(); function"); 
  E_DBGR_BreakpointCheckForHalt("Test_hwcrc_llsi\\369");
  while(1)
  {
  if(cnt == 0)
  {
  snprintf( chActionText, elCount(chActionText), "Verify v_coreId_u8 is 1 "); 
  snprintf( chExpectedText, elCount(chExpectedText), "Verify Verify v_coreId_u8 is 1"); 
  
  TestStepAddActionExpected( chActionText, chExpectedText );  
  }
  
  A_DBGR_VariableRead("v_coreId_u8",coreID);
  if(coreID == 1)
  {
    write("core ID is : %d",coreID);
    break;
  }
  if(cnt == 0)
  {
  snprintf( chActionText, elCount(chActionText), "Run debugger "); 
  snprintf( chExpectedText, elCount(chExpectedText), "Run debugger "); 
  }
  testWaitForTimeout(1000);
  A_DBGR_Go();
  cnt =cnt+1;
 
  }
  cnt =0;
  E_DBGR_VariableCheck("v_crcSts_u8",3,Equal);
  
  snprintf( chActionText, elCount(chActionText), "Delete all breakpoints "); 
  snprintf( chExpectedText, elCount(chExpectedText), "Breakpoints deleted"); 
  TestStepAddActionExpected( chActionText, chExpectedText );
  A_DBGR_BreakpointDeleteAll();
  /***************************************************************************************************************/    
  	                            // Test Step 6 Set a breakpoint after the line"v_sigVal_u32 = GetHWIO_g_CalcCRC_Sig();"
  /***************************************************************************************************************/
  snprintf( chActionText, elCount(chActionText), "Set Breakpoint in v_crcSts_u8 = GetHWIO_e_CalcCRC_St();"" inside Test_hwcrc_llsi "); 
  snprintf( chExpectedText, elCount(chExpectedText), "Verify Breakpoint is Set in v_crcSts_u8 = GetHWIO_e_CalcCRC_St();"" inside Test_hwcrc_llsi"); 
//  TestStepAddActionExpected( chActionText, chExpectedText );  
  A_DBGR_BreakpointSet("Test_hwcrc_llsi\\381");  

  A_DBGR_Go();
  
  snprintf( chActionText, elCount(chActionText), "Verify Breakpoint should hit in v_crcSts_u8 = GetHWIO_e_CalcCRC_St(); "); 
  snprintf( chExpectedText, elCount(chExpectedText), "Breakpoint hit in v_crcSts_u8 = GetHWIO_e_CalcCRC_St(); function"); 
  E_DBGR_BreakpointCheckForHalt("Test_hwcrc_llsi\\381");
  while(1)
  {
  if(cnt == 0)
  {
  snprintf( chActionText, elCount(chActionText), "Verify v_coreId_u8 is 1 "); 
  snprintf( chExpectedText, elCount(chExpectedText), "Verify Verify v_coreId_u8 is 1"); 
  
  TestStepAddActionExpected( chActionText, chExpectedText );  
  }
  
  A_DBGR_VariableRead("v_coreId_u8",coreID);
  if(coreID == 1)
  {
    write("core ID is : %d",coreID);
    break;
  }
  if(cnt == 0)
  {
  snprintf( chActionText, elCount(chActionText), "Run debugger "); 
  snprintf( chExpectedText, elCount(chExpectedText), "Run debugger "); 
  }
  testWaitForTimeout(1000);
  A_DBGR_Go();
  cnt =cnt+1;
 
  }
  cnt =0;
  E_DBGR_VariableCheck("v_sigVal_u32",0,Equal);
  snprintf( chActionText, elCount(chActionText), "Delete all breakpoints "); 
  snprintf( chExpectedText, elCount(chExpectedText), "Breakpoints deleted"); 
  TestStepAddActionExpected( chActionText, chExpectedText );
  A_DBGR_BreakpointDeleteAll();
  /***************************************************************************************************************/    
  	                            // Test Step 7 Set a breakpoint at line"v_crcSts_u8 = GetHWIO_e_CalcCRC_St();"" inside Test_hwcrc_llsi"
  /***************************************************************************************************************/
  snprintf( chActionText, elCount(chActionText), "Set Breakpoint in v_crcSts_u8 = GetHWIO_e_CalcCRC_St();"" inside Test_hwcrc_llsi "); 
  snprintf( chExpectedText, elCount(chExpectedText), "Verify Breakpoint is Set in v_crcSts_u8 = GetHWIO_e_CalcCRC_St();"" inside Test_hwcrc_llsi"); 
//  TestStepAddActionExpected( chActionText, chExpectedText );  
  A_DBGR_BreakpointSet("Test_hwcrc_llsi\\392");  

  A_DBGR_Go();
  
  snprintf( chActionText, elCount(chActionText), "Verify Breakpoint should hit in v_crcSts_u8 = GetHWIO_e_CalcCRC_St(); "); 
  snprintf( chExpectedText, elCount(chExpectedText), "Breakpoint hit in v_crcSts_u8 = GetHWIO_e_CalcCRC_St(); function"); 
  E_DBGR_BreakpointCheckForHalt("Test_hwcrc_llsi\\392");
  while(1)
  {
  if(cnt == 0)
  {
  snprintf( chActionText, elCount(chActionText), "Verify v_coreId_u8 is 1 "); 
  snprintf( chExpectedText, elCount(chExpectedText), "Verify Verify v_coreId_u8 is 1"); 
  
  TestStepAddActionExpected( chActionText, chExpectedText );  
  }
  
  A_DBGR_VariableRead("v_coreId_u8",coreID);
  if(coreID == 1)
  {
    write("core ID is : %d",coreID);
    break;
  }
  if(cnt == 0)
  {
  snprintf( chActionText, elCount(chActionText), "Run debugger "); 
  snprintf( chExpectedText, elCount(chExpectedText), "Run debugger "); 
  }
  testWaitForTimeout(1000);
  A_DBGR_Go();
  cnt =cnt+1;
 
  }
  cnt =0;
  E_DBGR_VariableCheck("v_crcSts_u8",0,Equal);
}

testcase Verify_Hardware_CRC32_Calculation_Invalid_Start_Address_Failure_Reporting_Core_2()
{
   /***************************************************************************************************************/    
                                                // Variable Definition
  /***************************************************************************************************************/ 
  

  
  /***************************************************************************************************************/    
                                               // Local Values
  /***************************************************************************************************************/ 
  

  
  /***************************************************************************************************************/    
                                              // Test Case Info
  /***************************************************************************************************************/
  setWriteDbgLevel(DebugOff);
  snprintf( chTestTitle, elCount(chTestTitle), "Verify_Hardware_CRC32_Calculation_Invalid_Start_Address_Failure_Reporting_Core_2" );
  snprintf( chTestDescription, elCount(chTestDescription), "Purpose:To check the GetHWIO_e_CalcCRC_St(); interface  ");
  TestCaseAddInfo( chTestTitle, "TC_L30SW_Q-37079847", chTestDescription );

  /***************************************************************************************************************/    
                                              // Start of Test Case
  /***************************************************************************************************************/
  
  /***************************************************************************************************************/    
                                              // Test Step 0 PRECONDITIONS
  /***************************************************************************************************************/
  snprintf( chActionText, elCount(chActionText), "Flash the Software and ECU is running "); 
  snprintf( chExpectedText, elCount(chExpectedText), "Ecu is should be in running state"); 
  TestStepAddActionExpected( chActionText, chExpectedText );
  
  A_DBGR_BreakpointDeleteAll();
  A_DBGR_R();
  A_DBGR_Go(); 

  /***************************************************************************************************************/    
                                              // Test Step 1 Set breakpoint in line Test_hwcrc_llsi(); inside "TestApp_Core2_10ms_MainFunction" function and inside testapp.c file
  /***************************************************************************************************************/
  snprintf( chActionText, elCount(chActionText), "Set Breakpoint in Test_hwcrc_llsi(); "); 
  snprintf( chExpectedText, elCount(chExpectedText), "Verify Breakpoint is Set in Test_hwcrc_llsi();"); 
  //TestStepAddActionExpected( chActionText, chExpectedText );  
  A_DBGR_BreakpointSet("TestApp_Core2_10ms_MainFunction\\36");  

  A_DBGR_Go();
  
  snprintf( chActionText, elCount(chActionText), "Verify Breakpoint should hit in Test_hwcrc_llsi(); "); 
  snprintf( chExpectedText, elCount(chExpectedText), "Breakpoint hit in Test_hwcrc_llsi(); function"); 
  E_DBGR_BreakpointCheckForHalt("TestApp_Core2_10ms_MainFunction\\36");
  
  snprintf( chActionText, elCount(chActionText), "Delete all breakpoints "); 
  snprintf( chExpectedText, elCount(chExpectedText), "Breakpoints deleted"); 
  TestStepAddActionExpected( chActionText, chExpectedText );
  
  A_DBGR_BreakpointDeleteAll();
  
  
   
  /***************************************************************************************************************/    
  	                            // Test Step 2 Set a breakpoint at "v_coreId_u8 = (BYTE)GetCoreID();" inside "Test_hwcrc_llsi" function
  /***************************************************************************************************************/
  
  snprintf( chActionText, elCount(chActionText), "Set Breakpoint in v_coreId_u8 = (BYTE)GetCoreID(); "); 
  snprintf( chExpectedText, elCount(chExpectedText), "Verify Breakpoint is Set in v_coreId_u8 = (BYTE)GetCoreID();"); 
  //TestStepAddActionExpected( chActionText, chExpectedText );  
  A_DBGR_BreakpointSet("Test_hwcrc_llsi\\352");  

  A_DBGR_Go();
  
  snprintf( chActionText, elCount(chActionText), "Verify Breakpoint should hit in v_coreId_u8 = (BYTE)GetCoreID(); "); 
  snprintf( chExpectedText, elCount(chExpectedText), "Breakpoint hit in v_coreId_u8 = (BYTE)GetCoreID(); function"); 
  E_DBGR_BreakpointCheckForHalt("Test_hwcrc_llsi\\352");
  
  /***************************************************************************************************************/    
  	                            // Test Step 3 Verify v_coreId_u8 in trace32 watch window
  /***************************************************************************************************************/
  
   while(1)
  {
  if(cnt == 0)
  {
  snprintf( chActionText, elCount(chActionText), "Verify v_coreId_u8 is 2 "); 
  snprintf( chExpectedText, elCount(chExpectedText), "Verify Verify v_coreId_u8 is 2"); 
  
  TestStepAddActionExpected( chActionText, chExpectedText );  
  }
  
  A_DBGR_VariableRead("v_coreId_u8",coreID);
  if(coreID == 2)
  {
    break;
  }
  if(cnt == 0)
  {
  snprintf( chActionText, elCount(chActionText), "Run debugger "); 
  snprintf( chExpectedText, elCount(chExpectedText), "Run debugger "); 
  }
  A_DBGR_Go();
  testWaitForTimeout(2000);
  cnt =cnt+1;
  }
  E_DBGR_VariableCheck("v_crcSts_u8",0,Equal);
  cnt =0;
  snprintf( chActionText, elCount(chActionText), "delete all breakpoints "); 
  snprintf( chExpectedText, elCount(chExpectedText), "delete all breakpoints "); 
  TestStepAddActionExpected( chActionText, chExpectedText );
  A_DBGR_BreakpointDeleteAll();
  /***************************************************************************************************************/    
  	                            // Test Step 4 Set a breakpoint at line"PerfmHWIO_h_CalcCRC ((BYTE)test_HwCrc_CRC32_ethernet_E, v_seed_u32, v_startAddr_u8, v_endAddr_u8);"
  /***************************************************************************************************************/
  snprintf( chActionText, elCount(chActionText), "Set Breakpoint inPerfmHWIO_h_CalcCRC ((BYTE)test_HwCrc_CRC32_ethernet_E, v_seed_u32, v_startAddr_u8, v_endAddr_u8); "); 
  snprintf( chExpectedText, elCount(chExpectedText), "Verify Breakpoint is Set in PerfmHWIO_h_CalcCRC ((BYTE)test_HwCrc_CRC32_ethernet_E, v_seed_u32, v_startAddr_u8, v_endAddr_u8);"); 
  //TestStepAddActionExpected( chActionText, chExpectedText );  
  A_DBGR_BreakpointSet("Test_hwcrc_llsi\\367");  

  A_DBGR_Go();
  
  snprintf( chActionText, elCount(chActionText), "Verify Breakpoint should hit in v_crcSts_u8 = GetHWIO_e_CalcCRC_St(); "); 
  snprintf( chExpectedText, elCount(chExpectedText), "Breakpoint hit in v_crcSts_u8 = GetHWIO_e_CalcCRC_St(); function"); 
  E_DBGR_BreakpointCheckForHalt("Test_hwcrc_llsi\\367");
  
  while(1)
  {
  if(cnt == 0)
  {
  snprintf( chActionText, elCount(chActionText), "Verify v_coreId_u8 is 2 "); 
  snprintf( chExpectedText, elCount(chExpectedText), "Verify Verify v_coreId_u8 is 2"); 
  
  TestStepAddActionExpected( chActionText, chExpectedText );  
  }
  
  A_DBGR_VariableRead("v_coreId_u8",coreID);
  if(coreID == 2)
  {
    write("core ID is : %d",coreID);
    break;
  }
  if(cnt == 0)
  {
  snprintf( chActionText, elCount(chActionText), "Run debugger "); 
  snprintf( chExpectedText, elCount(chExpectedText), "Run debugger "); 
  }
  testWaitForTimeout(1000);
  A_DBGR_Go();
  cnt =cnt+1;
 
  }
  cnt =0;
  A_DBGR_BreakpointDeleteAll();
  
   /***************************************************************************************************************/    
  	                            // Test Step 5 Set a breakpoint at line"v_crcSts_u8 = GetHWIO_e_CalcCRC_St();"" inside Test_hwcrc_llsi"
  /***************************************************************************************************************/
  snprintf( chActionText, elCount(chActionText), "Set Breakpoint in v_crcSts_u8 = GetHWIO_e_CalcCRC_St();"" inside Test_hwcrc_llsi "); 
  snprintf( chExpectedText, elCount(chExpectedText), "Verify Breakpoint is Set in v_crcSts_u8 = GetHWIO_e_CalcCRC_St();"" inside Test_hwcrc_llsi"); 
//  TestStepAddActionExpected( chActionText, chExpectedText );  
  A_DBGR_BreakpointSet("Test_hwcrc_llsi\\369");  

  A_DBGR_Go();
  
  snprintf( chActionText, elCount(chActionText), "Verify Breakpoint should hit in v_crcSts_u8 = GetHWIO_e_CalcCRC_St(); "); 
  snprintf( chExpectedText, elCount(chExpectedText), "Breakpoint hit in v_crcSts_u8 = GetHWIO_e_CalcCRC_St(); function"); 
  E_DBGR_BreakpointCheckForHalt("Test_hwcrc_llsi\\369");
  while(1)
  {
  if(cnt == 0)
  {
  snprintf( chActionText, elCount(chActionText), "Verify v_coreId_u8 is 2 "); 
  snprintf( chExpectedText, elCount(chExpectedText), "Verify Verify v_coreId_u8 is 2"); 
  
  TestStepAddActionExpected( chActionText, chExpectedText );  
  }
  
  A_DBGR_VariableRead("v_coreId_u8",coreID);
  if(coreID == 2)
  {
    write("core ID is : %d",coreID);
    break;
  }
  if(cnt == 0)
  {
  snprintf( chActionText, elCount(chActionText), "Run debugger "); 
  snprintf( chExpectedText, elCount(chExpectedText), "Run debugger "); 
  }
  testWaitForTimeout(1000);
  A_DBGR_Go();
  cnt =cnt+1;
 
  }
  cnt =0;
  E_DBGR_VariableCheck("v_crcSts_u8",3,Equal);
  
  snprintf( chActionText, elCount(chActionText), "Delete all breakpoints "); 
  snprintf( chExpectedText, elCount(chExpectedText), "Breakpoints deleted"); 
  TestStepAddActionExpected( chActionText, chExpectedText );
  A_DBGR_BreakpointDeleteAll();
  /***************************************************************************************************************/    
  	                            // Test Step 6 Set a breakpoint after the line"v_sigVal_u32 = GetHWIO_g_CalcCRC_Sig();"
  /***************************************************************************************************************/
  snprintf( chActionText, elCount(chActionText), "Set Breakpoint in v_crcSts_u8 = GetHWIO_e_CalcCRC_St();"" inside Test_hwcrc_llsi "); 
  snprintf( chExpectedText, elCount(chExpectedText), "Verify Breakpoint is Set in v_crcSts_u8 = GetHWIO_e_CalcCRC_St();"" inside Test_hwcrc_llsi"); 
//  TestStepAddActionExpected( chActionText, chExpectedText );  
  A_DBGR_BreakpointSet("Test_hwcrc_llsi\\381");  

  A_DBGR_Go();
  
  snprintf( chActionText, elCount(chActionText), "Verify Breakpoint should hit in v_crcSts_u8 = GetHWIO_e_CalcCRC_St(); "); 
  snprintf( chExpectedText, elCount(chExpectedText), "Breakpoint hit in v_crcSts_u8 = GetHWIO_e_CalcCRC_St(); function"); 
  E_DBGR_BreakpointCheckForHalt("Test_hwcrc_llsi\\381");
  while(1)
  {
  if(cnt == 0)
  {
  snprintf( chActionText, elCount(chActionText), "Verify v_coreId_u8 is 2 "); 
  snprintf( chExpectedText, elCount(chExpectedText), "Verify Verify v_coreId_u8 is 2"); 
  
  TestStepAddActionExpected( chActionText, chExpectedText );  
  }
  
  A_DBGR_VariableRead("v_coreId_u8",coreID);
  if(coreID == 2)
  {
    write("core ID is : %d",coreID);
    break;
  }
  if(cnt == 0)
  {
  snprintf( chActionText, elCount(chActionText), "Run debugger "); 
  snprintf( chExpectedText, elCount(chExpectedText), "Run debugger "); 
  }
  testWaitForTimeout(1000);
  A_DBGR_Go();
  cnt =cnt+1;
 
  }
  cnt =0;
  E_DBGR_VariableCheck("v_sigVal_u32",0,Equal);
  snprintf( chActionText, elCount(chActionText), "Delete all breakpoints "); 
  snprintf( chExpectedText, elCount(chExpectedText), "Breakpoints deleted"); 
  TestStepAddActionExpected( chActionText, chExpectedText );
  A_DBGR_BreakpointDeleteAll();
  /***************************************************************************************************************/    
  	                            // Test Step 7 Set a breakpoint at line"v_crcSts_u8 = GetHWIO_e_CalcCRC_St();"" inside Test_hwcrc_llsi"
  /***************************************************************************************************************/
  snprintf( chActionText, elCount(chActionText), "Set Breakpoint in v_crcSts_u8 = GetHWIO_e_CalcCRC_St();"" inside Test_hwcrc_llsi "); 
  snprintf( chExpectedText, elCount(chExpectedText), "Verify Breakpoint is Set in v_crcSts_u8 = GetHWIO_e_CalcCRC_St();"" inside Test_hwcrc_llsi"); 
//  TestStepAddActionExpected( chActionText, chExpectedText );  
  A_DBGR_BreakpointSet("Test_hwcrc_llsi\\392");  

  A_DBGR_Go();
  
  snprintf( chActionText, elCount(chActionText), "Verify Breakpoint should hit in v_crcSts_u8 = GetHWIO_e_CalcCRC_St(); "); 
  snprintf( chExpectedText, elCount(chExpectedText), "Breakpoint hit in v_crcSts_u8 = GetHWIO_e_CalcCRC_St(); function"); 
  E_DBGR_BreakpointCheckForHalt("Test_hwcrc_llsi\\392");
  while(1)
  {
  if(cnt == 0)
  {
  snprintf( chActionText, elCount(chActionText), "Verify v_coreId_u8 is 2 "); 
  snprintf( chExpectedText, elCount(chExpectedText), "Verify Verify v_coreId_u8 is 2"); 
  
  TestStepAddActionExpected( chActionText, chExpectedText );  
  }
  
  A_DBGR_VariableRead("v_coreId_u8",coreID);
  if(coreID == 2)
  {
    write("core ID is : %d",coreID);
    break;
  }
  if(cnt == 0)
  {
  snprintf( chActionText, elCount(chActionText), "Run debugger "); 
  snprintf( chExpectedText, elCount(chExpectedText), "Run debugger "); 
  }
  testWaitForTimeout(1000);
  A_DBGR_Go();
  cnt =cnt+1;
 
  }
  cnt =0;
  E_DBGR_VariableCheck("v_crcSts_u8",0,Equal);
}

testcase Verify_Hardware_CRC32_Calculation_Invalid_Start_Address_Failure_Reporting_Core_3()
{
   /***************************************************************************************************************/    
                                                // Variable Definition
  /***************************************************************************************************************/ 
  

  
  /***************************************************************************************************************/    
                                               // Local Values
  /***************************************************************************************************************/ 
  

  
  /***************************************************************************************************************/    
                                              // Test Case Info
  /***************************************************************************************************************/
  setWriteDbgLevel(DebugOff);
  snprintf( chTestTitle, elCount(chTestTitle), "Verify_Hardware_CRC32_Calculation_Invalid_Start_Address_Failure_Reporting_Core_3" );
  snprintf( chTestDescription, elCount(chTestDescription), "Purpose:To check the GetHWIO_e_CalcCRC_St(); interface  ");
  TestCaseAddInfo( chTestTitle, "TC_L30SW_Q-37079852", chTestDescription );

  /***************************************************************************************************************/    
                                              // Start of Test Case
  /***************************************************************************************************************/
  
  /***************************************************************************************************************/    
                                              // Test Step 0 PRECONDITIONS
  /***************************************************************************************************************/
  snprintf( chActionText, elCount(chActionText), "Flash the Software and ECU is running "); 
  snprintf( chExpectedText, elCount(chExpectedText), "Ecu is should be in running state"); 
  TestStepAddActionExpected( chActionText, chExpectedText );
  
  A_DBGR_BreakpointDeleteAll();
  A_DBGR_R();
  A_DBGR_Go();

  /***************************************************************************************************************/    
                                              // Test Step 1 Set breakpoint in line Test_hwcrc_llsi(); inside "TestApp_Core3_10ms_MainFunction" function and inside testapp.c file
  /***************************************************************************************************************/
  snprintf( chActionText, elCount(chActionText), "Set Breakpoint in Test_hwcrc_llsi(); "); 
  snprintf( chExpectedText, elCount(chExpectedText), "Verify Breakpoint is Set in Test_hwcrc_llsi();"); 
  //TestStepAddActionExpected( chActionText, chExpectedText );  
  A_DBGR_BreakpointSet("TestApp_Core3_10ms_MainFunction\\35");  

  A_DBGR_Go();
  
  snprintf( chActionText, elCount(chActionText), "Verify Breakpoint should hit in Test_hwcrc_llsi(); "); 
  snprintf( chExpectedText, elCount(chExpectedText), "Breakpoint hit in Test_hwcrc_llsi(); function"); 
  E_DBGR_BreakpointCheckForHalt("TestApp_Core3_10ms_MainFunction\\35");
  
  testWaitForTimeout(2000);
  
  snprintf( chActionText, elCount(chActionText), "Delete all breakpoints "); 
  snprintf( chExpectedText, elCount(chExpectedText), "Breakpoints deleted"); 
  TestStepAddActionExpected( chActionText, chExpectedText );
  
  A_DBGR_BreakpointDeleteAll();
   
  /***************************************************************************************************************/    
  	                            // Test Step 2 Set a breakpoint at "v_coreId_u8 = (BYTE)GetCoreID();" inside "Test_hwcrc_llsi" function
  /***************************************************************************************************************/
  
  snprintf( chActionText, elCount(chActionText), "Set Breakpoint in v_coreId_u8 = (BYTE)GetCoreID(); "); 
  snprintf( chExpectedText, elCount(chExpectedText), "Verify Breakpoint is Set in v_coreId_u8 = (BYTE)GetCoreID();"); 
  //TestStepAddActionExpected( chActionText, chExpectedText );  
  A_DBGR_BreakpointSet("Test_hwcrc_llsi\\352");  

  A_DBGR_Go();
  
  snprintf( chActionText, elCount(chActionText), "Verify Breakpoint should hit in v_coreId_u8 = (BYTE)GetCoreID(); "); 
  snprintf( chExpectedText, elCount(chExpectedText), "Breakpoint hit in v_coreId_u8 = (BYTE)GetCoreID(); function"); 
  E_DBGR_BreakpointCheckForHalt("Test_hwcrc_llsi\\352");
  
  /***************************************************************************************************************/    
  	                            // Test Step 3 Verify v_coreId_u8 in trace32 watch window
  /***************************************************************************************************************/
  
   while(1)
  {
  if(cnt == 0)
  {
  snprintf( chActionText, elCount(chActionText), "Verify v_coreId_u8 is 3 "); 
  snprintf( chExpectedText, elCount(chExpectedText), "Verify Verify v_coreId_u8 is 3"); 
  
  TestStepAddActionExpected( chActionText, chExpectedText );  
  }
  
  A_DBGR_VariableRead("v_coreId_u8",coreID);
  if(coreID == 3)
  {
    break;
  }
  if(cnt == 0)
  {
  snprintf( chActionText, elCount(chActionText), "Run debugger "); 
  snprintf( chExpectedText, elCount(chExpectedText), "Run debugger "); 
  }
  A_DBGR_Go();
  testWaitForTimeout(2000);
  cnt =cnt+1;
  }
  E_DBGR_VariableCheck("v_crcSts_u8",0,Equal);
  cnt =0;
  snprintf( chActionText, elCount(chActionText), "delete all breakpoints "); 
  snprintf( chExpectedText, elCount(chExpectedText), "delete all breakpoints "); 
  TestStepAddActionExpected( chActionText, chExpectedText );
  A_DBGR_BreakpointDeleteAll();
  /***************************************************************************************************************/    
  	                            // Test Step 4 Set a breakpoint at line"PerfmHWIO_h_CalcCRC ((BYTE)test_HwCrc_CRC32_ethernet_E, v_seed_u32, v_startAddr_u8, v_endAddr_u8);"
  /***************************************************************************************************************/
  snprintf( chActionText, elCount(chActionText), "Set Breakpoint inPerfmHWIO_h_CalcCRC ((BYTE)test_HwCrc_CRC32_ethernet_E, v_seed_u32, v_startAddr_u8, v_endAddr_u8); "); 
  snprintf( chExpectedText, elCount(chExpectedText), "Verify Breakpoint is Set in PerfmHWIO_h_CalcCRC ((BYTE)test_HwCrc_CRC32_ethernet_E, v_seed_u32, v_startAddr_u8, v_endAddr_u8);"); 
  //TestStepAddActionExpected( chActionText, chExpectedText );  
  A_DBGR_BreakpointSet("Test_hwcrc_llsi\\367");  

  A_DBGR_Go();
  
  snprintf( chActionText, elCount(chActionText), "Verify Breakpoint should hit in v_crcSts_u8 = GetHWIO_e_CalcCRC_St(); "); 
  snprintf( chExpectedText, elCount(chExpectedText), "Breakpoint hit in v_crcSts_u8 = GetHWIO_e_CalcCRC_St(); function"); 
  E_DBGR_BreakpointCheckForHalt("Test_hwcrc_llsi\\367");
  
  while(1)
  {
  if(cnt == 0)
  {
  snprintf( chActionText, elCount(chActionText), "Verify v_coreId_u8 is 3 "); 
  snprintf( chExpectedText, elCount(chExpectedText), "Verify Verify v_coreId_u8 is 3"); 
  
  TestStepAddActionExpected( chActionText, chExpectedText );  
  }
  
  A_DBGR_VariableRead("v_coreId_u8",coreID);
  if(coreID == 3)
  {
    write("core ID is : %d",coreID);
    break;
  }
  if(cnt == 0)
  {
  snprintf( chActionText, elCount(chActionText), "Run debugger "); 
  snprintf( chExpectedText, elCount(chExpectedText), "Run debugger "); 
  }
  testWaitForTimeout(3000);
  A_DBGR_Go();
  cnt =cnt+1;
 
  }
  cnt =0;
  A_DBGR_BreakpointDeleteAll();
  
   /***************************************************************************************************************/    
  	                            // Test Step 5 Set a breakpoint at line"v_crcSts_u8 = GetHWIO_e_CalcCRC_St();"" inside Test_hwcrc_llsi"
  /***************************************************************************************************************/
  snprintf( chActionText, elCount(chActionText), "Set Breakpoint in v_crcSts_u8 = GetHWIO_e_CalcCRC_St();"" inside Test_hwcrc_llsi "); 
  snprintf( chExpectedText, elCount(chExpectedText), "Verify Breakpoint is Set in v_crcSts_u8 = GetHWIO_e_CalcCRC_St();"" inside Test_hwcrc_llsi"); 
//  TestStepAddActionExpected( chActionText, chExpectedText );  
  A_DBGR_BreakpointSet("Test_hwcrc_llsi\\369");  

  A_DBGR_Go();
  
  snprintf( chActionText, elCount(chActionText), "Verify Breakpoint should hit in v_crcSts_u8 = GetHWIO_e_CalcCRC_St(); "); 
  snprintf( chExpectedText, elCount(chExpectedText), "Breakpoint hit in v_crcSts_u8 = GetHWIO_e_CalcCRC_St(); function"); 
  E_DBGR_BreakpointCheckForHalt("Test_hwcrc_llsi\\369");
  while(1)
  {
  if(cnt == 0)
  {
  snprintf( chActionText, elCount(chActionText), "Verify v_coreId_u8 is 3 "); 
  snprintf( chExpectedText, elCount(chExpectedText), "Verify Verify v_coreId_u8 is 3"); 
  
  TestStepAddActionExpected( chActionText, chExpectedText );  
  }
  
  A_DBGR_VariableRead("v_coreId_u8",coreID);
  if(coreID == 3)
  {
    write("core ID is : %d",coreID);
    break;
  }
  if(cnt == 0)
  {
  snprintf( chActionText, elCount(chActionText), "Run debugger "); 
  snprintf( chExpectedText, elCount(chExpectedText), "Run debugger "); 
  }
  testWaitForTimeout(1000);
  A_DBGR_Go();
  cnt =cnt+1;
 
  }
  cnt =0;
  E_DBGR_VariableCheck("v_crcSts_u8",3,Equal);
  
  snprintf( chActionText, elCount(chActionText), "Delete all breakpoints "); 
  snprintf( chExpectedText, elCount(chExpectedText), "Breakpoints deleted"); 
  TestStepAddActionExpected( chActionText, chExpectedText );
  A_DBGR_BreakpointDeleteAll();
  /***************************************************************************************************************/    
  	                            // Test Step 6 Set a breakpoint after the line"v_sigVal_u32 = GetHWIO_g_CalcCRC_Sig();"
  /***************************************************************************************************************/
  snprintf( chActionText, elCount(chActionText), "Set Breakpoint in v_crcSts_u8 = GetHWIO_e_CalcCRC_St();"" inside Test_hwcrc_llsi "); 
  snprintf( chExpectedText, elCount(chExpectedText), "Verify Breakpoint is Set in v_crcSts_u8 = GetHWIO_e_CalcCRC_St();"" inside Test_hwcrc_llsi"); 
//  TestStepAddActionExpected( chActionText, chExpectedText );  
  A_DBGR_BreakpointSet("Test_hwcrc_llsi\\381");  

  A_DBGR_Go();
  
  snprintf( chActionText, elCount(chActionText), "Verify Breakpoint should hit in v_crcSts_u8 = GetHWIO_e_CalcCRC_St(); "); 
  snprintf( chExpectedText, elCount(chExpectedText), "Breakpoint hit in v_crcSts_u8 = GetHWIO_e_CalcCRC_St(); function"); 
  E_DBGR_BreakpointCheckForHalt("Test_hwcrc_llsi\\381");
  while(1)
  {
  if(cnt == 0)
  {
  snprintf( chActionText, elCount(chActionText), "Verify v_coreId_u8 is 3 "); 
  snprintf( chExpectedText, elCount(chExpectedText), "Verify Verify v_coreId_u8 is 3"); 
  
  TestStepAddActionExpected( chActionText, chExpectedText );  
  }
  
  A_DBGR_VariableRead("v_coreId_u8",coreID);
  if(coreID == 3)
  {
    write("core ID is : %d",coreID);
    break;
  }
  if(cnt == 0)
  {
  snprintf( chActionText, elCount(chActionText), "Run debugger "); 
  snprintf( chExpectedText, elCount(chExpectedText), "Run debugger "); 
  }
  testWaitForTimeout(1000);
  A_DBGR_Go();
  cnt =cnt+1;
 
  }
  cnt =0;
  E_DBGR_VariableCheck("v_sigVal_u32",0,Equal);
  snprintf( chActionText, elCount(chActionText), "Delete all breakpoints "); 
  snprintf( chExpectedText, elCount(chExpectedText), "Breakpoints deleted"); 
  TestStepAddActionExpected( chActionText, chExpectedText );
  A_DBGR_BreakpointDeleteAll();
  /***************************************************************************************************************/    
  	                            // Test Step 7 Set a breakpoint at line"v_crcSts_u8 = GetHWIO_e_CalcCRC_St();"" inside Test_hwcrc_llsi"
  /***************************************************************************************************************/
  snprintf( chActionText, elCount(chActionText), "Set Breakpoint in v_crcSts_u8 = GetHWIO_e_CalcCRC_St();"" inside Test_hwcrc_llsi "); 
  snprintf( chExpectedText, elCount(chExpectedText), "Verify Breakpoint is Set in v_crcSts_u8 = GetHWIO_e_CalcCRC_St();"" inside Test_hwcrc_llsi"); 
//  TestStepAddActionExpected( chActionText, chExpectedText );  
  A_DBGR_BreakpointSet("Test_hwcrc_llsi\\392");  

  A_DBGR_Go();
  
  snprintf( chActionText, elCount(chActionText), "Verify Breakpoint should hit in v_crcSts_u8 = GetHWIO_e_CalcCRC_St(); "); 
  snprintf( chExpectedText, elCount(chExpectedText), "Breakpoint hit in v_crcSts_u8 = GetHWIO_e_CalcCRC_St(); function"); 
  E_DBGR_BreakpointCheckForHalt("Test_hwcrc_llsi\\392");
  while(1)
  {
  if(cnt == 0)
  {
  snprintf( chActionText, elCount(chActionText), "Verify v_coreId_u8 is 3 "); 
  snprintf( chExpectedText, elCount(chExpectedText), "Verify Verify v_coreId_u8 is 3"); 
  
  TestStepAddActionExpected( chActionText, chExpectedText );  
  }
  
  A_DBGR_VariableRead("v_coreId_u8",coreID);
  if(coreID == 3)
  {
    write("core ID is : %d",coreID);
    break;
  }
  if(cnt == 0)
  {
  snprintf( chActionText, elCount(chActionText), "Run debugger "); 
  snprintf( chExpectedText, elCount(chExpectedText), "Run debugger "); 
  }
  testWaitForTimeout(1000);
  A_DBGR_Go();
  cnt =cnt+1;
 
  }
  cnt =0;
  E_DBGR_VariableCheck("v_crcSts_u8",0,Equal);
}

testcase Verify_Hardware_CRC32_Calculation_Invalid_Start_Address_Failure_Reporting_Core_4()
{
   /***************************************************************************************************************/    
                                                // Variable Definition
  /***************************************************************************************************************/ 
  

  
  /***************************************************************************************************************/    
                                               // Local Values
  /***************************************************************************************************************/ 
  

  
  /***************************************************************************************************************/    
                                              // Test Case Info
  /***************************************************************************************************************/
  setWriteDbgLevel(DebugOff);
  snprintf( chTestTitle, elCount(chTestTitle), "Verify_Hardware_CRC32_Calculation_Invalid_Start_Address_Failure_Reporting_Core_4" );
  snprintf( chTestDescription, elCount(chTestDescription), "Purpose:To check the GetHWIO_e_CalcCRC_St(); interface  ");
  TestCaseAddInfo( chTestTitle, "TC_L30SW_Q-37079857", chTestDescription );

  /***************************************************************************************************************/    
                                              // Start of Test Case
  /***************************************************************************************************************/
  
  /***************************************************************************************************************/    
                                              // Test Step 0 PRECONDITIONS
  /***************************************************************************************************************/
  snprintf( chActionText, elCount(chActionText), "Flash the Software and ECU is running "); 
  snprintf( chExpectedText, elCount(chExpectedText), "Ecu is should be in running state"); 
  TestStepAddActionExpected( chActionText, chExpectedText );
  
  A_DBGR_BreakpointDeleteAll();
  A_DBGR_R();
  A_DBGR_Go(); 

  /***************************************************************************************************************/    
                                              // Test Step 1 Set breakpoint in line Test_hwcrc_llsi(); inside "TestApp_Core4_1000ms_MainFunction" function and inside testapp.c file
  /***************************************************************************************************************/
  snprintf( chActionText, elCount(chActionText), "Set Breakpoint in Test_hwcrc_llsi(); "); 
  snprintf( chExpectedText, elCount(chExpectedText), "Verify Breakpoint is Set in Test_hwcrc_llsi();"); 
  //TestStepAddActionExpected( chActionText, chExpectedText );  
  A_DBGR_BreakpointSet("TestApp_Core4_1000ms_MainFunction\\65");  

  A_DBGR_Go();
  
  snprintf( chActionText, elCount(chActionText), "Verify Breakpoint should hit in Test_hwcrc_llsi(); "); 
  snprintf( chExpectedText, elCount(chExpectedText), "Breakpoint hit in Test_hwcrc_llsi(); function"); 
  E_DBGR_BreakpointCheckForHalt("TestApp_Core4_1000ms_MainFunction\\65");
  
  testWaitForTimeout(2000);
  
  snprintf( chActionText, elCount(chActionText), "Delete all breakpoints "); 
  snprintf( chExpectedText, elCount(chExpectedText), "Breakpoints deleted"); 
  TestStepAddActionExpected( chActionText, chExpectedText );
  
  A_DBGR_BreakpointDeleteAll();
   
  /***************************************************************************************************************/    
  	                            // Test Step 2 Set a breakpoint at "v_coreId_u8 = (BYTE)GetCoreID();" inside "Test_hwcrc_llsi" function
  /***************************************************************************************************************/
  
  snprintf( chActionText, elCount(chActionText), "Set Breakpoint in v_coreId_u8 = (BYTE)GetCoreID(); "); 
  snprintf( chExpectedText, elCount(chExpectedText), "Verify Breakpoint is Set in v_coreId_u8 = (BYTE)GetCoreID();"); 
  //TestStepAddActionExpected( chActionText, chExpectedText );  
  A_DBGR_BreakpointSet("Test_hwcrc_llsi\\352");  

  A_DBGR_Go();
  
  snprintf( chActionText, elCount(chActionText), "Verify Breakpoint should hit in v_coreId_u8 = (BYTE)GetCoreID(); "); 
  snprintf( chExpectedText, elCount(chExpectedText), "Breakpoint hit in v_coreId_u8 = (BYTE)GetCoreID(); function"); 
  E_DBGR_BreakpointCheckForHalt("Test_hwcrc_llsi\\352");
  
  /***************************************************************************************************************/    
  	                            // Test Step 3 Verify v_coreId_u8 in trace32 watch window
  /***************************************************************************************************************/
  
   while(1)
  {
  if(cnt == 0)
  {
  snprintf( chActionText, elCount(chActionText), "Verify v_coreId_u8 is 4 "); 
  snprintf( chExpectedText, elCount(chExpectedText), "Verify Verify v_coreId_u8 is 4"); 
  
  TestStepAddActionExpected( chActionText, chExpectedText );  
  }
  
  A_DBGR_VariableRead("v_coreId_u8",coreID);
  if(coreID == 4)
  {
    break;
  }
  if(cnt == 0)
  {
  snprintf( chActionText, elCount(chActionText), "Run debugger "); 
  snprintf( chExpectedText, elCount(chExpectedText), "Run debugger "); 
  }
  A_DBGR_Go();
  testWaitForTimeout(3000);
  if(cnt == 3)
  {
    testWaitForTimeout(60000);
  }
  cnt =cnt+1;
  }
  E_DBGR_VariableCheck("v_crcSts_u8",0,Equal);
  cnt =0;
  snprintf( chActionText, elCount(chActionText), "delete all breakpoints "); 
  snprintf( chExpectedText, elCount(chExpectedText), "delete all breakpoints "); 
  TestStepAddActionExpected( chActionText, chExpectedText );
  A_DBGR_BreakpointDeleteAll();
  /***************************************************************************************************************/    
  	                            // Test Step 4 Set a breakpoint at line"PerfmHWIO_h_CalcCRC ((BYTE)test_HwCrc_CRC32_ethernet_E, v_seed_u32, v_startAddr_u8, v_endAddr_u8);"
  /***************************************************************************************************************/
  snprintf( chActionText, elCount(chActionText), "Set Breakpoint inPerfmHWIO_h_CalcCRC ((BYTE)test_HwCrc_CRC32_ethernet_E, v_seed_u32, v_startAddr_u8, v_endAddr_u8); "); 
  snprintf( chExpectedText, elCount(chExpectedText), "Verify Breakpoint is Set in PerfmHWIO_h_CalcCRC ((BYTE)test_HwCrc_CRC32_ethernet_E, v_seed_u32, v_startAddr_u8, v_endAddr_u8);"); 
  //TestStepAddActionExpected( chActionText, chExpectedText );  
  A_DBGR_BreakpointSet("Test_hwcrc_llsi\\367");  

  A_DBGR_Go();
  testWaitForTimeout(2000);
  snprintf( chActionText, elCount(chActionText), "Verify Breakpoint should hit in v_crcSts_u8 = GetHWIO_e_CalcCRC_St(); "); 
  snprintf( chExpectedText, elCount(chExpectedText), "Breakpoint hit in v_crcSts_u8 = GetHWIO_e_CalcCRC_St(); function"); 
  E_DBGR_BreakpointCheckForHalt("Test_hwcrc_llsi\\367");
  
  while(1)
  {
  if(cnt == 0)
  {
  snprintf( chActionText, elCount(chActionText), "Verify v_coreId_u8 is 4 "); 
  snprintf( chExpectedText, elCount(chExpectedText), "Verify Verify v_coreId_u8 is 4"); 
  
  TestStepAddActionExpected( chActionText, chExpectedText );  
  }
  
  A_DBGR_VariableRead("v_coreId_u8",coreID);
  if(coreID == 4)
  {
    write("core ID is : %d",coreID);
    break;
  }
  if(cnt == 0)
  {
  snprintf( chActionText, elCount(chActionText), "Run debugger "); 
  snprintf( chExpectedText, elCount(chExpectedText), "Run debugger "); 
  }
  A_DBGR_Go();
  testWaitForTimeout(4000);
  
  cnt =cnt+1;
 
  }
  cnt =0;
  A_DBGR_BreakpointDeleteAll();
  
   /***************************************************************************************************************/    
  	                            // Test Step 5 Set a breakpoint at line"v_crcSts_u8 = GetHWIO_e_CalcCRC_St();"" inside Test_hwcrc_llsi"
  /***************************************************************************************************************/
  snprintf( chActionText, elCount(chActionText), "Set Breakpoint in v_crcSts_u8 = GetHWIO_e_CalcCRC_St();"" inside Test_hwcrc_llsi "); 
  snprintf( chExpectedText, elCount(chExpectedText), "Verify Breakpoint is Set in v_crcSts_u8 = GetHWIO_e_CalcCRC_St();"" inside Test_hwcrc_llsi"); 
//  TestStepAddActionExpected( chActionText, chExpectedText );  
  A_DBGR_BreakpointSet("Test_hwcrc_llsi\\369");  

  A_DBGR_Go();
  
  snprintf( chActionText, elCount(chActionText), "Verify Breakpoint should hit in v_crcSts_u8 = GetHWIO_e_CalcCRC_St(); "); 
  snprintf( chExpectedText, elCount(chExpectedText), "Breakpoint hit in v_crcSts_u8 = GetHWIO_e_CalcCRC_St(); function"); 
  E_DBGR_BreakpointCheckForHalt("Test_hwcrc_llsi\\369");
  while(1)
  {
  if(cnt == 0)
  {
  snprintf( chActionText, elCount(chActionText), "Verify v_coreId_u8 is 4 "); 
  snprintf( chExpectedText, elCount(chExpectedText), "Verify Verify v_coreId_u8 is 4"); 
  
  TestStepAddActionExpected( chActionText, chExpectedText );  
  }
  
  A_DBGR_VariableRead("v_coreId_u8",coreID);
  if(coreID == 4)
  {
    write("core ID is : %d",coreID);
    break;
  }
  if(cnt == 0)
  {
  snprintf( chActionText, elCount(chActionText), "Run debugger "); 
  snprintf( chExpectedText, elCount(chExpectedText), "Run debugger "); 
  }
  testWaitForTimeout(1000);
  A_DBGR_Go();
  cnt =cnt+1;
 
  }
  cnt =0;
  E_DBGR_VariableCheck("v_crcSts_u8",3,Equal);
  
  snprintf( chActionText, elCount(chActionText), "Delete all breakpoints "); 
  snprintf( chExpectedText, elCount(chExpectedText), "Breakpoints deleted"); 
  TestStepAddActionExpected( chActionText, chExpectedText );
  A_DBGR_BreakpointDeleteAll();
  /***************************************************************************************************************/    
  	                            // Test Step 6 Set a breakpoint after the line"v_sigVal_u32 = GetHWIO_g_CalcCRC_Sig();"
  /***************************************************************************************************************/
  snprintf( chActionText, elCount(chActionText), "Set Breakpoint in v_crcSts_u8 = GetHWIO_e_CalcCRC_St();"" inside Test_hwcrc_llsi "); 
  snprintf( chExpectedText, elCount(chExpectedText), "Verify Breakpoint is Set in v_crcSts_u8 = GetHWIO_e_CalcCRC_St();"" inside Test_hwcrc_llsi"); 
//  TestStepAddActionExpected( chActionText, chExpectedText );  
  A_DBGR_BreakpointSet("Test_hwcrc_llsi\\381");  

  A_DBGR_Go();
  
  snprintf( chActionText, elCount(chActionText), "Verify Breakpoint should hit in v_crcSts_u8 = GetHWIO_e_CalcCRC_St(); "); 
  snprintf( chExpectedText, elCount(chExpectedText), "Breakpoint hit in v_crcSts_u8 = GetHWIO_e_CalcCRC_St(); function"); 
  E_DBGR_BreakpointCheckForHalt("Test_hwcrc_llsi\\381");
  while(1)
  {
  if(cnt == 0)
  {
  snprintf( chActionText, elCount(chActionText), "Verify v_coreId_u8 is 4 "); 
  snprintf( chExpectedText, elCount(chExpectedText), "Verify Verify v_coreId_u8 is 4"); 
  
  TestStepAddActionExpected( chActionText, chExpectedText );  
  }
  
  A_DBGR_VariableRead("v_coreId_u8",coreID);
  if(coreID == 4)
  {
    write("core ID is : %d",coreID);
    break;
  }
  if(cnt == 0)
  {
  snprintf( chActionText, elCount(chActionText), "Run debugger "); 
  snprintf( chExpectedText, elCount(chExpectedText), "Run debugger "); 
  }
  testWaitForTimeout(1000);
  A_DBGR_Go();
  cnt =cnt+1;
 
  }
  cnt =0;
  E_DBGR_VariableCheck("v_sigVal_u32",0,Equal);
  snprintf( chActionText, elCount(chActionText), "Delete all breakpoints "); 
  snprintf( chExpectedText, elCount(chExpectedText), "Breakpoints deleted"); 
  TestStepAddActionExpected( chActionText, chExpectedText );
  A_DBGR_BreakpointDeleteAll();
  /***************************************************************************************************************/    
  	                            // Test Step 7 Set a breakpoint at line"v_crcSts_u8 = GetHWIO_e_CalcCRC_St();"" inside Test_hwcrc_llsi"
  /***************************************************************************************************************/
  snprintf( chActionText, elCount(chActionText), "Set Breakpoint in v_crcSts_u8 = GetHWIO_e_CalcCRC_St();"" inside Test_hwcrc_llsi "); 
  snprintf( chExpectedText, elCount(chExpectedText), "Verify Breakpoint is Set in v_crcSts_u8 = GetHWIO_e_CalcCRC_St();"" inside Test_hwcrc_llsi"); 
//  TestStepAddActionExpected( chActionText, chExpectedText );  
  A_DBGR_BreakpointSet("Test_hwcrc_llsi\\392");  

  A_DBGR_Go();
  
  snprintf( chActionText, elCount(chActionText), "Verify Breakpoint should hit in v_crcSts_u8 = GetHWIO_e_CalcCRC_St(); "); 
  snprintf( chExpectedText, elCount(chExpectedText), "Breakpoint hit in v_crcSts_u8 = GetHWIO_e_CalcCRC_St(); function"); 
  E_DBGR_BreakpointCheckForHalt("Test_hwcrc_llsi\\392");
  while(1)
  {
  if(cnt == 0)
  {
  snprintf( chActionText, elCount(chActionText), "Verify v_coreId_u8 is 4 "); 
  snprintf( chExpectedText, elCount(chExpectedText), "Verify Verify v_coreId_u8 is 4"); 
  
  TestStepAddActionExpected( chActionText, chExpectedText );  
  }
  
  A_DBGR_VariableRead("v_coreId_u8",coreID);
  if(coreID == 4)
  {
    write("core ID is : %d",coreID);
    break;
  }
  if(cnt == 0)
  {
  snprintf( chActionText, elCount(chActionText), "Run debugger "); 
  snprintf( chExpectedText, elCount(chExpectedText), "Run debugger "); 
  }
  testWaitForTimeout(1000);
  A_DBGR_Go();
  cnt =cnt+1;
 
  }
  cnt =0;
  E_DBGR_VariableCheck("v_crcSts_u8",0,Equal);
}

testcase Verify_Hardware_CRC32_Calculation_Invalid_Start_Address_Failure_Reporting_Core_5()
{
  /***************************************************************************************************************/    
                                                // Variable Definition
  /***************************************************************************************************************/ 
  

  
  /***************************************************************************************************************/    
                                               // Local Values
  /***************************************************************************************************************/ 
  

  
  /***************************************************************************************************************/    
                                              // Test Case Info
  /***************************************************************************************************************/
  setWriteDbgLevel(DebugOff);
  snprintf( chTestTitle, elCount(chTestTitle), "Verify_Hardware_CRC32_Calculation_Invalid_Start_Address_Failure_Reporting_Core_5" );
  snprintf( chTestDescription, elCount(chTestDescription), "Purpose:To check the GetHWIO_e_CalcCRC_St(); interface  ");
  TestCaseAddInfo( chTestTitle, "TC_L30SW_Q-37079862", chTestDescription );

  /***************************************************************************************************************/    
                                              // Start of Test Case
  /***************************************************************************************************************/
  
  /***************************************************************************************************************/    
                                              // Test Step 0 PRECONDITIONS
  /***************************************************************************************************************/
  snprintf( chActionText, elCount(chActionText), "Flash the Software and ECU is running "); 
  snprintf( chExpectedText, elCount(chExpectedText), "Ecu is should be in running state"); 
  TestStepAddActionExpected( chActionText, chExpectedText );
  
  A_DBGR_BreakpointDeleteAll();
  A_DBGR_R();
  A_DBGR_Go(); 

  /***************************************************************************************************************/    
                                              // Test Step 1 Set breakpoint in line Test_hwcrc_llsi(); inside "TestApp_Core5_1000ms_MainFunction" function and inside testapp.c file
  /***************************************************************************************************************/
  snprintf( chActionText, elCount(chActionText), "Set Breakpoint in Test_hwcrc_llsi(); "); 
  snprintf( chExpectedText, elCount(chExpectedText), "Verify Breakpoint is Set in Test_hwcrc_llsi();"); 
  //TestStepAddActionExpected( chActionText, chExpectedText );  
  A_DBGR_BreakpointSet("TestApp_Core5_1000ms_MainFunction\\54");  

  A_DBGR_Go();
  
  snprintf( chActionText, elCount(chActionText), "Verify Breakpoint should hit in Test_hwcrc_llsi(); "); 
  snprintf( chExpectedText, elCount(chExpectedText), "Breakpoint hit in Test_hwcrc_llsi(); function"); 
  E_DBGR_BreakpointCheckForHalt("TestApp_Core5_1000ms_MainFunction\\54");
  
  testWaitForTimeout(2000);
  
  snprintf( chActionText, elCount(chActionText), "Delete all breakpoints "); 
  snprintf( chExpectedText, elCount(chExpectedText), "Breakpoints deleted"); 
  TestStepAddActionExpected( chActionText, chExpectedText );
  
  A_DBGR_BreakpointDeleteAll();  
   
  /***************************************************************************************************************/    
  	                            // Test Step 2 Set a breakpoint at "v_coreId_u8 = (BYTE)GetCoreID();" inside "Test_hwcrc_llsi" function
  /***************************************************************************************************************/
  
  snprintf( chActionText, elCount(chActionText), "Set Breakpoint in v_coreId_u8 = (BYTE)GetCoreID(); "); 
  snprintf( chExpectedText, elCount(chExpectedText), "Verify Breakpoint is Set in v_coreId_u8 = (BYTE)GetCoreID();"); 
  //TestStepAddActionExpected( chActionText, chExpectedText );  
  A_DBGR_BreakpointSet("Test_hwcrc_llsi\\352");  

  A_DBGR_Go();
  
  snprintf( chActionText, elCount(chActionText), "Verify Breakpoint should hit in v_coreId_u8 = (BYTE)GetCoreID(); "); 
  snprintf( chExpectedText, elCount(chExpectedText), "Breakpoint hit in v_coreId_u8 = (BYTE)GetCoreID(); function"); 
  E_DBGR_BreakpointCheckForHalt("Test_hwcrc_llsi\\352");
  
  /***************************************************************************************************************/    
  	                            // Test Step 3 Verify v_coreId_u8 in trace32 watch window
  /***************************************************************************************************************/
  
   while(1)
  {
  if(cnt == 0)
  {
  snprintf( chActionText, elCount(chActionText), "Verify v_coreId_u8 is 5 "); 
  snprintf( chExpectedText, elCount(chExpectedText), "Verify Verify v_coreId_u8 is 5"); 
  
  TestStepAddActionExpected( chActionText, chExpectedText );  
  }
  
  A_DBGR_VariableRead("v_coreId_u8",coreID);
  if(coreID == 5)
  {
    break;
  }
  if(cnt == 0)
  {
  snprintf( chActionText, elCount(chActionText), "Run debugger "); 
  snprintf( chExpectedText, elCount(chExpectedText), "Run debugger "); 
  }
  A_DBGR_Go();
  testWaitForTimeout(30000);
  
  cnt =cnt+1;
  }
  E_DBGR_VariableCheck("v_crcSts_u8",0,Equal);
  cnt =0;
  snprintf( chActionText, elCount(chActionText), "delete all breakpoints "); 
  snprintf( chExpectedText, elCount(chExpectedText), "delete all breakpoints "); 
  TestStepAddActionExpected( chActionText, chExpectedText );
  A_DBGR_BreakpointDeleteAll();
  /***************************************************************************************************************/    
  	                            // Test Step 4 Set a breakpoint at line"PerfmHWIO_h_CalcCRC ((BYTE)test_HwCrc_CRC32_ethernet_E, v_seed_u32, v_startAddr_u8, v_endAddr_u8);"
  /***************************************************************************************************************/
  snprintf( chActionText, elCount(chActionText), "Set Breakpoint inPerfmHWIO_h_CalcCRC ((BYTE)test_HwCrc_CRC32_ethernet_E, v_seed_u32, v_startAddr_u8, v_endAddr_u8); "); 
  snprintf( chExpectedText, elCount(chExpectedText), "Verify Breakpoint is Set in PerfmHWIO_h_CalcCRC ((BYTE)test_HwCrc_CRC32_ethernet_E, v_seed_u32, v_startAddr_u8, v_endAddr_u8);"); 
  //TestStepAddActionExpected( chActionText, chExpectedText );  
  A_DBGR_BreakpointSet("Test_hwcrc_llsi\\367");  

  A_DBGR_Go();
  
  testWaitForTimeout(4000);
  
  snprintf( chActionText, elCount(chActionText), "Verify Breakpoint should hit in v_crcSts_u8 = GetHWIO_e_CalcCRC_St(); "); 
  snprintf( chExpectedText, elCount(chExpectedText), "Breakpoint hit in v_crcSts_u8 = GetHWIO_e_CalcCRC_St(); function"); 
  E_DBGR_BreakpointCheckForHalt("Test_hwcrc_llsi\\367");
  
  while(1)
  {
  if(cnt == 0)
  {
  snprintf( chActionText, elCount(chActionText), "Verify v_coreId_u8 is 5 "); 
  snprintf( chExpectedText, elCount(chExpectedText), "Verify Verify v_coreId_u8 is 5"); 
  
  TestStepAddActionExpected( chActionText, chExpectedText );  
  }
  
  A_DBGR_VariableRead("v_coreId_u8",coreID);
  if(coreID == 5)
  {
    write("core ID is : %d",coreID);
    break;
  }
  if(cnt == 0)
  {
  snprintf( chActionText, elCount(chActionText), "Run debugger "); 
  snprintf( chExpectedText, elCount(chExpectedText), "Run debugger "); 
  }
  
  A_DBGR_Go();
  testWaitForTimeout(4000);
  cnt =cnt+1;
 
  }
  cnt =0;
  A_DBGR_BreakpointDeleteAll();
  
   /***************************************************************************************************************/    
  	                            // Test Step 5 Set a breakpoint at line"v_crcSts_u8 = GetHWIO_e_CalcCRC_St();"" inside Test_hwcrc_llsi"
  /***************************************************************************************************************/
  snprintf( chActionText, elCount(chActionText), "Set Breakpoint in v_crcSts_u8 = GetHWIO_e_CalcCRC_St();"" inside Test_hwcrc_llsi "); 
  snprintf( chExpectedText, elCount(chExpectedText), "Verify Breakpoint is Set in v_crcSts_u8 = GetHWIO_e_CalcCRC_St();"" inside Test_hwcrc_llsi"); 
//  TestStepAddActionExpected( chActionText, chExpectedText );  
  A_DBGR_BreakpointSet("Test_hwcrc_llsi\\369");  

  A_DBGR_Go();
  
  snprintf( chActionText, elCount(chActionText), "Verify Breakpoint should hit in v_crcSts_u8 = GetHWIO_e_CalcCRC_St(); "); 
  snprintf( chExpectedText, elCount(chExpectedText), "Breakpoint hit in v_crcSts_u8 = GetHWIO_e_CalcCRC_St(); function"); 
  E_DBGR_BreakpointCheckForHalt("Test_hwcrc_llsi\\369");
  while(1)
  {
  if(cnt == 0)
  {
  snprintf( chActionText, elCount(chActionText), "Verify v_coreId_u8 is 5 "); 
  snprintf( chExpectedText, elCount(chExpectedText), "Verify Verify v_coreId_u8 is 5"); 
  
  TestStepAddActionExpected( chActionText, chExpectedText );  
  }
  
  A_DBGR_VariableRead("v_coreId_u8",coreID);
  if(coreID == 5)
  {
    write("core ID is : %d",coreID);
    break;
  }
  if(cnt == 0)
  {
  snprintf( chActionText, elCount(chActionText), "Run debugger "); 
  snprintf( chExpectedText, elCount(chExpectedText), "Run debugger "); 
  }
  testWaitForTimeout(1000);
  A_DBGR_Go();
  cnt =cnt+1;
 
  }
  cnt =0;
  E_DBGR_VariableCheck("v_crcSts_u8",3,Equal);
  
  snprintf( chActionText, elCount(chActionText), "Delete all breakpoints "); 
  snprintf( chExpectedText, elCount(chExpectedText), "Breakpoints deleted"); 
  TestStepAddActionExpected( chActionText, chExpectedText );
  A_DBGR_BreakpointDeleteAll();
  /***************************************************************************************************************/    
  	                            // Test Step 6 Set a breakpoint after the line"v_sigVal_u32 = GetHWIO_g_CalcCRC_Sig();"
  /***************************************************************************************************************/
  snprintf( chActionText, elCount(chActionText), "Set Breakpoint in v_crcSts_u8 = GetHWIO_e_CalcCRC_St();"" inside Test_hwcrc_llsi "); 
  snprintf( chExpectedText, elCount(chExpectedText), "Verify Breakpoint is Set in v_crcSts_u8 = GetHWIO_e_CalcCRC_St();"" inside Test_hwcrc_llsi"); 
//  TestStepAddActionExpected( chActionText, chExpectedText );  
  A_DBGR_BreakpointSet("Test_hwcrc_llsi\\381");  

  A_DBGR_Go();
  
  snprintf( chActionText, elCount(chActionText), "Verify Breakpoint should hit in v_crcSts_u8 = GetHWIO_e_CalcCRC_St(); "); 
  snprintf( chExpectedText, elCount(chExpectedText), "Breakpoint hit in v_crcSts_u8 = GetHWIO_e_CalcCRC_St(); function"); 
  E_DBGR_BreakpointCheckForHalt("Test_hwcrc_llsi\\381");
  while(1)
  {
  if(cnt == 0)
  {
  snprintf( chActionText, elCount(chActionText), "Verify v_coreId_u8 is 5 "); 
  snprintf( chExpectedText, elCount(chExpectedText), "Verify Verify v_coreId_u8 is 5"); 
  
  TestStepAddActionExpected( chActionText, chExpectedText );  
  }
  
  A_DBGR_VariableRead("v_coreId_u8",coreID);
  if(coreID == 5)
  {
    write("core ID is : %d",coreID);
    break;
  }
  if(cnt == 0)
  {
  snprintf( chActionText, elCount(chActionText), "Run debugger "); 
  snprintf( chExpectedText, elCount(chExpectedText), "Run debugger "); 
  }
  testWaitForTimeout(1000);
  A_DBGR_Go();
  cnt =cnt+1;
 
  }
  cnt =0;
  E_DBGR_VariableCheck("v_sigVal_u32",0,Equal);
  snprintf( chActionText, elCount(chActionText), "Delete all breakpoints "); 
  snprintf( chExpectedText, elCount(chExpectedText), "Breakpoints deleted"); 
  TestStepAddActionExpected( chActionText, chExpectedText );
  A_DBGR_BreakpointDeleteAll();
  /***************************************************************************************************************/    
  	                            // Test Step 7 Set a breakpoint at line"v_crcSts_u8 = GetHWIO_e_CalcCRC_St();"" inside Test_hwcrc_llsi"
  /***************************************************************************************************************/
  snprintf( chActionText, elCount(chActionText), "Set Breakpoint in v_crcSts_u8 = GetHWIO_e_CalcCRC_St();"" inside Test_hwcrc_llsi "); 
  snprintf( chExpectedText, elCount(chExpectedText), "Verify Breakpoint is Set in v_crcSts_u8 = GetHWIO_e_CalcCRC_St();"" inside Test_hwcrc_llsi"); 
//  TestStepAddActionExpected( chActionText, chExpectedText );  
  A_DBGR_BreakpointSet("Test_hwcrc_llsi\\392");  

  A_DBGR_Go();
  
  snprintf( chActionText, elCount(chActionText), "Verify Breakpoint should hit in v_crcSts_u8 = GetHWIO_e_CalcCRC_St(); "); 
  snprintf( chExpectedText, elCount(chExpectedText), "Breakpoint hit in v_crcSts_u8 = GetHWIO_e_CalcCRC_St(); function"); 
  E_DBGR_BreakpointCheckForHalt("Test_hwcrc_llsi\\392");
  while(1)
  {
  if(cnt == 0)
  {
  snprintf( chActionText, elCount(chActionText), "Verify v_coreId_u8 is 5 "); 
  snprintf( chExpectedText, elCount(chExpectedText), "Verify Verify v_coreId_u8 is 5"); 
  
  TestStepAddActionExpected( chActionText, chExpectedText );  
  }
  
  A_DBGR_VariableRead("v_coreId_u8",coreID);
  if(coreID == 5)
  {
    write("core ID is : %d",coreID);
    break;
  }
  if(cnt == 0)
  {
  snprintf( chActionText, elCount(chActionText), "Run debugger "); 
  snprintf( chExpectedText, elCount(chExpectedText), "Run debugger "); 
  }
  testWaitForTimeout(1000);
  A_DBGR_Go();
  cnt =cnt+1;
 
  }
  cnt =0;
  E_DBGR_VariableCheck("v_crcSts_u8",0,Equal);
}

testcase Verify_Hardware_CRC32_Calculation_Invalid_End_Address_Failure_Reporting_Core_0()
{
  /***************************************************************************************************************/    
                                                // Variable Definition
  /***************************************************************************************************************/ 
  

  
  /***************************************************************************************************************/    
                                               // Local Values
  /***************************************************************************************************************/ 
  

  
  /***************************************************************************************************************/    
                                              // Test Case Info
  /***************************************************************************************************************/
  setWriteDbgLevel(DebugOff);
  snprintf( chTestTitle, elCount(chTestTitle), "Verify_Hardware_CRC32_Calculation_Invalid_End_Address_Failure_Reporting_Core_0" );
  snprintf( chTestDescription, elCount(chTestDescription), "Purpose:To check the GetHWIO_e_CalcCRC_St(); interface  ");
  TestCaseAddInfo( chTestTitle, "TC_L30SW_Q-37079807", chTestDescription );

  /***************************************************************************************************************/    
                                              // Start of Test Case
  /***************************************************************************************************************/
  
  /***************************************************************************************************************/    
                                              // Test Step 0 PRECONDITIONS
  /***************************************************************************************************************/
  snprintf( chActionText, elCount(chActionText), "Flash the Software and ECU is running "); 
  snprintf( chExpectedText, elCount(chExpectedText), "Ecu is should be in running state"); 
  TestStepAddActionExpected( chActionText, chExpectedText );
  
  A_DBGR_BreakpointDeleteAll();
  A_DBGR_R();
  A_DBGR_Go(); 

  /***************************************************************************************************************/    
                                              // Test Step 1 Set breakpoint in line Test_hwcrc_llsi(); inside "TestApp_Core0_10ms_MainFunction" function and inside testapp.c file
  /***************************************************************************************************************/
  snprintf( chActionText, elCount(chActionText), "Set Breakpoint in Test_hwcrc_llsi(); "); 
  snprintf( chExpectedText, elCount(chExpectedText), "Verify Breakpoint is Set in Test_hwcrc_llsi();"); 
  //TestStepAddActionExpected( chActionText, chExpectedText );  
  A_DBGR_BreakpointSet("TestApp_Core0_10ms_MainFunction\\45");  

  A_DBGR_Go();
  
  snprintf( chActionText, elCount(chActionText), "Verify Breakpoint should hit in Test_hwcrc_llsi(); "); 
  snprintf( chExpectedText, elCount(chExpectedText), "Breakpoint hit in Test_hwcrc_llsi(); function"); 
  E_DBGR_BreakpointCheckForHalt("TestApp_Core0_10ms_MainFunction\\45");
  
  snprintf( chActionText, elCount(chActionText), "Delete all breakpoints "); 
  snprintf( chExpectedText, elCount(chExpectedText), "Breakpoints deleted"); 
  TestStepAddActionExpected( chActionText, chExpectedText );
  
  A_DBGR_BreakpointDeleteAll();
  
   
  /***************************************************************************************************************/    
  	                            // Test Step 2 Set a breakpoint at "v_coreId_u8 = (BYTE)GetCoreID();" inside "Test_hwcrc_llsi" function
  /***************************************************************************************************************/
  
  snprintf( chActionText, elCount(chActionText), "Set Breakpoint in v_coreId_u8 = (BYTE)GetCoreID(); "); 
  snprintf( chExpectedText, elCount(chExpectedText), "Verify Breakpoint is Set in v_coreId_u8 = (BYTE)GetCoreID();"); 
  //TestStepAddActionExpected( chActionText, chExpectedText );  
  A_DBGR_BreakpointSet("Test_hwcrc_llsi\\392");  

  A_DBGR_Go();
  
  snprintf( chActionText, elCount(chActionText), "Verify Breakpoint should hit in v_coreId_u8 = (BYTE)GetCoreID(); "); 
  snprintf( chExpectedText, elCount(chExpectedText), "Breakpoint hit in v_coreId_u8 = (BYTE)GetCoreID(); function"); 
  E_DBGR_BreakpointCheckForHalt("Test_hwcrc_llsi\\392");
  
  /***************************************************************************************************************/    
  	                            // Test Step 3 Verify v_coreId_u8 in trace32 watch window
  /***************************************************************************************************************/
  
   while(1)
  {
  if(cnt == 0)
  {
  snprintf( chActionText, elCount(chActionText), "Verify v_coreId_u8 is 0 "); 
  snprintf( chExpectedText, elCount(chExpectedText), "Verify Verify v_coreId_u8 is 0"); 
  
  TestStepAddActionExpected( chActionText, chExpectedText );  
  }
  
  A_DBGR_VariableRead("v_coreId_u8",coreID);
  if(coreID == 0)
  {
    break;
  }
  if(cnt == 0)
  {
  snprintf( chActionText, elCount(chActionText), "Run debugger "); 
  snprintf( chExpectedText, elCount(chExpectedText), "Run debugger "); 
  }
  A_DBGR_Go();
  testWaitForTimeout(2000);
  cnt =cnt+1;
  }
  E_DBGR_VariableCheck("v_crcSts_u8",0,Equal);
  cnt =0;
  snprintf( chActionText, elCount(chActionText), "delete all breakpoints "); 
  snprintf( chExpectedText, elCount(chExpectedText), "delete all breakpoints "); 
  TestStepAddActionExpected( chActionText, chExpectedText );
  A_DBGR_BreakpointDeleteAll();
  /***************************************************************************************************************/    
  	                            // Test Step 4 Set a breakpoint at line"PerfmHWIO_h_CalcCRC ((BYTE)test_HwCrc_CRC32_ethernet_E, v_seed_u32, v_startAddr_u8, v_endAddr_u8);"
  /***************************************************************************************************************/
  snprintf( chActionText, elCount(chActionText), "Set Breakpoint inPerfmHWIO_h_CalcCRC ((BYTE)test_HwCrc_CRC32_ethernet_E, v_seed_u32, v_startAddr_u8, v_endAddr_u8); "); 
  snprintf( chExpectedText, elCount(chExpectedText), "Verify Breakpoint is Set in PerfmHWIO_h_CalcCRC ((BYTE)test_HwCrc_CRC32_ethernet_E, v_seed_u32, v_startAddr_u8, v_endAddr_u8);"); 
  //TestStepAddActionExpected( chActionText, chExpectedText );  
  A_DBGR_BreakpointSet("Test_hwcrc_llsi\\407");  

  A_DBGR_Go();
  
  snprintf( chActionText, elCount(chActionText), "Verify Breakpoint should hit in v_crcSts_u8 = GetHWIO_e_CalcCRC_St(); "); 
  snprintf( chExpectedText, elCount(chExpectedText), "Breakpoint hit in v_crcSts_u8 = GetHWIO_e_CalcCRC_St(); function"); 
  E_DBGR_BreakpointCheckForHalt("Test_hwcrc_llsi\\407");
  
  while(1)
  {
  if(cnt == 0)
  {
  snprintf( chActionText, elCount(chActionText), "Verify v_coreId_u8 is 0 "); 
  snprintf( chExpectedText, elCount(chExpectedText), "Verify Verify v_coreId_u8 is 0"); 
  
  TestStepAddActionExpected( chActionText, chExpectedText );  
  }
  
  A_DBGR_VariableRead("v_coreId_u8",coreID);
  if(coreID == 0)
  {
    write("core ID is : %d",coreID);
    break;
  }
  if(cnt == 0)
  {
  snprintf( chActionText, elCount(chActionText), "Run debugger "); 
  snprintf( chExpectedText, elCount(chExpectedText), "Run debugger "); 
  }
  testWaitForTimeout(1000);
  A_DBGR_Go();
  cnt =cnt+1;
 
  }
  cnt =0;
  A_DBGR_BreakpointDeleteAll();
  
   /***************************************************************************************************************/    
  	                            // Test Step 5 Set a breakpoint at line"v_crcSts_u8 = GetHWIO_e_CalcCRC_St();"" inside Test_hwcrc_llsi"
  /***************************************************************************************************************/
  snprintf( chActionText, elCount(chActionText), "Set Breakpoint in v_crcSts_u8 = GetHWIO_e_CalcCRC_St();"" inside Test_hwcrc_llsi "); 
  snprintf( chExpectedText, elCount(chExpectedText), "Verify Breakpoint is Set in v_crcSts_u8 = GetHWIO_e_CalcCRC_St();"" inside Test_hwcrc_llsi"); 
//  TestStepAddActionExpected( chActionText, chExpectedText );  
  A_DBGR_BreakpointSet("Test_hwcrc_llsi\\409");  

  A_DBGR_Go();
  
  snprintf( chActionText, elCount(chActionText), "Verify Breakpoint should hit in v_crcSts_u8 = GetHWIO_e_CalcCRC_St(); "); 
  snprintf( chExpectedText, elCount(chExpectedText), "Breakpoint hit in v_crcSts_u8 = GetHWIO_e_CalcCRC_St(); function"); 
  E_DBGR_BreakpointCheckForHalt("Test_hwcrc_llsi\\409");
  while(1)
  {
  if(cnt == 0)
  {
  snprintf( chActionText, elCount(chActionText), "Verify v_coreId_u8 is 0 "); 
  snprintf( chExpectedText, elCount(chExpectedText), "Verify Verify v_coreId_u8 is 0"); 
  
  TestStepAddActionExpected( chActionText, chExpectedText );  
  }
  
  A_DBGR_VariableRead("v_coreId_u8",coreID);
  if(coreID == 0)
  {
    write("core ID is : %d",coreID);
    break;
  }
  if(cnt == 0)
  {
  snprintf( chActionText, elCount(chActionText), "Run debugger "); 
  snprintf( chExpectedText, elCount(chExpectedText), "Run debugger "); 
  }
  testWaitForTimeout(1000);
  A_DBGR_Go();
  cnt =cnt+1;
 
  }
  cnt =0;
  E_DBGR_VariableCheck("v_crcSts_u8",3,Equal);
  
  snprintf( chActionText, elCount(chActionText), "Delete all breakpoints "); 
  snprintf( chExpectedText, elCount(chExpectedText), "Breakpoints deleted"); 
  TestStepAddActionExpected( chActionText, chExpectedText );
  A_DBGR_BreakpointDeleteAll();
  /***************************************************************************************************************/    
  	                            // Test Step 6 Set a breakpoint after the line"v_sigVal_u32 = GetHWIO_g_CalcCRC_Sig();"
  /***************************************************************************************************************/
  snprintf( chActionText, elCount(chActionText), "Set Breakpoint in v_crcSts_u8 = GetHWIO_e_CalcCRC_St();"" inside Test_hwcrc_llsi "); 
  snprintf( chExpectedText, elCount(chExpectedText), "Verify Breakpoint is Set in v_crcSts_u8 = GetHWIO_e_CalcCRC_St();"" inside Test_hwcrc_llsi"); 
//  TestStepAddActionExpected( chActionText, chExpectedText );  
  A_DBGR_BreakpointSet("Test_hwcrc_llsi\\421");  

  A_DBGR_Go();
  
  snprintf( chActionText, elCount(chActionText), "Verify Breakpoint should hit in v_crcSts_u8 = GetHWIO_e_CalcCRC_St(); "); 
  snprintf( chExpectedText, elCount(chExpectedText), "Breakpoint hit in v_crcSts_u8 = GetHWIO_e_CalcCRC_St(); function"); 
  E_DBGR_BreakpointCheckForHalt("Test_hwcrc_llsi\\421");
  while(1)
  {
  if(cnt == 0)
  {
  snprintf( chActionText, elCount(chActionText), "Verify v_coreId_u8 is 0 "); 
  snprintf( chExpectedText, elCount(chExpectedText), "Verify Verify v_coreId_u8 is 0"); 
  
  TestStepAddActionExpected( chActionText, chExpectedText );  
  }
  
  A_DBGR_VariableRead("v_coreId_u8",coreID);
  if(coreID == 0)
  {
    write("core ID is : %d",coreID);
    break;
  }
  if(cnt == 0)
  {
  snprintf( chActionText, elCount(chActionText), "Run debugger "); 
  snprintf( chExpectedText, elCount(chExpectedText), "Run debugger "); 
  }
  testWaitForTimeout(1000);
  A_DBGR_Go();
  cnt =cnt+1;
 
  }
  cnt =0;
  E_DBGR_VariableCheck("v_sigVal_u32",0,Equal);
  snprintf( chActionText, elCount(chActionText), "Delete all breakpoints "); 
  snprintf( chExpectedText, elCount(chExpectedText), "Breakpoints deleted"); 
  TestStepAddActionExpected( chActionText, chExpectedText );
  A_DBGR_BreakpointDeleteAll();
  /***************************************************************************************************************/    
  	                            // Test Step 7 Set a breakpoint at line"v_crcSts_u8 = GetHWIO_e_CalcCRC_St();"" inside Test_hwcrc_llsi"
  /***************************************************************************************************************/
  snprintf( chActionText, elCount(chActionText), "Set Breakpoint in v_crcSts_u8 = GetHWIO_e_CalcCRC_St();"" inside Test_hwcrc_llsi "); 
  snprintf( chExpectedText, elCount(chExpectedText), "Verify Breakpoint is Set in v_crcSts_u8 = GetHWIO_e_CalcCRC_St();"" inside Test_hwcrc_llsi"); 
//  TestStepAddActionExpected( chActionText, chExpectedText );  
  A_DBGR_BreakpointSet("Test_hwcrc_llsi\\432");  

  A_DBGR_Go();
  
  snprintf( chActionText, elCount(chActionText), "Verify Breakpoint should hit in v_crcSts_u8 = GetHWIO_e_CalcCRC_St(); "); 
  snprintf( chExpectedText, elCount(chExpectedText), "Breakpoint hit in v_crcSts_u8 = GetHWIO_e_CalcCRC_St(); function"); 
  E_DBGR_BreakpointCheckForHalt("Test_hwcrc_llsi\\432");
  while(1)
  {
  if(cnt == 0)
  {
  snprintf( chActionText, elCount(chActionText), "Verify v_coreId_u8 is 0 "); 
  snprintf( chExpectedText, elCount(chExpectedText), "Verify Verify v_coreId_u8 is 0"); 
  
  TestStepAddActionExpected( chActionText, chExpectedText );  
  }
  
  A_DBGR_VariableRead("v_coreId_u8",coreID);
  if(coreID == 0)
  {
    write("core ID is : %d",coreID);
    break;
  }
  if(cnt == 0)
  {
  snprintf( chActionText, elCount(chActionText), "Run debugger "); 
  snprintf( chExpectedText, elCount(chExpectedText), "Run debugger "); 
  }
  testWaitForTimeout(1000);
  A_DBGR_Go();
  cnt =cnt+1;
 
  }
  cnt =0;
  E_DBGR_VariableCheck("v_crcSts_u8",0,Equal);
}

testcase Verify_Hardware_CRC32_Calculation_Invalid_End_Address_Failure_Reporting_Core_1()
{
  /***************************************************************************************************************/    
                                                // Variable Definition
  /***************************************************************************************************************/ 
  

  
  /***************************************************************************************************************/    
                                               // Local Values
  /***************************************************************************************************************/ 
  

  
  /***************************************************************************************************************/    
                                              // Test Case Info
  /***************************************************************************************************************/
  setWriteDbgLevel(DebugOff);
  snprintf( chTestTitle, elCount(chTestTitle), "Verify_Hardware_CRC32_Calculation_Invalid_End_Address_Failure_Reporting_Core_1" );
  snprintf( chTestDescription, elCount(chTestDescription), "Purpose:To check the GetHWIO_e_CalcCRC_St(); interface  ");
  TestCaseAddInfo( chTestTitle, "TC_L30SW_Q-37079842", chTestDescription );

  /***************************************************************************************************************/    
                                              // Start of Test Case
  /***************************************************************************************************************/
  
  /***************************************************************************************************************/    
                                              // Test Step 0 PRECONDITIONS
  /***************************************************************************************************************/
  snprintf( chActionText, elCount(chActionText), "Flash the Software and ECU is running "); 
  snprintf( chExpectedText, elCount(chExpectedText), "Ecu is should be in running state"); 
  TestStepAddActionExpected( chActionText, chExpectedText );
  
  A_DBGR_BreakpointDeleteAll();
  A_DBGR_R();
  A_DBGR_Go(); 

  /***************************************************************************************************************/    
                                              // Test Step 1 Set breakpoint in line Test_hwcrc_llsi(); inside "TestApp_Core0_10ms_MainFunction" function and inside testapp.c file
  /***************************************************************************************************************/
  snprintf( chActionText, elCount(chActionText), "Set Breakpoint in Test_hwcrc_llsi(); "); 
  snprintf( chExpectedText, elCount(chExpectedText), "Verify Breakpoint is Set in Test_hwcrc_llsi();"); 
  //TestStepAddActionExpected( chActionText, chExpectedText );  
  A_DBGR_BreakpointSet("TestApp_Core0_10ms_MainFunction\\45");  

  A_DBGR_Go();
  
  snprintf( chActionText, elCount(chActionText), "Verify Breakpoint should hit in Test_hwcrc_llsi(); "); 
  snprintf( chExpectedText, elCount(chExpectedText), "Breakpoint hit in Test_hwcrc_llsi(); function"); 
  E_DBGR_BreakpointCheckForHalt("TestApp_Core0_10ms_MainFunction\\45");
  
  snprintf( chActionText, elCount(chActionText), "Delete all breakpoints "); 
  snprintf( chExpectedText, elCount(chExpectedText), "Breakpoints deleted"); 
  TestStepAddActionExpected( chActionText, chExpectedText );
  
  A_DBGR_BreakpointDeleteAll();
   
   
  /***************************************************************************************************************/    
  	                            // Test Step 2 Set a breakpoint at "v_coreId_u8 = (BYTE)GetCoreID();" inside "Test_hwcrc_llsi" function
  /***************************************************************************************************************/
  
  snprintf( chActionText, elCount(chActionText), "Set Breakpoint in v_coreId_u8 = (BYTE)GetCoreID(); "); 
  snprintf( chExpectedText, elCount(chExpectedText), "Verify Breakpoint is Set in v_coreId_u8 = (BYTE)GetCoreID();"); 
  //TestStepAddActionExpected( chActionText, chExpectedText );  
  A_DBGR_BreakpointSet("Test_hwcrc_llsi\\392");  

  A_DBGR_Go();
  
  snprintf( chActionText, elCount(chActionText), "Verify Breakpoint should hit in v_coreId_u8 = (BYTE)GetCoreID(); "); 
  snprintf( chExpectedText, elCount(chExpectedText), "Breakpoint hit in v_coreId_u8 = (BYTE)GetCoreID(); function"); 
  E_DBGR_BreakpointCheckForHalt("Test_hwcrc_llsi\\392");
  
  /***************************************************************************************************************/    
  	                            // Test Step 3 Verify v_coreId_u8 in trace32 watch window
  /***************************************************************************************************************/
  
   while(1)
  {
  if(cnt == 0)
  {
  snprintf( chActionText, elCount(chActionText), "Verify v_coreId_u8 is 1 "); 
  snprintf( chExpectedText, elCount(chExpectedText), "Verify Verify v_coreId_u8 is 1"); 
  
  TestStepAddActionExpected( chActionText, chExpectedText );  
  }
  
  A_DBGR_VariableRead("v_coreId_u8",coreID);
  if(coreID == 1)
  {
    break;
  }
  if(cnt == 0)
  {
  snprintf( chActionText, elCount(chActionText), "Run debugger "); 
  snprintf( chExpectedText, elCount(chExpectedText), "Run debugger "); 
  }
  A_DBGR_Go();
  testWaitForTimeout(2000);
  cnt =cnt+1;
  }
  E_DBGR_VariableCheck("v_crcSts_u8",0,Equal);
  cnt =0;
  snprintf( chActionText, elCount(chActionText), "delete all breakpoints "); 
  snprintf( chExpectedText, elCount(chExpectedText), "delete all breakpoints "); 
  TestStepAddActionExpected( chActionText, chExpectedText );
  A_DBGR_BreakpointDeleteAll();
  /***************************************************************************************************************/    
  	                            // Test Step 4 Set a breakpoint at line"PerfmHWIO_h_CalcCRC ((BYTE)test_HwCrc_CRC32_ethernet_E, v_seed_u32, v_startAddr_u8, v_endAddr_u8);"
  /***************************************************************************************************************/
  snprintf( chActionText, elCount(chActionText), "Set Breakpoint inPerfmHWIO_h_CalcCRC ((BYTE)test_HwCrc_CRC32_ethernet_E, v_seed_u32, v_startAddr_u8, v_endAddr_u8); "); 
  snprintf( chExpectedText, elCount(chExpectedText), "Verify Breakpoint is Set in PerfmHWIO_h_CalcCRC ((BYTE)test_HwCrc_CRC32_ethernet_E, v_seed_u32, v_startAddr_u8, v_endAddr_u8);"); 
  //TestStepAddActionExpected( chActionText, chExpectedText );  
  A_DBGR_BreakpointSet("Test_hwcrc_llsi\\407");  

  A_DBGR_Go();
  
  snprintf( chActionText, elCount(chActionText), "Verify Breakpoint should hit in v_crcSts_u8 = GetHWIO_e_CalcCRC_St(); "); 
  snprintf( chExpectedText, elCount(chExpectedText), "Breakpoint hit in v_crcSts_u8 = GetHWIO_e_CalcCRC_St(); function"); 
  E_DBGR_BreakpointCheckForHalt("Test_hwcrc_llsi\\407");
  
  while(1)
  {
  if(cnt == 0)
  {
  snprintf( chActionText, elCount(chActionText), "Verify v_coreId_u8 is 1 "); 
  snprintf( chExpectedText, elCount(chExpectedText), "Verify Verify v_coreId_u8 is 1"); 
  
  TestStepAddActionExpected( chActionText, chExpectedText );  
  }
  
  A_DBGR_VariableRead("v_coreId_u8",coreID);
  if(coreID == 1)
  {
    write("core ID is : %d",coreID);
    break;
  }
  if(cnt == 0)
  {
  snprintf( chActionText, elCount(chActionText), "Run debugger "); 
  snprintf( chExpectedText, elCount(chExpectedText), "Run debugger "); 
  }
  testWaitForTimeout(1000);
  A_DBGR_Go();
  cnt =cnt+1;
 
  }
  cnt =0;
  A_DBGR_BreakpointDeleteAll();
  
   /***************************************************************************************************************/    
  	                            // Test Step 5 Set a breakpoint at line"v_crcSts_u8 = GetHWIO_e_CalcCRC_St();"" inside Test_hwcrc_llsi"
  /***************************************************************************************************************/
  snprintf( chActionText, elCount(chActionText), "Set Breakpoint in v_crcSts_u8 = GetHWIO_e_CalcCRC_St();"" inside Test_hwcrc_llsi "); 
  snprintf( chExpectedText, elCount(chExpectedText), "Verify Breakpoint is Set in v_crcSts_u8 = GetHWIO_e_CalcCRC_St();"" inside Test_hwcrc_llsi"); 
//  TestStepAddActionExpected( chActionText, chExpectedText );  
  A_DBGR_BreakpointSet("Test_hwcrc_llsi\\409");  

  A_DBGR_Go();
  
  snprintf( chActionText, elCount(chActionText), "Verify Breakpoint should hit in v_crcSts_u8 = GetHWIO_e_CalcCRC_St(); "); 
  snprintf( chExpectedText, elCount(chExpectedText), "Breakpoint hit in v_crcSts_u8 = GetHWIO_e_CalcCRC_St(); function"); 
  E_DBGR_BreakpointCheckForHalt("Test_hwcrc_llsi\\409");
  while(1)
  {
  if(cnt == 0)
  {
  snprintf( chActionText, elCount(chActionText), "Verify v_coreId_u8 is 1 "); 
  snprintf( chExpectedText, elCount(chExpectedText), "Verify Verify v_coreId_u8 is 1"); 
  
  TestStepAddActionExpected( chActionText, chExpectedText );  
  }
  
  A_DBGR_VariableRead("v_coreId_u8",coreID);
  if(coreID == 1)
  {
    write("core ID is : %d",coreID);
    break;
  }
  if(cnt == 0)
  {
  snprintf( chActionText, elCount(chActionText), "Run debugger "); 
  snprintf( chExpectedText, elCount(chExpectedText), "Run debugger "); 
  }
  testWaitForTimeout(1000);
  A_DBGR_Go();
  cnt =cnt+1;
 
  }
  cnt =0;
  E_DBGR_VariableCheck("v_crcSts_u8",3,Equal);
  
  snprintf( chActionText, elCount(chActionText), "Delete all breakpoints "); 
  snprintf( chExpectedText, elCount(chExpectedText), "Breakpoints deleted"); 
  TestStepAddActionExpected( chActionText, chExpectedText );
  A_DBGR_BreakpointDeleteAll();
  /***************************************************************************************************************/    
  	                            // Test Step 6 Set a breakpoint after the line"v_sigVal_u32 = GetHWIO_g_CalcCRC_Sig();"
  /***************************************************************************************************************/
  snprintf( chActionText, elCount(chActionText), "Set Breakpoint in v_crcSts_u8 = GetHWIO_e_CalcCRC_St();"" inside Test_hwcrc_llsi "); 
  snprintf( chExpectedText, elCount(chExpectedText), "Verify Breakpoint is Set in v_crcSts_u8 = GetHWIO_e_CalcCRC_St();"" inside Test_hwcrc_llsi"); 
//  TestStepAddActionExpected( chActionText, chExpectedText );  
  A_DBGR_BreakpointSet("Test_hwcrc_llsi\\421");  

  A_DBGR_Go();
  
  snprintf( chActionText, elCount(chActionText), "Verify Breakpoint should hit in v_crcSts_u8 = GetHWIO_e_CalcCRC_St(); "); 
  snprintf( chExpectedText, elCount(chExpectedText), "Breakpoint hit in v_crcSts_u8 = GetHWIO_e_CalcCRC_St(); function"); 
  E_DBGR_BreakpointCheckForHalt("Test_hwcrc_llsi\\421");
  while(1)
  {
  if(cnt == 0)
  {
  snprintf( chActionText, elCount(chActionText), "Verify v_coreId_u8 is 1 "); 
  snprintf( chExpectedText, elCount(chExpectedText), "Verify Verify v_coreId_u8 is 1"); 
  
  TestStepAddActionExpected( chActionText, chExpectedText );  
  }
  
  A_DBGR_VariableRead("v_coreId_u8",coreID);
  if(coreID == 1)
  {
    write("core ID is : %d",coreID);
    break;
  }
  if(cnt == 0)
  {
  snprintf( chActionText, elCount(chActionText), "Run debugger "); 
  snprintf( chExpectedText, elCount(chExpectedText), "Run debugger "); 
  }
  testWaitForTimeout(1000);
  A_DBGR_Go();
  cnt =cnt+1;
 
  }
  cnt =0;
  E_DBGR_VariableCheck("v_sigVal_u32",0,Equal);
  snprintf( chActionText, elCount(chActionText), "Delete all breakpoints "); 
  snprintf( chExpectedText, elCount(chExpectedText), "Breakpoints deleted"); 
  TestStepAddActionExpected( chActionText, chExpectedText );
  A_DBGR_BreakpointDeleteAll();
  /***************************************************************************************************************/    
  	                            // Test Step 7 Set a breakpoint at line"v_crcSts_u8 = GetHWIO_e_CalcCRC_St();"" inside Test_hwcrc_llsi"
  /***************************************************************************************************************/
  snprintf( chActionText, elCount(chActionText), "Set Breakpoint in v_crcSts_u8 = GetHWIO_e_CalcCRC_St();"" inside Test_hwcrc_llsi "); 
  snprintf( chExpectedText, elCount(chExpectedText), "Verify Breakpoint is Set in v_crcSts_u8 = GetHWIO_e_CalcCRC_St();"" inside Test_hwcrc_llsi"); 
//  TestStepAddActionExpected( chActionText, chExpectedText );  
  A_DBGR_BreakpointSet("Test_hwcrc_llsi\\432");  

  A_DBGR_Go();
  
  snprintf( chActionText, elCount(chActionText), "Verify Breakpoint should hit in v_crcSts_u8 = GetHWIO_e_CalcCRC_St(); "); 
  snprintf( chExpectedText, elCount(chExpectedText), "Breakpoint hit in v_crcSts_u8 = GetHWIO_e_CalcCRC_St(); function"); 
  E_DBGR_BreakpointCheckForHalt("Test_hwcrc_llsi\\432");
  while(1)
  {
  if(cnt == 0)
  {
  snprintf( chActionText, elCount(chActionText), "Verify v_coreId_u8 is 1 "); 
  snprintf( chExpectedText, elCount(chExpectedText), "Verify Verify v_coreId_u8 is 1"); 
  
  TestStepAddActionExpected( chActionText, chExpectedText );  
  }
  
  A_DBGR_VariableRead("v_coreId_u8",coreID);
  if(coreID == 1)
  {
    write("core ID is : %d",coreID);
    break;
  }
  if(cnt == 0)
  {
  snprintf( chActionText, elCount(chActionText), "Run debugger "); 
  snprintf( chExpectedText, elCount(chExpectedText), "Run debugger "); 
  }
  testWaitForTimeout(1000);
  A_DBGR_Go();
  cnt =cnt+1;
 
  }
  cnt =0;
  E_DBGR_VariableCheck("v_crcSts_u8",0,Equal);
}

testcase Verify_Hardware_CRC32_Calculation_Invalid_End_Address_Failure_Reporting_Core_2()
{
  /***************************************************************************************************************/    
                                                // Variable Definition
  /***************************************************************************************************************/ 
  

  
  /***************************************************************************************************************/    
                                               // Local Values
  /***************************************************************************************************************/ 
  

  
  /***************************************************************************************************************/    
                                              // Test Case Info
  /***************************************************************************************************************/
  setWriteDbgLevel(DebugOff);
  snprintf( chTestTitle, elCount(chTestTitle), "Verify_Hardware_CRC32_Calculation_Invalid_End_Address_Failure_Reporting_Core_2" );
  snprintf( chTestDescription, elCount(chTestDescription), "Purpose:To check the GetHWIO_e_CalcCRC_St(); interface  ");
  TestCaseAddInfo( chTestTitle, "TC_L30SW_Q-37079848", chTestDescription );

  /***************************************************************************************************************/    
                                              // Start of Test Case
  /***************************************************************************************************************/
  
  /***************************************************************************************************************/    
                                              // Test Step 0 PRECONDITIONS
  /***************************************************************************************************************/
  snprintf( chActionText, elCount(chActionText), "Flash the Software and ECU is running "); 
  snprintf( chExpectedText, elCount(chExpectedText), "Ecu is should be in running state"); 
  TestStepAddActionExpected( chActionText, chExpectedText );
  
  A_DBGR_BreakpointDeleteAll();
  A_DBGR_R();
  A_DBGR_Go(); 

  /***************************************************************************************************************/    
                                              // Test Step 1 Set breakpoint in line Test_hwcrc_llsi(); inside "TestApp_Core2_10ms_MainFunction" function and inside testapp.c file
  /***************************************************************************************************************/
  snprintf( chActionText, elCount(chActionText), "Set Breakpoint in Test_hwcrc_llsi(); "); 
  snprintf( chExpectedText, elCount(chExpectedText), "Verify Breakpoint is Set in Test_hwcrc_llsi();"); 
  //TestStepAddActionExpected( chActionText, chExpectedText );  
  A_DBGR_BreakpointSet("TestApp_Core2_10ms_MainFunction\\36");  

  A_DBGR_Go();
  
  snprintf( chActionText, elCount(chActionText), "Verify Breakpoint should hit in Test_hwcrc_llsi(); "); 
  snprintf( chExpectedText, elCount(chExpectedText), "Breakpoint hit in Test_hwcrc_llsi(); function"); 
  E_DBGR_BreakpointCheckForHalt("TestApp_Core2_10ms_MainFunction\\36");
  
  snprintf( chActionText, elCount(chActionText), "Delete all breakpoints "); 
  snprintf( chExpectedText, elCount(chExpectedText), "Breakpoints deleted"); 
  TestStepAddActionExpected( chActionText, chExpectedText );
  
  A_DBGR_BreakpointDeleteAll();
  
  /***************************************************************************************************************/    
  	                            // Test Step 2 Set a breakpoint at "v_coreId_u8 = (BYTE)GetCoreID();" inside "Test_hwcrc_llsi" function
  /***************************************************************************************************************/
  
  snprintf( chActionText, elCount(chActionText), "Set Breakpoint in v_coreId_u8 = (BYTE)GetCoreID(); "); 
  snprintf( chExpectedText, elCount(chExpectedText), "Verify Breakpoint is Set in v_coreId_u8 = (BYTE)GetCoreID();"); 
  //TestStepAddActionExpected( chActionText, chExpectedText );  
  A_DBGR_BreakpointSet("Test_hwcrc_llsi\\392");  

  A_DBGR_Go();
  
  snprintf( chActionText, elCount(chActionText), "Verify Breakpoint should hit in v_coreId_u8 = (BYTE)GetCoreID(); "); 
  snprintf( chExpectedText, elCount(chExpectedText), "Breakpoint hit in v_coreId_u8 = (BYTE)GetCoreID(); function"); 
  E_DBGR_BreakpointCheckForHalt("Test_hwcrc_llsi\\392");
  
  /***************************************************************************************************************/    
  	                            // Test Step 3 Verify v_coreId_u8 in trace32 watch window
  /***************************************************************************************************************/
  
   while(1)
  {
  if(cnt == 0)
  {
  snprintf( chActionText, elCount(chActionText), "Verify v_coreId_u8 is 2 "); 
  snprintf( chExpectedText, elCount(chExpectedText), "Verify Verify v_coreId_u8 is 2"); 
  
  TestStepAddActionExpected( chActionText, chExpectedText );  
  }
  
  A_DBGR_VariableRead("v_coreId_u8",coreID);
  if(coreID == 2)
  {
    break;
  }
  if(cnt == 0)
  {
  snprintf( chActionText, elCount(chActionText), "Run debugger "); 
  snprintf( chExpectedText, elCount(chExpectedText), "Run debugger "); 
  }
  A_DBGR_Go();
  testWaitForTimeout(2000);
  cnt =cnt+1;
  }
  E_DBGR_VariableCheck("v_crcSts_u8",0,Equal);
  cnt =0;
  snprintf( chActionText, elCount(chActionText), "delete all breakpoints "); 
  snprintf( chExpectedText, elCount(chExpectedText), "delete all breakpoints "); 
  TestStepAddActionExpected( chActionText, chExpectedText );
  A_DBGR_BreakpointDeleteAll();
  /***************************************************************************************************************/    
  	                            // Test Step 4 Set a breakpoint at line"PerfmHWIO_h_CalcCRC ((BYTE)test_HwCrc_CRC32_ethernet_E, v_seed_u32, v_startAddr_u8, v_endAddr_u8);"
  /***************************************************************************************************************/
  snprintf( chActionText, elCount(chActionText), "Set Breakpoint inPerfmHWIO_h_CalcCRC ((BYTE)test_HwCrc_CRC32_ethernet_E, v_seed_u32, v_startAddr_u8, v_endAddr_u8); "); 
  snprintf( chExpectedText, elCount(chExpectedText), "Verify Breakpoint is Set in PerfmHWIO_h_CalcCRC ((BYTE)test_HwCrc_CRC32_ethernet_E, v_seed_u32, v_startAddr_u8, v_endAddr_u8);"); 
  //TestStepAddActionExpected( chActionText, chExpectedText );  
  A_DBGR_BreakpointSet("Test_hwcrc_llsi\\407");  

  A_DBGR_Go();
  
  snprintf( chActionText, elCount(chActionText), "Verify Breakpoint should hit in v_crcSts_u8 = GetHWIO_e_CalcCRC_St(); "); 
  snprintf( chExpectedText, elCount(chExpectedText), "Breakpoint hit in v_crcSts_u8 = GetHWIO_e_CalcCRC_St(); function"); 
  E_DBGR_BreakpointCheckForHalt("Test_hwcrc_llsi\\407");
  
  while(1)
  {
  if(cnt == 0)
  {
  snprintf( chActionText, elCount(chActionText), "Verify v_coreId_u8 is 2 "); 
  snprintf( chExpectedText, elCount(chExpectedText), "Verify Verify v_coreId_u8 is 2"); 
  
  TestStepAddActionExpected( chActionText, chExpectedText );  
  }
  
  A_DBGR_VariableRead("v_coreId_u8",coreID);
  if(coreID == 2)
  {
    write("core ID is : %d",coreID);
    break;
  }
  if(cnt == 0)
  {
  snprintf( chActionText, elCount(chActionText), "Run debugger "); 
  snprintf( chExpectedText, elCount(chExpectedText), "Run debugger "); 
  }
  testWaitForTimeout(1000);
  A_DBGR_Go();
  cnt =cnt+1;
 
  }
  cnt =0;
  A_DBGR_BreakpointDeleteAll();
  
   /***************************************************************************************************************/    
  	                            // Test Step 5 Set a breakpoint at line"v_crcSts_u8 = GetHWIO_e_CalcCRC_St();"" inside Test_hwcrc_llsi"
  /***************************************************************************************************************/
  snprintf( chActionText, elCount(chActionText), "Set Breakpoint in v_crcSts_u8 = GetHWIO_e_CalcCRC_St();"" inside Test_hwcrc_llsi "); 
  snprintf( chExpectedText, elCount(chExpectedText), "Verify Breakpoint is Set in v_crcSts_u8 = GetHWIO_e_CalcCRC_St();"" inside Test_hwcrc_llsi"); 
//  TestStepAddActionExpected( chActionText, chExpectedText );  
  A_DBGR_BreakpointSet("Test_hwcrc_llsi\\409");  

  A_DBGR_Go();
  
  snprintf( chActionText, elCount(chActionText), "Verify Breakpoint should hit in v_crcSts_u8 = GetHWIO_e_CalcCRC_St(); "); 
  snprintf( chExpectedText, elCount(chExpectedText), "Breakpoint hit in v_crcSts_u8 = GetHWIO_e_CalcCRC_St(); function"); 
  E_DBGR_BreakpointCheckForHalt("Test_hwcrc_llsi\\409");
  while(1)
  {
  if(cnt == 0)
  {
  snprintf( chActionText, elCount(chActionText), "Verify v_coreId_u8 is 2 "); 
  snprintf( chExpectedText, elCount(chExpectedText), "Verify Verify v_coreId_u8 is 2"); 
  
  TestStepAddActionExpected( chActionText, chExpectedText );  
  }
  
  A_DBGR_VariableRead("v_coreId_u8",coreID);
  if(coreID == 2)
  {
    write("core ID is : %d",coreID);
    break;
  }
  if(cnt == 0)
  {
  snprintf( chActionText, elCount(chActionText), "Run debugger "); 
  snprintf( chExpectedText, elCount(chExpectedText), "Run debugger "); 
  }
  testWaitForTimeout(1000);
  A_DBGR_Go();
  cnt =cnt+1;
 
  }
  cnt =0;
  E_DBGR_VariableCheck("v_crcSts_u8",3,Equal);
  
  snprintf( chActionText, elCount(chActionText), "Delete all breakpoints "); 
  snprintf( chExpectedText, elCount(chExpectedText), "Breakpoints deleted"); 
  TestStepAddActionExpected( chActionText, chExpectedText );
  A_DBGR_BreakpointDeleteAll();
  /***************************************************************************************************************/    
  	                            // Test Step 6 Set a breakpoint after the line"v_sigVal_u32 = GetHWIO_g_CalcCRC_Sig();"
  /***************************************************************************************************************/
  snprintf( chActionText, elCount(chActionText), "Set Breakpoint in v_crcSts_u8 = GetHWIO_e_CalcCRC_St();"" inside Test_hwcrc_llsi "); 
  snprintf( chExpectedText, elCount(chExpectedText), "Verify Breakpoint is Set in v_crcSts_u8 = GetHWIO_e_CalcCRC_St();"" inside Test_hwcrc_llsi"); 
//  TestStepAddActionExpected( chActionText, chExpectedText );  
  A_DBGR_BreakpointSet("Test_hwcrc_llsi\\421");  

  A_DBGR_Go();
  
  snprintf( chActionText, elCount(chActionText), "Verify Breakpoint should hit in v_crcSts_u8 = GetHWIO_e_CalcCRC_St(); "); 
  snprintf( chExpectedText, elCount(chExpectedText), "Breakpoint hit in v_crcSts_u8 = GetHWIO_e_CalcCRC_St(); function"); 
  E_DBGR_BreakpointCheckForHalt("Test_hwcrc_llsi\\421");
  while(1)
  {
  if(cnt == 0)
  {
  snprintf( chActionText, elCount(chActionText), "Verify v_coreId_u8 is 2 "); 
  snprintf( chExpectedText, elCount(chExpectedText), "Verify Verify v_coreId_u8 is 2"); 
  
  TestStepAddActionExpected( chActionText, chExpectedText );  
  }
  
  A_DBGR_VariableRead("v_coreId_u8",coreID);
  if(coreID == 2)
  {
    write("core ID is : %d",coreID);
    break;
  }
  if(cnt == 0)
  {
  snprintf( chActionText, elCount(chActionText), "Run debugger "); 
  snprintf( chExpectedText, elCount(chExpectedText), "Run debugger "); 
  }
  testWaitForTimeout(1000);
  A_DBGR_Go();
  cnt =cnt+1;
 
  }
  cnt =0;
  E_DBGR_VariableCheck("v_sigVal_u32",0,Equal);
  snprintf( chActionText, elCount(chActionText), "Delete all breakpoints "); 
  snprintf( chExpectedText, elCount(chExpectedText), "Breakpoints deleted"); 
  TestStepAddActionExpected( chActionText, chExpectedText );
  A_DBGR_BreakpointDeleteAll();
  /***************************************************************************************************************/    
  	                            // Test Step 7 Set a breakpoint at line"v_crcSts_u8 = GetHWIO_e_CalcCRC_St();"" inside Test_hwcrc_llsi"
  /***************************************************************************************************************/
  snprintf( chActionText, elCount(chActionText), "Set Breakpoint in v_crcSts_u8 = GetHWIO_e_CalcCRC_St();"" inside Test_hwcrc_llsi "); 
  snprintf( chExpectedText, elCount(chExpectedText), "Verify Breakpoint is Set in v_crcSts_u8 = GetHWIO_e_CalcCRC_St();"" inside Test_hwcrc_llsi"); 
//  TestStepAddActionExpected( chActionText, chExpectedText );  
  A_DBGR_BreakpointSet("Test_hwcrc_llsi\\432");  

  A_DBGR_Go();
  
  snprintf( chActionText, elCount(chActionText), "Verify Breakpoint should hit in v_crcSts_u8 = GetHWIO_e_CalcCRC_St(); "); 
  snprintf( chExpectedText, elCount(chExpectedText), "Breakpoint hit in v_crcSts_u8 = GetHWIO_e_CalcCRC_St(); function"); 
  E_DBGR_BreakpointCheckForHalt("Test_hwcrc_llsi\\432");
  while(1)
  {
  if(cnt == 0)
  {
  snprintf( chActionText, elCount(chActionText), "Verify v_coreId_u8 is 2 "); 
  snprintf( chExpectedText, elCount(chExpectedText), "Verify Verify v_coreId_u8 is 2"); 
  
  TestStepAddActionExpected( chActionText, chExpectedText );  
  }
  
  A_DBGR_VariableRead("v_coreId_u8",coreID);
  if(coreID == 2)
  {
    write("core ID is : %d",coreID);
    break;
  }
  if(cnt == 0)
  {
  snprintf( chActionText, elCount(chActionText), "Run debugger "); 
  snprintf( chExpectedText, elCount(chExpectedText), "Run debugger "); 
  }
  testWaitForTimeout(1000);
  A_DBGR_Go();
  cnt =cnt+1;
 
  }
  cnt =0;
  E_DBGR_VariableCheck("v_crcSts_u8",0,Equal);
}

testcase Verify_Hardware_CRC32_Calculation_Invalid_End_Address_Failure_Reporting_Core_3()
{
  /***************************************************************************************************************/    
                                                // Variable Definition
  /***************************************************************************************************************/ 
  

  
  /***************************************************************************************************************/    
                                               // Local Values
  /***************************************************************************************************************/ 
  

  
  /***************************************************************************************************************/    
                                              // Test Case Info
  /***************************************************************************************************************/
  setWriteDbgLevel(DebugOff);
  snprintf( chTestTitle, elCount(chTestTitle), "Verify_Hardware_CRC32_Calculation_Invalid_End_Address_Failure_Reporting_Core_3" );
  snprintf( chTestDescription, elCount(chTestDescription), "Purpose:To check the GetHWIO_e_CalcCRC_St(); interface  ");
  TestCaseAddInfo( chTestTitle, "TC_L30SW_Q-37079853", chTestDescription );

  /***************************************************************************************************************/    
                                              // Start of Test Case
  /***************************************************************************************************************/
  
  /***************************************************************************************************************/    
                                              // Test Step 0 PRECONDITIONS
  /***************************************************************************************************************/
  snprintf( chActionText, elCount(chActionText), "Flash the Software and ECU is running "); 
  snprintf( chExpectedText, elCount(chExpectedText), "Ecu is should be in running state"); 
  TestStepAddActionExpected( chActionText, chExpectedText );
  
  A_DBGR_BreakpointDeleteAll();
  A_DBGR_R();
  A_DBGR_Go(); 

  /***************************************************************************************************************/    
                                              // Test Step 1 Set breakpoint in line Test_hwcrc_llsi(); inside "TestApp_Core3_10ms_MainFunction" function and inside testapp.c file
  /***************************************************************************************************************/
  snprintf( chActionText, elCount(chActionText), "Set Breakpoint in Test_hwcrc_llsi(); "); 
  snprintf( chExpectedText, elCount(chExpectedText), "Verify Breakpoint is Set in Test_hwcrc_llsi();"); 
  //TestStepAddActionExpected( chActionText, chExpectedText );  
  A_DBGR_BreakpointSet("TestApp_Core3_10ms_MainFunction\\35");  

  A_DBGR_Go();
  
  snprintf( chActionText, elCount(chActionText), "Verify Breakpoint should hit in Test_hwcrc_llsi(); "); 
  snprintf( chExpectedText, elCount(chExpectedText), "Breakpoint hit in Test_hwcrc_llsi(); function"); 
  E_DBGR_BreakpointCheckForHalt("TestApp_Core3_10ms_MainFunction\\35");
  
  testWaitForTimeout(2000);
  
  snprintf( chActionText, elCount(chActionText), "Delete all breakpoints "); 
  snprintf( chExpectedText, elCount(chExpectedText), "Breakpoints deleted"); 
  TestStepAddActionExpected( chActionText, chExpectedText );
  
  A_DBGR_BreakpointDeleteAll();
   
  /***************************************************************************************************************/    
  	                            // Test Step 2 Set a breakpoint at "v_coreId_u8 = (BYTE)GetCoreID();" inside "Test_hwcrc_llsi" function
  /***************************************************************************************************************/
  
  snprintf( chActionText, elCount(chActionText), "Set Breakpoint in v_coreId_u8 = (BYTE)GetCoreID(); "); 
  snprintf( chExpectedText, elCount(chExpectedText), "Verify Breakpoint is Set in v_coreId_u8 = (BYTE)GetCoreID();"); 
  //TestStepAddActionExpected( chActionText, chExpectedText );  
  A_DBGR_BreakpointSet("Test_hwcrc_llsi\\392");  

  A_DBGR_Go();
  
  snprintf( chActionText, elCount(chActionText), "Verify Breakpoint should hit in v_coreId_u8 = (BYTE)GetCoreID(); "); 
  snprintf( chExpectedText, elCount(chExpectedText), "Breakpoint hit in v_coreId_u8 = (BYTE)GetCoreID(); function"); 
  E_DBGR_BreakpointCheckForHalt("Test_hwcrc_llsi\\392");
  
  /***************************************************************************************************************/    
  	                            // Test Step 3 Verify v_coreId_u8 in trace32 watch window
  /***************************************************************************************************************/
  
   while(1)
  {
  if(cnt == 0)
  {
  snprintf( chActionText, elCount(chActionText), "Verify v_coreId_u8 is 3 "); 
  snprintf( chExpectedText, elCount(chExpectedText), "Verify Verify v_coreId_u8 is 3"); 
  
  TestStepAddActionExpected( chActionText, chExpectedText );  
  }
  
  A_DBGR_VariableRead("v_coreId_u8",coreID);
  if(coreID == 3)
  {
    break;
  }
  if(cnt == 0)
  {
  snprintf( chActionText, elCount(chActionText), "Run debugger "); 
  snprintf( chExpectedText, elCount(chExpectedText), "Run debugger "); 
  }
  A_DBGR_Go();
  testWaitForTimeout(5000);
  cnt =cnt+1;
  }
  E_DBGR_VariableCheck("v_crcSts_u8",0,Equal);
  cnt =0;
  snprintf( chActionText, elCount(chActionText), "delete all breakpoints "); 
  snprintf( chExpectedText, elCount(chExpectedText), "delete all breakpoints "); 
  TestStepAddActionExpected( chActionText, chExpectedText );
  A_DBGR_BreakpointDeleteAll();
  /***************************************************************************************************************/    
  	                            // Test Step 4 Set a breakpoint at line"PerfmHWIO_h_CalcCRC ((BYTE)test_HwCrc_CRC32_ethernet_E, v_seed_u32, v_startAddr_u8, v_endAddr_u8);"
  /***************************************************************************************************************/
  snprintf( chActionText, elCount(chActionText), "Set Breakpoint inPerfmHWIO_h_CalcCRC ((BYTE)test_HwCrc_CRC32_ethernet_E, v_seed_u32, v_startAddr_u8, v_endAddr_u8); "); 
  snprintf( chExpectedText, elCount(chExpectedText), "Verify Breakpoint is Set in PerfmHWIO_h_CalcCRC ((BYTE)test_HwCrc_CRC32_ethernet_E, v_seed_u32, v_startAddr_u8, v_endAddr_u8);"); 
  //TestStepAddActionExpected( chActionText, chExpectedText );  
  A_DBGR_BreakpointSet("Test_hwcrc_llsi\\407");  

  A_DBGR_Go();
  
  snprintf( chActionText, elCount(chActionText), "Verify Breakpoint should hit in v_crcSts_u8 = GetHWIO_e_CalcCRC_St(); "); 
  snprintf( chExpectedText, elCount(chExpectedText), "Breakpoint hit in v_crcSts_u8 = GetHWIO_e_CalcCRC_St(); function"); 
  E_DBGR_BreakpointCheckForHalt("Test_hwcrc_llsi\\407");
  
  while(1)
  {
  if(cnt == 0)
  {
  snprintf( chActionText, elCount(chActionText), "Verify v_coreId_u8 is 3 "); 
  snprintf( chExpectedText, elCount(chExpectedText), "Verify Verify v_coreId_u8 is 3"); 
  
  TestStepAddActionExpected( chActionText, chExpectedText );  
  }
  
  A_DBGR_VariableRead("v_coreId_u8",coreID);
  if(coreID == 3)
  {
    write("core ID is : %d",coreID);
    break;
  }
  if(cnt == 0)
  {
  snprintf( chActionText, elCount(chActionText), "Run debugger "); 
  snprintf( chExpectedText, elCount(chExpectedText), "Run debugger "); 
  }
  testWaitForTimeout(3000);
  A_DBGR_Go();
  cnt =cnt+1;
 
  }
  cnt =0;
  A_DBGR_BreakpointDeleteAll();
  
   /***************************************************************************************************************/    
  	                            // Test Step 5 Set a breakpoint at line"v_crcSts_u8 = GetHWIO_e_CalcCRC_St();"" inside Test_hwcrc_llsi"
  /***************************************************************************************************************/
  snprintf( chActionText, elCount(chActionText), "Set Breakpoint in v_crcSts_u8 = GetHWIO_e_CalcCRC_St();"" inside Test_hwcrc_llsi "); 
  snprintf( chExpectedText, elCount(chExpectedText), "Verify Breakpoint is Set in v_crcSts_u8 = GetHWIO_e_CalcCRC_St();"" inside Test_hwcrc_llsi"); 
//  TestStepAddActionExpected( chActionText, chExpectedText );  
  A_DBGR_BreakpointSet("Test_hwcrc_llsi\\409");  

  A_DBGR_Go();
  
  snprintf( chActionText, elCount(chActionText), "Verify Breakpoint should hit in v_crcSts_u8 = GetHWIO_e_CalcCRC_St(); "); 
  snprintf( chExpectedText, elCount(chExpectedText), "Breakpoint hit in v_crcSts_u8 = GetHWIO_e_CalcCRC_St(); function"); 
  E_DBGR_BreakpointCheckForHalt("Test_hwcrc_llsi\\409");
  while(1)
  {
  if(cnt == 0)
  {
  snprintf( chActionText, elCount(chActionText), "Verify v_coreId_u8 is 3 "); 
  snprintf( chExpectedText, elCount(chExpectedText), "Verify Verify v_coreId_u8 is 3"); 
  
  TestStepAddActionExpected( chActionText, chExpectedText );  
  }
  
  A_DBGR_VariableRead("v_coreId_u8",coreID);
  if(coreID == 3)
  {
    write("core ID is : %d",coreID);
    break;
  }
  if(cnt == 0)
  {
  snprintf( chActionText, elCount(chActionText), "Run debugger "); 
  snprintf( chExpectedText, elCount(chExpectedText), "Run debugger "); 
  }
  testWaitForTimeout(2000);
  A_DBGR_Go();
  cnt =cnt+1;
 
  }
  cnt =0;
  E_DBGR_VariableCheck("v_crcSts_u8",3,Equal);
  
  snprintf( chActionText, elCount(chActionText), "Delete all breakpoints "); 
  snprintf( chExpectedText, elCount(chExpectedText), "Breakpoints deleted"); 
  TestStepAddActionExpected( chActionText, chExpectedText );
  A_DBGR_BreakpointDeleteAll();
  /***************************************************************************************************************/    
  	                            // Test Step 6 Set a breakpoint after the line"v_sigVal_u32 = GetHWIO_g_CalcCRC_Sig();"
  /***************************************************************************************************************/
  snprintf( chActionText, elCount(chActionText), "Set Breakpoint in v_crcSts_u8 = GetHWIO_e_CalcCRC_St();"" inside Test_hwcrc_llsi "); 
  snprintf( chExpectedText, elCount(chExpectedText), "Verify Breakpoint is Set in v_crcSts_u8 = GetHWIO_e_CalcCRC_St();"" inside Test_hwcrc_llsi"); 
//  TestStepAddActionExpected( chActionText, chExpectedText );  
  A_DBGR_BreakpointSet("Test_hwcrc_llsi\\421");  

  A_DBGR_Go();
  
  snprintf( chActionText, elCount(chActionText), "Verify Breakpoint should hit in v_crcSts_u8 = GetHWIO_e_CalcCRC_St(); "); 
  snprintf( chExpectedText, elCount(chExpectedText), "Breakpoint hit in v_crcSts_u8 = GetHWIO_e_CalcCRC_St(); function"); 
  E_DBGR_BreakpointCheckForHalt("Test_hwcrc_llsi\\421");
  while(1)
  {
  if(cnt == 0)
  {
  snprintf( chActionText, elCount(chActionText), "Verify v_coreId_u8 is 3 "); 
  snprintf( chExpectedText, elCount(chExpectedText), "Verify Verify v_coreId_u8 is 3"); 
  
  TestStepAddActionExpected( chActionText, chExpectedText );  
  }
  
  A_DBGR_VariableRead("v_coreId_u8",coreID);
  if(coreID == 3)
  {
    write("core ID is : %d",coreID);
    break;
  }
  if(cnt == 0)
  {
  snprintf( chActionText, elCount(chActionText), "Run debugger "); 
  snprintf( chExpectedText, elCount(chExpectedText), "Run debugger "); 
  }
  testWaitForTimeout(1000);
  A_DBGR_Go();
  cnt =cnt+1;
 
  }
  cnt =0;
  E_DBGR_VariableCheck("v_sigVal_u32",0,Equal);
  snprintf( chActionText, elCount(chActionText), "Delete all breakpoints "); 
  snprintf( chExpectedText, elCount(chExpectedText), "Breakpoints deleted"); 
  TestStepAddActionExpected( chActionText, chExpectedText );
  A_DBGR_BreakpointDeleteAll();
  /***************************************************************************************************************/    
  	                            // Test Step 7 Set a breakpoint at line"v_crcSts_u8 = GetHWIO_e_CalcCRC_St();"" inside Test_hwcrc_llsi"
  /***************************************************************************************************************/
  snprintf( chActionText, elCount(chActionText), "Set Breakpoint in v_crcSts_u8 = GetHWIO_e_CalcCRC_St();"" inside Test_hwcrc_llsi "); 
  snprintf( chExpectedText, elCount(chExpectedText), "Verify Breakpoint is Set in v_crcSts_u8 = GetHWIO_e_CalcCRC_St();"" inside Test_hwcrc_llsi"); 
//  TestStepAddActionExpected( chActionText, chExpectedText );  
  A_DBGR_BreakpointSet("Test_hwcrc_llsi\\432");  

  A_DBGR_Go();
  
  snprintf( chActionText, elCount(chActionText), "Verify Breakpoint should hit in v_crcSts_u8 = GetHWIO_e_CalcCRC_St(); "); 
  snprintf( chExpectedText, elCount(chExpectedText), "Breakpoint hit in v_crcSts_u8 = GetHWIO_e_CalcCRC_St(); function"); 
  E_DBGR_BreakpointCheckForHalt("Test_hwcrc_llsi\\432");
  while(1)
  {
  if(cnt == 0)
  {
  snprintf( chActionText, elCount(chActionText), "Verify v_coreId_u8 is 3 "); 
  snprintf( chExpectedText, elCount(chExpectedText), "Verify Verify v_coreId_u8 is 3"); 
  
  TestStepAddActionExpected( chActionText, chExpectedText );  
  }
  
  A_DBGR_VariableRead("v_coreId_u8",coreID);
  if(coreID == 3)
  {
    write("core ID is : %d",coreID);
    break;
  }
  if(cnt == 0)
  {
  snprintf( chActionText, elCount(chActionText), "Run debugger "); 
  snprintf( chExpectedText, elCount(chExpectedText), "Run debugger "); 
  }
  testWaitForTimeout(1000);
  A_DBGR_Go();
  cnt =cnt+1;
 
  }
  cnt =0;
  E_DBGR_VariableCheck("v_crcSts_u8",0,Equal);
}

testcase Verify_Hardware_CRC32_Calculation_Invalid_End_Address_Failure_Reporting_Core_4()
{
  /***************************************************************************************************************/    
                                                // Variable Definition
  /***************************************************************************************************************/ 
  

  
  /***************************************************************************************************************/    
                                               // Local Values
  /***************************************************************************************************************/ 
  

  
  /***************************************************************************************************************/    
                                              // Test Case Info
  /***************************************************************************************************************/
  setWriteDbgLevel(DebugOff);
  snprintf( chTestTitle, elCount(chTestTitle), "Verify_Hardware_CRC32_Calculation_Invalid_End_Address_Failure_Reporting_Core_4" );
  snprintf( chTestDescription, elCount(chTestDescription), "Purpose:To check the GetHWIO_e_CalcCRC_St(); interface  ");
  TestCaseAddInfo( chTestTitle, "TC_L30SW_Q-37079858", chTestDescription );

  /***************************************************************************************************************/    
                                              // Start of Test Case
  /***************************************************************************************************************/
  
  /***************************************************************************************************************/    
                                              // Test Step 0 PRECONDITIONS
  /***************************************************************************************************************/
  snprintf( chActionText, elCount(chActionText), "Flash the Software and ECU is running "); 
  snprintf( chExpectedText, elCount(chExpectedText), "Ecu is should be in running state"); 
  TestStepAddActionExpected( chActionText, chExpectedText );
  
  A_DBGR_BreakpointDeleteAll();
  A_DBGR_R();
  A_DBGR_Go(); 

  /***************************************************************************************************************/    
                                              // Test Step 1 Set breakpoint in line Test_hwcrc_llsi(); inside "TestApp_Core4_1000ms_MainFunction" function and inside testapp.c file
  /***************************************************************************************************************/
  snprintf( chActionText, elCount(chActionText), "Set Breakpoint in Test_hwcrc_llsi(); "); 
  snprintf( chExpectedText, elCount(chExpectedText), "Verify Breakpoint is Set in Test_hwcrc_llsi();"); 
  //TestStepAddActionExpected( chActionText, chExpectedText );  
  A_DBGR_BreakpointSet("TestApp_Core4_1000ms_MainFunction\\65");  

  A_DBGR_Go();
  
  snprintf( chActionText, elCount(chActionText), "Verify Breakpoint should hit in Test_hwcrc_llsi(); "); 
  snprintf( chExpectedText, elCount(chExpectedText), "Breakpoint hit in Test_hwcrc_llsi(); function"); 
  E_DBGR_BreakpointCheckForHalt("TestApp_Core4_1000ms_MainFunction\\65");
  
  testWaitForTimeout(2000);
  
  snprintf( chActionText, elCount(chActionText), "Delete all breakpoints "); 
  snprintf( chExpectedText, elCount(chExpectedText), "Breakpoints deleted"); 
  TestStepAddActionExpected( chActionText, chExpectedText );
  
  A_DBGR_BreakpointDeleteAll();
  
  /***************************************************************************************************************/    
  	                            // Test Step 2 Set a breakpoint at "v_coreId_u8 = (BYTE)GetCoreID();" inside "Test_hwcrc_llsi" function
  /***************************************************************************************************************/
  
  snprintf( chActionText, elCount(chActionText), "Set Breakpoint in v_coreId_u8 = (BYTE)GetCoreID(); "); 
  snprintf( chExpectedText, elCount(chExpectedText), "Verify Breakpoint is Set in v_coreId_u8 = (BYTE)GetCoreID();"); 
  //TestStepAddActionExpected( chActionText, chExpectedText );  
  A_DBGR_BreakpointSet("Test_hwcrc_llsi\\392");  

  A_DBGR_Go();
  
  snprintf( chActionText, elCount(chActionText), "Verify Breakpoint should hit in v_coreId_u8 = (BYTE)GetCoreID(); "); 
  snprintf( chExpectedText, elCount(chExpectedText), "Breakpoint hit in v_coreId_u8 = (BYTE)GetCoreID(); function"); 
  E_DBGR_BreakpointCheckForHalt("Test_hwcrc_llsi\\392");
  
  /***************************************************************************************************************/    
  	                            // Test Step 3 Verify v_coreId_u8 in trace32 watch window
  /***************************************************************************************************************/
  
   while(1)
  {
  if(cnt == 0)
  {
  snprintf( chActionText, elCount(chActionText), "Verify v_coreId_u8 is 4 "); 
  snprintf( chExpectedText, elCount(chExpectedText), "Verify Verify v_coreId_u8 is 4"); 
  
  TestStepAddActionExpected( chActionText, chExpectedText );  
  }
  
  A_DBGR_VariableRead("v_coreId_u8",coreID);
  if(coreID == 4)
  {
    break;
  }
  if(cnt == 0)
  {
  snprintf( chActionText, elCount(chActionText), "Run debugger "); 
  snprintf( chExpectedText, elCount(chExpectedText), "Run debugger "); 
  }
  A_DBGR_Go();
  testWaitForTimeout(30000);
  cnt =cnt+1;
  }
  E_DBGR_VariableCheck("v_crcSts_u8",0,Equal);
  cnt =0;
  snprintf( chActionText, elCount(chActionText), "delete all breakpoints "); 
  snprintf( chExpectedText, elCount(chExpectedText), "delete all breakpoints "); 
  TestStepAddActionExpected( chActionText, chExpectedText );
  A_DBGR_BreakpointDeleteAll();
  /***************************************************************************************************************/    
  	                            // Test Step 4 Set a breakpoint at line"PerfmHWIO_h_CalcCRC ((BYTE)test_HwCrc_CRC32_ethernet_E, v_seed_u32, v_startAddr_u8, v_endAddr_u8);"
  /***************************************************************************************************************/
  snprintf( chActionText, elCount(chActionText), "Set Breakpoint inPerfmHWIO_h_CalcCRC ((BYTE)test_HwCrc_CRC32_ethernet_E, v_seed_u32, v_startAddr_u8, v_endAddr_u8); "); 
  snprintf( chExpectedText, elCount(chExpectedText), "Verify Breakpoint is Set in PerfmHWIO_h_CalcCRC ((BYTE)test_HwCrc_CRC32_ethernet_E, v_seed_u32, v_startAddr_u8, v_endAddr_u8);"); 
  //TestStepAddActionExpected( chActionText, chExpectedText );  
  A_DBGR_BreakpointSet("Test_hwcrc_llsi\\407");  

  A_DBGR_Go();
  testWaitForTimeout(5000);
  snprintf( chActionText, elCount(chActionText), "Verify Breakpoint should hit in v_crcSts_u8 = GetHWIO_e_CalcCRC_St(); "); 
  snprintf( chExpectedText, elCount(chExpectedText), "Breakpoint hit in v_crcSts_u8 = GetHWIO_e_CalcCRC_St(); function"); 
  E_DBGR_BreakpointCheckForHalt("Test_hwcrc_llsi\\407");
  
  while(1)
  {
  if(cnt == 0)
  {
  snprintf( chActionText, elCount(chActionText), "Verify v_coreId_u8 is 4 "); 
  snprintf( chExpectedText, elCount(chExpectedText), "Verify Verify v_coreId_u8 is 4"); 
  
  TestStepAddActionExpected( chActionText, chExpectedText );  
  }
  
  A_DBGR_VariableRead("v_coreId_u8",coreID);
  if(coreID == 4)
  {
    write("core ID is : %d",coreID);
    break;
  }
  if(cnt == 0)
  {
  snprintf( chActionText, elCount(chActionText), "Run debugger "); 
  snprintf( chExpectedText, elCount(chExpectedText), "Run debugger "); 
  }
  testWaitForTimeout(7000);
  A_DBGR_Go();
  cnt =cnt+1;
 
  }
  cnt =0;
  A_DBGR_BreakpointDeleteAll();
  
   /***************************************************************************************************************/    
  	                            // Test Step 5 Set a breakpoint at line"v_crcSts_u8 = GetHWIO_e_CalcCRC_St();"" inside Test_hwcrc_llsi"
  /***************************************************************************************************************/
  snprintf( chActionText, elCount(chActionText), "Set Breakpoint in v_crcSts_u8 = GetHWIO_e_CalcCRC_St();"" inside Test_hwcrc_llsi "); 
  snprintf( chExpectedText, elCount(chExpectedText), "Verify Breakpoint is Set in v_crcSts_u8 = GetHWIO_e_CalcCRC_St();"" inside Test_hwcrc_llsi"); 
//  TestStepAddActionExpected( chActionText, chExpectedText );  
  A_DBGR_BreakpointSet("Test_hwcrc_llsi\\409");  

  A_DBGR_Go();
  
  snprintf( chActionText, elCount(chActionText), "Verify Breakpoint should hit in v_crcSts_u8 = GetHWIO_e_CalcCRC_St(); "); 
  snprintf( chExpectedText, elCount(chExpectedText), "Breakpoint hit in v_crcSts_u8 = GetHWIO_e_CalcCRC_St(); function"); 
  E_DBGR_BreakpointCheckForHalt("Test_hwcrc_llsi\\409");
  while(1)
  {
  if(cnt == 0)
  {
  snprintf( chActionText, elCount(chActionText), "Verify v_coreId_u8 is 4 "); 
  snprintf( chExpectedText, elCount(chExpectedText), "Verify Verify v_coreId_u8 is 4"); 
  
  TestStepAddActionExpected( chActionText, chExpectedText );  
  }
  
  A_DBGR_VariableRead("v_coreId_u8",coreID);
  if(coreID == 4)
  {
    write("core ID is : %d",coreID);
    break;
  }
  if(cnt == 0)
  {
  snprintf( chActionText, elCount(chActionText), "Run debugger "); 
  snprintf( chExpectedText, elCount(chExpectedText), "Run debugger "); 
  }
  testWaitForTimeout(1000);
  A_DBGR_Go();
  cnt =cnt+1;
 
  }
  cnt =0;
  E_DBGR_VariableCheck("v_crcSts_u8",3,Equal);
  
  snprintf( chActionText, elCount(chActionText), "Delete all breakpoints "); 
  snprintf( chExpectedText, elCount(chExpectedText), "Breakpoints deleted"); 
  TestStepAddActionExpected( chActionText, chExpectedText );
  A_DBGR_BreakpointDeleteAll();
  /***************************************************************************************************************/    
  	                            // Test Step 6 Set a breakpoint after the line"v_sigVal_u32 = GetHWIO_g_CalcCRC_Sig();"
  /***************************************************************************************************************/
  snprintf( chActionText, elCount(chActionText), "Set Breakpoint in v_crcSts_u8 = GetHWIO_e_CalcCRC_St();"" inside Test_hwcrc_llsi "); 
  snprintf( chExpectedText, elCount(chExpectedText), "Verify Breakpoint is Set in v_crcSts_u8 = GetHWIO_e_CalcCRC_St();"" inside Test_hwcrc_llsi"); 
//  TestStepAddActionExpected( chActionText, chExpectedText );  
  A_DBGR_BreakpointSet("Test_hwcrc_llsi\\421");  

  A_DBGR_Go();
  
  snprintf( chActionText, elCount(chActionText), "Verify Breakpoint should hit in v_crcSts_u8 = GetHWIO_e_CalcCRC_St(); "); 
  snprintf( chExpectedText, elCount(chExpectedText), "Breakpoint hit in v_crcSts_u8 = GetHWIO_e_CalcCRC_St(); function"); 
  E_DBGR_BreakpointCheckForHalt("Test_hwcrc_llsi\\421");
  while(1)
  {
  if(cnt == 0)
  {
  snprintf( chActionText, elCount(chActionText), "Verify v_coreId_u8 is 4 "); 
  snprintf( chExpectedText, elCount(chExpectedText), "Verify Verify v_coreId_u8 is 4"); 
  
  TestStepAddActionExpected( chActionText, chExpectedText );  
  }
  
  A_DBGR_VariableRead("v_coreId_u8",coreID);
  if(coreID == 4)
  {
    write("core ID is : %d",coreID);
    break;
  }
  if(cnt == 0)
  {
  snprintf( chActionText, elCount(chActionText), "Run debugger "); 
  snprintf( chExpectedText, elCount(chExpectedText), "Run debugger "); 
  }
  testWaitForTimeout(1000);
  A_DBGR_Go();
  cnt =cnt+1;
 
  }
  cnt =0;
  E_DBGR_VariableCheck("v_sigVal_u32",0,Equal);
  snprintf( chActionText, elCount(chActionText), "Delete all breakpoints "); 
  snprintf( chExpectedText, elCount(chExpectedText), "Breakpoints deleted"); 
  TestStepAddActionExpected( chActionText, chExpectedText );
  A_DBGR_BreakpointDeleteAll();
  /***************************************************************************************************************/    
  	                            // Test Step 7 Set a breakpoint at line"v_crcSts_u8 = GetHWIO_e_CalcCRC_St();"" inside Test_hwcrc_llsi"
  /***************************************************************************************************************/
  snprintf( chActionText, elCount(chActionText), "Set Breakpoint in v_crcSts_u8 = GetHWIO_e_CalcCRC_St();"" inside Test_hwcrc_llsi "); 
  snprintf( chExpectedText, elCount(chExpectedText), "Verify Breakpoint is Set in v_crcSts_u8 = GetHWIO_e_CalcCRC_St();"" inside Test_hwcrc_llsi"); 
//  TestStepAddActionExpected( chActionText, chExpectedText );  
  A_DBGR_BreakpointSet("Test_hwcrc_llsi\\432");  

  A_DBGR_Go();
  
  snprintf( chActionText, elCount(chActionText), "Verify Breakpoint should hit in v_crcSts_u8 = GetHWIO_e_CalcCRC_St(); "); 
  snprintf( chExpectedText, elCount(chExpectedText), "Breakpoint hit in v_crcSts_u8 = GetHWIO_e_CalcCRC_St(); function"); 
  E_DBGR_BreakpointCheckForHalt("Test_hwcrc_llsi\\432");
  while(1)
  {
  if(cnt == 0)
  {
  snprintf( chActionText, elCount(chActionText), "Verify v_coreId_u8 is 4 "); 
  snprintf( chExpectedText, elCount(chExpectedText), "Verify Verify v_coreId_u8 is 4"); 
  
  TestStepAddActionExpected( chActionText, chExpectedText );  
  }
  
  A_DBGR_VariableRead("v_coreId_u8",coreID);
  if(coreID == 4)
  {
    write("core ID is : %d",coreID);
    break;
  }
  if(cnt == 0)
  {
  snprintf( chActionText, elCount(chActionText), "Run debugger "); 
  snprintf( chExpectedText, elCount(chExpectedText), "Run debugger "); 
  }
  testWaitForTimeout(1000);
  A_DBGR_Go();
  cnt =cnt+1;
 
  }
  cnt =0;
  E_DBGR_VariableCheck("v_crcSts_u8",0,Equal);
}

testcase Verify_Hardware_CRC32_Calculation_Invalid_End_Address_Failure_Reporting_Core_5()
{
  /***************************************************************************************************************/    
                                                // Variable Definition
  /***************************************************************************************************************/ 
  

  
  /***************************************************************************************************************/    
                                               // Local Values
  /***************************************************************************************************************/ 
  

  
  /***************************************************************************************************************/    
                                              // Test Case Info
  /***************************************************************************************************************/
  setWriteDbgLevel(DebugOff);
  snprintf( chTestTitle, elCount(chTestTitle), "Verify_Hardware_CRC32_Calculation_Invalid_End_Address_Failure_Reporting_Core_5" );
  snprintf( chTestDescription, elCount(chTestDescription), "Purpose:To check the GetHWIO_e_CalcCRC_St(); interface  ");
  TestCaseAddInfo( chTestTitle, "TC_L30SW_Q-37079863", chTestDescription );

  /***************************************************************************************************************/    
                                              // Start of Test Case
  /***************************************************************************************************************/
  
  /***************************************************************************************************************/    
                                              // Test Step 0 PRECONDITIONS
  /***************************************************************************************************************/
  snprintf( chActionText, elCount(chActionText), "Flash the Software and ECU is running "); 
  snprintf( chExpectedText, elCount(chExpectedText), "Ecu is should be in running state"); 
  TestStepAddActionExpected( chActionText, chExpectedText );
  
  A_DBGR_BreakpointDeleteAll();
  A_DBGR_R();
  A_DBGR_Go(); 

  /***************************************************************************************************************/    
                                              // Test Step 1 Set breakpoint in line Test_hwcrc_llsi(); inside "TestApp_Core5_1000ms_MainFunction" function and inside testapp.c file
  /***************************************************************************************************************/
  snprintf( chActionText, elCount(chActionText), "Set Breakpoint in Test_hwcrc_llsi(); "); 
  snprintf( chExpectedText, elCount(chExpectedText), "Verify Breakpoint is Set in Test_hwcrc_llsi();"); 
  //TestStepAddActionExpected( chActionText, chExpectedText );  
  A_DBGR_BreakpointSet("TestApp_Core5_1000ms_MainFunction\\54");  

  A_DBGR_Go();
  
  snprintf( chActionText, elCount(chActionText), "Verify Breakpoint should hit in Test_hwcrc_llsi(); "); 
  snprintf( chExpectedText, elCount(chExpectedText), "Breakpoint hit in Test_hwcrc_llsi(); function"); 
  E_DBGR_BreakpointCheckForHalt("TestApp_Core5_1000ms_MainFunction\\54");
  
  testWaitForTimeout(2000);
  
  snprintf( chActionText, elCount(chActionText), "Delete all breakpoints "); 
  snprintf( chExpectedText, elCount(chExpectedText), "Breakpoints deleted"); 
  TestStepAddActionExpected( chActionText, chExpectedText );
  
  A_DBGR_BreakpointDeleteAll();  
  /***************************************************************************************************************/    
  	                            // Test Step 2 Set a breakpoint at "v_coreId_u8 = (BYTE)GetCoreID();" inside "Test_hwcrc_llsi" function
  /***************************************************************************************************************/
  
  snprintf( chActionText, elCount(chActionText), "Set Breakpoint in v_coreId_u8 = (BYTE)GetCoreID(); "); 
  snprintf( chExpectedText, elCount(chExpectedText), "Verify Breakpoint is Set in v_coreId_u8 = (BYTE)GetCoreID();"); 
  //TestStepAddActionExpected( chActionText, chExpectedText );  
  A_DBGR_BreakpointSet("Test_hwcrc_llsi\\392");  

  A_DBGR_Go();
  
  snprintf( chActionText, elCount(chActionText), "Verify Breakpoint should hit in v_coreId_u8 = (BYTE)GetCoreID(); "); 
  snprintf( chExpectedText, elCount(chExpectedText), "Breakpoint hit in v_coreId_u8 = (BYTE)GetCoreID(); function"); 
  E_DBGR_BreakpointCheckForHalt("Test_hwcrc_llsi\\392");
  
  /***************************************************************************************************************/    
  	                            // Test Step 3 Verify v_coreId_u8 in trace32 watch window
  /***************************************************************************************************************/
  
   while(1)
  {
  if(cnt == 0)
  {
  snprintf( chActionText, elCount(chActionText), "Verify v_coreId_u8 is 5 "); 
  snprintf( chExpectedText, elCount(chExpectedText), "Verify Verify v_coreId_u8 is 5"); 
  
  TestStepAddActionExpected( chActionText, chExpectedText );  
  }
  
  A_DBGR_VariableRead("v_coreId_u8",coreID);
  if(coreID == 5)
  {
    break;
  }
  if(cnt == 0)
  {
  snprintf( chActionText, elCount(chActionText), "Run debugger "); 
  snprintf( chExpectedText, elCount(chExpectedText), "Run debugger "); 
  }
  A_DBGR_Go();
  testWaitForTimeout(30000);
  
  cnt =cnt+1;
  }
  E_DBGR_VariableCheck("v_crcSts_u8",0,Equal);
  cnt =0;
  snprintf( chActionText, elCount(chActionText), "delete all breakpoints "); 
  snprintf( chExpectedText, elCount(chExpectedText), "delete all breakpoints "); 
  TestStepAddActionExpected( chActionText, chExpectedText );
  A_DBGR_BreakpointDeleteAll();
  /***************************************************************************************************************/    
  	                            // Test Step 4 Set a breakpoint at line"PerfmHWIO_h_CalcCRC ((BYTE)test_HwCrc_CRC32_ethernet_E, v_seed_u32, v_startAddr_u8, v_endAddr_u8);"
  /***************************************************************************************************************/
  snprintf( chActionText, elCount(chActionText), "Set Breakpoint inPerfmHWIO_h_CalcCRC ((BYTE)test_HwCrc_CRC32_ethernet_E, v_seed_u32, v_startAddr_u8, v_endAddr_u8); "); 
  snprintf( chExpectedText, elCount(chExpectedText), "Verify Breakpoint is Set in PerfmHWIO_h_CalcCRC ((BYTE)test_HwCrc_CRC32_ethernet_E, v_seed_u32, v_startAddr_u8, v_endAddr_u8);"); 
  //TestStepAddActionExpected( chActionText, chExpectedText );  
  A_DBGR_BreakpointSet("Test_hwcrc_llsi\\407");  

  A_DBGR_Go();
  testWaitForTimeout(6000);
  snprintf( chActionText, elCount(chActionText), "Verify Breakpoint should hit in v_crcSts_u8 = GetHWIO_e_CalcCRC_St(); "); 
  snprintf( chExpectedText, elCount(chExpectedText), "Breakpoint hit in v_crcSts_u8 = GetHWIO_e_CalcCRC_St(); function"); 
  E_DBGR_BreakpointCheckForHalt("Test_hwcrc_llsi\\407");
  
  while(1)
  {
  if(cnt == 0)
  {
  snprintf( chActionText, elCount(chActionText), "Verify v_coreId_u8 is 5 "); 
  snprintf( chExpectedText, elCount(chExpectedText), "Verify Verify v_coreId_u8 is 5"); 
  
  TestStepAddActionExpected( chActionText, chExpectedText );  
  }
  
  A_DBGR_VariableRead("v_coreId_u8",coreID);
  if(coreID == 5)
  {
    write("core ID is : %d",coreID);
    break;
  }
  if(cnt == 0)
  {
  snprintf( chActionText, elCount(chActionText), "Run debugger "); 
  snprintf( chExpectedText, elCount(chExpectedText), "Run debugger "); 
  }
  testWaitForTimeout(2000);
  A_DBGR_Go();
  cnt =cnt+1;
 
  }
  cnt =0;
  A_DBGR_BreakpointDeleteAll();
  
   /***************************************************************************************************************/    
  	                            // Test Step 5 Set a breakpoint at line"v_crcSts_u8 = GetHWIO_e_CalcCRC_St();"" inside Test_hwcrc_llsi"
  /***************************************************************************************************************/
  snprintf( chActionText, elCount(chActionText), "Set Breakpoint in v_crcSts_u8 = GetHWIO_e_CalcCRC_St();"" inside Test_hwcrc_llsi "); 
  snprintf( chExpectedText, elCount(chExpectedText), "Verify Breakpoint is Set in v_crcSts_u8 = GetHWIO_e_CalcCRC_St();"" inside Test_hwcrc_llsi"); 
//  TestStepAddActionExpected( chActionText, chExpectedText );  
  A_DBGR_BreakpointSet("Test_hwcrc_llsi\\409");  

  A_DBGR_Go();
  
  snprintf( chActionText, elCount(chActionText), "Verify Breakpoint should hit in v_crcSts_u8 = GetHWIO_e_CalcCRC_St(); "); 
  snprintf( chExpectedText, elCount(chExpectedText), "Breakpoint hit in v_crcSts_u8 = GetHWIO_e_CalcCRC_St(); function"); 
  E_DBGR_BreakpointCheckForHalt("Test_hwcrc_llsi\\409");
  while(1)
  {
  if(cnt == 0)
  {
  snprintf( chActionText, elCount(chActionText), "Verify v_coreId_u8 is 5 "); 
  snprintf( chExpectedText, elCount(chExpectedText), "Verify Verify v_coreId_u8 is 5"); 
  
  TestStepAddActionExpected( chActionText, chExpectedText );  
  }
  
  A_DBGR_VariableRead("v_coreId_u8",coreID);
  if(coreID == 5)
  {
    write("core ID is : %d",coreID);
    break;
  }
  if(cnt == 0)
  {
  snprintf( chActionText, elCount(chActionText), "Run debugger "); 
  snprintf( chExpectedText, elCount(chExpectedText), "Run debugger "); 
  }
  testWaitForTimeout(1000);
  A_DBGR_Go();
  cnt =cnt+1;
 
  }
  cnt =0;
  E_DBGR_VariableCheck("v_crcSts_u8",3,Equal);
  
  snprintf( chActionText, elCount(chActionText), "Delete all breakpoints "); 
  snprintf( chExpectedText, elCount(chExpectedText), "Breakpoints deleted"); 
  TestStepAddActionExpected( chActionText, chExpectedText );
  A_DBGR_BreakpointDeleteAll();
  /***************************************************************************************************************/    
  	                            // Test Step 6 Set a breakpoint after the line"v_sigVal_u32 = GetHWIO_g_CalcCRC_Sig();"
  /***************************************************************************************************************/
  snprintf( chActionText, elCount(chActionText), "Set Breakpoint in v_crcSts_u8 = GetHWIO_e_CalcCRC_St();"" inside Test_hwcrc_llsi "); 
  snprintf( chExpectedText, elCount(chExpectedText), "Verify Breakpoint is Set in v_crcSts_u8 = GetHWIO_e_CalcCRC_St();"" inside Test_hwcrc_llsi"); 
//  TestStepAddActionExpected( chActionText, chExpectedText );  
  A_DBGR_BreakpointSet("Test_hwcrc_llsi\\421");  

  A_DBGR_Go();
  
  snprintf( chActionText, elCount(chActionText), "Verify Breakpoint should hit in v_crcSts_u8 = GetHWIO_e_CalcCRC_St(); "); 
  snprintf( chExpectedText, elCount(chExpectedText), "Breakpoint hit in v_crcSts_u8 = GetHWIO_e_CalcCRC_St(); function"); 
  E_DBGR_BreakpointCheckForHalt("Test_hwcrc_llsi\\421");
  while(1)
  {
  if(cnt == 0)
  {
  snprintf( chActionText, elCount(chActionText), "Verify v_coreId_u8 is 5 "); 
  snprintf( chExpectedText, elCount(chExpectedText), "Verify Verify v_coreId_u8 is 5"); 
  
  TestStepAddActionExpected( chActionText, chExpectedText );  
  }
  
  A_DBGR_VariableRead("v_coreId_u8",coreID);
  if(coreID == 5)
  {
    write("core ID is : %d",coreID);
    break;
  }
  if(cnt == 0)
  {
  snprintf( chActionText, elCount(chActionText), "Run debugger "); 
  snprintf( chExpectedText, elCount(chExpectedText), "Run debugger "); 
  }
  testWaitForTimeout(1000);
  A_DBGR_Go();
  cnt =cnt+1;
 
  }
  cnt =0;
  E_DBGR_VariableCheck("v_sigVal_u32",0,Equal);
  snprintf( chActionText, elCount(chActionText), "Delete all breakpoints "); 
  snprintf( chExpectedText, elCount(chExpectedText), "Breakpoints deleted"); 
  TestStepAddActionExpected( chActionText, chExpectedText );
  A_DBGR_BreakpointDeleteAll();
  /***************************************************************************************************************/    
  	                            // Test Step 7 Set a breakpoint at line"v_crcSts_u8 = GetHWIO_e_CalcCRC_St();"" inside Test_hwcrc_llsi"
  /***************************************************************************************************************/
  snprintf( chActionText, elCount(chActionText), "Set Breakpoint in v_crcSts_u8 = GetHWIO_e_CalcCRC_St();"" inside Test_hwcrc_llsi "); 
  snprintf( chExpectedText, elCount(chExpectedText), "Verify Breakpoint is Set in v_crcSts_u8 = GetHWIO_e_CalcCRC_St();"" inside Test_hwcrc_llsi"); 
//  TestStepAddActionExpected( chActionText, chExpectedText );  
  A_DBGR_BreakpointSet("Test_hwcrc_llsi\\432");  

  A_DBGR_Go();
  
  snprintf( chActionText, elCount(chActionText), "Verify Breakpoint should hit in v_crcSts_u8 = GetHWIO_e_CalcCRC_St(); "); 
  snprintf( chExpectedText, elCount(chExpectedText), "Breakpoint hit in v_crcSts_u8 = GetHWIO_e_CalcCRC_St(); function"); 
  E_DBGR_BreakpointCheckForHalt("Test_hwcrc_llsi\\432");
  while(1)
  {
  if(cnt == 0)
  {
  snprintf( chActionText, elCount(chActionText), "Verify v_coreId_u8 is 5 "); 
  snprintf( chExpectedText, elCount(chExpectedText), "Verify Verify v_coreId_u8 is 5"); 
  
  TestStepAddActionExpected( chActionText, chExpectedText );  
  }
  
  A_DBGR_VariableRead("v_coreId_u8",coreID);
  if(coreID == 5)
  {
    write("core ID is : %d",coreID);
    break;
  }
  if(cnt == 0)
  {
  snprintf( chActionText, elCount(chActionText), "Run debugger "); 
  snprintf( chExpectedText, elCount(chExpectedText), "Run debugger "); 
  }
  testWaitForTimeout(1000);
  A_DBGR_Go();
  cnt =cnt+1;
 
  }
  cnt =0;
  E_DBGR_VariableCheck("v_crcSts_u8",0,Equal);
}

testcase Verify_Hardware_CRC16_Calculation_Invalid_End_Address_Failure_Reporting_Core_0()
{
  /***************************************************************************************************************/    
                                                // Variable Definition
  /***************************************************************************************************************/ 
  

  
  /***************************************************************************************************************/    
                                               // Local Values
  /***************************************************************************************************************/ 
  

  
  /***************************************************************************************************************/    
                                              // Test Case Info
  /***************************************************************************************************************/
  setWriteDbgLevel(DebugOff);
  snprintf( chTestTitle, elCount(chTestTitle), "Verify_Hardware_CRC16_Calculation_Invalid_End_Address_Failure_Reporting_Core_0" );
  snprintf( chTestDescription, elCount(chTestDescription), "Purpose:To check the GetHWIO_e_CalcCRC_St(); interface  ");
  TestCaseAddInfo( chTestTitle, "TC_L30SW_Q-37079808", chTestDescription );

  /***************************************************************************************************************/    
                                              // Start of Test Case
  /***************************************************************************************************************/
  
  /***************************************************************************************************************/    
                                              // Test Step 0 PRECONDITIONS
  /***************************************************************************************************************/
  snprintf( chActionText, elCount(chActionText), "Flash the Software and ECU is running "); 
  snprintf( chExpectedText, elCount(chExpectedText), "Ecu is should be in running state"); 
  TestStepAddActionExpected( chActionText, chExpectedText );
  
  A_DBGR_BreakpointDeleteAll();
  A_DBGR_R();
  A_DBGR_Go(); 

  /***************************************************************************************************************/    
                                              // Test Step 1 Set breakpoint in line Test_hwcrc_llsi(); inside "TestApp_Core0_10ms_MainFunction" function and inside testapp.c file
  /***************************************************************************************************************/
  snprintf( chActionText, elCount(chActionText), "Set Breakpoint in Test_hwcrc_llsi(); "); 
  snprintf( chExpectedText, elCount(chExpectedText), "Verify Breakpoint is Set in Test_hwcrc_llsi();"); 
  //TestStepAddActionExpected( chActionText, chExpectedText );  
  A_DBGR_BreakpointSet("TestApp_Core0_10ms_MainFunction\\45");  

  A_DBGR_Go();
  
  snprintf( chActionText, elCount(chActionText), "Verify Breakpoint should hit in Test_hwcrc_llsi(); "); 
  snprintf( chExpectedText, elCount(chExpectedText), "Breakpoint hit in Test_hwcrc_llsi(); function"); 
  E_DBGR_BreakpointCheckForHalt("TestApp_Core0_10ms_MainFunction\\45");
  
  snprintf( chActionText, elCount(chActionText), "Delete all breakpoints "); 
  snprintf( chExpectedText, elCount(chExpectedText), "Breakpoints deleted"); 
  TestStepAddActionExpected( chActionText, chExpectedText );
  
  A_DBGR_BreakpointDeleteAll();
  
   
  /***************************************************************************************************************/    
  	                            // Test Step 2 Set a breakpoint at "v_coreId_u8 = (BYTE)GetCoreID();" inside "Test_hwcrc_llsi" function
  /***************************************************************************************************************/
  
  snprintf( chActionText, elCount(chActionText), "Set Breakpoint in v_coreId_u8 = (BYTE)GetCoreID(); "); 
  snprintf( chExpectedText, elCount(chExpectedText), "Verify Breakpoint is Set in v_coreId_u8 = (BYTE)GetCoreID();"); 
  //TestStepAddActionExpected( chActionText, chExpectedText );  
  A_DBGR_BreakpointSet("Test_hwcrc_llsi\\678");  

  A_DBGR_Go();
  
  snprintf( chActionText, elCount(chActionText), "Verify Breakpoint should hit in v_coreId_u8 = (BYTE)GetCoreID(); "); 
  snprintf( chExpectedText, elCount(chExpectedText), "Breakpoint hit in v_coreId_u8 = (BYTE)GetCoreID(); function"); 
  E_DBGR_BreakpointCheckForHalt("Test_hwcrc_llsi\\678");
  
  /***************************************************************************************************************/    
  	                            // Test Step 3 Verify v_coreId_u8 in trace32 watch window
  /***************************************************************************************************************/
  
   while(1)
  {
  if(cnt == 0)
  {
  snprintf( chActionText, elCount(chActionText), "Verify v_coreId_u8 is 0 "); 
  snprintf( chExpectedText, elCount(chExpectedText), "Verify Verify v_coreId_u8 is 0"); 
  
  TestStepAddActionExpected( chActionText, chExpectedText );  
  }
  
  A_DBGR_VariableRead("v_coreId_u8",coreID);
  if(coreID == 0)
  {
    break;
  }
  if(cnt == 0)
  {
  snprintf( chActionText, elCount(chActionText), "Run debugger "); 
  snprintf( chExpectedText, elCount(chExpectedText), "Run debugger "); 
  }
  A_DBGR_Go();
  testWaitForTimeout(2000);
  cnt =cnt+1;
  }
  E_DBGR_VariableCheck("v_crcSts_u8",0,Equal);
  cnt =0;
  snprintf( chActionText, elCount(chActionText), "delete all breakpoints "); 
  snprintf( chExpectedText, elCount(chExpectedText), "delete all breakpoints "); 
  TestStepAddActionExpected( chActionText, chExpectedText );
  A_DBGR_BreakpointDeleteAll();
  /***************************************************************************************************************/    
  	                            // Test Step 4 Set a breakpoint at line"PerfmHWIO_h_CalcCRC ((BYTE)test_HwCrc_CRC32_ethernet_E, v_seed_u32, v_startAddr_u8, v_endAddr_u8);"
  /***************************************************************************************************************/
  snprintf( chActionText, elCount(chActionText), "Set Breakpoint inPerfmHWIO_h_CalcCRC ((BYTE)test_HwCrc_CRC32_ethernet_E, v_seed_u32, v_startAddr_u8, v_endAddr_u8); "); 
  snprintf( chExpectedText, elCount(chExpectedText), "Verify Breakpoint is Set in PerfmHWIO_h_CalcCRC ((BYTE)test_HwCrc_CRC32_ethernet_E, v_seed_u32, v_startAddr_u8, v_endAddr_u8);"); 
  //TestStepAddActionExpected( chActionText, chExpectedText );  
  A_DBGR_BreakpointSet("Test_hwcrc_llsi\\699");  

  A_DBGR_Go();
  
  snprintf( chActionText, elCount(chActionText), "Verify Breakpoint should hit in v_crcSts_u8 = GetHWIO_e_CalcCRC_St(); "); 
  snprintf( chExpectedText, elCount(chExpectedText), "Breakpoint hit in v_crcSts_u8 = GetHWIO_e_CalcCRC_St(); function"); 
  E_DBGR_BreakpointCheckForHalt("Test_hwcrc_llsi\\699");
  
  while(1)
  {
  if(cnt == 0)
  {
  snprintf( chActionText, elCount(chActionText), "Verify v_coreId_u8 is 0 "); 
  snprintf( chExpectedText, elCount(chExpectedText), "Verify Verify v_coreId_u8 is 0"); 
  
  TestStepAddActionExpected( chActionText, chExpectedText );  
  }
  
  A_DBGR_VariableRead("v_coreId_u8",coreID);
  if(coreID == 0)
  {
    write("core ID is : %d",coreID);
    break;
  }
  if(cnt == 0)
  {
  snprintf( chActionText, elCount(chActionText), "Run debugger "); 
  snprintf( chExpectedText, elCount(chExpectedText), "Run debugger "); 
  }
  testWaitForTimeout(1000);
  A_DBGR_Go();
  cnt =cnt+1;
 
  }
  cnt =0;
  A_DBGR_BreakpointDeleteAll();
  
   /***************************************************************************************************************/    
  	                            // Test Step 5 Set a breakpoint at line"v_crcSts_u8 = GetHWIO_e_CalcCRC_St();"" inside Test_hwcrc_llsi"
  /***************************************************************************************************************/
  snprintf( chActionText, elCount(chActionText), "Set Breakpoint in v_crcSts_u8 = GetHWIO_e_CalcCRC_St();"" inside Test_hwcrc_llsi "); 
  snprintf( chExpectedText, elCount(chExpectedText), "Verify Breakpoint is Set in v_crcSts_u8 = GetHWIO_e_CalcCRC_St();"" inside Test_hwcrc_llsi"); 
//  TestStepAddActionExpected( chActionText, chExpectedText );  
  A_DBGR_BreakpointSet("Test_hwcrc_llsi\\701");  

  A_DBGR_Go();
  
  snprintf( chActionText, elCount(chActionText), "Verify Breakpoint should hit in v_crcSts_u8 = GetHWIO_e_CalcCRC_St(); "); 
  snprintf( chExpectedText, elCount(chExpectedText), "Breakpoint hit in v_crcSts_u8 = GetHWIO_e_CalcCRC_St(); function"); 
  E_DBGR_BreakpointCheckForHalt("Test_hwcrc_llsi\\701");
  while(1)
  {
  if(cnt == 0)
  {
  snprintf( chActionText, elCount(chActionText), "Verify v_coreId_u8 is 0 "); 
  snprintf( chExpectedText, elCount(chExpectedText), "Verify Verify v_coreId_u8 is 0"); 
  
  TestStepAddActionExpected( chActionText, chExpectedText );  
  }
  
  A_DBGR_VariableRead("v_coreId_u8",coreID);
  if(coreID == 0)
  {
    write("core ID is : %d",coreID);
    break;
  }
  if(cnt == 0)
  {
  snprintf( chActionText, elCount(chActionText), "Run debugger "); 
  snprintf( chExpectedText, elCount(chExpectedText), "Run debugger "); 
  }
  testWaitForTimeout(1000);
  A_DBGR_Go();
  cnt =cnt+1;
 
  }
  cnt =0;
  E_DBGR_VariableCheck("v_crcSts_u8",3,Equal);
  
  snprintf( chActionText, elCount(chActionText), "Delete all breakpoints "); 
  snprintf( chExpectedText, elCount(chExpectedText), "Breakpoints deleted"); 
  TestStepAddActionExpected( chActionText, chExpectedText );
  A_DBGR_BreakpointDeleteAll();
  /***************************************************************************************************************/    
  	                            // Test Step 6 Set a breakpoint after the line"v_sigVal_u32 = GetHWIO_g_CalcCRC_Sig();"
  /***************************************************************************************************************/
  snprintf( chActionText, elCount(chActionText), "Set Breakpoint in v_crcSts_u8 = GetHWIO_e_CalcCRC_St();"" inside Test_hwcrc_llsi "); 
  snprintf( chExpectedText, elCount(chExpectedText), "Verify Breakpoint is Set in v_crcSts_u8 = GetHWIO_e_CalcCRC_St();"" inside Test_hwcrc_llsi"); 
//  TestStepAddActionExpected( chActionText, chExpectedText );  
  A_DBGR_BreakpointSet("Test_hwcrc_llsi\\727");  

  A_DBGR_Go();
  
  snprintf( chActionText, elCount(chActionText), "Verify Breakpoint should hit in v_crcSts_u8 = GetHWIO_e_CalcCRC_St(); "); 
  snprintf( chExpectedText, elCount(chExpectedText), "Breakpoint hit in v_crcSts_u8 = GetHWIO_e_CalcCRC_St(); function"); 
  E_DBGR_BreakpointCheckForHalt("Test_hwcrc_llsi\\727");
  while(1)
  {
  if(cnt == 0)
  {
  snprintf( chActionText, elCount(chActionText), "Verify v_coreId_u8 is 0 "); 
  snprintf( chExpectedText, elCount(chExpectedText), "Verify Verify v_coreId_u8 is 0"); 
  
  TestStepAddActionExpected( chActionText, chExpectedText );  
  }
  
  A_DBGR_VariableRead("v_coreId_u8",coreID);
  if(coreID == 0)
  {
    write("core ID is : %d",coreID);
    break;
  }
  if(cnt == 0)
  {
  snprintf( chActionText, elCount(chActionText), "Run debugger "); 
  snprintf( chExpectedText, elCount(chExpectedText), "Run debugger "); 
  }
  testWaitForTimeout(1000);
  A_DBGR_Go();
  cnt =cnt+1;
 
  }
  cnt =0;
  E_DBGR_VariableCheck("v_sigVal_u32",0,Equal);
  snprintf( chActionText, elCount(chActionText), "Delete all breakpoints "); 
  snprintf( chExpectedText, elCount(chExpectedText), "Breakpoints deleted"); 
  TestStepAddActionExpected( chActionText, chExpectedText );
  A_DBGR_BreakpointDeleteAll();
  /***************************************************************************************************************/    
  	                            // Test Step 7 Set a breakpoint at line"v_crcSts_u8 = GetHWIO_e_CalcCRC_St();"" inside Test_hwcrc_llsi"
  /***************************************************************************************************************/
  snprintf( chActionText, elCount(chActionText), "Set Breakpoint in v_crcSts_u8 = GetHWIO_e_CalcCRC_St();"" inside Test_hwcrc_llsi "); 
  snprintf( chExpectedText, elCount(chExpectedText), "Verify Breakpoint is Set in v_crcSts_u8 = GetHWIO_e_CalcCRC_St();"" inside Test_hwcrc_llsi"); 
//  TestStepAddActionExpected( chActionText, chExpectedText );  
  A_DBGR_BreakpointSet("Test_hwcrc_llsi\\748");  

  A_DBGR_Go();
  
  snprintf( chActionText, elCount(chActionText), "Verify Breakpoint should hit in v_crcSts_u8 = GetHWIO_e_CalcCRC_St(); "); 
  snprintf( chExpectedText, elCount(chExpectedText), "Breakpoint hit in v_crcSts_u8 = GetHWIO_e_CalcCRC_St(); function"); 
  E_DBGR_BreakpointCheckForHalt("Test_hwcrc_llsi\\748");
  while(1)
  {
  if(cnt == 0)
  {
  snprintf( chActionText, elCount(chActionText), "Verify v_coreId_u8 is 0 "); 
  snprintf( chExpectedText, elCount(chExpectedText), "Verify Verify v_coreId_u8 is 0"); 
  
  TestStepAddActionExpected( chActionText, chExpectedText );  
  }
  
  A_DBGR_VariableRead("v_coreId_u8",coreID);
  if(coreID == 0)
  {
    write("core ID is : %d",coreID);
    break;
  }
  if(cnt == 0)
  {
  snprintf( chActionText, elCount(chActionText), "Run debugger "); 
  snprintf( chExpectedText, elCount(chExpectedText), "Run debugger "); 
  }
  testWaitForTimeout(1000);
  A_DBGR_Go();
  cnt =cnt+1;
 
  }
  cnt =0;
  E_DBGR_VariableCheck("v_crcSts_u8",0,Equal);
}

testcase Verify_Hardware_CRC8_Calculation_Invalid_End_Address_Failure_Reporting_Core_0()
{
  /***************************************************************************************************************/    
                                                // Variable Definition
  /***************************************************************************************************************/ 
  

  
  /***************************************************************************************************************/    
                                               // Local Values
  /***************************************************************************************************************/ 
  

  
  /***************************************************************************************************************/    
                                              // Test Case Info
  /***************************************************************************************************************/
  setWriteDbgLevel(DebugOff);
  snprintf( chTestTitle, elCount(chTestTitle), "Verify_Hardware_CRC8_Calculation_Invalid_End_Address_Failure_Reporting_Core_0" );
  snprintf( chTestDescription, elCount(chTestDescription), "Purpose:To check the GetHWIO_e_CalcCRC_St(); interface  ");
  TestCaseAddInfo( chTestTitle, "TC_L30SW_Q-37079809", chTestDescription );

  /***************************************************************************************************************/    
                                              // Start of Test Case
  /***************************************************************************************************************/
  
  /***************************************************************************************************************/    
                                              // Test Step 0 PRECONDITIONS
  /***************************************************************************************************************/
  snprintf( chActionText, elCount(chActionText), "Flash the Software and ECU is running "); 
  snprintf( chExpectedText, elCount(chExpectedText), "Ecu is should be in running state"); 
  TestStepAddActionExpected( chActionText, chExpectedText );
  
  A_DBGR_BreakpointDeleteAll();
  A_DBGR_R();
  A_DBGR_Go(); 

  /***************************************************************************************************************/    
                                              // Test Step 1 Set breakpoint in line Test_hwcrc_llsi(); inside "TestApp_Core0_10ms_MainFunction" function and inside testapp.c file
  /***************************************************************************************************************/
  snprintf( chActionText, elCount(chActionText), "Set Breakpoint in Test_hwcrc_llsi(); "); 
  snprintf( chExpectedText, elCount(chExpectedText), "Verify Breakpoint is Set in Test_hwcrc_llsi();"); 
  //TestStepAddActionExpected( chActionText, chExpectedText );  
  A_DBGR_BreakpointSet("TestApp_Core0_10ms_MainFunction\\45");  

  A_DBGR_Go();
  
  snprintf( chActionText, elCount(chActionText), "Verify Breakpoint should hit in Test_hwcrc_llsi(); "); 
  snprintf( chExpectedText, elCount(chExpectedText), "Breakpoint hit in Test_hwcrc_llsi(); function"); 
  E_DBGR_BreakpointCheckForHalt("TestApp_Core0_10ms_MainFunction\\45");
  
  snprintf( chActionText, elCount(chActionText), "Delete all breakpoints "); 
  snprintf( chExpectedText, elCount(chExpectedText), "Breakpoints deleted"); 
  TestStepAddActionExpected( chActionText, chExpectedText );
  
  A_DBGR_BreakpointDeleteAll();
  
   
  /***************************************************************************************************************/    
  	                            // Test Step 2 Set a breakpoint at "v_coreId_u8 = (BYTE)GetCoreID();" inside "Test_hwcrc_llsi" function
  /***************************************************************************************************************/
  
  snprintf( chActionText, elCount(chActionText), "Set Breakpoint in v_coreId_u8 = (BYTE)GetCoreID(); "); 
  snprintf( chExpectedText, elCount(chExpectedText), "Verify Breakpoint is Set in v_coreId_u8 = (BYTE)GetCoreID();"); 
  //TestStepAddActionExpected( chActionText, chExpectedText );  
  A_DBGR_BreakpointSet("Test_hwcrc_llsi\\748");  

  A_DBGR_Go();
  
  snprintf( chActionText, elCount(chActionText), "Verify Breakpoint should hit in v_coreId_u8 = (BYTE)GetCoreID(); "); 
  snprintf( chExpectedText, elCount(chExpectedText), "Breakpoint hit in v_coreId_u8 = (BYTE)GetCoreID(); function"); 
  E_DBGR_BreakpointCheckForHalt("Test_hwcrc_llsi\\748");
  
  /***************************************************************************************************************/    
  	                            // Test Step 3 Verify v_coreId_u8 in trace32 watch window
  /***************************************************************************************************************/
  
   while(1)
  {
  if(cnt == 0)
  {
  snprintf( chActionText, elCount(chActionText), "Verify v_coreId_u8 is 0 "); 
  snprintf( chExpectedText, elCount(chExpectedText), "Verify Verify v_coreId_u8 is 0"); 
  
  TestStepAddActionExpected( chActionText, chExpectedText );  
  }
  
  A_DBGR_VariableRead("v_coreId_u8",coreID);
  if(coreID == 0)
  {
    break;
  }
  if(cnt == 0)
  {
  snprintf( chActionText, elCount(chActionText), "Run debugger "); 
  snprintf( chExpectedText, elCount(chExpectedText), "Run debugger "); 
  }
  A_DBGR_Go();
  testWaitForTimeout(2000);
  cnt =cnt+1;
  }
  E_DBGR_VariableCheck("v_crcSts_u8",0,Equal);
  cnt =0;
  snprintf( chActionText, elCount(chActionText), "delete all breakpoints "); 
  snprintf( chExpectedText, elCount(chExpectedText), "delete all breakpoints "); 
  TestStepAddActionExpected( chActionText, chExpectedText );
  A_DBGR_BreakpointDeleteAll();
  /***************************************************************************************************************/    
  	                            // Test Step 4 Set a breakpoint at line"PerfmHWIO_h_CalcCRC ((BYTE)test_HwCrc_CRC32_ethernet_E, v_seed_u32, v_startAddr_u8, v_endAddr_u8);"
  /***************************************************************************************************************/
  snprintf( chActionText, elCount(chActionText), "Set Breakpoint inPerfmHWIO_h_CalcCRC ((BYTE)test_HwCrc_CRC32_ethernet_E, v_seed_u32, v_startAddr_u8, v_endAddr_u8); "); 
  snprintf( chExpectedText, elCount(chExpectedText), "Verify Breakpoint is Set in PerfmHWIO_h_CalcCRC ((BYTE)test_HwCrc_CRC32_ethernet_E, v_seed_u32, v_startAddr_u8, v_endAddr_u8);"); 
  //TestStepAddActionExpected( chActionText, chExpectedText );  
  A_DBGR_BreakpointSet("Test_hwcrc_llsi\\764");  

  A_DBGR_Go();
  
  snprintf( chActionText, elCount(chActionText), "Verify Breakpoint should hit in v_crcSts_u8 = GetHWIO_e_CalcCRC_St(); "); 
  snprintf( chExpectedText, elCount(chExpectedText), "Breakpoint hit in v_crcSts_u8 = GetHWIO_e_CalcCRC_St(); function"); 
  E_DBGR_BreakpointCheckForHalt("Test_hwcrc_llsi\\764");
  
  while(1)
  {
  if(cnt == 0)
  {
  snprintf( chActionText, elCount(chActionText), "Verify v_coreId_u8 is 0 "); 
  snprintf( chExpectedText, elCount(chExpectedText), "Verify Verify v_coreId_u8 is 0"); 
  
  TestStepAddActionExpected( chActionText, chExpectedText );  
  }
  
  A_DBGR_VariableRead("v_coreId_u8",coreID);
  if(coreID == 0)
  {
    write("core ID is : %d",coreID);
    break;
  }
  if(cnt == 0)
  {
  snprintf( chActionText, elCount(chActionText), "Run debugger "); 
  snprintf( chExpectedText, elCount(chExpectedText), "Run debugger "); 
  }
  testWaitForTimeout(1000);
  A_DBGR_Go();
  cnt =cnt+1;
 
  }
  cnt =0;
  A_DBGR_BreakpointDeleteAll();
  
   /***************************************************************************************************************/    
  	                            // Test Step 5 Set a breakpoint at line"v_crcSts_u8 = GetHWIO_e_CalcCRC_St();"" inside Test_hwcrc_llsi"
  /***************************************************************************************************************/
  snprintf( chActionText, elCount(chActionText), "Set Breakpoint in v_crcSts_u8 = GetHWIO_e_CalcCRC_St();"" inside Test_hwcrc_llsi "); 
  snprintf( chExpectedText, elCount(chExpectedText), "Verify Breakpoint is Set in v_crcSts_u8 = GetHWIO_e_CalcCRC_St();"" inside Test_hwcrc_llsi"); 
//  TestStepAddActionExpected( chActionText, chExpectedText );  
  A_DBGR_BreakpointSet("Test_hwcrc_llsi\\766");  

  A_DBGR_Go();
  
  snprintf( chActionText, elCount(chActionText), "Verify Breakpoint should hit in v_crcSts_u8 = GetHWIO_e_CalcCRC_St(); "); 
  snprintf( chExpectedText, elCount(chExpectedText), "Breakpoint hit in v_crcSts_u8 = GetHWIO_e_CalcCRC_St(); function"); 
  E_DBGR_BreakpointCheckForHalt("Test_hwcrc_llsi\\766");
  while(1)
  {
  if(cnt == 0)
  {
  snprintf( chActionText, elCount(chActionText), "Verify v_coreId_u8 is 0 "); 
  snprintf( chExpectedText, elCount(chExpectedText), "Verify Verify v_coreId_u8 is 0"); 
  
  TestStepAddActionExpected( chActionText, chExpectedText );  
  }
  
  A_DBGR_VariableRead("v_coreId_u8",coreID);
  if(coreID == 0)
  {
    write("core ID is : %d",coreID);
    break;
  }
  if(cnt == 0)
  {
  snprintf( chActionText, elCount(chActionText), "Run debugger "); 
  snprintf( chExpectedText, elCount(chExpectedText), "Run debugger "); 
  }
  testWaitForTimeout(1000);
  A_DBGR_Go();
  cnt =cnt+1;
 
  }
  cnt =0;
  E_DBGR_VariableCheck("v_crcSts_u8",3,Equal);
  
  snprintf( chActionText, elCount(chActionText), "Delete all breakpoints "); 
  snprintf( chExpectedText, elCount(chExpectedText), "Breakpoints deleted"); 
  TestStepAddActionExpected( chActionText, chExpectedText );
  A_DBGR_BreakpointDeleteAll();
  /***************************************************************************************************************/    
  	                            // Test Step 6 Set a breakpoint after the line"v_sigVal_u32 = GetHWIO_g_CalcCRC_Sig();"
  /***************************************************************************************************************/
  snprintf( chActionText, elCount(chActionText), "Set Breakpoint in v_crcSts_u8 = GetHWIO_e_CalcCRC_St();"" inside Test_hwcrc_llsi "); 
  snprintf( chExpectedText, elCount(chExpectedText), "Verify Breakpoint is Set in v_crcSts_u8 = GetHWIO_e_CalcCRC_St();"" inside Test_hwcrc_llsi"); 
//  TestStepAddActionExpected( chActionText, chExpectedText );  
  A_DBGR_BreakpointSet("Test_hwcrc_llsi\\792");  

  A_DBGR_Go();
  
  snprintf( chActionText, elCount(chActionText), "Verify Breakpoint should hit in v_crcSts_u8 = GetHWIO_e_CalcCRC_St(); "); 
  snprintf( chExpectedText, elCount(chExpectedText), "Breakpoint hit in v_crcSts_u8 = GetHWIO_e_CalcCRC_St(); function"); 
  E_DBGR_BreakpointCheckForHalt("Test_hwcrc_llsi\\792");
  while(1)
  {
  if(cnt == 0)
  {
  snprintf( chActionText, elCount(chActionText), "Verify v_coreId_u8 is 0 "); 
  snprintf( chExpectedText, elCount(chExpectedText), "Verify Verify v_coreId_u8 is 0"); 
  
  TestStepAddActionExpected( chActionText, chExpectedText );  
  }
  
  A_DBGR_VariableRead("v_coreId_u8",coreID);
  if(coreID == 0)
  {
    write("core ID is : %d",coreID);
    break;
  }
  if(cnt == 0)
  {
  snprintf( chActionText, elCount(chActionText), "Run debugger "); 
  snprintf( chExpectedText, elCount(chExpectedText), "Run debugger "); 
  }
  testWaitForTimeout(1000);
  A_DBGR_Go();
  cnt =cnt+1;
 
  }
  cnt =0;
  E_DBGR_VariableCheck("v_sigVal_u32",0,Equal);
  snprintf( chActionText, elCount(chActionText), "Delete all breakpoints "); 
  snprintf( chExpectedText, elCount(chExpectedText), "Breakpoints deleted"); 
  TestStepAddActionExpected( chActionText, chExpectedText );
  A_DBGR_BreakpointDeleteAll();
  /***************************************************************************************************************/    
  	                            // Test Step 7 Set a breakpoint at line"v_crcSts_u8 = GetHWIO_e_CalcCRC_St();"" inside Test_hwcrc_llsi"
  /***************************************************************************************************************/
  snprintf( chActionText, elCount(chActionText), "Set Breakpoint in v_crcSts_u8 = GetHWIO_e_CalcCRC_St();"" inside Test_hwcrc_llsi "); 
  snprintf( chExpectedText, elCount(chExpectedText), "Verify Breakpoint is Set in v_crcSts_u8 = GetHWIO_e_CalcCRC_St();"" inside Test_hwcrc_llsi"); 
//  TestStepAddActionExpected( chActionText, chExpectedText );  
  A_DBGR_BreakpointSet("Test_hwcrc_llsi\\813");  

  A_DBGR_Go();
  
  snprintf( chActionText, elCount(chActionText), "Verify Breakpoint should hit in v_crcSts_u8 = GetHWIO_e_CalcCRC_St(); "); 
  snprintf( chExpectedText, elCount(chExpectedText), "Breakpoint hit in v_crcSts_u8 = GetHWIO_e_CalcCRC_St(); function"); 
  E_DBGR_BreakpointCheckForHalt("Test_hwcrc_llsi\\813");
  while(1)
  {
  if(cnt == 0)
  {
  snprintf( chActionText, elCount(chActionText), "Verify v_coreId_u8 is 0 "); 
  snprintf( chExpectedText, elCount(chExpectedText), "Verify Verify v_coreId_u8 is 0"); 
  
  TestStepAddActionExpected( chActionText, chExpectedText );  
  }
  
  A_DBGR_VariableRead("v_coreId_u8",coreID);
  if(coreID == 0)
  {
    write("core ID is : %d",coreID);
    break;
  }
  if(cnt == 0)
  {
  snprintf( chActionText, elCount(chActionText), "Run debugger "); 
  snprintf( chExpectedText, elCount(chExpectedText), "Run debugger "); 
  }
  testWaitForTimeout(1000);
  A_DBGR_Go();
  cnt =cnt+1;
 
  }
  cnt =0;
  E_DBGR_VariableCheck("v_crcSts_u8",0,Equal);
}

testcase Verify_Hardware_CRC16_Calculation_Invalid_Start_Address_Failure_Reporting_Core_0()
{
  /***************************************************************************************************************/    
                                                // Variable Definition
  /***************************************************************************************************************/ 
  

  
  /***************************************************************************************************************/    
                                               // Local Values
  /***************************************************************************************************************/ 
  

  
  /***************************************************************************************************************/    
                                              // Test Case Info
  /***************************************************************************************************************/
  setWriteDbgLevel(DebugOff);
  snprintf( chTestTitle, elCount(chTestTitle), "Verify_Hardware_CRC16_Calculation_Invalid_Start_Address_Failure_Reporting_Core_0" );
  snprintf( chTestDescription, elCount(chTestDescription), "Purpose:To check the GetHWIO_e_CalcCRC_St(); interface  ");
  TestCaseAddInfo( chTestTitle, "TC_L30SW_Q-36925407", chTestDescription );

  /***************************************************************************************************************/    
                                              // Start of Test Case
  /***************************************************************************************************************/
  
  /***************************************************************************************************************/    
                                              // Test Step 0 PRECONDITIONS
  /***************************************************************************************************************/
  snprintf( chActionText, elCount(chActionText), "Flash the Software and ECU is running "); 
  snprintf( chExpectedText, elCount(chExpectedText), "Ecu is should be in running state"); 
  TestStepAddActionExpected( chActionText, chExpectedText );
  
  A_DBGR_BreakpointDeleteAll();
  A_DBGR_R();
  A_DBGR_Go(); 

  /***************************************************************************************************************/    
                                              // Test Step 1 Set breakpoint in line Test_hwcrc_llsi(); inside "TestApp_Core0_10ms_MainFunction" function and inside testapp.c file
  /***************************************************************************************************************/
  snprintf( chActionText, elCount(chActionText), "Set Breakpoint in Test_hwcrc_llsi(); "); 
  snprintf( chExpectedText, elCount(chExpectedText), "Verify Breakpoint is Set in Test_hwcrc_llsi();"); 
  //TestStepAddActionExpected( chActionText, chExpectedText );  
  A_DBGR_BreakpointSet("TestApp_Core0_10ms_MainFunction\\45");  

  A_DBGR_Go();
  
  snprintf( chActionText, elCount(chActionText), "Verify Breakpoint should hit in Test_hwcrc_llsi(); "); 
  snprintf( chExpectedText, elCount(chExpectedText), "Breakpoint hit in Test_hwcrc_llsi(); function"); 
  E_DBGR_BreakpointCheckForHalt("TestApp_Core0_10ms_MainFunction\\45");
  
  snprintf( chActionText, elCount(chActionText), "Delete all breakpoints "); 
  snprintf( chExpectedText, elCount(chExpectedText), "Breakpoints deleted"); 
  TestStepAddActionExpected( chActionText, chExpectedText );
  
  A_DBGR_BreakpointDeleteAll();
  
   
  /***************************************************************************************************************/    
  	                            // Test Step 2 Set a breakpoint at "v_coreId_u8 = (BYTE)GetCoreID();" inside "Test_hwcrc_llsi" function
  /***************************************************************************************************************/
  
  snprintf( chActionText, elCount(chActionText), "Set Breakpoint in v_coreId_u8 = (BYTE)GetCoreID(); "); 
  snprintf( chExpectedText, elCount(chExpectedText), "Verify Breakpoint is Set in v_coreId_u8 = (BYTE)GetCoreID();"); 
  //TestStepAddActionExpected( chActionText, chExpectedText );  
  A_DBGR_BreakpointSet("Test_hwcrc_llsi\\615");  

  A_DBGR_Go();
  
  snprintf( chActionText, elCount(chActionText), "Verify Breakpoint should hit in v_coreId_u8 = (BYTE)GetCoreID(); "); 
  snprintf( chExpectedText, elCount(chExpectedText), "Breakpoint hit in v_coreId_u8 = (BYTE)GetCoreID(); function"); 
  E_DBGR_BreakpointCheckForHalt("Test_hwcrc_llsi\\615");
  
  /***************************************************************************************************************/    
  	                            // Test Step 3 Verify v_coreId_u8 in trace32 watch window
  /***************************************************************************************************************/
  
   while(1)
  {
  if(cnt == 0)
  {
  snprintf( chActionText, elCount(chActionText), "Verify v_coreId_u8 is 0 "); 
  snprintf( chExpectedText, elCount(chExpectedText), "Verify Verify v_coreId_u8 is 0"); 
  
  TestStepAddActionExpected( chActionText, chExpectedText );  
  }
  
  A_DBGR_VariableRead("v_coreId_u8",coreID);
  if(coreID == 0)
  {
    break;
  }
  if(cnt == 0)
  {
  snprintf( chActionText, elCount(chActionText), "Run debugger "); 
  snprintf( chExpectedText, elCount(chExpectedText), "Run debugger "); 
  }
  A_DBGR_Go();
  testWaitForTimeout(2000);
  cnt =cnt+1;
  }
  E_DBGR_VariableCheck("v_crcSts_u8",0,Equal);
  cnt =0;
  snprintf( chActionText, elCount(chActionText), "delete all breakpoints "); 
  snprintf( chExpectedText, elCount(chExpectedText), "delete all breakpoints "); 
  TestStepAddActionExpected( chActionText, chExpectedText );
  A_DBGR_BreakpointDeleteAll();
  /***************************************************************************************************************/    
  	                            // Test Step 4 Set a breakpoint at line"PerfmHWIO_h_CalcCRC ((BYTE)test_HwCrc_CRC32_ethernet_E, v_seed_u32, v_startAddr_u8, v_endAddr_u8);"
  /***************************************************************************************************************/
  snprintf( chActionText, elCount(chActionText), "Set Breakpoint inPerfmHWIO_h_CalcCRC ((BYTE)test_HwCrc_CRC32_ethernet_E, v_seed_u32, v_startAddr_u8, v_endAddr_u8); "); 
  snprintf( chExpectedText, elCount(chExpectedText), "Verify Breakpoint is Set in PerfmHWIO_h_CalcCRC ((BYTE)test_HwCrc_CRC32_ethernet_E, v_seed_u32, v_startAddr_u8, v_endAddr_u8);"); 
  //TestStepAddActionExpected( chActionText, chExpectedText );  
  A_DBGR_BreakpointSet("Test_hwcrc_llsi\\630");  

  A_DBGR_Go();
  
  snprintf( chActionText, elCount(chActionText), "Verify Breakpoint should hit in v_crcSts_u8 = GetHWIO_e_CalcCRC_St(); "); 
  snprintf( chExpectedText, elCount(chExpectedText), "Breakpoint hit in v_crcSts_u8 = GetHWIO_e_CalcCRC_St(); function"); 
  E_DBGR_BreakpointCheckForHalt("Test_hwcrc_llsi\\630");
  
  while(1)
  {
  if(cnt == 0)
  {
  snprintf( chActionText, elCount(chActionText), "Verify v_coreId_u8 is 0 "); 
  snprintf( chExpectedText, elCount(chExpectedText), "Verify Verify v_coreId_u8 is 0"); 
  
  TestStepAddActionExpected( chActionText, chExpectedText );  
  }
  
  A_DBGR_VariableRead("v_coreId_u8",coreID);
  if(coreID == 0)
  {
    write("core ID is : %d",coreID);
    break;
  }
  if(cnt == 0)
  {
  snprintf( chActionText, elCount(chActionText), "Run debugger "); 
  snprintf( chExpectedText, elCount(chExpectedText), "Run debugger "); 
  }
  testWaitForTimeout(1000);
  A_DBGR_Go();
  cnt =cnt+1;
 
  }
  cnt =0;
  A_DBGR_BreakpointDeleteAll();
  
   /***************************************************************************************************************/    
  	                            // Test Step 5 Set a breakpoint at line"v_crcSts_u8 = GetHWIO_e_CalcCRC_St();"" inside Test_hwcrc_llsi"
  /***************************************************************************************************************/
  snprintf( chActionText, elCount(chActionText), "Set Breakpoint in v_crcSts_u8 = GetHWIO_e_CalcCRC_St();"" inside Test_hwcrc_llsi "); 
  snprintf( chExpectedText, elCount(chExpectedText), "Verify Breakpoint is Set in v_crcSts_u8 = GetHWIO_e_CalcCRC_St();"" inside Test_hwcrc_llsi"); 
//  TestStepAddActionExpected( chActionText, chExpectedText );  
  A_DBGR_BreakpointSet("Test_hwcrc_llsi\\632");  

  A_DBGR_Go();
  
  snprintf( chActionText, elCount(chActionText), "Verify Breakpoint should hit in v_crcSts_u8 = GetHWIO_e_CalcCRC_St(); "); 
  snprintf( chExpectedText, elCount(chExpectedText), "Breakpoint hit in v_crcSts_u8 = GetHWIO_e_CalcCRC_St(); function"); 
  E_DBGR_BreakpointCheckForHalt("Test_hwcrc_llsi\\632");
  while(1)
  {
  if(cnt == 0)
  {
  snprintf( chActionText, elCount(chActionText), "Verify v_coreId_u8 is 0 "); 
  snprintf( chExpectedText, elCount(chExpectedText), "Verify Verify v_coreId_u8 is 0"); 
  
  TestStepAddActionExpected( chActionText, chExpectedText );  
  }
  
  A_DBGR_VariableRead("v_coreId_u8",coreID);
  if(coreID == 0)
  {
    write("core ID is : %d",coreID);
    break;
  }
  if(cnt == 0)
  {
  snprintf( chActionText, elCount(chActionText), "Run debugger "); 
  snprintf( chExpectedText, elCount(chExpectedText), "Run debugger "); 
  }
  testWaitForTimeout(1000);
  A_DBGR_Go();
  cnt =cnt+1;
 
  }
  cnt =0;
  E_DBGR_VariableCheck("v_crcSts_u8",3,Equal);
  
  snprintf( chActionText, elCount(chActionText), "Delete all breakpoints "); 
  snprintf( chExpectedText, elCount(chExpectedText), "Breakpoints deleted"); 
  TestStepAddActionExpected( chActionText, chExpectedText );
  A_DBGR_BreakpointDeleteAll();
  /***************************************************************************************************************/    
  	                            // Test Step 6 Set a breakpoint after the line"v_sigVal_u32 = GetHWIO_g_CalcCRC_Sig();"
  /***************************************************************************************************************/
  snprintf( chActionText, elCount(chActionText), "Set Breakpoint in v_crcSts_u8 = GetHWIO_e_CalcCRC_St();"" inside Test_hwcrc_llsi "); 
  snprintf( chExpectedText, elCount(chExpectedText), "Verify Breakpoint is Set in v_crcSts_u8 = GetHWIO_e_CalcCRC_St();"" inside Test_hwcrc_llsi"); 
//  TestStepAddActionExpected( chActionText, chExpectedText );  
  A_DBGR_BreakpointSet("Test_hwcrc_llsi\\657");  

  A_DBGR_Go();
  
  snprintf( chActionText, elCount(chActionText), "Verify Breakpoint should hit in v_crcSts_u8 = GetHWIO_e_CalcCRC_St(); "); 
  snprintf( chExpectedText, elCount(chExpectedText), "Breakpoint hit in v_crcSts_u8 = GetHWIO_e_CalcCRC_St(); function"); 
  E_DBGR_BreakpointCheckForHalt("Test_hwcrc_llsi\\657");
  while(1)
  {
  if(cnt == 0)
  {
  snprintf( chActionText, elCount(chActionText), "Verify v_coreId_u8 is 0 "); 
  snprintf( chExpectedText, elCount(chExpectedText), "Verify Verify v_coreId_u8 is 0"); 
  
  TestStepAddActionExpected( chActionText, chExpectedText );  
  }
  
  A_DBGR_VariableRead("v_coreId_u8",coreID);
  if(coreID == 0)
  {
    write("core ID is : %d",coreID);
    break;
  }
  if(cnt == 0)
  {
  snprintf( chActionText, elCount(chActionText), "Run debugger "); 
  snprintf( chExpectedText, elCount(chExpectedText), "Run debugger "); 
  }
  testWaitForTimeout(1000);
  A_DBGR_Go();
  cnt =cnt+1;
 
  }
  cnt =0;
  E_DBGR_VariableCheck("v_sigVal_u32",0,Equal);
  snprintf( chActionText, elCount(chActionText), "Delete all breakpoints "); 
  snprintf( chExpectedText, elCount(chExpectedText), "Breakpoints deleted"); 
  TestStepAddActionExpected( chActionText, chExpectedText );
  A_DBGR_BreakpointDeleteAll();
  /***************************************************************************************************************/    
  	                            // Test Step 7 Set a breakpoint at line"v_crcSts_u8 = GetHWIO_e_CalcCRC_St();"" inside Test_hwcrc_llsi"
  /***************************************************************************************************************/
  snprintf( chActionText, elCount(chActionText), "Set Breakpoint in v_crcSts_u8 = GetHWIO_e_CalcCRC_St();"" inside Test_hwcrc_llsi "); 
  snprintf( chExpectedText, elCount(chExpectedText), "Verify Breakpoint is Set in v_crcSts_u8 = GetHWIO_e_CalcCRC_St();"" inside Test_hwcrc_llsi"); 
//  TestStepAddActionExpected( chActionText, chExpectedText );  
  A_DBGR_BreakpointSet("Test_hwcrc_llsi\\678");  

  A_DBGR_Go();
  
  snprintf( chActionText, elCount(chActionText), "Verify Breakpoint should hit in v_crcSts_u8 = GetHWIO_e_CalcCRC_St(); "); 
  snprintf( chExpectedText, elCount(chExpectedText), "Breakpoint hit in v_crcSts_u8 = GetHWIO_e_CalcCRC_St(); function"); 
  E_DBGR_BreakpointCheckForHalt("Test_hwcrc_llsi\\678");
  while(1)
  {
  if(cnt == 0)
  {
  snprintf( chActionText, elCount(chActionText), "Verify v_coreId_u8 is 0 "); 
  snprintf( chExpectedText, elCount(chExpectedText), "Verify Verify v_coreId_u8 is 0"); 
  
  TestStepAddActionExpected( chActionText, chExpectedText );  
  }
  
  A_DBGR_VariableRead("v_coreId_u8",coreID);
  if(coreID == 0)
  {
    write("core ID is : %d",coreID);
    break;
  }
  if(cnt == 0)
  {
  snprintf( chActionText, elCount(chActionText), "Run debugger "); 
  snprintf( chExpectedText, elCount(chExpectedText), "Run debugger "); 
  }
  testWaitForTimeout(1000);
  A_DBGR_Go();
  cnt =cnt+1;
 
  }
  cnt =0;
  E_DBGR_VariableCheck("v_crcSts_u8",0,Equal);
}

testcase Verify_Hardware_CRC8_Calculation_Invalid_Start_Address_Failure_Reporting_Core_0()
{
   /***************************************************************************************************************/    
                                                // Variable Definition
  /***************************************************************************************************************/ 
  

  
  /***************************************************************************************************************/    
                                               // Local Values
  /***************************************************************************************************************/ 
  

  
  /***************************************************************************************************************/    
                                              // Test Case Info
  /***************************************************************************************************************/
  setWriteDbgLevel(DebugOff);
  snprintf( chTestTitle, elCount(chTestTitle), "Verify_Hardware_CRC8_Calculation_Invalid_Start_Address_Failure_Reporting_Core_0" );
  snprintf( chTestDescription, elCount(chTestDescription), "Purpose:To check the GetHWIO_e_CalcCRC_St(); interface  ");
  TestCaseAddInfo( chTestTitle, "TC_L30SW_Q-36925408", chTestDescription );

  /***************************************************************************************************************/    
                                              // Start of Test Case
  /***************************************************************************************************************/
  
  /***************************************************************************************************************/    
                                              // Test Step 0 PRECONDITIONS
  /***************************************************************************************************************/
  snprintf( chActionText, elCount(chActionText), "Flash the Software and ECU is running "); 
  snprintf( chExpectedText, elCount(chExpectedText), "Ecu is should be in running state"); 
  TestStepAddActionExpected( chActionText, chExpectedText );
  
  A_DBGR_BreakpointDeleteAll();
  A_DBGR_R();
  A_DBGR_Go(); 

  /***************************************************************************************************************/    
                                              // Test Step 1 Set breakpoint in line Test_hwcrc_llsi(); inside "TestApp_Core0_10ms_MainFunction" function and inside testapp.c file
  /***************************************************************************************************************/
  snprintf( chActionText, elCount(chActionText), "Set Breakpoint in Test_hwcrc_llsi(); "); 
  snprintf( chExpectedText, elCount(chExpectedText), "Verify Breakpoint is Set in Test_hwcrc_llsi();"); 
  //TestStepAddActionExpected( chActionText, chExpectedText );  
  A_DBGR_BreakpointSet("TestApp_Core0_10ms_MainFunction\\45");  

  A_DBGR_Go();
  
  snprintf( chActionText, elCount(chActionText), "Verify Breakpoint should hit in Test_hwcrc_llsi(); "); 
  snprintf( chExpectedText, elCount(chExpectedText), "Breakpoint hit in Test_hwcrc_llsi(); function"); 
  E_DBGR_BreakpointCheckForHalt("TestApp_Core0_10ms_MainFunction\\45");
  
  snprintf( chActionText, elCount(chActionText), "Delete all breakpoints "); 
  snprintf( chExpectedText, elCount(chExpectedText), "Breakpoints deleted"); 
  TestStepAddActionExpected( chActionText, chExpectedText );
  
  A_DBGR_BreakpointDeleteAll();
  
   
  /***************************************************************************************************************/    
  	                            // Test Step 2 Set a breakpoint at "v_coreId_u8 = (BYTE)GetCoreID();" inside "Test_hwcrc_llsi" function
  /***************************************************************************************************************/
  
  snprintf( chActionText, elCount(chActionText), "Set Breakpoint in v_coreId_u8 = (BYTE)GetCoreID(); "); 
  snprintf( chExpectedText, elCount(chExpectedText), "Verify Breakpoint is Set in v_coreId_u8 = (BYTE)GetCoreID();"); 
  //TestStepAddActionExpected( chActionText, chExpectedText );  
  A_DBGR_BreakpointSet("Test_hwcrc_llsi\\308");  

  A_DBGR_Go();
  
  snprintf( chActionText, elCount(chActionText), "Verify Breakpoint should hit in v_coreId_u8 = (BYTE)GetCoreID(); "); 
  snprintf( chExpectedText, elCount(chExpectedText), "Breakpoint hit in v_coreId_u8 = (BYTE)GetCoreID(); function"); 
  E_DBGR_BreakpointCheckForHalt("Test_hwcrc_llsi\\308");
  
  /***************************************************************************************************************/    
  	                            // Test Step 3 Verify v_coreId_u8 in trace32 watch window
  /***************************************************************************************************************/
  
   while(1)
  {
  if(cnt == 0)
  {
  snprintf( chActionText, elCount(chActionText), "Verify v_coreId_u8 is 0 "); 
  snprintf( chExpectedText, elCount(chExpectedText), "Verify Verify v_coreId_u8 is 0"); 
  
  TestStepAddActionExpected( chActionText, chExpectedText );  
  }
  
  A_DBGR_VariableRead("v_coreId_u8",coreID);
  if(coreID == 0)
  {
    break;
  }
  if(cnt == 0)
  {
  snprintf( chActionText, elCount(chActionText), "Run debugger "); 
  snprintf( chExpectedText, elCount(chExpectedText), "Run debugger "); 
  }
  A_DBGR_Go();
  testWaitForTimeout(2000);
  cnt =cnt+1;
  }
  E_DBGR_VariableCheck("v_crcSts_u8",0,Equal);
  cnt =0;
  snprintf( chActionText, elCount(chActionText), "delete all breakpoints "); 
  snprintf( chExpectedText, elCount(chExpectedText), "delete all breakpoints "); 
  TestStepAddActionExpected( chActionText, chExpectedText );
  A_DBGR_BreakpointDeleteAll();
  /***************************************************************************************************************/    
  	                            // Test Step 4 Set a breakpoint at line"PerfmHWIO_h_CalcCRC ((BYTE)test_HwCrc_CRC32_ethernet_E, v_seed_u32, v_startAddr_u8, v_endAddr_u8);"
  /***************************************************************************************************************/
  snprintf( chActionText, elCount(chActionText), "Set Breakpoint inPerfmHWIO_h_CalcCRC ((BYTE)test_HwCrc_CRC32_ethernet_E, v_seed_u32, v_startAddr_u8, v_endAddr_u8); "); 
  snprintf( chExpectedText, elCount(chExpectedText), "Verify Breakpoint is Set in PerfmHWIO_h_CalcCRC ((BYTE)test_HwCrc_CRC32_ethernet_E, v_seed_u32, v_startAddr_u8, v_endAddr_u8);"); 
  //TestStepAddActionExpected( chActionText, chExpectedText );  
  A_DBGR_BreakpointSet("Test_hwcrc_llsi\\327");  

  A_DBGR_Go();
  
  snprintf( chActionText, elCount(chActionText), "Verify Breakpoint should hit in v_crcSts_u8 = GetHWIO_e_CalcCRC_St(); "); 
  snprintf( chExpectedText, elCount(chExpectedText), "Breakpoint hit in v_crcSts_u8 = GetHWIO_e_CalcCRC_St(); function"); 
  E_DBGR_BreakpointCheckForHalt("Test_hwcrc_llsi\\327");
  
  while(1)
  {
  if(cnt == 0)
  {
  snprintf( chActionText, elCount(chActionText), "Verify v_coreId_u8 is 0 "); 
  snprintf( chExpectedText, elCount(chExpectedText), "Verify Verify v_coreId_u8 is 0"); 
  
  TestStepAddActionExpected( chActionText, chExpectedText );  
  }
  
  A_DBGR_VariableRead("v_coreId_u8",coreID);
  if(coreID == 0)
  {
    write("core ID is : %d",coreID);
    break;
  }
  if(cnt == 0)
  {
  snprintf( chActionText, elCount(chActionText), "Run debugger "); 
  snprintf( chExpectedText, elCount(chExpectedText), "Run debugger "); 
  }
  testWaitForTimeout(1000);
  A_DBGR_Go();
  cnt =cnt+1;
 
  }
  cnt =0;
  A_DBGR_BreakpointDeleteAll();
  
   /***************************************************************************************************************/    
  	                            // Test Step 5 Set a breakpoint at line"v_crcSts_u8 = GetHWIO_e_CalcCRC_St();"" inside Test_hwcrc_llsi"
  /***************************************************************************************************************/
  snprintf( chActionText, elCount(chActionText), "Set Breakpoint in v_crcSts_u8 = GetHWIO_e_CalcCRC_St();"" inside Test_hwcrc_llsi "); 
  snprintf( chExpectedText, elCount(chExpectedText), "Verify Breakpoint is Set in v_crcSts_u8 = GetHWIO_e_CalcCRC_St();"" inside Test_hwcrc_llsi"); 
//  TestStepAddActionExpected( chActionText, chExpectedText );  
  A_DBGR_BreakpointSet("Test_hwcrc_llsi\\329");  

  A_DBGR_Go();
  
  snprintf( chActionText, elCount(chActionText), "Verify Breakpoint should hit in v_crcSts_u8 = GetHWIO_e_CalcCRC_St(); "); 
  snprintf( chExpectedText, elCount(chExpectedText), "Breakpoint hit in v_crcSts_u8 = GetHWIO_e_CalcCRC_St(); function"); 
  E_DBGR_BreakpointCheckForHalt("Test_hwcrc_llsi\\329");
  while(1)
  {
  if(cnt == 0)
  {
  snprintf( chActionText, elCount(chActionText), "Verify v_coreId_u8 is 0 "); 
  snprintf( chExpectedText, elCount(chExpectedText), "Verify Verify v_coreId_u8 is 0"); 
  
  TestStepAddActionExpected( chActionText, chExpectedText );  
  }
  
  A_DBGR_VariableRead("v_coreId_u8",coreID);
  if(coreID == 0)
  {
    write("core ID is : %d",coreID);
    break;
  }
  if(cnt == 0)
  {
  snprintf( chActionText, elCount(chActionText), "Run debugger "); 
  snprintf( chExpectedText, elCount(chExpectedText), "Run debugger "); 
  }
  testWaitForTimeout(1000);
  A_DBGR_Go();
  cnt =cnt+1;
 
  }
  cnt =0;
  E_DBGR_VariableCheck("v_crcSts_u8",3,Equal);
  
  snprintf( chActionText, elCount(chActionText), "Delete all breakpoints "); 
  snprintf( chExpectedText, elCount(chExpectedText), "Breakpoints deleted"); 
  TestStepAddActionExpected( chActionText, chExpectedText );
  A_DBGR_BreakpointDeleteAll();
  /***************************************************************************************************************/    
  	                            // Test Step 6 Set a breakpoint after the line"v_sigVal_u32 = GetHWIO_g_CalcCRC_Sig();"
  /***************************************************************************************************************/
  snprintf( chActionText, elCount(chActionText), "Set Breakpoint in v_crcSts_u8 = GetHWIO_e_CalcCRC_St();"" inside Test_hwcrc_llsi "); 
  snprintf( chExpectedText, elCount(chExpectedText), "Verify Breakpoint is Set in v_crcSts_u8 = GetHWIO_e_CalcCRC_St();"" inside Test_hwcrc_llsi"); 
//  TestStepAddActionExpected( chActionText, chExpectedText );  
  A_DBGR_BreakpointSet("Test_hwcrc_llsi\\341");  

  A_DBGR_Go();
  
  snprintf( chActionText, elCount(chActionText), "Verify Breakpoint should hit in v_crcSts_u8 = GetHWIO_e_CalcCRC_St(); "); 
  snprintf( chExpectedText, elCount(chExpectedText), "Breakpoint hit in v_crcSts_u8 = GetHWIO_e_CalcCRC_St(); function"); 
  E_DBGR_BreakpointCheckForHalt("Test_hwcrc_llsi\\341");
  while(1)
  {
  if(cnt == 0)
  {
  snprintf( chActionText, elCount(chActionText), "Verify v_coreId_u8 is 0 "); 
  snprintf( chExpectedText, elCount(chExpectedText), "Verify Verify v_coreId_u8 is 0"); 
  
  TestStepAddActionExpected( chActionText, chExpectedText );  
  }
  
  A_DBGR_VariableRead("v_coreId_u8",coreID);
  if(coreID == 0)
  {
    write("core ID is : %d",coreID);
    break;
  }
  if(cnt == 0)
  {
  snprintf( chActionText, elCount(chActionText), "Run debugger "); 
  snprintf( chExpectedText, elCount(chExpectedText), "Run debugger "); 
  }
  testWaitForTimeout(1000);
  A_DBGR_Go();
  cnt =cnt+1;
 
  }
  cnt =0;
  E_DBGR_VariableCheck("v_sigVal_u32",0,Equal);
  snprintf( chActionText, elCount(chActionText), "Delete all breakpoints "); 
  snprintf( chExpectedText, elCount(chExpectedText), "Breakpoints deleted"); 
  TestStepAddActionExpected( chActionText, chExpectedText );
  A_DBGR_BreakpointDeleteAll();
  /***************************************************************************************************************/    
  	                            // Test Step 7 Set a breakpoint at line"v_crcSts_u8 = GetHWIO_e_CalcCRC_St();"" inside Test_hwcrc_llsi"
  /***************************************************************************************************************/
  snprintf( chActionText, elCount(chActionText), "Set Breakpoint in v_crcSts_u8 = GetHWIO_e_CalcCRC_St();"" inside Test_hwcrc_llsi "); 
  snprintf( chExpectedText, elCount(chExpectedText), "Verify Breakpoint is Set in v_crcSts_u8 = GetHWIO_e_CalcCRC_St();"" inside Test_hwcrc_llsi"); 
//  TestStepAddActionExpected( chActionText, chExpectedText );  
  A_DBGR_BreakpointSet("Test_hwcrc_llsi\\352");  

  A_DBGR_Go();
  
  snprintf( chActionText, elCount(chActionText), "Verify Breakpoint should hit in v_crcSts_u8 = GetHWIO_e_CalcCRC_St(); "); 
  snprintf( chExpectedText, elCount(chExpectedText), "Breakpoint hit in v_crcSts_u8 = GetHWIO_e_CalcCRC_St(); function"); 
  E_DBGR_BreakpointCheckForHalt("Test_hwcrc_llsi\\352");
  while(1)
  {
  if(cnt == 0)
  {
  snprintf( chActionText, elCount(chActionText), "Verify v_coreId_u8 is 0 "); 
  snprintf( chExpectedText, elCount(chExpectedText), "Verify Verify v_coreId_u8 is 0"); 
  
  TestStepAddActionExpected( chActionText, chExpectedText );  
  }
  
  A_DBGR_VariableRead("v_coreId_u8",coreID);
  if(coreID == 0)
  {
    write("core ID is : %d",coreID);
    break;
  }
  if(cnt == 0)
  {
  snprintf( chActionText, elCount(chActionText), "Run debugger "); 
  snprintf( chExpectedText, elCount(chExpectedText), "Run debugger "); 
  }
  testWaitForTimeout(1000);
  A_DBGR_Go();
  cnt =cnt+1;
 
  }
  cnt =0;
  E_DBGR_VariableCheck("v_crcSts_u8",0,Equal);
}

testcase Verify_CRC_Request_Before_Reading_Signatur_Of_Last_Request_Passed()
{
   /***************************************************************************************************************/    
                                                // Variable Definition
  /***************************************************************************************************************/ 
  

  
  /***************************************************************************************************************/    
                                               // Local Values
  /***************************************************************************************************************/ 
  

  
  /***************************************************************************************************************/    
                                              // Test Case Info
  /***************************************************************************************************************/
  setWriteDbgLevel(DebugOff);
  snprintf( chTestTitle, elCount(chTestTitle), "Verify_CRC_Request_Before_Reading_Signatur_Of_Last_Request_Passed" );
  snprintf( chTestDescription, elCount(chTestDescription), "Purpose:To check the GetHWIO_e_CalcCRC_St(); interface  ");
  TestCaseAddInfo( chTestTitle, "TC_L30SW_Q-37084929", chTestDescription );

  /***************************************************************************************************************/    
                                              // Start of Test Case
  /***************************************************************************************************************/
  
  /***************************************************************************************************************/    
                                              // Test Step 0 PRECONDITIONS
  /***************************************************************************************************************/
  snprintf( chActionText, elCount(chActionText), "Flash the Software and ECU is running "); 
  snprintf( chExpectedText, elCount(chExpectedText), "Ecu is should be in running state"); 
  TestStepAddActionExpected( chActionText, chExpectedText );
  
  A_DBGR_BreakpointDeleteAll();
  A_DBGR_R();
  A_DBGR_Go(); 

  /***************************************************************************************************************/    
                                              // Test Step 1 Set breakpoint in line Test_hwcrc_llsi(); inside "TestApp_Core0_10ms_MainFunction" function and inside testapp.c file
  /***************************************************************************************************************/
  snprintf( chActionText, elCount(chActionText), "Set Breakpoint in Test_hwcrc_llsi(); "); 
  snprintf( chExpectedText, elCount(chExpectedText), "Verify Breakpoint is Set in Test_hwcrc_llsi();"); 
  //TestStepAddActionExpected( chActionText, chExpectedText );  
  A_DBGR_BreakpointSet("TestApp_Core0_10ms_MainFunction\\45");  

  A_DBGR_Go();
  
  snprintf( chActionText, elCount(chActionText), "Verify Breakpoint should hit in Test_hwcrc_llsi(); "); 
  snprintf( chExpectedText, elCount(chExpectedText), "Breakpoint hit in Test_hwcrc_llsi(); function"); 
  E_DBGR_BreakpointCheckForHalt("TestApp_Core0_10ms_MainFunction\\45");
  
  snprintf( chActionText, elCount(chActionText), "Delete all breakpoints "); 
  snprintf( chExpectedText, elCount(chExpectedText), "Breakpoints deleted"); 
  TestStepAddActionExpected( chActionText, chExpectedText );
  
  A_DBGR_BreakpointDeleteAll();
  
   
  /***************************************************************************************************************/    
  	                            // Test Step 2 Set a breakpoint at "v_coreId_u8 = (BYTE)GetCoreID();" inside "Test_hwcrc_llsi" function
  /***************************************************************************************************************/
  
  snprintf( chActionText, elCount(chActionText), "Set Breakpoint in v_coreId_u8 = (BYTE)GetCoreID(); "); 
  snprintf( chExpectedText, elCount(chExpectedText), "Verify Breakpoint is Set in v_coreId_u8 = (BYTE)GetCoreID();"); 
  //TestStepAddActionExpected( chActionText, chExpectedText );  
  A_DBGR_BreakpointSet("Test_hwcrc_llsi\\813");  

  A_DBGR_Go();
  
  snprintf( chActionText, elCount(chActionText), "Verify Breakpoint should hit in v_coreId_u8 = (BYTE)GetCoreID(); "); 
  snprintf( chExpectedText, elCount(chExpectedText), "Breakpoint hit in v_coreId_u8 = (BYTE)GetCoreID(); function"); 
  E_DBGR_BreakpointCheckForHalt("Test_hwcrc_llsi\\813");
  
  /***************************************************************************************************************/    
  	                            // Test Step 3 Verify v_coreId_u8 in trace32 watch window
  /***************************************************************************************************************/
  
   while(1)
  {
  if(cnt == 0)
  {
  snprintf( chActionText, elCount(chActionText), "Verify v_coreId_u8 is 0 "); 
  snprintf( chExpectedText, elCount(chExpectedText), "Verify Verify v_coreId_u8 is 0"); 
  
  TestStepAddActionExpected( chActionText, chExpectedText );  
  }
  
  A_DBGR_VariableRead("v_coreId_u8",coreID);
  if(coreID == 0)
  {
    break;
  }
  if(cnt == 0)
  {
  snprintf( chActionText, elCount(chActionText), "Run debugger "); 
  snprintf( chExpectedText, elCount(chExpectedText), "Run debugger "); 
  }
  A_DBGR_Go();
  testWaitForTimeout(60000);
  cnt =cnt+1;
  }
  E_DBGR_VariableCheck("v_crcSts_u8",0,Equal);
  cnt =0;
  snprintf( chActionText, elCount(chActionText), "delete all breakpoints "); 
  snprintf( chExpectedText, elCount(chExpectedText), "delete all breakpoints "); 
  TestStepAddActionExpected( chActionText, chExpectedText );
  A_DBGR_BreakpointDeleteAll();
  /***************************************************************************************************************/    
  	                            // Test Step 4 Set a breakpoint at line"PerfmHWIO_h_CalcCRC ((BYTE)test_HwCrc_CRC32_ethernet_E, v_seed_u32, v_startAddr_u8, v_endAddr_u8);"
  /***************************************************************************************************************/
  snprintf( chActionText, elCount(chActionText), "Set Breakpoint inPerfmHWIO_h_CalcCRC ((BYTE)test_HwCrc_CRC32_ethernet_E, v_seed_u32, v_startAddr_u8, v_endAddr_u8); "); 
  snprintf( chExpectedText, elCount(chExpectedText), "Verify Breakpoint is Set in PerfmHWIO_h_CalcCRC ((BYTE)test_HwCrc_CRC32_ethernet_E, v_seed_u32, v_startAddr_u8, v_endAddr_u8);"); 
  //TestStepAddActionExpected( chActionText, chExpectedText );  
  A_DBGR_BreakpointSet("Test_hwcrc_llsi\\829");  

  A_DBGR_Go();
  
  snprintf( chActionText, elCount(chActionText), "Verify Breakpoint should hit in v_crcSts_u8 = GetHWIO_e_CalcCRC_St(); "); 
  snprintf( chExpectedText, elCount(chExpectedText), "Breakpoint hit in v_crcSts_u8 = GetHWIO_e_CalcCRC_St(); function"); 
  E_DBGR_BreakpointCheckForHalt("Test_hwcrc_llsi\\829");
  
  while(1)
  {
  if(cnt == 0)
  {
  snprintf( chActionText, elCount(chActionText), "Verify v_coreId_u8 is 0 "); 
  snprintf( chExpectedText, elCount(chExpectedText), "Verify Verify v_coreId_u8 is 0"); 
  
  TestStepAddActionExpected( chActionText, chExpectedText );  
  }
  
  A_DBGR_VariableRead("v_coreId_u8",coreID);
  if(coreID == 0)
  {
    write("core ID is : %d",coreID);
    break;
  }
  if(cnt == 0)
  {
  snprintf( chActionText, elCount(chActionText), "Run debugger "); 
  snprintf( chExpectedText, elCount(chExpectedText), "Run debugger "); 
  }
  testWaitForTimeout(1000);
  A_DBGR_Go();
  cnt =cnt+1;
 
  }
  cnt =0;
  A_DBGR_BreakpointDeleteAll();
  
   /***************************************************************************************************************/    
  	                            // Test Step 5 Set a breakpoint at line"v_crcSts_u8 = GetHWIO_e_CalcCRC_St();"" inside Test_hwcrc_llsi"
  /***************************************************************************************************************/
  snprintf( chActionText, elCount(chActionText), "Set Breakpoint in v_crcSts_u8 = GetHWIO_e_CalcCRC_St();"" inside Test_hwcrc_llsi "); 
  snprintf( chExpectedText, elCount(chExpectedText), "Verify Breakpoint is Set in v_crcSts_u8 = GetHWIO_e_CalcCRC_St();"" inside Test_hwcrc_llsi"); 
//  TestStepAddActionExpected( chActionText, chExpectedText );  
  A_DBGR_BreakpointSet("Test_hwcrc_llsi\\831");  

  A_DBGR_Go();
  
  snprintf( chActionText, elCount(chActionText), "Verify Breakpoint should hit in v_crcSts_u8 = GetHWIO_e_CalcCRC_St(); "); 
  snprintf( chExpectedText, elCount(chExpectedText), "Breakpoint hit in v_crcSts_u8 = GetHWIO_e_CalcCRC_St(); function"); 
  E_DBGR_BreakpointCheckForHalt("Test_hwcrc_llsi\\831");
  while(1)
  {
  if(cnt == 0)
  {
  snprintf( chActionText, elCount(chActionText), "Verify v_coreId_u8 is 0 "); 
  snprintf( chExpectedText, elCount(chExpectedText), "Verify Verify v_coreId_u8 is 0"); 
  
  TestStepAddActionExpected( chActionText, chExpectedText );  
  }
  
  A_DBGR_VariableRead("v_coreId_u8",coreID);
  if(coreID == 0)
  {
    write("core ID is : %d",coreID);
    break;
  }
  if(cnt == 0)
  {
  snprintf( chActionText, elCount(chActionText), "Run debugger "); 
  snprintf( chExpectedText, elCount(chExpectedText), "Run debugger "); 
  }
  testWaitForTimeout(1000);
  A_DBGR_Go();
  cnt =cnt+1;
 
  }
  cnt =0;
  E_DBGR_VariableCheck("v_crcSts_u8",2,Equal);
  
  snprintf( chActionText, elCount(chActionText), "Delete all breakpoints "); 
  snprintf( chExpectedText, elCount(chExpectedText), "Breakpoints deleted"); 
  TestStepAddActionExpected( chActionText, chExpectedText );
  A_DBGR_BreakpointDeleteAll();
  
  /***************************************************************************************************************/    
  	                            // Test Step 6 Set a breakpoint at line"v_crcSts_u8 = GetHWIO_e_CalcCRC_St();"" inside Test_hwcrc_llsi"
  /***************************************************************************************************************/
  snprintf( chActionText, elCount(chActionText), "Set Breakpoint in v_crcSts_u8 = GetHWIO_e_CalcCRC_St();"" inside Test_hwcrc_llsi "); 
  snprintf( chExpectedText, elCount(chExpectedText), "Verify Breakpoint is Set in v_crcSts_u8 = GetHWIO_e_CalcCRC_St();"" inside Test_hwcrc_llsi"); 
//  TestStepAddActionExpected( chActionText, chExpectedText );  
  A_DBGR_BreakpointSet("Test_hwcrc_llsi\\859");  

  A_DBGR_Go();
  
  snprintf( chActionText, elCount(chActionText), "Verify Breakpoint should hit in v_crcSts_u8 = GetHWIO_e_CalcCRC_St(); "); 
  snprintf( chExpectedText, elCount(chExpectedText), "Breakpoint hit in v_crcSts_u8 = GetHWIO_e_CalcCRC_St(); function"); 
  E_DBGR_BreakpointCheckForHalt("Test_hwcrc_llsi\\859");
  while(1)
  {
  if(cnt == 0)
  {
  snprintf( chActionText, elCount(chActionText), "Verify v_coreId_u8 is 0 "); 
  snprintf( chExpectedText, elCount(chExpectedText), "Verify Verify v_coreId_u8 is 0"); 
  
  TestStepAddActionExpected( chActionText, chExpectedText );  
  }
  
  A_DBGR_VariableRead("v_coreId_u8",coreID);
  if(coreID == 0)
  {
    write("core ID is : %d",coreID);
    break;
  }
  if(cnt == 0)
  {
  snprintf( chActionText, elCount(chActionText), "Run debugger "); 
  snprintf( chExpectedText, elCount(chExpectedText), "Run debugger "); 
  }
  testWaitForTimeout(1000);
  A_DBGR_Go();
  cnt =cnt+1;
 
  }
  cnt =0;
  //E_DBGR_VariableCheck("v_crcSts_u8",0,Equal);
  
  snprintf( chActionText, elCount(chActionText), "Delete all breakpoints "); 
  snprintf( chExpectedText, elCount(chExpectedText), "Breakpoints deleted"); 
  //TestStepAddActionExpected( chActionText, chExpectedText );
  A_DBGR_BreakpointDeleteAll();
  
  /***************************************************************************************************************/    
  	                            // Test Step 7 Set a breakpoint at line"v_crcSts_u8 = GetHWIO_e_CalcCRC_St();"" inside Test_hwcrc_llsi"
  /***************************************************************************************************************/
  snprintf( chActionText, elCount(chActionText), "Set Breakpoint in v_crcSts_u8 = GetHWIO_e_CalcCRC_St();"" inside Test_hwcrc_llsi "); 
  snprintf( chExpectedText, elCount(chExpectedText), "Verify Breakpoint is Set in v_crcSts_u8 = GetHWIO_e_CalcCRC_St();"" inside Test_hwcrc_llsi"); 
//  TestStepAddActionExpected( chActionText, chExpectedText );  
  A_DBGR_BreakpointSet("Test_hwcrc_llsi\\861");  

  A_DBGR_Go();
  testWaitForTimeout(4000);
  snprintf( chActionText, elCount(chActionText), "Verify Breakpoint should hit in v_crcSts_u8 = GetHWIO_e_CalcCRC_St(); "); 
  snprintf( chExpectedText, elCount(chExpectedText), "Breakpoint hit in v_crcSts_u8 = GetHWIO_e_CalcCRC_St(); function"); 
  E_DBGR_BreakpointCheckForHalt("Test_hwcrc_llsi\\861");
  while(1)
  {
  if(cnt == 0)
  {
  snprintf( chActionText, elCount(chActionText), "Verify v_coreId_u8 is 0 "); 
  snprintf( chExpectedText, elCount(chExpectedText), "Verify Verify v_coreId_u8 is 0"); 
  
  TestStepAddActionExpected( chActionText, chExpectedText );  
  }
  
  A_DBGR_VariableRead("v_coreId_u8",coreID);
  if(coreID == 0)
  {
    write("core ID is : %d",coreID);
    break;
  }
  if(cnt == 0)
  {
  snprintf( chActionText, elCount(chActionText), "Run debugger "); 
  snprintf( chExpectedText, elCount(chExpectedText), "Run debugger "); 
  }
  testWaitForTimeout(2000);
  A_DBGR_Go();
  cnt =cnt+1;
 
  }
  cnt =0;
  E_DBGR_VariableCheck("v_crcSts_u8",2,Equal);
  snprintf( chActionText, elCount(chActionText), "Delete all breakpoints "); 
  snprintf( chExpectedText, elCount(chExpectedText), "Breakpoints deleted"); 
  TestStepAddActionExpected( chActionText, chExpectedText );
  A_DBGR_BreakpointDeleteAll();

  /***************************************************************************************************************/    
  	                            // Test Step 8 Set a breakpoint after the line"v_sigVal_u32 = GetHWIO_g_CalcCRC_Sig();"
  /***************************************************************************************************************/
  snprintf( chActionText, elCount(chActionText), "Set Breakpoint in v_crcSts_u8 = GetHWIO_e_CalcCRC_St();"" inside Test_hwcrc_llsi "); 
  snprintf( chExpectedText, elCount(chExpectedText), "Verify Breakpoint is Set in v_crcSts_u8 = GetHWIO_e_CalcCRC_St();"" inside Test_hwcrc_llsi"); 
//  TestStepAddActionExpected( chActionText, chExpectedText );  
  A_DBGR_BreakpointSet("Test_hwcrc_llsi\\888");  

  A_DBGR_Go();
  
  snprintf( chActionText, elCount(chActionText), "Verify Breakpoint should hit in v_crcSts_u8 = GetHWIO_e_CalcCRC_St(); "); 
  snprintf( chExpectedText, elCount(chExpectedText), "Breakpoint hit in v_crcSts_u8 = GetHWIO_e_CalcCRC_St(); function"); 
  E_DBGR_BreakpointCheckForHalt("Test_hwcrc_llsi\\888");
  while(1)
  {
  if(cnt == 0)
  {
  snprintf( chActionText, elCount(chActionText), "Verify v_coreId_u8 is 0 "); 
  snprintf( chExpectedText, elCount(chExpectedText), "Verify Verify v_coreId_u8 is 0"); 
  
  TestStepAddActionExpected( chActionText, chExpectedText );  
  }
  
  A_DBGR_VariableRead("v_coreId_u8",coreID);
  if(coreID == 0)
  {
    write("core ID is : %d",coreID);
    break;
  }
  if(cnt == 0)
  {
  snprintf( chActionText, elCount(chActionText), "Run debugger "); 
  snprintf( chExpectedText, elCount(chExpectedText), "Run debugger "); 
  }
  testWaitForTimeout(1000);
  A_DBGR_Go();
  cnt =cnt+1;
 
  }
  cnt =0;
  E_DBGR_VariableCheck("v_sigVal_u32",0xA0,Equal);
  snprintf( chActionText, elCount(chActionText), "Delete all breakpoints "); 
  snprintf( chExpectedText, elCount(chExpectedText), "Breakpoints deleted"); 
  TestStepAddActionExpected( chActionText, chExpectedText );
  A_DBGR_BreakpointDeleteAll();
  
  /***************************************************************************************************************/    
  	                            // Test Step 9 Set a breakpoint at line"v_crcSts_u8 = GetHWIO_e_CalcCRC_St();"" inside Test_hwcrc_llsi"
  /***************************************************************************************************************/
  snprintf( chActionText, elCount(chActionText), "Set Breakpoint in v_crcSts_u8 = GetHWIO_e_CalcCRC_St();"" inside Test_hwcrc_llsi "); 
  snprintf( chExpectedText, elCount(chExpectedText), "Verify Breakpoint is Set in v_crcSts_u8 = GetHWIO_e_CalcCRC_St();"" inside Test_hwcrc_llsi"); 
//  TestStepAddActionExpected( chActionText, chExpectedText );  
  A_DBGR_BreakpointSet("Test_hwcrc_llsi\\910");  

  A_DBGR_Go();
  
  snprintf( chActionText, elCount(chActionText), "Verify Breakpoint should hit in v_crcSts_u8 = GetHWIO_e_CalcCRC_St(); "); 
  snprintf( chExpectedText, elCount(chExpectedText), "Breakpoint hit in v_crcSts_u8 = GetHWIO_e_CalcCRC_St(); function"); 
  E_DBGR_BreakpointCheckForHalt("Test_hwcrc_llsi\\910");
  while(1)
  {
  if(cnt == 0)
  {
  snprintf( chActionText, elCount(chActionText), "Verify v_coreId_u8 is 0 "); 
  snprintf( chExpectedText, elCount(chExpectedText), "Verify Verify v_coreId_u8 is 0"); 
  
  TestStepAddActionExpected( chActionText, chExpectedText );  
  }
  
  A_DBGR_VariableRead("v_coreId_u8",coreID);
  if(coreID == 0)
  {
    write("core ID is : %d",coreID);
    break;
  }
  if(cnt == 0)
  {
  snprintf( chActionText, elCount(chActionText), "Run debugger "); 
  snprintf( chExpectedText, elCount(chExpectedText), "Run debugger "); 
  }
  testWaitForTimeout(1000);
  A_DBGR_Go();
  cnt =cnt+1;
 
  }
  cnt =0;
  E_DBGR_VariableCheck("v_crcSts_u8",0,Equal);
}

testcase Verify_CRC_Request_Before_Reading_Signatur_Of_Last_Request_Failed()
{
   /***************************************************************************************************************/    
                                                // Variable Definition
  /***************************************************************************************************************/ 
  

  
  /***************************************************************************************************************/    
                                               // Local Values
  /***************************************************************************************************************/ 
  

  
  /***************************************************************************************************************/    
                                              // Test Case Info
  /***************************************************************************************************************/
  setWriteDbgLevel(DebugOff);
  snprintf( chTestTitle, elCount(chTestTitle), "Verify_CRC_Request_Before_Reading_Signatur_Of_Last_Request_Failed" );
  snprintf( chTestDescription, elCount(chTestDescription), "Purpose:To check the GetHWIO_e_CalcCRC_St(); interface  ");
  TestCaseAddInfo( chTestTitle, "TC_L30SW_Q-37084972", chTestDescription );

  /***************************************************************************************************************/    
                                              // Start of Test Case
  /***************************************************************************************************************/
  
  /***************************************************************************************************************/    
                                              // Test Step 0 PRECONDITIONS
  /***************************************************************************************************************/
  snprintf( chActionText, elCount(chActionText), "Flash the Software and ECU is running "); 
  snprintf( chExpectedText, elCount(chExpectedText), "Ecu is should be in running state"); 
  TestStepAddActionExpected( chActionText, chExpectedText );
  
  A_DBGR_BreakpointDeleteAll();
  A_DBGR_R();
  A_DBGR_Go(); 

  /***************************************************************************************************************/    
                                              // Test Step 1 Set breakpoint in line Test_hwcrc_llsi(); inside "TestApp_Core0_10ms_MainFunction" function and inside testapp.c file
  /***************************************************************************************************************/
  snprintf( chActionText, elCount(chActionText), "Set Breakpoint in Test_hwcrc_llsi(); "); 
  snprintf( chExpectedText, elCount(chExpectedText), "Verify Breakpoint is Set in Test_hwcrc_llsi();"); 
  //TestStepAddActionExpected( chActionText, chExpectedText );  
  A_DBGR_BreakpointSet("TestApp_Core0_10ms_MainFunction\\45");  

  A_DBGR_Go();
  
  snprintf( chActionText, elCount(chActionText), "Verify Breakpoint should hit in Test_hwcrc_llsi(); "); 
  snprintf( chExpectedText, elCount(chExpectedText), "Breakpoint hit in Test_hwcrc_llsi(); function"); 
  E_DBGR_BreakpointCheckForHalt("TestApp_Core0_10ms_MainFunction\\45");
  
  snprintf( chActionText, elCount(chActionText), "Delete all breakpoints "); 
  snprintf( chExpectedText, elCount(chExpectedText), "Breakpoints deleted"); 
  TestStepAddActionExpected( chActionText, chExpectedText );
  
  A_DBGR_BreakpointDeleteAll();
  
   
  /***************************************************************************************************************/    
  	                            // Test Step 2 Set a breakpoint at "v_coreId_u8 = (BYTE)GetCoreID();" inside "Test_hwcrc_llsi" function
  /***************************************************************************************************************/
  
  snprintf( chActionText, elCount(chActionText), "Set Breakpoint in v_coreId_u8 = (BYTE)GetCoreID(); "); 
  snprintf( chExpectedText, elCount(chExpectedText), "Verify Breakpoint is Set in v_coreId_u8 = (BYTE)GetCoreID();"); 
  //TestStepAddActionExpected( chActionText, chExpectedText );  
  A_DBGR_BreakpointSet("Test_hwcrc_llsi\\308");  

  A_DBGR_Go();
  
  snprintf( chActionText, elCount(chActionText), "Verify Breakpoint should hit in v_coreId_u8 = (BYTE)GetCoreID(); "); 
  snprintf( chExpectedText, elCount(chExpectedText), "Breakpoint hit in v_coreId_u8 = (BYTE)GetCoreID(); function"); 
  E_DBGR_BreakpointCheckForHalt("Test_hwcrc_llsi\\308");
  
  /***************************************************************************************************************/    
  	                            // Test Step 3 Verify v_coreId_u8 in trace32 watch window
  /***************************************************************************************************************/
  
   while(1)
  {
  if(cnt == 0)
  {
  snprintf( chActionText, elCount(chActionText), "Verify v_coreId_u8 is 0 "); 
  snprintf( chExpectedText, elCount(chExpectedText), "Verify Verify v_coreId_u8 is 0"); 
  
  TestStepAddActionExpected( chActionText, chExpectedText );  
  }
  
  A_DBGR_VariableRead("v_coreId_u8",coreID);
  if(coreID == 0)
  {
    break;
  }
  if(cnt == 0)
  {
  snprintf( chActionText, elCount(chActionText), "Run debugger "); 
  snprintf( chExpectedText, elCount(chExpectedText), "Run debugger "); 
  }
  A_DBGR_Go();
  testWaitForTimeout(60000);
  cnt =cnt+1;
  }
  E_DBGR_VariableCheck("v_crcSts_u8",0,Equal);
  cnt =0;
  snprintf( chActionText, elCount(chActionText), "delete all breakpoints "); 
  snprintf( chExpectedText, elCount(chExpectedText), "delete all breakpoints "); 
  TestStepAddActionExpected( chActionText, chExpectedText );
  A_DBGR_BreakpointDeleteAll();
  /***************************************************************************************************************/    
  	                            // Test Step 4 Set a breakpoint at line"PerfmHWIO_h_CalcCRC ((BYTE)test_HwCrc_CRC32_ethernet_E, v_seed_u32, v_startAddr_u8, v_endAddr_u8);"
  /***************************************************************************************************************/
  snprintf( chActionText, elCount(chActionText), "Set Breakpoint inPerfmHWIO_h_CalcCRC ((BYTE)test_HwCrc_CRC32_ethernet_E, v_seed_u32, v_startAddr_u8, v_endAddr_u8); "); 
  snprintf( chExpectedText, elCount(chExpectedText), "Verify Breakpoint is Set in PerfmHWIO_h_CalcCRC ((BYTE)test_HwCrc_CRC32_ethernet_E, v_seed_u32, v_startAddr_u8, v_endAddr_u8);"); 
  //TestStepAddActionExpected( chActionText, chExpectedText );  
  A_DBGR_BreakpointSet("Test_hwcrc_llsi\\518");  

  A_DBGR_Go();
  
  snprintf( chActionText, elCount(chActionText), "Verify Breakpoint should hit in v_crcSts_u8 = GetHWIO_e_CalcCRC_St(); "); 
  snprintf( chExpectedText, elCount(chExpectedText), "Breakpoint hit in v_crcSts_u8 = GetHWIO_e_CalcCRC_St(); function"); 
  E_DBGR_BreakpointCheckForHalt("Test_hwcrc_llsi\\518");
  
  while(1)
  {
  if(cnt == 0)
  {
  snprintf( chActionText, elCount(chActionText), "Verify v_coreId_u8 is 0 "); 
  snprintf( chExpectedText, elCount(chExpectedText), "Verify Verify v_coreId_u8 is 0"); 
  
  TestStepAddActionExpected( chActionText, chExpectedText );  
  }
  
  A_DBGR_VariableRead("v_coreId_u8",coreID);
  if(coreID == 0)
  {
    write("core ID is : %d",coreID);
    break;
  }
  if(cnt == 0)
  {
  snprintf( chActionText, elCount(chActionText), "Run debugger "); 
  snprintf( chExpectedText, elCount(chExpectedText), "Run debugger "); 
  }
  testWaitForTimeout(5000);
  A_DBGR_Go();
  cnt =cnt+1;
 
  }
  cnt =0;
  A_DBGR_BreakpointDeleteAll();
  
   /***************************************************************************************************************/    
  	                            // Test Step 5 Set a breakpoint at line"v_crcSts_u8 = GetHWIO_e_CalcCRC_St();"" inside Test_hwcrc_llsi"
  /***************************************************************************************************************/
  snprintf( chActionText, elCount(chActionText), "Set Breakpoint in v_crcSts_u8 = GetHWIO_e_CalcCRC_St();"" inside Test_hwcrc_llsi "); 
  snprintf( chExpectedText, elCount(chExpectedText), "Verify Breakpoint is Set in v_crcSts_u8 = GetHWIO_e_CalcCRC_St();"" inside Test_hwcrc_llsi"); 
//  TestStepAddActionExpected( chActionText, chExpectedText );  
  A_DBGR_BreakpointSet("Test_hwcrc_llsi\\520");  

  A_DBGR_Go();
  
  snprintf( chActionText, elCount(chActionText), "Verify Breakpoint should hit in v_crcSts_u8 = GetHWIO_e_CalcCRC_St(); "); 
  snprintf( chExpectedText, elCount(chExpectedText), "Breakpoint hit in v_crcSts_u8 = GetHWIO_e_CalcCRC_St(); function"); 
  E_DBGR_BreakpointCheckForHalt("Test_hwcrc_llsi\\520");
  while(1)
  {
  if(cnt == 0)
  {
  snprintf( chActionText, elCount(chActionText), "Verify v_coreId_u8 is 0 "); 
  snprintf( chExpectedText, elCount(chExpectedText), "Verify Verify v_coreId_u8 is 0"); 
  
  TestStepAddActionExpected( chActionText, chExpectedText );  
  }
  
  A_DBGR_VariableRead("v_coreId_u8",coreID);
  if(coreID == 0)
  {
    write("core ID is : %d",coreID);
    break;
  }
  if(cnt == 0)
  {
  snprintf( chActionText, elCount(chActionText), "Run debugger "); 
  snprintf( chExpectedText, elCount(chExpectedText), "Run debugger "); 
  }
  testWaitForTimeout(5000);
  A_DBGR_Go();
  cnt =cnt+1;
 
  }
  cnt =0;
  E_DBGR_VariableCheck("v_crcSts_u8",3,Equal);
  
  snprintf( chActionText, elCount(chActionText), "Delete all breakpoints "); 
  snprintf( chExpectedText, elCount(chExpectedText), "Breakpoints deleted"); 
  TestStepAddActionExpected( chActionText, chExpectedText );
  A_DBGR_BreakpointDeleteAll();
  
  /***************************************************************************************************************/    
  	                            // Test Step 6 Set a breakpoint at line"v_crcSts_u8 = GetHWIO_e_CalcCRC_St();"" inside Test_hwcrc_llsi"
  /***************************************************************************************************************/
  snprintf( chActionText, elCount(chActionText), "Set Breakpoint in v_crcSts_u8 = GetHWIO_e_CalcCRC_St();"" inside Test_hwcrc_llsi "); 
  snprintf( chExpectedText, elCount(chExpectedText), "Verify Breakpoint is Set in v_crcSts_u8 = GetHWIO_e_CalcCRC_St();"" inside Test_hwcrc_llsi"); 
//  TestStepAddActionExpected( chActionText, chExpectedText );  
  A_DBGR_BreakpointSet("Test_hwcrc_llsi\\534");  
  testWaitForTimeout(1000);
  A_DBGR_Go();
  
  snprintf( chActionText, elCount(chActionText), "Verify Breakpoint should hit in v_crcSts_u8 = GetHWIO_e_CalcCRC_St(); "); 
  snprintf( chExpectedText, elCount(chExpectedText), "Breakpoint hit in v_crcSts_u8 = GetHWIO_e_CalcCRC_St(); function"); 
  E_DBGR_BreakpointCheckForHalt("Test_hwcrc_llsi\\534");
  while(1)
  {
  if(cnt == 0)
  {
  snprintf( chActionText, elCount(chActionText), "Verify v_coreId_u8 is 0 "); 
  snprintf( chExpectedText, elCount(chExpectedText), "Verify Verify v_coreId_u8 is 0"); 
  
  TestStepAddActionExpected( chActionText, chExpectedText );  
  }
  
  A_DBGR_VariableRead("v_coreId_u8",coreID);
  if(coreID == 0)
  {
    write("core ID is : %d",coreID);
    break;
  }
  if(cnt == 0)
  {
  snprintf( chActionText, elCount(chActionText), "Run debugger "); 
  snprintf( chExpectedText, elCount(chExpectedText), "Run debugger "); 
  }
  testWaitForTimeout(3000);
  A_DBGR_Go();
  cnt =cnt+1;
 
  }
  cnt =0;
  //E_DBGR_VariableCheck("v_crcSts_u8",0,Equal);
  
//  snprintf( chActionText, elCount(chActionText), "Delete all breakpoints "); 
//  snprintf( chExpectedText, elCount(chExpectedText), "Breakpoints deleted"); 
//  TestStepAddActionExpected( chActionText, chExpectedText );
  A_DBGR_BreakpointDeleteAll();
  
  /***************************************************************************************************************/    
  	                            // Test Step 7 Set a breakpoint at line"v_crcSts_u8 = GetHWIO_e_CalcCRC_St();"" inside Test_hwcrc_llsi"
  /***************************************************************************************************************/
  snprintf( chActionText, elCount(chActionText), "Set Breakpoint in v_crcSts_u8 = GetHWIO_e_CalcCRC_St();"" inside Test_hwcrc_llsi "); 
  snprintf( chExpectedText, elCount(chExpectedText), "Verify Breakpoint is Set in v_crcSts_u8 = GetHWIO_e_CalcCRC_St();"" inside Test_hwcrc_llsi"); 
//  TestStepAddActionExpected( chActionText, chExpectedText );  
  A_DBGR_BreakpointSet("Test_hwcrc_llsi\\536");  

  A_DBGR_Go();
  testWaitForTimeout(4000);
  snprintf( chActionText, elCount(chActionText), "Verify Breakpoint should hit in v_crcSts_u8 = GetHWIO_e_CalcCRC_St(); "); 
  snprintf( chExpectedText, elCount(chExpectedText), "Breakpoint hit in v_crcSts_u8 = GetHWIO_e_CalcCRC_St(); function"); 
  E_DBGR_BreakpointCheckForHalt("Test_hwcrc_llsi\\536");
  while(1)
  {
  if(cnt == 0)
  {
  snprintf( chActionText, elCount(chActionText), "Verify v_coreId_u8 is 0 "); 
  snprintf( chExpectedText, elCount(chExpectedText), "Verify Verify v_coreId_u8 is 0"); 
  
  TestStepAddActionExpected( chActionText, chExpectedText );  
  }
  
  A_DBGR_VariableRead("v_coreId_u8",coreID);
  if(coreID == 0)
  {
    write("core ID is : %d",coreID);
    break;
  }
  if(cnt == 0)
  {
  snprintf( chActionText, elCount(chActionText), "Run debugger "); 
  snprintf( chExpectedText, elCount(chExpectedText), "Run debugger "); 
  }
  testWaitForTimeout(2000);
  A_DBGR_Go();
  cnt =cnt+1;
 
  }
  cnt =0;
  E_DBGR_VariableCheck("v_crcSts_u8",3,Equal);
  snprintf( chActionText, elCount(chActionText), "Delete all breakpoints "); 
  snprintf( chExpectedText, elCount(chExpectedText), "Breakpoints deleted"); 
  TestStepAddActionExpected( chActionText, chExpectedText );
  A_DBGR_BreakpointDeleteAll();

  /***************************************************************************************************************/    
  	                            // Test Step 8 Set a breakpoint after the line"v_sigVal_u32 = GetHWIO_g_CalcCRC_Sig();"
  /***************************************************************************************************************/
  snprintf( chActionText, elCount(chActionText), "Set Breakpoint in v_crcSts_u8 = GetHWIO_e_CalcCRC_St();"" inside Test_hwcrc_llsi "); 
  snprintf( chExpectedText, elCount(chExpectedText), "Verify Breakpoint is Set in v_crcSts_u8 = GetHWIO_e_CalcCRC_St();"" inside Test_hwcrc_llsi"); 
//  TestStepAddActionExpected( chActionText, chExpectedText );  
  A_DBGR_BreakpointSet("Test_hwcrc_llsi\\549");  

  A_DBGR_Go();
  
  snprintf( chActionText, elCount(chActionText), "Verify Breakpoint should hit in v_crcSts_u8 = GetHWIO_e_CalcCRC_St(); "); 
  snprintf( chExpectedText, elCount(chExpectedText), "Breakpoint hit in v_crcSts_u8 = GetHWIO_e_CalcCRC_St(); function"); 
  E_DBGR_BreakpointCheckForHalt("Test_hwcrc_llsi\\549");
  while(1)
  {
  if(cnt == 0)
  {
  snprintf( chActionText, elCount(chActionText), "Verify v_coreId_u8 is 0 "); 
  snprintf( chExpectedText, elCount(chExpectedText), "Verify Verify v_coreId_u8 is 0"); 
  
  TestStepAddActionExpected( chActionText, chExpectedText );  
  }
  
  A_DBGR_VariableRead("v_coreId_u8",coreID);
  if(coreID == 0)
  {
    write("core ID is : %d",coreID);
    break;
  }
  if(cnt == 0)
  {
  snprintf( chActionText, elCount(chActionText), "Run debugger "); 
  snprintf( chExpectedText, elCount(chExpectedText), "Run debugger "); 
  }
  testWaitForTimeout(1000);
  A_DBGR_Go();
  cnt =cnt+1;
 
  }
  cnt =0;
  E_DBGR_VariableCheck("v_sigVal_u32",0,Equal);
  snprintf( chActionText, elCount(chActionText), "Delete all breakpoints "); 
  snprintf( chExpectedText, elCount(chExpectedText), "Breakpoints deleted"); 
  TestStepAddActionExpected( chActionText, chExpectedText );
  A_DBGR_BreakpointDeleteAll();
  
  /***************************************************************************************************************/    
  	                            // Test Step 9 Set a breakpoint at line"v_crcSts_u8 = GetHWIO_e_CalcCRC_St();"" inside Test_hwcrc_llsi"
  /***************************************************************************************************************/
  snprintf( chActionText, elCount(chActionText), "Set Breakpoint in v_crcSts_u8 = GetHWIO_e_CalcCRC_St();"" inside Test_hwcrc_llsi "); 
  snprintf( chExpectedText, elCount(chExpectedText), "Verify Breakpoint is Set in v_crcSts_u8 = GetHWIO_e_CalcCRC_St();"" inside Test_hwcrc_llsi"); 
//  TestStepAddActionExpected( chActionText, chExpectedText );  
  A_DBGR_BreakpointSet("Test_hwcrc_llsi\\549");  

  A_DBGR_Go();
  
  snprintf( chActionText, elCount(chActionText), "Verify Breakpoint should hit in v_crcSts_u8 = GetHWIO_e_CalcCRC_St(); "); 
  snprintf( chExpectedText, elCount(chExpectedText), "Breakpoint hit in v_crcSts_u8 = GetHWIO_e_CalcCRC_St(); function"); 
  E_DBGR_BreakpointCheckForHalt("Test_hwcrc_llsi\\549");
  while(1)
  {
  if(cnt == 0)
  {
  snprintf( chActionText, elCount(chActionText), "Verify v_coreId_u8 is 0 "); 
  snprintf( chExpectedText, elCount(chExpectedText), "Verify Verify v_coreId_u8 is 0"); 
  
  TestStepAddActionExpected( chActionText, chExpectedText );  
  }
  
  A_DBGR_VariableRead("v_coreId_u8",coreID);
  if(coreID == 0)
  {
    write("core ID is : %d",coreID);
    break;
  }
  if(cnt == 0)
  {
  snprintf( chActionText, elCount(chActionText), "Run debugger "); 
  snprintf( chExpectedText, elCount(chExpectedText), "Run debugger "); 
  }
  testWaitForTimeout(1000);
  A_DBGR_Go();
  cnt =cnt+1;
 
  }
  cnt =0;
  E_DBGR_VariableCheck("v_crcSts_u8",0,Equal);
}

testcase Verify_Hardware_CRC8_Calculation_Failure_Reporting_Core_1()
{
  /***************************************************************************************************************/    
                                                // Variable Definition
  /***************************************************************************************************************/ 
  

  
  /***************************************************************************************************************/    
                                               // Local Values
  /***************************************************************************************************************/ 
  

  
  /***************************************************************************************************************/    
                                              // Test Case Info
  /***************************************************************************************************************/
  setWriteDbgLevel(DebugOff);
  snprintf( chTestTitle, elCount(chTestTitle), "Verify_Hardware_CRC8_Calculation_Failure_Reporting_Core_1" );
  snprintf( chTestDescription, elCount(chTestDescription), "Purpose:To check the GetHWIO_e_CalcCRC_St(); interface  ");
  TestCaseAddInfo( chTestTitle, "TC_L30SW_Q-37518364", chTestDescription );

  /***************************************************************************************************************/    
                                              // Start of Test Case
  /***************************************************************************************************************/
  
  /***************************************************************************************************************/    
                                              // Test Step 0 PRECONDITIONS
  /***************************************************************************************************************/
  snprintf( chActionText, elCount(chActionText), "Flash the Software and ECU is running "); 
  snprintf( chExpectedText, elCount(chExpectedText), "Ecu is should be in running state"); 
  TestStepAddActionExpected( chActionText, chExpectedText );
  
  A_DBGR_BreakpointDeleteAll();
  A_DBGR_R();
  A_DBGR_Go(); 

  /***************************************************************************************************************/    
                                              // Test Step 1 Set breakpoint in line Test_hwcrc_llsi(); inside "TestApp_Core0_10ms_MainFunction" function and inside testapp.c file
  /***************************************************************************************************************/
  snprintf( chActionText, elCount(chActionText), "Set Breakpoint in Test_hwcrc_llsi(); "); 
  snprintf( chExpectedText, elCount(chExpectedText), "Verify Breakpoint is Set in Test_hwcrc_llsi();"); 
  //TestStepAddActionExpected( chActionText, chExpectedText );  
  A_DBGR_BreakpointSet("TestApp_Core0_10ms_MainFunction\\45");  

  A_DBGR_Go();
  
  snprintf( chActionText, elCount(chActionText), "Verify Breakpoint should hit in Test_hwcrc_llsi(); "); 
  snprintf( chExpectedText, elCount(chExpectedText), "Breakpoint hit in Test_hwcrc_llsi(); function"); 
  E_DBGR_BreakpointCheckForHalt("TestApp_Core0_10ms_MainFunction\\45");
  
  snprintf( chActionText, elCount(chActionText), "Delete all breakpoints "); 
  snprintf( chExpectedText, elCount(chExpectedText), "Breakpoints deleted"); 
  TestStepAddActionExpected( chActionText, chExpectedText );
  
  A_DBGR_BreakpointDeleteAll();
   
  
   
  /***************************************************************************************************************/    
  	                            // Test Step 2 Set a breakpoint at "v_coreId_u8 = (BYTE)GetCoreID();" inside "Test_hwcrc_llsi" function
  /***************************************************************************************************************/
  
  snprintf( chActionText, elCount(chActionText), "Set Breakpoint in v_coreId_u8 = (BYTE)GetCoreID(); "); 
  snprintf( chExpectedText, elCount(chExpectedText), "Verify Breakpoint is Set in v_coreId_u8 = (BYTE)GetCoreID();"); 
  //TestStepAddActionExpected( chActionText, chExpectedText );  
  A_DBGR_BreakpointSet("Test_hwcrc_llsi\\910");  

  A_DBGR_Go();
  
  snprintf( chActionText, elCount(chActionText), "Verify Breakpoint should hit in v_coreId_u8 = (BYTE)GetCoreID(); "); 
  snprintf( chExpectedText, elCount(chExpectedText), "Breakpoint hit in v_coreId_u8 = (BYTE)GetCoreID(); function"); 
  E_DBGR_BreakpointCheckForHalt("Test_hwcrc_llsi\\910");
  
  /***************************************************************************************************************/    
  	                            // Test Step 3 Verify v_coreId_u8 in trace32 watch window
  /***************************************************************************************************************/
  
   while(1)
  {
  if(cnt == 0)
  {
  snprintf( chActionText, elCount(chActionText), "Verify v_coreId_u8 is 1 "); 
  snprintf( chExpectedText, elCount(chExpectedText), "Verify Verify v_coreId_u8 is 1"); 
  
  TestStepAddActionExpected( chActionText, chExpectedText );  
  }
  
  A_DBGR_VariableRead("v_coreId_u8",coreID);
  if(coreID == 1)
  {
    break;
  }
  if(cnt == 0)
  {
  snprintf( chActionText, elCount(chActionText), "Run debugger "); 
  snprintf( chExpectedText, elCount(chExpectedText), "Run debugger "); 
  }
  A_DBGR_Go();
  cnt =cnt+1;
  }
  E_DBGR_VariableCheck("v_crcSts_u8",0,Equal);
  cnt =0;
  snprintf( chActionText, elCount(chActionText), "delete all breakpoints "); 
  snprintf( chExpectedText, elCount(chExpectedText), "delete all breakpoints "); 
  TestStepAddActionExpected( chActionText, chExpectedText );
  A_DBGR_BreakpointDeleteAll();
  /***************************************************************************************************************/    
  	                            // Test Step 4 Set a breakpoint at line"PerfmHWIO_h_CalcCRC ((BYTE)test_HwCrc_CRC32_ethernet_E, v_seed_u32, v_startAddr_u8, v_endAddr_u8);"
  /***************************************************************************************************************/
  snprintf( chActionText, elCount(chActionText), "Set Breakpoint inPerfmHWIO_h_CalcCRC ((BYTE)test_HwCrc_CRC32_ethernet_E, v_seed_u32, v_startAddr_u8, v_endAddr_u8); "); 
  snprintf( chExpectedText, elCount(chExpectedText), "Verify Breakpoint is Set in PerfmHWIO_h_CalcCRC ((BYTE)test_HwCrc_CRC32_ethernet_E, v_seed_u32, v_startAddr_u8, v_endAddr_u8);"); 
  //TestStepAddActionExpected( chActionText, chExpectedText );  
  A_DBGR_BreakpointSet("Test_hwcrc_llsi\\926");  

  A_DBGR_Go();
  
  snprintf( chActionText, elCount(chActionText), "Verify Breakpoint should hit in v_crcSts_u8 = GetHWIO_e_CalcCRC_St(); "); 
  snprintf( chExpectedText, elCount(chExpectedText), "Breakpoint hit in v_crcSts_u8 = GetHWIO_e_CalcCRC_St(); function"); 
  E_DBGR_BreakpointCheckForHalt("Test_hwcrc_llsi\\926");
  
  while(1)
  {
  if(cnt == 0)
  {
  snprintf( chActionText, elCount(chActionText), "Verify v_coreId_u8 is 1 "); 
  snprintf( chExpectedText, elCount(chExpectedText), "Verify Verify v_coreId_u8 is 1"); 
  
  TestStepAddActionExpected( chActionText, chExpectedText );  
  }
  
  A_DBGR_VariableRead("v_coreId_u8",coreID);
  if(coreID == 1)
  {
    write("core ID is : %d",coreID);
    break;
  }
  if(cnt == 0)
  {
  snprintf( chActionText, elCount(chActionText), "Run debugger "); 
  snprintf( chExpectedText, elCount(chExpectedText), "Run debugger "); 
  }
  testWaitForTimeout(1000);
  A_DBGR_Go();
  cnt =cnt+1;
 
  }
  cnt =0;
  A_DBGR_BreakpointDeleteAll();
  
   /***************************************************************************************************************/    
  	                            // Test Step 5 Set a breakpoint at line"v_crcSts_u8 = GetHWIO_e_CalcCRC_St();"" inside Test_hwcrc_llsi"
  /***************************************************************************************************************/
  snprintf( chActionText, elCount(chActionText), "Set Breakpoint in v_crcSts_u8 = GetHWIO_e_CalcCRC_St();"" inside Test_hwcrc_llsi "); 
  snprintf( chExpectedText, elCount(chExpectedText), "Verify Breakpoint is Set in v_crcSts_u8 = GetHWIO_e_CalcCRC_St();"" inside Test_hwcrc_llsi"); 
//  TestStepAddActionExpected( chActionText, chExpectedText );  
  A_DBGR_BreakpointSet("Test_hwcrc_llsi\\928");  

  A_DBGR_Go();
  
  snprintf( chActionText, elCount(chActionText), "Verify Breakpoint should hit in v_crcSts_u8 = GetHWIO_e_CalcCRC_St(); "); 
  snprintf( chExpectedText, elCount(chExpectedText), "Breakpoint hit in v_crcSts_u8 = GetHWIO_e_CalcCRC_St(); function"); 
  E_DBGR_BreakpointCheckForHalt("Test_hwcrc_llsi\\928");
  while(1)
  {
  if(cnt == 0)
  {
  snprintf( chActionText, elCount(chActionText), "Verify v_coreId_u8 is 1 "); 
  snprintf( chExpectedText, elCount(chExpectedText), "Verify Verify v_coreId_u8 is 1"); 
  
  TestStepAddActionExpected( chActionText, chExpectedText );  
  }
  
  A_DBGR_VariableRead("v_coreId_u8",coreID);
  if(coreID == 1)
  {
    write("core ID is : %d",coreID);
    break;
  }
  if(cnt == 0)
  {
  snprintf( chActionText, elCount(chActionText), "Run debugger "); 
  snprintf( chExpectedText, elCount(chExpectedText), "Run debugger "); 
  }
  testWaitForTimeout(1000);
  A_DBGR_Go();
  cnt =cnt+1;
 
  }
  cnt =0;
  E_DBGR_VariableCheck("v_crcSts_u8",3,Equal);
  
  snprintf( chActionText, elCount(chActionText), "Delete all breakpoints "); 
  snprintf( chExpectedText, elCount(chExpectedText), "Breakpoints deleted"); 
  TestStepAddActionExpected( chActionText, chExpectedText );
  A_DBGR_BreakpointDeleteAll();
  /***************************************************************************************************************/    
  	                            // Test Step 6 Set a breakpoint after the line"v_sigVal_u32 = GetHWIO_g_CalcCRC_Sig();"
  /***************************************************************************************************************/
  snprintf( chActionText, elCount(chActionText), "Set Breakpoint in v_crcSts_u8 = GetHWIO_e_CalcCRC_St();"" inside Test_hwcrc_llsi "); 
  snprintf( chExpectedText, elCount(chExpectedText), "Verify Breakpoint is Set in v_crcSts_u8 = GetHWIO_e_CalcCRC_St();"" inside Test_hwcrc_llsi"); 
//  TestStepAddActionExpected( chActionText, chExpectedText );  
  A_DBGR_BreakpointSet("Test_hwcrc_llsi\\954");  

  A_DBGR_Go();
  testWaitForTimeout(1000);
  snprintf( chActionText, elCount(chActionText), "Verify Breakpoint should hit in v_crcSts_u8 = GetHWIO_e_CalcCRC_St(); "); 
  snprintf( chExpectedText, elCount(chExpectedText), "Breakpoint hit in v_crcSts_u8 = GetHWIO_e_CalcCRC_St(); function"); 
  E_DBGR_BreakpointCheckForHalt("Test_hwcrc_llsi\\954");
  while(1)
  {
  if(cnt == 0)
  {
  snprintf( chActionText, elCount(chActionText), "Verify v_coreId_u8 is 1 "); 
  snprintf( chExpectedText, elCount(chExpectedText), "Verify Verify v_coreId_u8 is 1"); 
  
  TestStepAddActionExpected( chActionText, chExpectedText );  
  }
  
  A_DBGR_VariableRead("v_coreId_u8",coreID);
  if(coreID == 1)
  {
    write("core ID is : %d",coreID);
    break;
  }
  if(cnt == 0)
  {
  snprintf( chActionText, elCount(chActionText), "Run debugger "); 
  snprintf( chExpectedText, elCount(chExpectedText), "Run debugger "); 
  }
  testWaitForTimeout(3000);
  A_DBGR_Go();
  cnt =cnt+1;
 
  }
  cnt =0;
  E_DBGR_VariableCheck("v_sigVal_u32",0,Equal);
  snprintf( chActionText, elCount(chActionText), "Delete all breakpoints "); 
  snprintf( chExpectedText, elCount(chExpectedText), "Breakpoints deleted"); 
  TestStepAddActionExpected( chActionText, chExpectedText );
  A_DBGR_BreakpointDeleteAll();
  /***************************************************************************************************************/    
  	                            // Test Step 7 Set a breakpoint at line"v_crcSts_u8 = GetHWIO_e_CalcCRC_St();"" inside Test_hwcrc_llsi"
  /***************************************************************************************************************/
  snprintf( chActionText, elCount(chActionText), "Set Breakpoint in v_crcSts_u8 = GetHWIO_e_CalcCRC_St();"" inside Test_hwcrc_llsi "); 
  snprintf( chExpectedText, elCount(chExpectedText), "Verify Breakpoint is Set in v_crcSts_u8 = GetHWIO_e_CalcCRC_St();"" inside Test_hwcrc_llsi"); 
//  TestStepAddActionExpected( chActionText, chExpectedText );  
  A_DBGR_BreakpointSet("Test_hwcrc_llsi\\975");  

  A_DBGR_Go();
  
  snprintf( chActionText, elCount(chActionText), "Verify Breakpoint should hit in v_crcSts_u8 = GetHWIO_e_CalcCRC_St(); "); 
  snprintf( chExpectedText, elCount(chExpectedText), "Breakpoint hit in v_crcSts_u8 = GetHWIO_e_CalcCRC_St(); function"); 
  E_DBGR_BreakpointCheckForHalt("Test_hwcrc_llsi\\975");
  while(1)
  {
  if(cnt == 0)
  {
  snprintf( chActionText, elCount(chActionText), "Verify v_coreId_u8 is 1 "); 
  snprintf( chExpectedText, elCount(chExpectedText), "Verify Verify v_coreId_u8 is 1"); 
  
  TestStepAddActionExpected( chActionText, chExpectedText );  
  }
  
  A_DBGR_VariableRead("v_coreId_u8",coreID);
  if(coreID == 1)
  {
    write("core ID is : %d",coreID);
    break;
  }
  if(cnt == 0)
  {
  snprintf( chActionText, elCount(chActionText), "Run debugger "); 
  snprintf( chExpectedText, elCount(chExpectedText), "Run debugger "); 
  }
  testWaitForTimeout(1000);
  A_DBGR_Go();
  cnt =cnt+1;
 
  }
  cnt =0;
  E_DBGR_VariableCheck("v_crcSts_u8",0,Equal);
}

testcase Verify_Hardware_CRC8_Calculation_Failure_Reporting_Core_2()
{
  /***************************************************************************************************************/    
                                                // Variable Definition
  /***************************************************************************************************************/ 
  

  
  /***************************************************************************************************************/    
                                               // Local Values
  /***************************************************************************************************************/ 
  

  
  /***************************************************************************************************************/    
                                              // Test Case Info
  /***************************************************************************************************************/
  setWriteDbgLevel(DebugOff);
  snprintf( chTestTitle, elCount(chTestTitle), "Verify_Hardware_CRC8_Calculation_Failure_Reporting_Core_2" );
  snprintf( chTestDescription, elCount(chTestDescription), "Purpose:To check the GetHWIO_e_CalcCRC_St(); interface  ");
  TestCaseAddInfo( chTestTitle, "TC_L30SW_Q-37518481", chTestDescription );

  /***************************************************************************************************************/    
                                              // Start of Test Case
  /***************************************************************************************************************/
  
  /***************************************************************************************************************/    
                                              // Test Step 0 PRECONDITIONS
  /***************************************************************************************************************/
  snprintf( chActionText, elCount(chActionText), "Flash the Software and ECU is running "); 
  snprintf( chExpectedText, elCount(chExpectedText), "Ecu is should be in running state"); 
  TestStepAddActionExpected( chActionText, chExpectedText );
  
  A_DBGR_BreakpointDeleteAll();
  A_DBGR_R();
  A_DBGR_Go(); 

  /***************************************************************************************************************/    
                                              // Test Step 1 Set breakpoint in line Test_hwcrc_llsi(); inside "TestApp_Core2_10ms_MainFunction" function and inside testapp.c file
  /***************************************************************************************************************/
  snprintf( chActionText, elCount(chActionText), "Set Breakpoint in Test_hwcrc_llsi(); "); 
  snprintf( chExpectedText, elCount(chExpectedText), "Verify Breakpoint is Set in Test_hwcrc_llsi();"); 
  //TestStepAddActionExpected( chActionText, chExpectedText );  
  A_DBGR_BreakpointSet("TestApp_Core2_10ms_MainFunction\\36");  

  A_DBGR_Go();
  
  snprintf( chActionText, elCount(chActionText), "Verify Breakpoint should hit in Test_hwcrc_llsi(); "); 
  snprintf( chExpectedText, elCount(chExpectedText), "Breakpoint hit in Test_hwcrc_llsi(); function"); 
  E_DBGR_BreakpointCheckForHalt("TestApp_Core2_10ms_MainFunction\\36");
  
  snprintf( chActionText, elCount(chActionText), "Delete all breakpoints "); 
  snprintf( chExpectedText, elCount(chExpectedText), "Breakpoints deleted"); 
  TestStepAddActionExpected( chActionText, chExpectedText );
  
  A_DBGR_BreakpointDeleteAll();
   
  
   
  /***************************************************************************************************************/    
  	                            // Test Step 2 Set a breakpoint at "v_coreId_u8 = (BYTE)GetCoreID();" inside "Test_hwcrc_llsi" function
  /***************************************************************************************************************/
  
  snprintf( chActionText, elCount(chActionText), "Set Breakpoint in v_coreId_u8 = (BYTE)GetCoreID(); "); 
  snprintf( chExpectedText, elCount(chExpectedText), "Verify Breakpoint is Set in v_coreId_u8 = (BYTE)GetCoreID();"); 
  //TestStepAddActionExpected( chActionText, chExpectedText );  
  A_DBGR_BreakpointSet("Test_hwcrc_llsi\\910");  

  A_DBGR_Go();
  
  snprintf( chActionText, elCount(chActionText), "Verify Breakpoint should hit in v_coreId_u8 = (BYTE)GetCoreID(); "); 
  snprintf( chExpectedText, elCount(chExpectedText), "Breakpoint hit in v_coreId_u8 = (BYTE)GetCoreID(); function"); 
  E_DBGR_BreakpointCheckForHalt("Test_hwcrc_llsi\\910");
  
  /***************************************************************************************************************/    
  	                            // Test Step 3 Verify v_coreId_u8 in trace32 watch window
  /***************************************************************************************************************/
  
   while(1)
  {
  if(cnt == 0)
  {
  snprintf( chActionText, elCount(chActionText), "Verify v_coreId_u8 is 2 "); 
  snprintf( chExpectedText, elCount(chExpectedText), "Verify Verify v_coreId_u8 is 2"); 
  
  TestStepAddActionExpected( chActionText, chExpectedText );  
  }
  
  A_DBGR_VariableRead("v_coreId_u8",coreID);
  if(coreID == 2)
  {
    break;
  }
  if(cnt == 0)
  {
  snprintf( chActionText, elCount(chActionText), "Run debugger "); 
  snprintf( chExpectedText, elCount(chExpectedText), "Run debugger "); 
  }
  A_DBGR_Go();
  cnt =cnt+1;
  }
  E_DBGR_VariableCheck("v_crcSts_u8",0,Equal);
  cnt =0;
  snprintf( chActionText, elCount(chActionText), "delete all breakpoints "); 
  snprintf( chExpectedText, elCount(chExpectedText), "delete all breakpoints "); 
  TestStepAddActionExpected( chActionText, chExpectedText );
  A_DBGR_BreakpointDeleteAll();
  /***************************************************************************************************************/    
  	                            // Test Step 4 Set a breakpoint at line"PerfmHWIO_h_CalcCRC ((BYTE)test_HwCrc_CRC32_ethernet_E, v_seed_u32, v_startAddr_u8, v_endAddr_u8);"
  /***************************************************************************************************************/
  snprintf( chActionText, elCount(chActionText), "Set Breakpoint inPerfmHWIO_h_CalcCRC ((BYTE)test_HwCrc_CRC32_ethernet_E, v_seed_u32, v_startAddr_u8, v_endAddr_u8); "); 
  snprintf( chExpectedText, elCount(chExpectedText), "Verify Breakpoint is Set in PerfmHWIO_h_CalcCRC ((BYTE)test_HwCrc_CRC32_ethernet_E, v_seed_u32, v_startAddr_u8, v_endAddr_u8);"); 
  //TestStepAddActionExpected( chActionText, chExpectedText );  
  A_DBGR_BreakpointSet("Test_hwcrc_llsi\\926");  

  A_DBGR_Go();
  
  snprintf( chActionText, elCount(chActionText), "Verify Breakpoint should hit in v_crcSts_u8 = GetHWIO_e_CalcCRC_St(); "); 
  snprintf( chExpectedText, elCount(chExpectedText), "Breakpoint hit in v_crcSts_u8 = GetHWIO_e_CalcCRC_St(); function"); 
  E_DBGR_BreakpointCheckForHalt("Test_hwcrc_llsi\\926");
  
  while(1)
  {
  if(cnt == 0)
  {
  snprintf( chActionText, elCount(chActionText), "Verify v_coreId_u8 is 2 "); 
  snprintf( chExpectedText, elCount(chExpectedText), "Verify Verify v_coreId_u8 is 2"); 
  
  TestStepAddActionExpected( chActionText, chExpectedText );  
  }
  
  A_DBGR_VariableRead("v_coreId_u8",coreID);
  if(coreID == 2)
  {
    write("core ID is : %d",coreID);
    break;
  }
  if(cnt == 0)
  {
  snprintf( chActionText, elCount(chActionText), "Run debugger "); 
  snprintf( chExpectedText, elCount(chExpectedText), "Run debugger "); 
  }
  testWaitForTimeout(1000);
  A_DBGR_Go();
  cnt =cnt+1;
 
  }
  cnt =0;
  A_DBGR_BreakpointDeleteAll();
  
   /***************************************************************************************************************/    
  	                            // Test Step 5 Set a breakpoint at line"v_crcSts_u8 = GetHWIO_e_CalcCRC_St();"" inside Test_hwcrc_llsi"
  /***************************************************************************************************************/
  snprintf( chActionText, elCount(chActionText), "Set Breakpoint in v_crcSts_u8 = GetHWIO_e_CalcCRC_St();"" inside Test_hwcrc_llsi "); 
  snprintf( chExpectedText, elCount(chExpectedText), "Verify Breakpoint is Set in v_crcSts_u8 = GetHWIO_e_CalcCRC_St();"" inside Test_hwcrc_llsi"); 
//  TestStepAddActionExpected( chActionText, chExpectedText );  
  A_DBGR_BreakpointSet("Test_hwcrc_llsi\\928");  

  A_DBGR_Go();
  
  snprintf( chActionText, elCount(chActionText), "Verify Breakpoint should hit in v_crcSts_u8 = GetHWIO_e_CalcCRC_St(); "); 
  snprintf( chExpectedText, elCount(chExpectedText), "Breakpoint hit in v_crcSts_u8 = GetHWIO_e_CalcCRC_St(); function"); 
  E_DBGR_BreakpointCheckForHalt("Test_hwcrc_llsi\\928");
  while(1)
  {
  if(cnt == 0)
  {
  snprintf( chActionText, elCount(chActionText), "Verify v_coreId_u8 is 2 "); 
  snprintf( chExpectedText, elCount(chExpectedText), "Verify Verify v_coreId_u8 is 2"); 
  
  TestStepAddActionExpected( chActionText, chExpectedText );  
  }
  
  A_DBGR_VariableRead("v_coreId_u8",coreID);
  if(coreID == 2)
  {
    write("core ID is : %d",coreID);
    break;
  }
  if(cnt == 0)
  {
  snprintf( chActionText, elCount(chActionText), "Run debugger "); 
  snprintf( chExpectedText, elCount(chExpectedText), "Run debugger "); 
  }
  testWaitForTimeout(1000);
  A_DBGR_Go();
  cnt =cnt+1;
 
  }
  cnt =0;
  E_DBGR_VariableCheck("v_crcSts_u8",3,Equal);
  
  snprintf( chActionText, elCount(chActionText), "Delete all breakpoints "); 
  snprintf( chExpectedText, elCount(chExpectedText), "Breakpoints deleted"); 
  TestStepAddActionExpected( chActionText, chExpectedText );
  A_DBGR_BreakpointDeleteAll();
  /***************************************************************************************************************/    
  	                            // Test Step 6 Set a breakpoint after the line"v_sigVal_u32 = GetHWIO_g_CalcCRC_Sig();"
  /***************************************************************************************************************/
  snprintf( chActionText, elCount(chActionText), "Set Breakpoint in v_crcSts_u8 = GetHWIO_e_CalcCRC_St();"" inside Test_hwcrc_llsi "); 
  snprintf( chExpectedText, elCount(chExpectedText), "Verify Breakpoint is Set in v_crcSts_u8 = GetHWIO_e_CalcCRC_St();"" inside Test_hwcrc_llsi"); 
//  TestStepAddActionExpected( chActionText, chExpectedText );  
  A_DBGR_BreakpointSet("Test_hwcrc_llsi\\954");  

  A_DBGR_Go();
  testWaitForTimeout(1000);
  snprintf( chActionText, elCount(chActionText), "Verify Breakpoint should hit in v_crcSts_u8 = GetHWIO_e_CalcCRC_St(); "); 
  snprintf( chExpectedText, elCount(chExpectedText), "Breakpoint hit in v_crcSts_u8 = GetHWIO_e_CalcCRC_St(); function"); 
  E_DBGR_BreakpointCheckForHalt("Test_hwcrc_llsi\\954");
  while(1)
  {
  if(cnt == 0)
  {
  snprintf( chActionText, elCount(chActionText), "Verify v_coreId_u8 is 2 "); 
  snprintf( chExpectedText, elCount(chExpectedText), "Verify Verify v_coreId_u8 is 2"); 
  
  TestStepAddActionExpected( chActionText, chExpectedText );  
  }
  
  A_DBGR_VariableRead("v_coreId_u8",coreID);
  if(coreID == 2)
  {
    write("core ID is : %d",coreID);
    break;
  }
  if(cnt == 0)
  {
  snprintf( chActionText, elCount(chActionText), "Run debugger "); 
  snprintf( chExpectedText, elCount(chExpectedText), "Run debugger "); 
  }
  testWaitForTimeout(3000);
  A_DBGR_Go();
  cnt =cnt+1;
 
  }
  cnt =0;
  E_DBGR_VariableCheck("v_sigVal_u32",0,Equal);
  snprintf( chActionText, elCount(chActionText), "Delete all breakpoints "); 
  snprintf( chExpectedText, elCount(chExpectedText), "Breakpoints deleted"); 
  TestStepAddActionExpected( chActionText, chExpectedText );
  A_DBGR_BreakpointDeleteAll();
  /***************************************************************************************************************/    
  	                            // Test Step 7 Set a breakpoint at line"v_crcSts_u8 = GetHWIO_e_CalcCRC_St();"" inside Test_hwcrc_llsi"
  /***************************************************************************************************************/
  snprintf( chActionText, elCount(chActionText), "Set Breakpoint in v_crcSts_u8 = GetHWIO_e_CalcCRC_St();"" inside Test_hwcrc_llsi "); 
  snprintf( chExpectedText, elCount(chExpectedText), "Verify Breakpoint is Set in v_crcSts_u8 = GetHWIO_e_CalcCRC_St();"" inside Test_hwcrc_llsi"); 
//  TestStepAddActionExpected( chActionText, chExpectedText );  
  A_DBGR_BreakpointSet("Test_hwcrc_llsi\\975");  

  A_DBGR_Go();
  
  snprintf( chActionText, elCount(chActionText), "Verify Breakpoint should hit in v_crcSts_u8 = GetHWIO_e_CalcCRC_St(); "); 
  snprintf( chExpectedText, elCount(chExpectedText), "Breakpoint hit in v_crcSts_u8 = GetHWIO_e_CalcCRC_St(); function"); 
  E_DBGR_BreakpointCheckForHalt("Test_hwcrc_llsi\\975");
  while(1)
  {
  if(cnt == 0)
  {
  snprintf( chActionText, elCount(chActionText), "Verify v_coreId_u8 is 2 "); 
  snprintf( chExpectedText, elCount(chExpectedText), "Verify Verify v_coreId_u8 is 2"); 
  
  TestStepAddActionExpected( chActionText, chExpectedText );  
  }
  
  A_DBGR_VariableRead("v_coreId_u8",coreID);
  if(coreID == 2)
  {
    write("core ID is : %d",coreID);
    break;
  }
  if(cnt == 0)
  {
  snprintf( chActionText, elCount(chActionText), "Run debugger "); 
  snprintf( chExpectedText, elCount(chExpectedText), "Run debugger "); 
  }
  testWaitForTimeout(1000);
  A_DBGR_Go();
  cnt =cnt+1;
 
  }
  cnt =0;
  E_DBGR_VariableCheck("v_crcSts_u8",0,Equal);
}

testcase Verify_Hardware_CRC8_Calculation_Failure_Reporting_Core_3()
{
  /***************************************************************************************************************/    
                                                // Variable Definition
  /***************************************************************************************************************/ 
  

  
  /***************************************************************************************************************/    
                                               // Local Values
  /***************************************************************************************************************/ 
  

  
  /***************************************************************************************************************/    
                                              // Test Case Info
  /***************************************************************************************************************/
  setWriteDbgLevel(DebugOff);
  snprintf( chTestTitle, elCount(chTestTitle), "Verify_Hardware_CRC8_Calculation_Failure_Reporting_Core_3" );
  snprintf( chTestDescription, elCount(chTestDescription), "Purpose:To check the GetHWIO_e_CalcCRC_St(); interface  ");
  TestCaseAddInfo( chTestTitle, "TC_L30SW_Q-37518528", chTestDescription );

  /***************************************************************************************************************/    
                                              // Start of Test Case
  /***************************************************************************************************************/
  
  /***************************************************************************************************************/    
                                              // Test Step 0 PRECONDITIONS
  /***************************************************************************************************************/
  snprintf( chActionText, elCount(chActionText), "Flash the Software and ECU is running "); 
  snprintf( chExpectedText, elCount(chExpectedText), "Ecu is should be in running state"); 
  TestStepAddActionExpected( chActionText, chExpectedText );
  
  A_DBGR_BreakpointDeleteAll();
  A_DBGR_R();
  A_DBGR_Go(); 

  /***************************************************************************************************************/    
                                              // Test Step 1 Set breakpoint in line Test_hwcrc_llsi(); inside "TestApp_Core3_10ms_MainFunction" function and inside testapp.c file
  /***************************************************************************************************************/
  snprintf( chActionText, elCount(chActionText), "Set Breakpoint in Test_hwcrc_llsi(); "); 
  snprintf( chExpectedText, elCount(chExpectedText), "Verify Breakpoint is Set in Test_hwcrc_llsi();"); 
  //TestStepAddActionExpected( chActionText, chExpectedText );  
  A_DBGR_BreakpointSet("TestApp_Core3_10ms_MainFunction\\35");  

  A_DBGR_Go();
  
  snprintf( chActionText, elCount(chActionText), "Verify Breakpoint should hit in Test_hwcrc_llsi(); "); 
  snprintf( chExpectedText, elCount(chExpectedText), "Breakpoint hit in Test_hwcrc_llsi(); function"); 
  E_DBGR_BreakpointCheckForHalt("TestApp_Core3_10ms_MainFunction\\35");
  
  testWaitForTimeout(2000);
  
  snprintf( chActionText, elCount(chActionText), "Delete all breakpoints "); 
  snprintf( chExpectedText, elCount(chExpectedText), "Breakpoints deleted"); 
  TestStepAddActionExpected( chActionText, chExpectedText );
  
  A_DBGR_BreakpointDeleteAll();
   
  
   
  /***************************************************************************************************************/    
  	                            // Test Step 2 Set a breakpoint at "v_coreId_u8 = (BYTE)GetCoreID();" inside "Test_hwcrc_llsi" function
  /***************************************************************************************************************/
  
  snprintf( chActionText, elCount(chActionText), "Set Breakpoint in v_coreId_u8 = (BYTE)GetCoreID(); "); 
  snprintf( chExpectedText, elCount(chExpectedText), "Verify Breakpoint is Set in v_coreId_u8 = (BYTE)GetCoreID();"); 
  //TestStepAddActionExpected( chActionText, chExpectedText );  
  A_DBGR_BreakpointSet("Test_hwcrc_llsi\\910");  

  A_DBGR_Go();
  
  snprintf( chActionText, elCount(chActionText), "Verify Breakpoint should hit in v_coreId_u8 = (BYTE)GetCoreID(); "); 
  snprintf( chExpectedText, elCount(chExpectedText), "Breakpoint hit in v_coreId_u8 = (BYTE)GetCoreID(); function"); 
  E_DBGR_BreakpointCheckForHalt("Test_hwcrc_llsi\\910");
  
  /***************************************************************************************************************/    
  	                            // Test Step 3 Verify v_coreId_u8 in trace32 watch window
  /***************************************************************************************************************/
  
   while(1)
  {
  if(cnt == 0)
  {
  snprintf( chActionText, elCount(chActionText), "Verify v_coreId_u8 is 3 "); 
  snprintf( chExpectedText, elCount(chExpectedText), "Verify Verify v_coreId_u8 is 3"); 
  
  TestStepAddActionExpected( chActionText, chExpectedText );  
  }
  
  A_DBGR_VariableRead("v_coreId_u8",coreID);
  if(coreID == 3)
  {
    break;
  }
  if(cnt == 0)
  {
  snprintf( chActionText, elCount(chActionText), "Run debugger "); 
  snprintf( chExpectedText, elCount(chExpectedText), "Run debugger "); 
  }
  A_DBGR_Go();
  cnt =cnt+1;
  }
  E_DBGR_VariableCheck("v_crcSts_u8",0,Equal);
  cnt =0;
  snprintf( chActionText, elCount(chActionText), "delete all breakpoints "); 
  snprintf( chExpectedText, elCount(chExpectedText), "delete all breakpoints "); 
  TestStepAddActionExpected( chActionText, chExpectedText );
  A_DBGR_BreakpointDeleteAll();
  /***************************************************************************************************************/    
  	                            // Test Step 4 Set a breakpoint at line"PerfmHWIO_h_CalcCRC ((BYTE)test_HwCrc_CRC32_ethernet_E, v_seed_u32, v_startAddr_u8, v_endAddr_u8);"
  /***************************************************************************************************************/
  snprintf( chActionText, elCount(chActionText), "Set Breakpoint inPerfmHWIO_h_CalcCRC ((BYTE)test_HwCrc_CRC32_ethernet_E, v_seed_u32, v_startAddr_u8, v_endAddr_u8); "); 
  snprintf( chExpectedText, elCount(chExpectedText), "Verify Breakpoint is Set in PerfmHWIO_h_CalcCRC ((BYTE)test_HwCrc_CRC32_ethernet_E, v_seed_u32, v_startAddr_u8, v_endAddr_u8);"); 
  //TestStepAddActionExpected( chActionText, chExpectedText );  
  A_DBGR_BreakpointSet("Test_hwcrc_llsi\\926");  

  A_DBGR_Go();
  
  snprintf( chActionText, elCount(chActionText), "Verify Breakpoint should hit in v_crcSts_u8 = GetHWIO_e_CalcCRC_St(); "); 
  snprintf( chExpectedText, elCount(chExpectedText), "Breakpoint hit in v_crcSts_u8 = GetHWIO_e_CalcCRC_St(); function"); 
  E_DBGR_BreakpointCheckForHalt("Test_hwcrc_llsi\\926");
  
  while(1)
  {
  if(cnt == 0)
  {
  snprintf( chActionText, elCount(chActionText), "Verify v_coreId_u8 is 3 "); 
  snprintf( chExpectedText, elCount(chExpectedText), "Verify Verify v_coreId_u8 is 3"); 
  
  TestStepAddActionExpected( chActionText, chExpectedText );  
  }
  
  A_DBGR_VariableRead("v_coreId_u8",coreID);
  if(coreID == 3)
  {
    write("core ID is : %d",coreID);
    break;
  }
  if(cnt == 0)
  {
  snprintf( chActionText, elCount(chActionText), "Run debugger "); 
  snprintf( chExpectedText, elCount(chExpectedText), "Run debugger "); 
  }
  testWaitForTimeout(3000);
  A_DBGR_Go();
  cnt =cnt+1;
 
  }
  cnt =0;
  A_DBGR_BreakpointDeleteAll();
  
   /***************************************************************************************************************/    
  	                            // Test Step 5 Set a breakpoint at line"v_crcSts_u8 = GetHWIO_e_CalcCRC_St();"" inside Test_hwcrc_llsi"
  /***************************************************************************************************************/
  snprintf( chActionText, elCount(chActionText), "Set Breakpoint in v_crcSts_u8 = GetHWIO_e_CalcCRC_St();"" inside Test_hwcrc_llsi "); 
  snprintf( chExpectedText, elCount(chExpectedText), "Verify Breakpoint is Set in v_crcSts_u8 = GetHWIO_e_CalcCRC_St();"" inside Test_hwcrc_llsi"); 
//  TestStepAddActionExpected( chActionText, chExpectedText );  
  A_DBGR_BreakpointSet("Test_hwcrc_llsi\\928");  

  A_DBGR_Go();
  
  snprintf( chActionText, elCount(chActionText), "Verify Breakpoint should hit in v_crcSts_u8 = GetHWIO_e_CalcCRC_St(); "); 
  snprintf( chExpectedText, elCount(chExpectedText), "Breakpoint hit in v_crcSts_u8 = GetHWIO_e_CalcCRC_St(); function"); 
  E_DBGR_BreakpointCheckForHalt("Test_hwcrc_llsi\\928");
  while(1)
  {
  if(cnt == 0)
  {
  snprintf( chActionText, elCount(chActionText), "Verify v_coreId_u8 is 3 "); 
  snprintf( chExpectedText, elCount(chExpectedText), "Verify Verify v_coreId_u8 is 3"); 
  
  TestStepAddActionExpected( chActionText, chExpectedText );  
  }
  
  A_DBGR_VariableRead("v_coreId_u8",coreID);
  if(coreID == 3)
  {
    write("core ID is : %d",coreID);
    break;
  }
  if(cnt == 0)
  {
  snprintf( chActionText, elCount(chActionText), "Run debugger "); 
  snprintf( chExpectedText, elCount(chExpectedText), "Run debugger "); 
  }
  testWaitForTimeout(3000);
  A_DBGR_Go();
  cnt =cnt+1;
 
  }
  cnt =0;
  E_DBGR_VariableCheck("v_crcSts_u8",3,Equal);
  
  snprintf( chActionText, elCount(chActionText), "Delete all breakpoints "); 
  snprintf( chExpectedText, elCount(chExpectedText), "Breakpoints deleted"); 
  TestStepAddActionExpected( chActionText, chExpectedText );
  A_DBGR_BreakpointDeleteAll();
  /***************************************************************************************************************/    
  	                            // Test Step 6 Set a breakpoint after the line"v_sigVal_u32 = GetHWIO_g_CalcCRC_Sig();"
  /***************************************************************************************************************/
  snprintf( chActionText, elCount(chActionText), "Set Breakpoint in v_crcSts_u8 = GetHWIO_e_CalcCRC_St();"" inside Test_hwcrc_llsi "); 
  snprintf( chExpectedText, elCount(chExpectedText), "Verify Breakpoint is Set in v_crcSts_u8 = GetHWIO_e_CalcCRC_St();"" inside Test_hwcrc_llsi"); 
//  TestStepAddActionExpected( chActionText, chExpectedText );  
  A_DBGR_BreakpointSet("Test_hwcrc_llsi\\954");  

  A_DBGR_Go();
  testWaitForTimeout(1000);
  snprintf( chActionText, elCount(chActionText), "Verify Breakpoint should hit in v_crcSts_u8 = GetHWIO_e_CalcCRC_St(); "); 
  snprintf( chExpectedText, elCount(chExpectedText), "Breakpoint hit in v_crcSts_u8 = GetHWIO_e_CalcCRC_St(); function"); 
  E_DBGR_BreakpointCheckForHalt("Test_hwcrc_llsi\\954");
  while(1)
  {
  if(cnt == 0)
  {
  snprintf( chActionText, elCount(chActionText), "Verify v_coreId_u8 is 3 "); 
  snprintf( chExpectedText, elCount(chExpectedText), "Verify Verify v_coreId_u8 is 3"); 
  
  TestStepAddActionExpected( chActionText, chExpectedText );  
  }
  
  A_DBGR_VariableRead("v_coreId_u8",coreID);
  if(coreID == 3)
  {
    write("core ID is : %d",coreID);
    break;
  }
  if(cnt == 0)
  {
  snprintf( chActionText, elCount(chActionText), "Run debugger "); 
  snprintf( chExpectedText, elCount(chExpectedText), "Run debugger "); 
  }
  testWaitForTimeout(3000);
  A_DBGR_Go();
  cnt =cnt+1;
 
  }
  cnt =0;
  E_DBGR_VariableCheck("v_sigVal_u32",0,Equal);
  snprintf( chActionText, elCount(chActionText), "Delete all breakpoints "); 
  snprintf( chExpectedText, elCount(chExpectedText), "Breakpoints deleted"); 
  TestStepAddActionExpected( chActionText, chExpectedText );
  A_DBGR_BreakpointDeleteAll();
  /***************************************************************************************************************/    
  	                            // Test Step 7 Set a breakpoint at line"v_crcSts_u8 = GetHWIO_e_CalcCRC_St();"" inside Test_hwcrc_llsi"
  /***************************************************************************************************************/
  snprintf( chActionText, elCount(chActionText), "Set Breakpoint in v_crcSts_u8 = GetHWIO_e_CalcCRC_St();"" inside Test_hwcrc_llsi "); 
  snprintf( chExpectedText, elCount(chExpectedText), "Verify Breakpoint is Set in v_crcSts_u8 = GetHWIO_e_CalcCRC_St();"" inside Test_hwcrc_llsi"); 
//  TestStepAddActionExpected( chActionText, chExpectedText );  
  A_DBGR_BreakpointSet("Test_hwcrc_llsi\\975");  

  A_DBGR_Go();
  
  snprintf( chActionText, elCount(chActionText), "Verify Breakpoint should hit in v_crcSts_u8 = GetHWIO_e_CalcCRC_St(); "); 
  snprintf( chExpectedText, elCount(chExpectedText), "Breakpoint hit in v_crcSts_u8 = GetHWIO_e_CalcCRC_St(); function"); 
  E_DBGR_BreakpointCheckForHalt("Test_hwcrc_llsi\\975");
  while(1)
  {
  if(cnt == 0)
  {
  snprintf( chActionText, elCount(chActionText), "Verify v_coreId_u8 is 3 "); 
  snprintf( chExpectedText, elCount(chExpectedText), "Verify Verify v_coreId_u8 is 3"); 
  
  TestStepAddActionExpected( chActionText, chExpectedText );  
  }
  
  A_DBGR_VariableRead("v_coreId_u8",coreID);
  if(coreID == 3)
  {
    write("core ID is : %d",coreID);
    break;
  }
  if(cnt == 0)
  {
  snprintf( chActionText, elCount(chActionText), "Run debugger "); 
  snprintf( chExpectedText, elCount(chExpectedText), "Run debugger "); 
  }
  testWaitForTimeout(1000);
  A_DBGR_Go();
  cnt =cnt+1;
 
  }
  cnt =0;
  E_DBGR_VariableCheck("v_crcSts_u8",0,Equal);
}

testcase Verify_Hardware_CRC8_Calculation_Failure_Reporting_Core_4()
{
  /***************************************************************************************************************/    
                                                // Variable Definition
  /***************************************************************************************************************/ 
  

  
  /***************************************************************************************************************/    
                                               // Local Values
  /***************************************************************************************************************/ 
  

  
  /***************************************************************************************************************/    
                                              // Test Case Info
  /***************************************************************************************************************/
  setWriteDbgLevel(DebugOff);
  snprintf( chTestTitle, elCount(chTestTitle), "Verify_Hardware_CRC8_Calculation_Failure_Reporting_Core_4" );
  snprintf( chTestDescription, elCount(chTestDescription), "Purpose:To check the GetHWIO_e_CalcCRC_St(); interface  ");
  TestCaseAddInfo( chTestTitle, "TC_L30SW_Q-37518531", chTestDescription );

  /***************************************************************************************************************/    
                                              // Start of Test Case
  /***************************************************************************************************************/
  
  /***************************************************************************************************************/    
                                              // Test Step 0 PRECONDITIONS
  /***************************************************************************************************************/
  snprintf( chActionText, elCount(chActionText), "Flash the Software and ECU is running "); 
  snprintf( chExpectedText, elCount(chExpectedText), "Ecu is should be in running state"); 
  TestStepAddActionExpected( chActionText, chExpectedText );
  
  A_DBGR_BreakpointDeleteAll();
  A_DBGR_R();
  A_DBGR_Go(); 

  /***************************************************************************************************************/    
                                              // Test Step 1 Set breakpoint in line Test_hwcrc_llsi(); inside "TestApp_Core4_1000ms_MainFunction" function and inside testapp.c file
  /***************************************************************************************************************/
  snprintf( chActionText, elCount(chActionText), "Set Breakpoint in Test_hwcrc_llsi(); "); 
  snprintf( chExpectedText, elCount(chExpectedText), "Verify Breakpoint is Set in Test_hwcrc_llsi();"); 
  //TestStepAddActionExpected( chActionText, chExpectedText );  
  A_DBGR_BreakpointSet("TestApp_Core4_1000ms_MainFunction\\65");  

  A_DBGR_Go();
  
  snprintf( chActionText, elCount(chActionText), "Verify Breakpoint should hit in Test_hwcrc_llsi(); "); 
  snprintf( chExpectedText, elCount(chExpectedText), "Breakpoint hit in Test_hwcrc_llsi(); function"); 
  E_DBGR_BreakpointCheckForHalt("TestApp_Core4_1000ms_MainFunction\\65");
  
  testWaitForTimeout(2000);
  
  snprintf( chActionText, elCount(chActionText), "Delete all breakpoints "); 
  snprintf( chExpectedText, elCount(chExpectedText), "Breakpoints deleted"); 
  TestStepAddActionExpected( chActionText, chExpectedText );
  
  A_DBGR_BreakpointDeleteAll();
   
  /***************************************************************************************************************/    
  	                            // Test Step 2 Set a breakpoint at "v_coreId_u8 = (BYTE)GetCoreID();" inside "Test_hwcrc_llsi" function
  /***************************************************************************************************************/
  
  snprintf( chActionText, elCount(chActionText), "Set Breakpoint in v_coreId_u8 = (BYTE)GetCoreID(); "); 
  snprintf( chExpectedText, elCount(chExpectedText), "Verify Breakpoint is Set in v_coreId_u8 = (BYTE)GetCoreID();"); 
  //TestStepAddActionExpected( chActionText, chExpectedText );  
  A_DBGR_BreakpointSet("Test_hwcrc_llsi\\910");  

  A_DBGR_Go();
  
  snprintf( chActionText, elCount(chActionText), "Verify Breakpoint should hit in v_coreId_u8 = (BYTE)GetCoreID(); "); 
  snprintf( chExpectedText, elCount(chExpectedText), "Breakpoint hit in v_coreId_u8 = (BYTE)GetCoreID(); function"); 
  E_DBGR_BreakpointCheckForHalt("Test_hwcrc_llsi\\910");
  
  /***************************************************************************************************************/    
  	                            // Test Step 3 Verify v_coreId_u8 in trace32 watch window
  /***************************************************************************************************************/
  
   while(1)
  {
  if(cnt == 0)
  {
  snprintf( chActionText, elCount(chActionText), "Verify v_coreId_u8 is 4 "); 
  snprintf( chExpectedText, elCount(chExpectedText), "Verify Verify v_coreId_u8 is 4"); 
  
  TestStepAddActionExpected( chActionText, chExpectedText );  
  }
  
  A_DBGR_VariableRead("v_coreId_u8",coreID);
  if(coreID == 4)
  {
    break;
  }
  if(cnt == 0)
  {
  snprintf( chActionText, elCount(chActionText), "Run debugger "); 
  snprintf( chExpectedText, elCount(chExpectedText), "Run debugger "); 
  }
  A_DBGR_Go();
  
  testWaitForTimeout(30000);
  
  cnt =cnt+1;
  }
  E_DBGR_VariableCheck("v_crcSts_u8",0,Equal);
  cnt =0;
  snprintf( chActionText, elCount(chActionText), "delete all breakpoints "); 
  snprintf( chExpectedText, elCount(chExpectedText), "delete all breakpoints "); 
  TestStepAddActionExpected( chActionText, chExpectedText );
  A_DBGR_BreakpointDeleteAll();
  /***************************************************************************************************************/    
  	                            // Test Step 4 Set a breakpoint at line"PerfmHWIO_h_CalcCRC ((BYTE)test_HwCrc_CRC32_ethernet_E, v_seed_u32, v_startAddr_u8, v_endAddr_u8);"
  /***************************************************************************************************************/
  snprintf( chActionText, elCount(chActionText), "Set Breakpoint inPerfmHWIO_h_CalcCRC ((BYTE)test_HwCrc_CRC32_ethernet_E, v_seed_u32, v_startAddr_u8, v_endAddr_u8); "); 
  snprintf( chExpectedText, elCount(chExpectedText), "Verify Breakpoint is Set in PerfmHWIO_h_CalcCRC ((BYTE)test_HwCrc_CRC32_ethernet_E, v_seed_u32, v_startAddr_u8, v_endAddr_u8);"); 
  //TestStepAddActionExpected( chActionText, chExpectedText );  
  A_DBGR_BreakpointSet("Test_hwcrc_llsi\\926");  

  A_DBGR_Go();
  
  snprintf( chActionText, elCount(chActionText), "Verify Breakpoint should hit in v_crcSts_u8 = GetHWIO_e_CalcCRC_St(); "); 
  snprintf( chExpectedText, elCount(chExpectedText), "Breakpoint hit in v_crcSts_u8 = GetHWIO_e_CalcCRC_St(); function"); 
  E_DBGR_BreakpointCheckForHalt("Test_hwcrc_llsi\\926");
  
  while(1)
  {
  if(cnt == 0)
  {
  snprintf( chActionText, elCount(chActionText), "Verify v_coreId_u8 is 4 "); 
  snprintf( chExpectedText, elCount(chExpectedText), "Verify Verify v_coreId_u8 is 4"); 
  
  TestStepAddActionExpected( chActionText, chExpectedText );  
  }
  
  A_DBGR_VariableRead("v_coreId_u8",coreID);
  if(coreID == 4)
  {
    write("core ID is : %d",coreID);
    break;
  }
  if(cnt == 0)
  {
  snprintf( chActionText, elCount(chActionText), "Run debugger "); 
  snprintf( chExpectedText, elCount(chExpectedText), "Run debugger "); 
  }
  testWaitForTimeout(1000);
  A_DBGR_Go();
  cnt =cnt+1;
 
  }
  cnt =0;
  A_DBGR_BreakpointDeleteAll();
  
   /***************************************************************************************************************/    
  	                            // Test Step 5 Set a breakpoint at line"v_crcSts_u8 = GetHWIO_e_CalcCRC_St();"" inside Test_hwcrc_llsi"
  /***************************************************************************************************************/
  snprintf( chActionText, elCount(chActionText), "Set Breakpoint in v_crcSts_u8 = GetHWIO_e_CalcCRC_St();"" inside Test_hwcrc_llsi "); 
  snprintf( chExpectedText, elCount(chExpectedText), "Verify Breakpoint is Set in v_crcSts_u8 = GetHWIO_e_CalcCRC_St();"" inside Test_hwcrc_llsi"); 
//  TestStepAddActionExpected( chActionText, chExpectedText );  
  A_DBGR_BreakpointSet("Test_hwcrc_llsi\\928");  

  A_DBGR_Go();
  
  snprintf( chActionText, elCount(chActionText), "Verify Breakpoint should hit in v_crcSts_u8 = GetHWIO_e_CalcCRC_St(); "); 
  snprintf( chExpectedText, elCount(chExpectedText), "Breakpoint hit in v_crcSts_u8 = GetHWIO_e_CalcCRC_St(); function"); 
  E_DBGR_BreakpointCheckForHalt("Test_hwcrc_llsi\\928");
  while(1)
  {
  if(cnt == 0)
  {
  snprintf( chActionText, elCount(chActionText), "Verify v_coreId_u8 is 4 "); 
  snprintf( chExpectedText, elCount(chExpectedText), "Verify Verify v_coreId_u8 is 4"); 
  
  TestStepAddActionExpected( chActionText, chExpectedText );  
  }
  
  A_DBGR_VariableRead("v_coreId_u8",coreID);
  if(coreID == 4)
  {
    write("core ID is : %d",coreID);
    break;
  }
  if(cnt == 0)
  {
  snprintf( chActionText, elCount(chActionText), "Run debugger "); 
  snprintf( chExpectedText, elCount(chExpectedText), "Run debugger "); 
  }
  testWaitForTimeout(1000);
  A_DBGR_Go();
  cnt =cnt+1;
 
  }
  cnt =0;
  E_DBGR_VariableCheck("v_crcSts_u8",3,Equal);
  
  snprintf( chActionText, elCount(chActionText), "Delete all breakpoints "); 
  snprintf( chExpectedText, elCount(chExpectedText), "Breakpoints deleted"); 
  TestStepAddActionExpected( chActionText, chExpectedText );
  A_DBGR_BreakpointDeleteAll();
  /***************************************************************************************************************/    
  	                            // Test Step 6 Set a breakpoint after the line"v_sigVal_u32 = GetHWIO_g_CalcCRC_Sig();"
  /***************************************************************************************************************/
  snprintf( chActionText, elCount(chActionText), "Set Breakpoint in v_crcSts_u8 = GetHWIO_e_CalcCRC_St();"" inside Test_hwcrc_llsi "); 
  snprintf( chExpectedText, elCount(chExpectedText), "Verify Breakpoint is Set in v_crcSts_u8 = GetHWIO_e_CalcCRC_St();"" inside Test_hwcrc_llsi"); 
//  TestStepAddActionExpected( chActionText, chExpectedText );  
  A_DBGR_BreakpointSet("Test_hwcrc_llsi\\954");  

  A_DBGR_Go();
  testWaitForTimeout(1000);
  snprintf( chActionText, elCount(chActionText), "Verify Breakpoint should hit in v_crcSts_u8 = GetHWIO_e_CalcCRC_St(); "); 
  snprintf( chExpectedText, elCount(chExpectedText), "Breakpoint hit in v_crcSts_u8 = GetHWIO_e_CalcCRC_St(); function"); 
  E_DBGR_BreakpointCheckForHalt("Test_hwcrc_llsi\\954");
  while(1)
  {
  if(cnt == 0)
  {
  snprintf( chActionText, elCount(chActionText), "Verify v_coreId_u8 is 4 "); 
  snprintf( chExpectedText, elCount(chExpectedText), "Verify Verify v_coreId_u8 is 4"); 
  
  TestStepAddActionExpected( chActionText, chExpectedText );  
  }
  
  A_DBGR_VariableRead("v_coreId_u8",coreID);
  if(coreID == 4)
  {
    write("core ID is : %d",coreID);
    break;
  }
  if(cnt == 0)
  {
  snprintf( chActionText, elCount(chActionText), "Run debugger "); 
  snprintf( chExpectedText, elCount(chExpectedText), "Run debugger "); 
  }
  testWaitForTimeout(3000);
  A_DBGR_Go();
  cnt =cnt+1;
 
  }
  cnt =0;
  E_DBGR_VariableCheck("v_sigVal_u32",0,Equal);
  snprintf( chActionText, elCount(chActionText), "Delete all breakpoints "); 
  snprintf( chExpectedText, elCount(chExpectedText), "Breakpoints deleted"); 
  TestStepAddActionExpected( chActionText, chExpectedText );
  A_DBGR_BreakpointDeleteAll();
  /***************************************************************************************************************/    
  	                            // Test Step 7 Set a breakpoint at line"v_crcSts_u8 = GetHWIO_e_CalcCRC_St();"" inside Test_hwcrc_llsi"
  /***************************************************************************************************************/
  snprintf( chActionText, elCount(chActionText), "Set Breakpoint in v_crcSts_u8 = GetHWIO_e_CalcCRC_St();"" inside Test_hwcrc_llsi "); 
  snprintf( chExpectedText, elCount(chExpectedText), "Verify Breakpoint is Set in v_crcSts_u8 = GetHWIO_e_CalcCRC_St();"" inside Test_hwcrc_llsi"); 
//  TestStepAddActionExpected( chActionText, chExpectedText );  
  A_DBGR_BreakpointSet("Test_hwcrc_llsi\\975");  

  A_DBGR_Go();
  
  snprintf( chActionText, elCount(chActionText), "Verify Breakpoint should hit in v_crcSts_u8 = GetHWIO_e_CalcCRC_St(); "); 
  snprintf( chExpectedText, elCount(chExpectedText), "Breakpoint hit in v_crcSts_u8 = GetHWIO_e_CalcCRC_St(); function"); 
  E_DBGR_BreakpointCheckForHalt("Test_hwcrc_llsi\\975");
  while(1)
  {
  if(cnt == 0)
  {
  snprintf( chActionText, elCount(chActionText), "Verify v_coreId_u8 is 4 "); 
  snprintf( chExpectedText, elCount(chExpectedText), "Verify Verify v_coreId_u8 is 4"); 
  
  TestStepAddActionExpected( chActionText, chExpectedText );  
  }
  
  A_DBGR_VariableRead("v_coreId_u8",coreID);
  if(coreID == 4)
  {
    write("core ID is : %d",coreID);
    break;
  }
  if(cnt == 0)
  {
  snprintf( chActionText, elCount(chActionText), "Run debugger "); 
  snprintf( chExpectedText, elCount(chExpectedText), "Run debugger "); 
  }
  testWaitForTimeout(1000);
  A_DBGR_Go();
  cnt =cnt+1;
 
  }
  cnt =0;
  E_DBGR_VariableCheck("v_crcSts_u8",0,Equal);
}

testcase Verify_Hardware_CRC8_Calculation_Failure_Reporting_Core_5()
{
  /***************************************************************************************************************/    
                                                // Variable Definition
  /***************************************************************************************************************/ 
  

  
  /***************************************************************************************************************/    
                                               // Local Values
  /***************************************************************************************************************/ 
  

  
  /***************************************************************************************************************/    
                                              // Test Case Info
  /***************************************************************************************************************/
  setWriteDbgLevel(DebugOff);
  snprintf( chTestTitle, elCount(chTestTitle), "Verify_Hardware_CRC8_Calculation_Failure_Reporting_Core_5" );
  snprintf( chTestDescription, elCount(chTestDescription), "Purpose:To check the GetHWIO_e_CalcCRC_St(); interface  ");
  TestCaseAddInfo( chTestTitle, "TC_L30SW_Q-37518534", chTestDescription );

  /***************************************************************************************************************/    
                                              // Start of Test Case
  /***************************************************************************************************************/
  
  /***************************************************************************************************************/    
                                              // Test Step 0 PRECONDITIONS
  /***************************************************************************************************************/
  snprintf( chActionText, elCount(chActionText), "Flash the Software and ECU is running "); 
  snprintf( chExpectedText, elCount(chExpectedText), "Ecu is should be in running state"); 
  TestStepAddActionExpected( chActionText, chExpectedText );
  
  A_DBGR_BreakpointDeleteAll();
  A_DBGR_R();
  A_DBGR_Go(); 

  /***************************************************************************************************************/    
                                              // Test Step 1 Set breakpoint in line Test_hwcrc_llsi(); inside "TestApp_Core5_1000ms_MainFunction" function and inside testapp.c file
  /***************************************************************************************************************/
  snprintf( chActionText, elCount(chActionText), "Set Breakpoint in Test_hwcrc_llsi(); "); 
  snprintf( chExpectedText, elCount(chExpectedText), "Verify Breakpoint is Set in Test_hwcrc_llsi();"); 
  //TestStepAddActionExpected( chActionText, chExpectedText );  
  A_DBGR_BreakpointSet("TestApp_Core5_1000ms_MainFunction\\54");  

  A_DBGR_Go();
  
  snprintf( chActionText, elCount(chActionText), "Verify Breakpoint should hit in Test_hwcrc_llsi(); "); 
  snprintf( chExpectedText, elCount(chExpectedText), "Breakpoint hit in Test_hwcrc_llsi(); function"); 
  E_DBGR_BreakpointCheckForHalt("TestApp_Core5_1000ms_MainFunction\\54");
  
  testWaitForTimeout(2000);
  
  snprintf( chActionText, elCount(chActionText), "Delete all breakpoints "); 
  snprintf( chExpectedText, elCount(chExpectedText), "Breakpoints deleted"); 
  TestStepAddActionExpected( chActionText, chExpectedText );
  
  A_DBGR_BreakpointDeleteAll();   
  /***************************************************************************************************************/    
  	                            // Test Step 2 Set a breakpoint at "v_coreId_u8 = (BYTE)GetCoreID();" inside "Test_hwcrc_llsi" function
  /***************************************************************************************************************/
  
  snprintf( chActionText, elCount(chActionText), "Set Breakpoint in v_coreId_u8 = (BYTE)GetCoreID(); "); 
  snprintf( chExpectedText, elCount(chExpectedText), "Verify Breakpoint is Set in v_coreId_u8 = (BYTE)GetCoreID();"); 
  //TestStepAddActionExpected( chActionText, chExpectedText );  
  A_DBGR_BreakpointSet("Test_hwcrc_llsi\\910");  

  A_DBGR_Go();
  testWaitForTimeout(2000);
  snprintf( chActionText, elCount(chActionText), "Verify Breakpoint should hit in v_coreId_u8 = (BYTE)GetCoreID(); "); 
  snprintf( chExpectedText, elCount(chExpectedText), "Breakpoint hit in v_coreId_u8 = (BYTE)GetCoreID(); function"); 
  E_DBGR_BreakpointCheckForHalt("Test_hwcrc_llsi\\910");
  
  /***************************************************************************************************************/    
  	                            // Test Step 3 Verify v_coreId_u8 in trace32 watch window
  /***************************************************************************************************************/
  
   while(1)
  {
  if(cnt == 0)
  {
  snprintf( chActionText, elCount(chActionText), "Verify v_coreId_u8 is 5 "); 
  snprintf( chExpectedText, elCount(chExpectedText), "Verify Verify v_coreId_u8 is 5"); 
  
  TestStepAddActionExpected( chActionText, chExpectedText );  
  }
  
  A_DBGR_VariableRead("v_coreId_u8",coreID);
  if(coreID == 5)
  {
    break;
  }
  if(cnt == 0)
  {
  snprintf( chActionText, elCount(chActionText), "Run debugger "); 
  snprintf( chExpectedText, elCount(chExpectedText), "Run debugger "); 
  }
  A_DBGR_Go();
  testWaitForTimeout(30000);
  
  cnt =cnt+1;
  }
  E_DBGR_VariableCheck("v_crcSts_u8",0,Equal);
  cnt =0;
  snprintf( chActionText, elCount(chActionText), "delete all breakpoints "); 
  snprintf( chExpectedText, elCount(chExpectedText), "delete all breakpoints "); 
  TestStepAddActionExpected( chActionText, chExpectedText );
  A_DBGR_BreakpointDeleteAll();
  /***************************************************************************************************************/    
  	                            // Test Step 4 Set a breakpoint at line"PerfmHWIO_h_CalcCRC ((BYTE)test_HwCrc_CRC32_ethernet_E, v_seed_u32, v_startAddr_u8, v_endAddr_u8);"
  /***************************************************************************************************************/
  snprintf( chActionText, elCount(chActionText), "Set Breakpoint inPerfmHWIO_h_CalcCRC ((BYTE)test_HwCrc_CRC32_ethernet_E, v_seed_u32, v_startAddr_u8, v_endAddr_u8); "); 
  snprintf( chExpectedText, elCount(chExpectedText), "Verify Breakpoint is Set in PerfmHWIO_h_CalcCRC ((BYTE)test_HwCrc_CRC32_ethernet_E, v_seed_u32, v_startAddr_u8, v_endAddr_u8);"); 
  //TestStepAddActionExpected( chActionText, chExpectedText );  
  A_DBGR_BreakpointSet("Test_hwcrc_llsi\\926");  

  A_DBGR_Go();
  
  snprintf( chActionText, elCount(chActionText), "Verify Breakpoint should hit in v_crcSts_u8 = GetHWIO_e_CalcCRC_St(); "); 
  snprintf( chExpectedText, elCount(chExpectedText), "Breakpoint hit in v_crcSts_u8 = GetHWIO_e_CalcCRC_St(); function"); 
  E_DBGR_BreakpointCheckForHalt("Test_hwcrc_llsi\\926");
  
  while(1)
  {
  if(cnt == 0)
  {
  snprintf( chActionText, elCount(chActionText), "Verify v_coreId_u8 is 5 "); 
  snprintf( chExpectedText, elCount(chExpectedText), "Verify Verify v_coreId_u8 is 5"); 
  
  TestStepAddActionExpected( chActionText, chExpectedText );  
  }
  
  A_DBGR_VariableRead("v_coreId_u8",coreID);
  if(coreID == 5)
  {
    write("core ID is : %d",coreID);
    break;
  }
  if(cnt == 0)
  {
  snprintf( chActionText, elCount(chActionText), "Run debugger "); 
  snprintf( chExpectedText, elCount(chExpectedText), "Run debugger "); 
  }
  testWaitForTimeout(1000);
  A_DBGR_Go();
  cnt =cnt+1;
 
  }
  cnt =0;
  A_DBGR_BreakpointDeleteAll();
  
   /***************************************************************************************************************/    
  	                            // Test Step 5 Set a breakpoint at line"v_crcSts_u8 = GetHWIO_e_CalcCRC_St();"" inside Test_hwcrc_llsi"
  /***************************************************************************************************************/
  snprintf( chActionText, elCount(chActionText), "Set Breakpoint in v_crcSts_u8 = GetHWIO_e_CalcCRC_St();"" inside Test_hwcrc_llsi "); 
  snprintf( chExpectedText, elCount(chExpectedText), "Verify Breakpoint is Set in v_crcSts_u8 = GetHWIO_e_CalcCRC_St();"" inside Test_hwcrc_llsi"); 
//  TestStepAddActionExpected( chActionText, chExpectedText );  
  A_DBGR_BreakpointSet("Test_hwcrc_llsi\\928");  

  A_DBGR_Go();
  
  snprintf( chActionText, elCount(chActionText), "Verify Breakpoint should hit in v_crcSts_u8 = GetHWIO_e_CalcCRC_St(); "); 
  snprintf( chExpectedText, elCount(chExpectedText), "Breakpoint hit in v_crcSts_u8 = GetHWIO_e_CalcCRC_St(); function"); 
  E_DBGR_BreakpointCheckForHalt("Test_hwcrc_llsi\\928");
  while(1)
  {
  if(cnt == 0)
  {
  snprintf( chActionText, elCount(chActionText), "Verify v_coreId_u8 is 5 "); 
  snprintf( chExpectedText, elCount(chExpectedText), "Verify Verify v_coreId_u8 is 5"); 
  
  TestStepAddActionExpected( chActionText, chExpectedText );  
  }
  
  A_DBGR_VariableRead("v_coreId_u8",coreID);
  if(coreID == 5)
  {
    write("core ID is : %d",coreID);
    break;
  }
  if(cnt == 0)
  {
  snprintf( chActionText, elCount(chActionText), "Run debugger "); 
  snprintf( chExpectedText, elCount(chExpectedText), "Run debugger "); 
  }
  testWaitForTimeout(1000);
  A_DBGR_Go();
  cnt =cnt+1;
 
  }
  cnt =0;
  E_DBGR_VariableCheck("v_crcSts_u8",3,Equal);
  
  snprintf( chActionText, elCount(chActionText), "Delete all breakpoints "); 
  snprintf( chExpectedText, elCount(chExpectedText), "Breakpoints deleted"); 
  TestStepAddActionExpected( chActionText, chExpectedText );
  A_DBGR_BreakpointDeleteAll();
  /***************************************************************************************************************/    
  	                            // Test Step 6 Set a breakpoint after the line"v_sigVal_u32 = GetHWIO_g_CalcCRC_Sig();"
  /***************************************************************************************************************/
  snprintf( chActionText, elCount(chActionText), "Set Breakpoint in v_crcSts_u8 = GetHWIO_e_CalcCRC_St();"" inside Test_hwcrc_llsi "); 
  snprintf( chExpectedText, elCount(chExpectedText), "Verify Breakpoint is Set in v_crcSts_u8 = GetHWIO_e_CalcCRC_St();"" inside Test_hwcrc_llsi"); 
//  TestStepAddActionExpected( chActionText, chExpectedText );  
  A_DBGR_BreakpointSet("Test_hwcrc_llsi\\954");  

  A_DBGR_Go();
  testWaitForTimeout(1000);
  snprintf( chActionText, elCount(chActionText), "Verify Breakpoint should hit in v_crcSts_u8 = GetHWIO_e_CalcCRC_St(); "); 
  snprintf( chExpectedText, elCount(chExpectedText), "Breakpoint hit in v_crcSts_u8 = GetHWIO_e_CalcCRC_St(); function"); 
  E_DBGR_BreakpointCheckForHalt("Test_hwcrc_llsi\\954");
  while(1)
  {
  if(cnt == 0)
  {
  snprintf( chActionText, elCount(chActionText), "Verify v_coreId_u8 is 5 "); 
  snprintf( chExpectedText, elCount(chExpectedText), "Verify Verify v_coreId_u8 is 5"); 
  
  TestStepAddActionExpected( chActionText, chExpectedText );  
  }
  
  A_DBGR_VariableRead("v_coreId_u8",coreID);
  if(coreID == 5)
  {
    write("core ID is : %d",coreID);
    break;
  }
  if(cnt == 0)
  {
  snprintf( chActionText, elCount(chActionText), "Run debugger "); 
  snprintf( chExpectedText, elCount(chExpectedText), "Run debugger "); 
  }
  testWaitForTimeout(3000);
  A_DBGR_Go();
  cnt =cnt+1;
 
  }
  cnt =0;
  E_DBGR_VariableCheck("v_sigVal_u32",0,Equal);
  snprintf( chActionText, elCount(chActionText), "Delete all breakpoints "); 
  snprintf( chExpectedText, elCount(chExpectedText), "Breakpoints deleted"); 
  TestStepAddActionExpected( chActionText, chExpectedText );
  A_DBGR_BreakpointDeleteAll();
  /***************************************************************************************************************/    
  	                            // Test Step 7 Set a breakpoint at line"v_crcSts_u8 = GetHWIO_e_CalcCRC_St();"" inside Test_hwcrc_llsi"
  /***************************************************************************************************************/
  snprintf( chActionText, elCount(chActionText), "Set Breakpoint in v_crcSts_u8 = GetHWIO_e_CalcCRC_St();"" inside Test_hwcrc_llsi "); 
  snprintf( chExpectedText, elCount(chExpectedText), "Verify Breakpoint is Set in v_crcSts_u8 = GetHWIO_e_CalcCRC_St();"" inside Test_hwcrc_llsi"); 
//  TestStepAddActionExpected( chActionText, chExpectedText );  
  A_DBGR_BreakpointSet("Test_hwcrc_llsi\\975");  

  A_DBGR_Go();
  
  snprintf( chActionText, elCount(chActionText), "Verify Breakpoint should hit in v_crcSts_u8 = GetHWIO_e_CalcCRC_St(); "); 
  snprintf( chExpectedText, elCount(chExpectedText), "Breakpoint hit in v_crcSts_u8 = GetHWIO_e_CalcCRC_St(); function"); 
  E_DBGR_BreakpointCheckForHalt("Test_hwcrc_llsi\\975");
  while(1)
  {
  if(cnt == 0)
  {
  snprintf( chActionText, elCount(chActionText), "Verify v_coreId_u8 is 5 "); 
  snprintf( chExpectedText, elCount(chExpectedText), "Verify Verify v_coreId_u8 is 5"); 
  
  TestStepAddActionExpected( chActionText, chExpectedText );  
  }
  
  A_DBGR_VariableRead("v_coreId_u8",coreID);
  if(coreID == 5)
  {
    write("core ID is : %d",coreID);
    break;
  }
  if(cnt == 0)
  {
  snprintf( chActionText, elCount(chActionText), "Run debugger "); 
  snprintf( chExpectedText, elCount(chExpectedText), "Run debugger "); 
  }
  testWaitForTimeout(1000);
  A_DBGR_Go();
  cnt =cnt+1;
 
  }
  cnt =0;
  E_DBGR_VariableCheck("v_crcSts_u8",0,Equal);
}


testcase Verify_Hardware_CRC16_Calculation_Failure_Reporting_Core_1()
{
  /***************************************************************************************************************/    
                                                // Variable Definition
  /***************************************************************************************************************/ 
  

  
  /***************************************************************************************************************/    
                                               // Local Values
  /***************************************************************************************************************/ 
  

  
  /***************************************************************************************************************/    
                                              // Test Case Info
  /***************************************************************************************************************/
  setWriteDbgLevel(DebugOff);
  snprintf( chTestTitle, elCount(chTestTitle), "Verify_Hardware_CRC16_Calculation_Failure_Reporting_Core_1" );
  snprintf( chTestDescription, elCount(chTestDescription), "Purpose:To check the GetHWIO_e_CalcCRC_St(); interface  ");
  TestCaseAddInfo( chTestTitle, "TC_L30SW_Q-37518550", chTestDescription );

  /***************************************************************************************************************/    
                                              // Start of Test Case
  /***************************************************************************************************************/
  
  /***************************************************************************************************************/    
                                              // Test Step 0 PRECONDITIONS
  /***************************************************************************************************************/
  snprintf( chActionText, elCount(chActionText), "Flash the Software and ECU is running "); 
  snprintf( chExpectedText, elCount(chExpectedText), "Ecu is should be in running state"); 
  TestStepAddActionExpected( chActionText, chExpectedText );
  
  A_DBGR_BreakpointDeleteAll();
  A_DBGR_R();
  A_DBGR_Go(); 

  /***************************************************************************************************************/    
                                              // Test Step 1 Set breakpoint in line Test_hwcrc_llsi(); inside "TestApp_Core0_10ms_MainFunction" function and inside testapp.c file
  /***************************************************************************************************************/
  snprintf( chActionText, elCount(chActionText), "Set Breakpoint in Test_hwcrc_llsi(); "); 
  snprintf( chExpectedText, elCount(chExpectedText), "Verify Breakpoint is Set in Test_hwcrc_llsi();"); 
  //TestStepAddActionExpected( chActionText, chExpectedText );  
  A_DBGR_BreakpointSet("TestApp_Core0_10ms_MainFunction\\45");  

  A_DBGR_Go();
  
  snprintf( chActionText, elCount(chActionText), "Verify Breakpoint should hit in Test_hwcrc_llsi(); "); 
  snprintf( chExpectedText, elCount(chExpectedText), "Breakpoint hit in Test_hwcrc_llsi(); function"); 
  E_DBGR_BreakpointCheckForHalt("TestApp_Core0_10ms_MainFunction\\45");
  
  snprintf( chActionText, elCount(chActionText), "Delete all breakpoints "); 
  snprintf( chExpectedText, elCount(chExpectedText), "Breakpoints deleted"); 
  TestStepAddActionExpected( chActionText, chExpectedText );
  
  A_DBGR_BreakpointDeleteAll();
   
  
   
  /***************************************************************************************************************/    
  	                            // Test Step 2 Set a breakpoint at "v_coreId_u8 = (BYTE)GetCoreID();" inside "Test_hwcrc_llsi" function
  /***************************************************************************************************************/
  
  snprintf( chActionText, elCount(chActionText), "Set Breakpoint in v_coreId_u8 = (BYTE)GetCoreID(); "); 
  snprintf( chExpectedText, elCount(chExpectedText), "Verify Breakpoint is Set in v_coreId_u8 = (BYTE)GetCoreID();"); 
  //TestStepAddActionExpected( chActionText, chExpectedText );  
  A_DBGR_BreakpointSet("Test_hwcrc_llsi\\975");  

  A_DBGR_Go();
  
  snprintf( chActionText, elCount(chActionText), "Verify Breakpoint should hit in v_coreId_u8 = (BYTE)GetCoreID(); "); 
  snprintf( chExpectedText, elCount(chExpectedText), "Breakpoint hit in v_coreId_u8 = (BYTE)GetCoreID(); function"); 
  E_DBGR_BreakpointCheckForHalt("Test_hwcrc_llsi\\975");
  
  /***************************************************************************************************************/    
  	                            // Test Step 3 Verify v_coreId_u8 in trace32 watch window
  /***************************************************************************************************************/
  
   while(1)
  {
  if(cnt == 0)
  {
  snprintf( chActionText, elCount(chActionText), "Verify v_coreId_u8 is 1 "); 
  snprintf( chExpectedText, elCount(chExpectedText), "Verify Verify v_coreId_u8 is 1"); 
  
  TestStepAddActionExpected( chActionText, chExpectedText );  
  }
  
  A_DBGR_VariableRead("v_coreId_u8",coreID);
  if(coreID == 1)
  {
    break;
  }
  if(cnt == 0)
  {
  snprintf( chActionText, elCount(chActionText), "Run debugger "); 
  snprintf( chExpectedText, elCount(chExpectedText), "Run debugger "); 
  }
  A_DBGR_Go();
  cnt =cnt+1;
  }
  E_DBGR_VariableCheck("v_crcSts_u8",0,Equal);
  cnt =0;
  snprintf( chActionText, elCount(chActionText), "delete all breakpoints "); 
  snprintf( chExpectedText, elCount(chExpectedText), "delete all breakpoints "); 
  TestStepAddActionExpected( chActionText, chExpectedText );
  A_DBGR_BreakpointDeleteAll();
  /***************************************************************************************************************/    
  	                            // Test Step 4 Set a breakpoint at line"PerfmHWIO_h_CalcCRC ((BYTE)test_HwCrc_CRC32_ethernet_E, v_seed_u32, v_startAddr_u8, v_endAddr_u8);"
  /***************************************************************************************************************/
  snprintf( chActionText, elCount(chActionText), "Set Breakpoint inPerfmHWIO_h_CalcCRC ((BYTE)test_HwCrc_CRC32_ethernet_E, v_seed_u32, v_startAddr_u8, v_endAddr_u8); "); 
  snprintf( chExpectedText, elCount(chExpectedText), "Verify Breakpoint is Set in PerfmHWIO_h_CalcCRC ((BYTE)test_HwCrc_CRC32_ethernet_E, v_seed_u32, v_startAddr_u8, v_endAddr_u8);"); 
  //TestStepAddActionExpected( chActionText, chExpectedText );  
  A_DBGR_BreakpointSet("Test_hwcrc_llsi\\990");  

  A_DBGR_Go();
  
  snprintf( chActionText, elCount(chActionText), "Verify Breakpoint should hit in v_crcSts_u8 = GetHWIO_e_CalcCRC_St(); "); 
  snprintf( chExpectedText, elCount(chExpectedText), "Breakpoint hit in v_crcSts_u8 = GetHWIO_e_CalcCRC_St(); function"); 
  E_DBGR_BreakpointCheckForHalt("Test_hwcrc_llsi\\990");
  
  while(1)
  {
  if(cnt == 0)
  {
  snprintf( chActionText, elCount(chActionText), "Verify v_coreId_u8 is 1 "); 
  snprintf( chExpectedText, elCount(chExpectedText), "Verify Verify v_coreId_u8 is 1"); 
  
  TestStepAddActionExpected( chActionText, chExpectedText );  
  }
  
  A_DBGR_VariableRead("v_coreId_u8",coreID);
  if(coreID == 1)
  {
    write("core ID is : %d",coreID);
    break;
  }
  if(cnt == 0)
  {
  snprintf( chActionText, elCount(chActionText), "Run debugger "); 
  snprintf( chExpectedText, elCount(chExpectedText), "Run debugger "); 
  }
  testWaitForTimeout(1000);
  A_DBGR_Go();
  cnt =cnt+1;
 
  }
  cnt =0;
  A_DBGR_BreakpointDeleteAll();
  
   /***************************************************************************************************************/    
  	                            // Test Step 5 Set a breakpoint at line"v_crcSts_u8 = GetHWIO_e_CalcCRC_St();"" inside Test_hwcrc_llsi"
  /***************************************************************************************************************/
  snprintf( chActionText, elCount(chActionText), "Set Breakpoint in v_crcSts_u8 = GetHWIO_e_CalcCRC_St();"" inside Test_hwcrc_llsi "); 
  snprintf( chExpectedText, elCount(chExpectedText), "Verify Breakpoint is Set in v_crcSts_u8 = GetHWIO_e_CalcCRC_St();"" inside Test_hwcrc_llsi"); 
//  TestStepAddActionExpected( chActionText, chExpectedText );  
  A_DBGR_BreakpointSet("Test_hwcrc_llsi\\992");  

  A_DBGR_Go();
  
  snprintf( chActionText, elCount(chActionText), "Verify Breakpoint should hit in v_crcSts_u8 = GetHWIO_e_CalcCRC_St(); "); 
  snprintf( chExpectedText, elCount(chExpectedText), "Breakpoint hit in v_crcSts_u8 = GetHWIO_e_CalcCRC_St(); function"); 
  E_DBGR_BreakpointCheckForHalt("Test_hwcrc_llsi\\992");
  while(1)
  {
  if(cnt == 0)
  {
  snprintf( chActionText, elCount(chActionText), "Verify v_coreId_u8 is 1 "); 
  snprintf( chExpectedText, elCount(chExpectedText), "Verify Verify v_coreId_u8 is 1"); 
  
  TestStepAddActionExpected( chActionText, chExpectedText );  
  }
  
  A_DBGR_VariableRead("v_coreId_u8",coreID);
  if(coreID == 1)
  {
    write("core ID is : %d",coreID);
    break;
  }
  if(cnt == 0)
  {
  snprintf( chActionText, elCount(chActionText), "Run debugger "); 
  snprintf( chExpectedText, elCount(chExpectedText), "Run debugger "); 
  }
  testWaitForTimeout(1000);
  A_DBGR_Go();
  cnt =cnt+1;
 
  }
  cnt =0;
  E_DBGR_VariableCheck("v_crcSts_u8",3,Equal);
  
  snprintf( chActionText, elCount(chActionText), "Delete all breakpoints "); 
  snprintf( chExpectedText, elCount(chExpectedText), "Breakpoints deleted"); 
  TestStepAddActionExpected( chActionText, chExpectedText );
  A_DBGR_BreakpointDeleteAll();
  /***************************************************************************************************************/    
  	                            // Test Step 6 Set a breakpoint after the line"v_sigVal_u32 = GetHWIO_g_CalcCRC_Sig();"
  /***************************************************************************************************************/
  snprintf( chActionText, elCount(chActionText), "Set Breakpoint in v_crcSts_u8 = GetHWIO_e_CalcCRC_St();"" inside Test_hwcrc_llsi "); 
  snprintf( chExpectedText, elCount(chExpectedText), "Verify Breakpoint is Set in v_crcSts_u8 = GetHWIO_e_CalcCRC_St();"" inside Test_hwcrc_llsi"); 
//  TestStepAddActionExpected( chActionText, chExpectedText );  
  A_DBGR_BreakpointSet("Test_hwcrc_llsi\\1018");  

  A_DBGR_Go();
  testWaitForTimeout(1000);
  snprintf( chActionText, elCount(chActionText), "Verify Breakpoint should hit in v_crcSts_u8 = GetHWIO_e_CalcCRC_St(); "); 
  snprintf( chExpectedText, elCount(chExpectedText), "Breakpoint hit in v_crcSts_u8 = GetHWIO_e_CalcCRC_St(); function"); 
  E_DBGR_BreakpointCheckForHalt("Test_hwcrc_llsi\\1018");
  while(1)
  {
  if(cnt == 0)
  {
  snprintf( chActionText, elCount(chActionText), "Verify v_coreId_u8 is 1 "); 
  snprintf( chExpectedText, elCount(chExpectedText), "Verify Verify v_coreId_u8 is 1"); 
  
  TestStepAddActionExpected( chActionText, chExpectedText );  
  }
  
  A_DBGR_VariableRead("v_coreId_u8",coreID);
  if(coreID == 1)
  {
    write("core ID is : %d",coreID);
    break;
  }
  if(cnt == 0)
  {
  snprintf( chActionText, elCount(chActionText), "Run debugger "); 
  snprintf( chExpectedText, elCount(chExpectedText), "Run debugger "); 
  }
  testWaitForTimeout(3000);
  A_DBGR_Go();
  cnt =cnt+1;
 
  }
  cnt =0;
  E_DBGR_VariableCheck("v_sigVal_u32",0,Equal);
  snprintf( chActionText, elCount(chActionText), "Delete all breakpoints "); 
  snprintf( chExpectedText, elCount(chExpectedText), "Breakpoints deleted"); 
  TestStepAddActionExpected( chActionText, chExpectedText );
  A_DBGR_BreakpointDeleteAll();
  /***************************************************************************************************************/    
  	                            // Test Step 7 Set a breakpoint at line"v_crcSts_u8 = GetHWIO_e_CalcCRC_St();"" inside Test_hwcrc_llsi"
  /***************************************************************************************************************/
  snprintf( chActionText, elCount(chActionText), "Set Breakpoint in v_crcSts_u8 = GetHWIO_e_CalcCRC_St();"" inside Test_hwcrc_llsi "); 
  snprintf( chExpectedText, elCount(chExpectedText), "Verify Breakpoint is Set in v_crcSts_u8 = GetHWIO_e_CalcCRC_St();"" inside Test_hwcrc_llsi"); 
//  TestStepAddActionExpected( chActionText, chExpectedText );  
  A_DBGR_BreakpointSet("Test_hwcrc_llsi\\1039");  

  A_DBGR_Go();
  
  snprintf( chActionText, elCount(chActionText), "Verify Breakpoint should hit in v_crcSts_u8 = GetHWIO_e_CalcCRC_St(); "); 
  snprintf( chExpectedText, elCount(chExpectedText), "Breakpoint hit in v_crcSts_u8 = GetHWIO_e_CalcCRC_St(); function"); 
  E_DBGR_BreakpointCheckForHalt("Test_hwcrc_llsi\\1039");
  while(1)
  {
  if(cnt == 0)
  {
  snprintf( chActionText, elCount(chActionText), "Verify v_coreId_u8 is 1 "); 
  snprintf( chExpectedText, elCount(chExpectedText), "Verify Verify v_coreId_u8 is 1"); 
  
  TestStepAddActionExpected( chActionText, chExpectedText );  
  }
  
  A_DBGR_VariableRead("v_coreId_u8",coreID);
  if(coreID == 1)
  {
    write("core ID is : %d",coreID);
    break;
  }
  if(cnt == 0)
  {
  snprintf( chActionText, elCount(chActionText), "Run debugger "); 
  snprintf( chExpectedText, elCount(chExpectedText), "Run debugger "); 
  }
  testWaitForTimeout(1000);
  A_DBGR_Go();
  cnt =cnt+1;
 
  }
  cnt =0;
  E_DBGR_VariableCheck("v_crcSts_u8",0,Equal);
}

testcase Verify_Hardware_CRC16_Calculation_Failure_Reporting_Core_2()
{
  /***************************************************************************************************************/    
                                                // Variable Definition
  /***************************************************************************************************************/ 
  

  
  /***************************************************************************************************************/    
                                               // Local Values
  /***************************************************************************************************************/ 
  

  
  /***************************************************************************************************************/    
                                              // Test Case Info
  /***************************************************************************************************************/
  setWriteDbgLevel(DebugOff);
  snprintf( chTestTitle, elCount(chTestTitle), "Verify_Hardware_CRC16_Calculation_Failure_Reporting_Core_2" );
  snprintf( chTestDescription, elCount(chTestDescription), "Purpose:To check the GetHWIO_e_CalcCRC_St(); interface  ");
  TestCaseAddInfo( chTestTitle, "TC_L30SW_Q-37518578", chTestDescription );

  /***************************************************************************************************************/    
                                              // Start of Test Case
  /***************************************************************************************************************/
  
  /***************************************************************************************************************/    
                                              // Test Step 0 PRECONDITIONS
  /***************************************************************************************************************/
  snprintf( chActionText, elCount(chActionText), "Flash the Software and ECU is running "); 
  snprintf( chExpectedText, elCount(chExpectedText), "Ecu is should be in running state"); 
  TestStepAddActionExpected( chActionText, chExpectedText );
  
  A_DBGR_BreakpointDeleteAll();
  A_DBGR_R();
  A_DBGR_Go();

  /***************************************************************************************************************/    
                                              // Test Step 1 Set breakpoint in line Test_hwcrc_llsi(); inside "TestApp_Core2_10ms_MainFunction" function and inside testapp.c file
  /***************************************************************************************************************/
  snprintf( chActionText, elCount(chActionText), "Set Breakpoint in Test_hwcrc_llsi(); "); 
  snprintf( chExpectedText, elCount(chExpectedText), "Verify Breakpoint is Set in Test_hwcrc_llsi();"); 
  //TestStepAddActionExpected( chActionText, chExpectedText );  
  A_DBGR_BreakpointSet("TestApp_Core2_10ms_MainFunction\\36");  

  A_DBGR_Go();
  
  snprintf( chActionText, elCount(chActionText), "Verify Breakpoint should hit in Test_hwcrc_llsi(); "); 
  snprintf( chExpectedText, elCount(chExpectedText), "Breakpoint hit in Test_hwcrc_llsi(); function"); 
  E_DBGR_BreakpointCheckForHalt("TestApp_Core2_10ms_MainFunction\\36");
  
  snprintf( chActionText, elCount(chActionText), "Delete all breakpoints "); 
  snprintf( chExpectedText, elCount(chExpectedText), "Breakpoints deleted"); 
  TestStepAddActionExpected( chActionText, chExpectedText );
  
  A_DBGR_BreakpointDeleteAll();
   
  
   
  /***************************************************************************************************************/    
  	                            // Test Step 2 Set a breakpoint at "v_coreId_u8 = (BYTE)GetCoreID();" inside "Test_hwcrc_llsi" function
  /***************************************************************************************************************/
  
  snprintf( chActionText, elCount(chActionText), "Set Breakpoint in v_coreId_u8 = (BYTE)GetCoreID(); "); 
  snprintf( chExpectedText, elCount(chExpectedText), "Verify Breakpoint is Set in v_coreId_u8 = (BYTE)GetCoreID();"); 
  //TestStepAddActionExpected( chActionText, chExpectedText );  
  A_DBGR_BreakpointSet("Test_hwcrc_llsi\\975");  

  A_DBGR_Go();
  
  snprintf( chActionText, elCount(chActionText), "Verify Breakpoint should hit in v_coreId_u8 = (BYTE)GetCoreID(); "); 
  snprintf( chExpectedText, elCount(chExpectedText), "Breakpoint hit in v_coreId_u8 = (BYTE)GetCoreID(); function"); 
  E_DBGR_BreakpointCheckForHalt("Test_hwcrc_llsi\\975");
  
  /***************************************************************************************************************/    
  	                            // Test Step 3 Verify v_coreId_u8 in trace32 watch window
  /***************************************************************************************************************/
  
   while(1)
  {
  if(cnt == 0)
  {
  snprintf( chActionText, elCount(chActionText), "Verify v_coreId_u8 is 2 "); 
  snprintf( chExpectedText, elCount(chExpectedText), "Verify Verify v_coreId_u8 is 2"); 
  
  TestStepAddActionExpected( chActionText, chExpectedText );  
  }
  
  A_DBGR_VariableRead("v_coreId_u8",coreID);
  if(coreID == 2)
  {
    break;
  }
  if(cnt == 0)
  {
  snprintf( chActionText, elCount(chActionText), "Run debugger "); 
  snprintf( chExpectedText, elCount(chExpectedText), "Run debugger "); 
  }
  A_DBGR_Go();
  cnt =cnt+1;
  }
  E_DBGR_VariableCheck("v_crcSts_u8",0,Equal);
  cnt =0;
  snprintf( chActionText, elCount(chActionText), "delete all breakpoints "); 
  snprintf( chExpectedText, elCount(chExpectedText), "delete all breakpoints "); 
  TestStepAddActionExpected( chActionText, chExpectedText );
  A_DBGR_BreakpointDeleteAll();
  /***************************************************************************************************************/    
  	                            // Test Step 4 Set a breakpoint at line"PerfmHWIO_h_CalcCRC ((BYTE)test_HwCrc_CRC32_ethernet_E, v_seed_u32, v_startAddr_u8, v_endAddr_u8);"
  /***************************************************************************************************************/
  snprintf( chActionText, elCount(chActionText), "Set Breakpoint inPerfmHWIO_h_CalcCRC ((BYTE)test_HwCrc_CRC32_ethernet_E, v_seed_u32, v_startAddr_u8, v_endAddr_u8); "); 
  snprintf( chExpectedText, elCount(chExpectedText), "Verify Breakpoint is Set in PerfmHWIO_h_CalcCRC ((BYTE)test_HwCrc_CRC32_ethernet_E, v_seed_u32, v_startAddr_u8, v_endAddr_u8);"); 
  //TestStepAddActionExpected( chActionText, chExpectedText );  
  A_DBGR_BreakpointSet("Test_hwcrc_llsi\\990");  

  A_DBGR_Go();
  
  snprintf( chActionText, elCount(chActionText), "Verify Breakpoint should hit in v_crcSts_u8 = GetHWIO_e_CalcCRC_St(); "); 
  snprintf( chExpectedText, elCount(chExpectedText), "Breakpoint hit in v_crcSts_u8 = GetHWIO_e_CalcCRC_St(); function"); 
  E_DBGR_BreakpointCheckForHalt("Test_hwcrc_llsi\\990");
  
  while(1)
  {
  if(cnt == 0)
  {
  snprintf( chActionText, elCount(chActionText), "Verify v_coreId_u8 is 2 "); 
  snprintf( chExpectedText, elCount(chExpectedText), "Verify Verify v_coreId_u8 is 2"); 
  
  TestStepAddActionExpected( chActionText, chExpectedText );  
  }
  
  A_DBGR_VariableRead("v_coreId_u8",coreID);
  if(coreID == 2)
  {
    write("core ID is : %d",coreID);
    break;
  }
  if(cnt == 0)
  {
  snprintf( chActionText, elCount(chActionText), "Run debugger "); 
  snprintf( chExpectedText, elCount(chExpectedText), "Run debugger "); 
  }
  testWaitForTimeout(1000);
  A_DBGR_Go();
  cnt =cnt+1;
 
  }
  cnt =0;
  A_DBGR_BreakpointDeleteAll();
  
   /***************************************************************************************************************/    
  	                            // Test Step 5 Set a breakpoint at line"v_crcSts_u8 = GetHWIO_e_CalcCRC_St();"" inside Test_hwcrc_llsi"
  /***************************************************************************************************************/
  snprintf( chActionText, elCount(chActionText), "Set Breakpoint in v_crcSts_u8 = GetHWIO_e_CalcCRC_St();"" inside Test_hwcrc_llsi "); 
  snprintf( chExpectedText, elCount(chExpectedText), "Verify Breakpoint is Set in v_crcSts_u8 = GetHWIO_e_CalcCRC_St();"" inside Test_hwcrc_llsi"); 
//  TestStepAddActionExpected( chActionText, chExpectedText );  
  A_DBGR_BreakpointSet("Test_hwcrc_llsi\\992");  

  A_DBGR_Go();
  
  snprintf( chActionText, elCount(chActionText), "Verify Breakpoint should hit in v_crcSts_u8 = GetHWIO_e_CalcCRC_St(); "); 
  snprintf( chExpectedText, elCount(chExpectedText), "Breakpoint hit in v_crcSts_u8 = GetHWIO_e_CalcCRC_St(); function"); 
  E_DBGR_BreakpointCheckForHalt("Test_hwcrc_llsi\\992");
  while(1)
  {
  if(cnt == 0)
  {
  snprintf( chActionText, elCount(chActionText), "Verify v_coreId_u8 is 2 "); 
  snprintf( chExpectedText, elCount(chExpectedText), "Verify Verify v_coreId_u8 is 2"); 
  
  TestStepAddActionExpected( chActionText, chExpectedText );  
  }
  
  A_DBGR_VariableRead("v_coreId_u8",coreID);
  if(coreID == 2)
  {
    write("core ID is : %d",coreID);
    break;
  }
  if(cnt == 0)
  {
  snprintf( chActionText, elCount(chActionText), "Run debugger "); 
  snprintf( chExpectedText, elCount(chExpectedText), "Run debugger "); 
  }
  testWaitForTimeout(1000);
  A_DBGR_Go();
  cnt =cnt+1;
 
  }
  cnt =0;
  E_DBGR_VariableCheck("v_crcSts_u8",3,Equal);
  
  snprintf( chActionText, elCount(chActionText), "Delete all breakpoints "); 
  snprintf( chExpectedText, elCount(chExpectedText), "Breakpoints deleted"); 
  TestStepAddActionExpected( chActionText, chExpectedText );
  A_DBGR_BreakpointDeleteAll();
  /***************************************************************************************************************/    
  	                            // Test Step 6 Set a breakpoint after the line"v_sigVal_u32 = GetHWIO_g_CalcCRC_Sig();"
  /***************************************************************************************************************/
  snprintf( chActionText, elCount(chActionText), "Set Breakpoint in v_crcSts_u8 = GetHWIO_e_CalcCRC_St();"" inside Test_hwcrc_llsi "); 
  snprintf( chExpectedText, elCount(chExpectedText), "Verify Breakpoint is Set in v_crcSts_u8 = GetHWIO_e_CalcCRC_St();"" inside Test_hwcrc_llsi"); 
//  TestStepAddActionExpected( chActionText, chExpectedText );  
  A_DBGR_BreakpointSet("Test_hwcrc_llsi\\1018");  

  A_DBGR_Go();
  testWaitForTimeout(1000);
  snprintf( chActionText, elCount(chActionText), "Verify Breakpoint should hit in v_crcSts_u8 = GetHWIO_e_CalcCRC_St(); "); 
  snprintf( chExpectedText, elCount(chExpectedText), "Breakpoint hit in v_crcSts_u8 = GetHWIO_e_CalcCRC_St(); function"); 
  E_DBGR_BreakpointCheckForHalt("Test_hwcrc_llsi\\1018");
  while(1)
  {
  if(cnt == 0)
  {
  snprintf( chActionText, elCount(chActionText), "Verify v_coreId_u8 is 2 "); 
  snprintf( chExpectedText, elCount(chExpectedText), "Verify Verify v_coreId_u8 is 2"); 
  
  TestStepAddActionExpected( chActionText, chExpectedText );  
  }
  
  A_DBGR_VariableRead("v_coreId_u8",coreID);
  if(coreID == 2)
  {
    write("core ID is : %d",coreID);
    break;
  }
  if(cnt == 0)
  {
  snprintf( chActionText, elCount(chActionText), "Run debugger "); 
  snprintf( chExpectedText, elCount(chExpectedText), "Run debugger "); 
  }
  testWaitForTimeout(3000);
  A_DBGR_Go();
  cnt =cnt+1;
 
  }
  cnt =0;
  E_DBGR_VariableCheck("v_sigVal_u32",0,Equal);
  snprintf( chActionText, elCount(chActionText), "Delete all breakpoints "); 
  snprintf( chExpectedText, elCount(chExpectedText), "Breakpoints deleted"); 
  TestStepAddActionExpected( chActionText, chExpectedText );
  A_DBGR_BreakpointDeleteAll();
  /***************************************************************************************************************/    
  	                            // Test Step 7 Set a breakpoint at line"v_crcSts_u8 = GetHWIO_e_CalcCRC_St();"" inside Test_hwcrc_llsi"
  /***************************************************************************************************************/
  snprintf( chActionText, elCount(chActionText), "Set Breakpoint in v_crcSts_u8 = GetHWIO_e_CalcCRC_St();"" inside Test_hwcrc_llsi "); 
  snprintf( chExpectedText, elCount(chExpectedText), "Verify Breakpoint is Set in v_crcSts_u8 = GetHWIO_e_CalcCRC_St();"" inside Test_hwcrc_llsi"); 
//  TestStepAddActionExpected( chActionText, chExpectedText );  
  A_DBGR_BreakpointSet("Test_hwcrc_llsi\\1039");  

  A_DBGR_Go();
  
  snprintf( chActionText, elCount(chActionText), "Verify Breakpoint should hit in v_crcSts_u8 = GetHWIO_e_CalcCRC_St(); "); 
  snprintf( chExpectedText, elCount(chExpectedText), "Breakpoint hit in v_crcSts_u8 = GetHWIO_e_CalcCRC_St(); function"); 
  E_DBGR_BreakpointCheckForHalt("Test_hwcrc_llsi\\1039");
  while(1)
  {
  if(cnt == 0)
  {
  snprintf( chActionText, elCount(chActionText), "Verify v_coreId_u8 is 2 "); 
  snprintf( chExpectedText, elCount(chExpectedText), "Verify Verify v_coreId_u8 is 2"); 
  
  TestStepAddActionExpected( chActionText, chExpectedText );  
  }
  
  A_DBGR_VariableRead("v_coreId_u8",coreID);
  if(coreID == 2)
  {
    write("core ID is : %d",coreID);
    break;
  }
  if(cnt == 0)
  {
  snprintf( chActionText, elCount(chActionText), "Run debugger "); 
  snprintf( chExpectedText, elCount(chExpectedText), "Run debugger "); 
  }
  testWaitForTimeout(1000);
  A_DBGR_Go();
  cnt =cnt+1;
 
  }
  cnt =0;
  E_DBGR_VariableCheck("v_crcSts_u8",0,Equal);
}

testcase Verify_Hardware_CRC16_Calculation_Failure_Reporting_Core_3()
{
  /***************************************************************************************************************/    
                                                // Variable Definition
  /***************************************************************************************************************/ 
  

  
  /***************************************************************************************************************/    
                                               // Local Values
  /***************************************************************************************************************/ 
  

  
  /***************************************************************************************************************/    
                                              // Test Case Info
  /***************************************************************************************************************/
  setWriteDbgLevel(DebugOff);
  snprintf( chTestTitle, elCount(chTestTitle), "Verify_Hardware_CRC16_Calculation_Failure_Reporting_Core_3" );
  snprintf( chTestDescription, elCount(chTestDescription), "Purpose:To check the GetHWIO_e_CalcCRC_St(); interface  ");
  TestCaseAddInfo( chTestTitle, "TC_L30SW_Q-37518579", chTestDescription );

  /***************************************************************************************************************/    
                                              // Start of Test Case
  /***************************************************************************************************************/
  
  /***************************************************************************************************************/    
                                              // Test Step 0 PRECONDITIONS
  /***************************************************************************************************************/
  snprintf( chActionText, elCount(chActionText), "Flash the Software and ECU is running "); 
  snprintf( chExpectedText, elCount(chExpectedText), "Ecu is should be in running state"); 
  TestStepAddActionExpected( chActionText, chExpectedText );
  
  A_DBGR_BreakpointDeleteAll();
  A_DBGR_R();
  A_DBGR_Go(); 

  /***************************************************************************************************************/    
                                              // Test Step 1 Set breakpoint in line Test_hwcrc_llsi(); inside "TestApp_Core3_10ms_MainFunction" function and inside testapp.c file
  /***************************************************************************************************************/
  snprintf( chActionText, elCount(chActionText), "Set Breakpoint in Test_hwcrc_llsi(); "); 
  snprintf( chExpectedText, elCount(chExpectedText), "Verify Breakpoint is Set in Test_hwcrc_llsi();"); 
  //TestStepAddActionExpected( chActionText, chExpectedText );  
  A_DBGR_BreakpointSet("TestApp_Core3_10ms_MainFunction\\35");  

  A_DBGR_Go();
  
  snprintf( chActionText, elCount(chActionText), "Verify Breakpoint should hit in Test_hwcrc_llsi(); "); 
  snprintf( chExpectedText, elCount(chExpectedText), "Breakpoint hit in Test_hwcrc_llsi(); function"); 
  E_DBGR_BreakpointCheckForHalt("TestApp_Core3_10ms_MainFunction\\35");
  
  testWaitForTimeout(2000);
  
  snprintf( chActionText, elCount(chActionText), "Delete all breakpoints "); 
  snprintf( chExpectedText, elCount(chExpectedText), "Breakpoints deleted"); 
  TestStepAddActionExpected( chActionText, chExpectedText );
  
  A_DBGR_BreakpointDeleteAll();
   
  
   
  /***************************************************************************************************************/    
  	                            // Test Step 2 Set a breakpoint at "v_coreId_u8 = (BYTE)GetCoreID();" inside "Test_hwcrc_llsi" function
  /***************************************************************************************************************/
  
  snprintf( chActionText, elCount(chActionText), "Set Breakpoint in v_coreId_u8 = (BYTE)GetCoreID(); "); 
  snprintf( chExpectedText, elCount(chExpectedText), "Verify Breakpoint is Set in v_coreId_u8 = (BYTE)GetCoreID();"); 
  //TestStepAddActionExpected( chActionText, chExpectedText );  
  A_DBGR_BreakpointSet("Test_hwcrc_llsi\\975");  

  A_DBGR_Go();
  
  snprintf( chActionText, elCount(chActionText), "Verify Breakpoint should hit in v_coreId_u8 = (BYTE)GetCoreID(); "); 
  snprintf( chExpectedText, elCount(chExpectedText), "Breakpoint hit in v_coreId_u8 = (BYTE)GetCoreID(); function"); 
  E_DBGR_BreakpointCheckForHalt("Test_hwcrc_llsi\\975");
  
  /***************************************************************************************************************/    
  	                            // Test Step 3 Verify v_coreId_u8 in trace32 watch window
  /***************************************************************************************************************/
  
   while(1)
  {
  if(cnt == 0)
  {
  snprintf( chActionText, elCount(chActionText), "Verify v_coreId_u8 is 3 "); 
  snprintf( chExpectedText, elCount(chExpectedText), "Verify Verify v_coreId_u8 is 3"); 
  
  TestStepAddActionExpected( chActionText, chExpectedText );  
  }
  
  A_DBGR_VariableRead("v_coreId_u8",coreID);
  if(coreID == 3)
  {
    break;
  }
  if(cnt == 0)
  {
  snprintf( chActionText, elCount(chActionText), "Run debugger "); 
  snprintf( chExpectedText, elCount(chExpectedText), "Run debugger "); 
  }
  A_DBGR_Go();
  cnt =cnt+1;
  }
  E_DBGR_VariableCheck("v_crcSts_u8",0,Equal);
  cnt =0;
  snprintf( chActionText, elCount(chActionText), "delete all breakpoints "); 
  snprintf( chExpectedText, elCount(chExpectedText), "delete all breakpoints "); 
  TestStepAddActionExpected( chActionText, chExpectedText );
  A_DBGR_BreakpointDeleteAll();
  /***************************************************************************************************************/    
  	                            // Test Step 4 Set a breakpoint at line"PerfmHWIO_h_CalcCRC ((BYTE)test_HwCrc_CRC32_ethernet_E, v_seed_u32, v_startAddr_u8, v_endAddr_u8);"
  /***************************************************************************************************************/
  snprintf( chActionText, elCount(chActionText), "Set Breakpoint inPerfmHWIO_h_CalcCRC ((BYTE)test_HwCrc_CRC32_ethernet_E, v_seed_u32, v_startAddr_u8, v_endAddr_u8); "); 
  snprintf( chExpectedText, elCount(chExpectedText), "Verify Breakpoint is Set in PerfmHWIO_h_CalcCRC ((BYTE)test_HwCrc_CRC32_ethernet_E, v_seed_u32, v_startAddr_u8, v_endAddr_u8);"); 
  //TestStepAddActionExpected( chActionText, chExpectedText );  
  A_DBGR_BreakpointSet("Test_hwcrc_llsi\\990");  

  A_DBGR_Go();
  
  snprintf( chActionText, elCount(chActionText), "Verify Breakpoint should hit in v_crcSts_u8 = GetHWIO_e_CalcCRC_St(); "); 
  snprintf( chExpectedText, elCount(chExpectedText), "Breakpoint hit in v_crcSts_u8 = GetHWIO_e_CalcCRC_St(); function"); 
  E_DBGR_BreakpointCheckForHalt("Test_hwcrc_llsi\\990");
  
  while(1)
  {
  if(cnt == 0)
  {
  snprintf( chActionText, elCount(chActionText), "Verify v_coreId_u8 is 3 "); 
  snprintf( chExpectedText, elCount(chExpectedText), "Verify Verify v_coreId_u8 is 3"); 
  
  TestStepAddActionExpected( chActionText, chExpectedText );  
  }
  
  A_DBGR_VariableRead("v_coreId_u8",coreID);
  if(coreID == 3)
  {
    write("core ID is : %d",coreID);
    break;
  }
  if(cnt == 0)
  {
  snprintf( chActionText, elCount(chActionText), "Run debugger "); 
  snprintf( chExpectedText, elCount(chExpectedText), "Run debugger "); 
  }
  testWaitForTimeout(5000);
  A_DBGR_Go();
  cnt =cnt+1;
 
  }
  cnt =0;
  A_DBGR_BreakpointDeleteAll();
  
   /***************************************************************************************************************/    
  	                            // Test Step 5 Set a breakpoint at line"v_crcSts_u8 = GetHWIO_e_CalcCRC_St();"" inside Test_hwcrc_llsi"
  /***************************************************************************************************************/
  snprintf( chActionText, elCount(chActionText), "Set Breakpoint in v_crcSts_u8 = GetHWIO_e_CalcCRC_St();"" inside Test_hwcrc_llsi "); 
  snprintf( chExpectedText, elCount(chExpectedText), "Verify Breakpoint is Set in v_crcSts_u8 = GetHWIO_e_CalcCRC_St();"" inside Test_hwcrc_llsi"); 
//  TestStepAddActionExpected( chActionText, chExpectedText );  
  A_DBGR_BreakpointSet("Test_hwcrc_llsi\\992");  

  A_DBGR_Go();
  
  snprintf( chActionText, elCount(chActionText), "Verify Breakpoint should hit in v_crcSts_u8 = GetHWIO_e_CalcCRC_St(); "); 
  snprintf( chExpectedText, elCount(chExpectedText), "Breakpoint hit in v_crcSts_u8 = GetHWIO_e_CalcCRC_St(); function"); 
  E_DBGR_BreakpointCheckForHalt("Test_hwcrc_llsi\\992");
  while(1)
  {
  if(cnt == 0)
  {
  snprintf( chActionText, elCount(chActionText), "Verify v_coreId_u8 is 3 "); 
  snprintf( chExpectedText, elCount(chExpectedText), "Verify Verify v_coreId_u8 is 3"); 
  
  TestStepAddActionExpected( chActionText, chExpectedText );  
  }
  
  A_DBGR_VariableRead("v_coreId_u8",coreID);
  if(coreID == 3)
  {
    write("core ID is : %d",coreID);
    break;
  }
  if(cnt == 0)
  {
  snprintf( chActionText, elCount(chActionText), "Run debugger "); 
  snprintf( chExpectedText, elCount(chExpectedText), "Run debugger "); 
  }
  testWaitForTimeout(1000);
  A_DBGR_Go();
  cnt =cnt+1;
 
  }
  cnt =0;
  E_DBGR_VariableCheck("v_crcSts_u8",3,Equal);
  
  snprintf( chActionText, elCount(chActionText), "Delete all breakpoints "); 
  snprintf( chExpectedText, elCount(chExpectedText), "Breakpoints deleted"); 
  TestStepAddActionExpected( chActionText, chExpectedText );
  A_DBGR_BreakpointDeleteAll();
  /***************************************************************************************************************/    
  	                            // Test Step 6 Set a breakpoint after the line"v_sigVal_u32 = GetHWIO_g_CalcCRC_Sig();"
  /***************************************************************************************************************/
  snprintf( chActionText, elCount(chActionText), "Set Breakpoint in v_crcSts_u8 = GetHWIO_e_CalcCRC_St();"" inside Test_hwcrc_llsi "); 
  snprintf( chExpectedText, elCount(chExpectedText), "Verify Breakpoint is Set in v_crcSts_u8 = GetHWIO_e_CalcCRC_St();"" inside Test_hwcrc_llsi"); 
//  TestStepAddActionExpected( chActionText, chExpectedText );  
  A_DBGR_BreakpointSet("Test_hwcrc_llsi\\1018");  

  A_DBGR_Go();
  testWaitForTimeout(3000);
  snprintf( chActionText, elCount(chActionText), "Verify Breakpoint should hit in v_crcSts_u8 = GetHWIO_e_CalcCRC_St(); "); 
  snprintf( chExpectedText, elCount(chExpectedText), "Breakpoint hit in v_crcSts_u8 = GetHWIO_e_CalcCRC_St(); function"); 
  E_DBGR_BreakpointCheckForHalt("Test_hwcrc_llsi\\1018");
  while(1)
  {
  if(cnt == 0)
  {
  snprintf( chActionText, elCount(chActionText), "Verify v_coreId_u8 is 3 "); 
  snprintf( chExpectedText, elCount(chExpectedText), "Verify Verify v_coreId_u8 is 3"); 
  
  TestStepAddActionExpected( chActionText, chExpectedText );  
  }
  
  A_DBGR_VariableRead("v_coreId_u8",coreID);
  if(coreID == 3)
  {
    write("core ID is : %d",coreID);
    break;
  }
  if(cnt == 0)
  {
  snprintf( chActionText, elCount(chActionText), "Run debugger "); 
  snprintf( chExpectedText, elCount(chExpectedText), "Run debugger "); 
  }
  testWaitForTimeout(3000);
  A_DBGR_Go();
  cnt =cnt+1;
 
  }
  cnt =0;
  E_DBGR_VariableCheck("v_sigVal_u32",0,Equal);
  snprintf( chActionText, elCount(chActionText), "Delete all breakpoints "); 
  snprintf( chExpectedText, elCount(chExpectedText), "Breakpoints deleted"); 
  TestStepAddActionExpected( chActionText, chExpectedText );
  A_DBGR_BreakpointDeleteAll();
  /***************************************************************************************************************/    
  	                            // Test Step 7 Set a breakpoint at line"v_crcSts_u8 = GetHWIO_e_CalcCRC_St();"" inside Test_hwcrc_llsi"
  /***************************************************************************************************************/
  snprintf( chActionText, elCount(chActionText), "Set Breakpoint in v_crcSts_u8 = GetHWIO_e_CalcCRC_St();"" inside Test_hwcrc_llsi "); 
  snprintf( chExpectedText, elCount(chExpectedText), "Verify Breakpoint is Set in v_crcSts_u8 = GetHWIO_e_CalcCRC_St();"" inside Test_hwcrc_llsi"); 
//  TestStepAddActionExpected( chActionText, chExpectedText );  
  A_DBGR_BreakpointSet("Test_hwcrc_llsi\\1039");  

  A_DBGR_Go();
  
  snprintf( chActionText, elCount(chActionText), "Verify Breakpoint should hit in v_crcSts_u8 = GetHWIO_e_CalcCRC_St(); "); 
  snprintf( chExpectedText, elCount(chExpectedText), "Breakpoint hit in v_crcSts_u8 = GetHWIO_e_CalcCRC_St(); function"); 
  E_DBGR_BreakpointCheckForHalt("Test_hwcrc_llsi\\1039");
  while(1)
  {
  if(cnt == 0)
  {
  snprintf( chActionText, elCount(chActionText), "Verify v_coreId_u8 is 3 "); 
  snprintf( chExpectedText, elCount(chExpectedText), "Verify Verify v_coreId_u8 is 3"); 
  
  TestStepAddActionExpected( chActionText, chExpectedText );  
  }
  
  A_DBGR_VariableRead("v_coreId_u8",coreID);
  if(coreID == 3)
  {
    write("core ID is : %d",coreID);
    break;
  }
  if(cnt == 0)
  {
  snprintf( chActionText, elCount(chActionText), "Run debugger "); 
  snprintf( chExpectedText, elCount(chExpectedText), "Run debugger "); 
  }
  testWaitForTimeout(1000);
  A_DBGR_Go();
  cnt =cnt+1;
 
  }
  cnt =0;
  E_DBGR_VariableCheck("v_crcSts_u8",0,Equal);
}

testcase Verify_Hardware_CRC16_Calculation_Failure_Reporting_Core_4()
{
  /***************************************************************************************************************/    
                                                // Variable Definition
  /***************************************************************************************************************/ 
  

  
  /***************************************************************************************************************/    
                                               // Local Values
  /***************************************************************************************************************/ 
  

  
  /***************************************************************************************************************/    
                                              // Test Case Info
  /***************************************************************************************************************/
  setWriteDbgLevel(DebugOff);
  snprintf( chTestTitle, elCount(chTestTitle), "Verify_Hardware_CRC16_Calculation_Failure_Reporting_Core_4" );
  snprintf( chTestDescription, elCount(chTestDescription), "Purpose:To check the GetHWIO_e_CalcCRC_St(); interface  ");
  TestCaseAddInfo( chTestTitle, "TC_L30SW_Q-37518581", chTestDescription );

  /***************************************************************************************************************/    
                                              // Start of Test Case
  /***************************************************************************************************************/
  
  /***************************************************************************************************************/    
                                              // Test Step 0 PRECONDITIONS
  /***************************************************************************************************************/
  snprintf( chActionText, elCount(chActionText), "Flash the Software and ECU is running "); 
  snprintf( chExpectedText, elCount(chExpectedText), "Ecu is should be in running state"); 
  TestStepAddActionExpected( chActionText, chExpectedText );
  
  A_DBGR_BreakpointDeleteAll();
  A_DBGR_R();
  A_DBGR_Go(); 

  /***************************************************************************************************************/    
                                              // Test Step 1 Set breakpoint in line Test_hwcrc_llsi(); inside "TestApp_Core4_1000ms_MainFunction" function and inside testapp.c file
  /***************************************************************************************************************/
  snprintf( chActionText, elCount(chActionText), "Set Breakpoint in Test_hwcrc_llsi(); "); 
  snprintf( chExpectedText, elCount(chExpectedText), "Verify Breakpoint is Set in Test_hwcrc_llsi();"); 
  //TestStepAddActionExpected( chActionText, chExpectedText );  
  A_DBGR_BreakpointSet("TestApp_Core4_1000ms_MainFunction\\65");  

  A_DBGR_Go();
  
  snprintf( chActionText, elCount(chActionText), "Verify Breakpoint should hit in Test_hwcrc_llsi(); "); 
  snprintf( chExpectedText, elCount(chExpectedText), "Breakpoint hit in Test_hwcrc_llsi(); function"); 
  E_DBGR_BreakpointCheckForHalt("TestApp_Core4_1000ms_MainFunction\\65");
  
  testWaitForTimeout(2000);
  
  snprintf( chActionText, elCount(chActionText), "Delete all breakpoints "); 
  snprintf( chExpectedText, elCount(chExpectedText), "Breakpoints deleted"); 
  TestStepAddActionExpected( chActionText, chExpectedText );
  
  A_DBGR_BreakpointDeleteAll();
   
  /***************************************************************************************************************/    
  	                            // Test Step 2 Set a breakpoint at "v_coreId_u8 = (BYTE)GetCoreID();" inside "Test_hwcrc_llsi" function
  /***************************************************************************************************************/
  
  snprintf( chActionText, elCount(chActionText), "Set Breakpoint in v_coreId_u8 = (BYTE)GetCoreID(); "); 
  snprintf( chExpectedText, elCount(chExpectedText), "Verify Breakpoint is Set in v_coreId_u8 = (BYTE)GetCoreID();"); 
  //TestStepAddActionExpected( chActionText, chExpectedText );  
  A_DBGR_BreakpointSet("Test_hwcrc_llsi\\975");  

  A_DBGR_Go();
  
  snprintf( chActionText, elCount(chActionText), "Verify Breakpoint should hit in v_coreId_u8 = (BYTE)GetCoreID(); "); 
  snprintf( chExpectedText, elCount(chExpectedText), "Breakpoint hit in v_coreId_u8 = (BYTE)GetCoreID(); function"); 
  E_DBGR_BreakpointCheckForHalt("Test_hwcrc_llsi\\975");
  
  /***************************************************************************************************************/    
  	                            // Test Step 3 Verify v_coreId_u8 in trace32 watch window
  /***************************************************************************************************************/
  
   while(1)
  {
  if(cnt == 0)
  {
  snprintf( chActionText, elCount(chActionText), "Verify v_coreId_u8 is 4 "); 
  snprintf( chExpectedText, elCount(chExpectedText), "Verify Verify v_coreId_u8 is 4"); 
  
  TestStepAddActionExpected( chActionText, chExpectedText );  
  }
  
  A_DBGR_VariableRead("v_coreId_u8",coreID);
  if(coreID == 4)
  {
    break;
  }
  if(cnt == 0)
  {
  snprintf( chActionText, elCount(chActionText), "Run debugger "); 
  snprintf( chExpectedText, elCount(chExpectedText), "Run debugger "); 
  }
  A_DBGR_Go();
  
  testWaitForTimeout(30000);
  
  cnt =cnt+1;
  }
  E_DBGR_VariableCheck("v_crcSts_u8",0,Equal);
  cnt =0;
  snprintf( chActionText, elCount(chActionText), "delete all breakpoints "); 
  snprintf( chExpectedText, elCount(chExpectedText), "delete all breakpoints "); 
  TestStepAddActionExpected( chActionText, chExpectedText );
  A_DBGR_BreakpointDeleteAll();
  /***************************************************************************************************************/    
  	                            // Test Step 4 Set a breakpoint at line"PerfmHWIO_h_CalcCRC ((BYTE)test_HwCrc_CRC32_ethernet_E, v_seed_u32, v_startAddr_u8, v_endAddr_u8);"
  /***************************************************************************************************************/
  snprintf( chActionText, elCount(chActionText), "Set Breakpoint inPerfmHWIO_h_CalcCRC ((BYTE)test_HwCrc_CRC32_ethernet_E, v_seed_u32, v_startAddr_u8, v_endAddr_u8); "); 
  snprintf( chExpectedText, elCount(chExpectedText), "Verify Breakpoint is Set in PerfmHWIO_h_CalcCRC ((BYTE)test_HwCrc_CRC32_ethernet_E, v_seed_u32, v_startAddr_u8, v_endAddr_u8);"); 
  //TestStepAddActionExpected( chActionText, chExpectedText );  
  A_DBGR_BreakpointSet("Test_hwcrc_llsi\\990");  

  A_DBGR_Go();
  
  snprintf( chActionText, elCount(chActionText), "Verify Breakpoint should hit in v_crcSts_u8 = GetHWIO_e_CalcCRC_St(); "); 
  snprintf( chExpectedText, elCount(chExpectedText), "Breakpoint hit in v_crcSts_u8 = GetHWIO_e_CalcCRC_St(); function"); 
  E_DBGR_BreakpointCheckForHalt("Test_hwcrc_llsi\\990");
  
  while(1)
  {
  if(cnt == 0)
  {
  snprintf( chActionText, elCount(chActionText), "Verify v_coreId_u8 is 4 "); 
  snprintf( chExpectedText, elCount(chExpectedText), "Verify Verify v_coreId_u8 is 4"); 
  
  TestStepAddActionExpected( chActionText, chExpectedText );  
  }
  
  A_DBGR_VariableRead("v_coreId_u8",coreID);
  if(coreID == 4)
  {
    write("core ID is : %d",coreID);
    break;
  }
  if(cnt == 0)
  {
  snprintf( chActionText, elCount(chActionText), "Run debugger "); 
  snprintf( chExpectedText, elCount(chExpectedText), "Run debugger "); 
  }
  testWaitForTimeout(1000);
  A_DBGR_Go();
  cnt =cnt+1;
 
  }
  cnt =0;
  A_DBGR_BreakpointDeleteAll();
  
   /***************************************************************************************************************/    
  	                            // Test Step 5 Set a breakpoint at line"v_crcSts_u8 = GetHWIO_e_CalcCRC_St();"" inside Test_hwcrc_llsi"
  /***************************************************************************************************************/
  snprintf( chActionText, elCount(chActionText), "Set Breakpoint in v_crcSts_u8 = GetHWIO_e_CalcCRC_St();"" inside Test_hwcrc_llsi "); 
  snprintf( chExpectedText, elCount(chExpectedText), "Verify Breakpoint is Set in v_crcSts_u8 = GetHWIO_e_CalcCRC_St();"" inside Test_hwcrc_llsi"); 
//  TestStepAddActionExpected( chActionText, chExpectedText );  
  A_DBGR_BreakpointSet("Test_hwcrc_llsi\\992");  

  A_DBGR_Go();
  
  snprintf( chActionText, elCount(chActionText), "Verify Breakpoint should hit in v_crcSts_u8 = GetHWIO_e_CalcCRC_St(); "); 
  snprintf( chExpectedText, elCount(chExpectedText), "Breakpoint hit in v_crcSts_u8 = GetHWIO_e_CalcCRC_St(); function"); 
  E_DBGR_BreakpointCheckForHalt("Test_hwcrc_llsi\\992");
  while(1)
  {
  if(cnt == 0)
  {
  snprintf( chActionText, elCount(chActionText), "Verify v_coreId_u8 is 4 "); 
  snprintf( chExpectedText, elCount(chExpectedText), "Verify Verify v_coreId_u8 is 4"); 
  
  TestStepAddActionExpected( chActionText, chExpectedText );  
  }
  
  A_DBGR_VariableRead("v_coreId_u8",coreID);
  if(coreID == 4)
  {
    write("core ID is : %d",coreID);
    break;
  }
  if(cnt == 0)
  {
  snprintf( chActionText, elCount(chActionText), "Run debugger "); 
  snprintf( chExpectedText, elCount(chExpectedText), "Run debugger "); 
  }
  testWaitForTimeout(1000);
  A_DBGR_Go();
  cnt =cnt+1;
 
  }
  cnt =0;
  E_DBGR_VariableCheck("v_crcSts_u8",3,Equal);
  
  snprintf( chActionText, elCount(chActionText), "Delete all breakpoints "); 
  snprintf( chExpectedText, elCount(chExpectedText), "Breakpoints deleted"); 
  TestStepAddActionExpected( chActionText, chExpectedText );
  A_DBGR_BreakpointDeleteAll();
  /***************************************************************************************************************/    
  	                            // Test Step 6 Set a breakpoint after the line"v_sigVal_u32 = GetHWIO_g_CalcCRC_Sig();"
  /***************************************************************************************************************/
  snprintf( chActionText, elCount(chActionText), "Set Breakpoint in v_crcSts_u8 = GetHWIO_e_CalcCRC_St();"" inside Test_hwcrc_llsi "); 
  snprintf( chExpectedText, elCount(chExpectedText), "Verify Breakpoint is Set in v_crcSts_u8 = GetHWIO_e_CalcCRC_St();"" inside Test_hwcrc_llsi"); 
//  TestStepAddActionExpected( chActionText, chExpectedText );  
  A_DBGR_BreakpointSet("Test_hwcrc_llsi\\1018");  

  A_DBGR_Go();
  testWaitForTimeout(1000);
  snprintf( chActionText, elCount(chActionText), "Verify Breakpoint should hit in v_crcSts_u8 = GetHWIO_e_CalcCRC_St(); "); 
  snprintf( chExpectedText, elCount(chExpectedText), "Breakpoint hit in v_crcSts_u8 = GetHWIO_e_CalcCRC_St(); function"); 
  E_DBGR_BreakpointCheckForHalt("Test_hwcrc_llsi\\1018");
  while(1)
  {
  if(cnt == 0)
  {
  snprintf( chActionText, elCount(chActionText), "Verify v_coreId_u8 is 4 "); 
  snprintf( chExpectedText, elCount(chExpectedText), "Verify Verify v_coreId_u8 is 4"); 
  
  TestStepAddActionExpected( chActionText, chExpectedText );  
  }
  
  A_DBGR_VariableRead("v_coreId_u8",coreID);
  if(coreID == 4)
  {
    write("core ID is : %d",coreID);
    break;
  }
  if(cnt == 0)
  {
  snprintf( chActionText, elCount(chActionText), "Run debugger "); 
  snprintf( chExpectedText, elCount(chExpectedText), "Run debugger "); 
  }
  testWaitForTimeout(3000);
  A_DBGR_Go();
  cnt =cnt+1;
 
  }
  cnt =0;
  E_DBGR_VariableCheck("v_sigVal_u32",0,Equal);
  snprintf( chActionText, elCount(chActionText), "Delete all breakpoints "); 
  snprintf( chExpectedText, elCount(chExpectedText), "Breakpoints deleted"); 
  TestStepAddActionExpected( chActionText, chExpectedText );
  A_DBGR_BreakpointDeleteAll();
  /***************************************************************************************************************/    
  	                            // Test Step 7 Set a breakpoint at line"v_crcSts_u8 = GetHWIO_e_CalcCRC_St();"" inside Test_hwcrc_llsi"
  /***************************************************************************************************************/
  snprintf( chActionText, elCount(chActionText), "Set Breakpoint in v_crcSts_u8 = GetHWIO_e_CalcCRC_St();"" inside Test_hwcrc_llsi "); 
  snprintf( chExpectedText, elCount(chExpectedText), "Verify Breakpoint is Set in v_crcSts_u8 = GetHWIO_e_CalcCRC_St();"" inside Test_hwcrc_llsi"); 
//  TestStepAddActionExpected( chActionText, chExpectedText );  
  A_DBGR_BreakpointSet("Test_hwcrc_llsi\\1039");  

  A_DBGR_Go();
  
  snprintf( chActionText, elCount(chActionText), "Verify Breakpoint should hit in v_crcSts_u8 = GetHWIO_e_CalcCRC_St(); "); 
  snprintf( chExpectedText, elCount(chExpectedText), "Breakpoint hit in v_crcSts_u8 = GetHWIO_e_CalcCRC_St(); function"); 
  E_DBGR_BreakpointCheckForHalt("Test_hwcrc_llsi\\1039");
  while(1)
  {
  if(cnt == 0)
  {
  snprintf( chActionText, elCount(chActionText), "Verify v_coreId_u8 is 4 "); 
  snprintf( chExpectedText, elCount(chExpectedText), "Verify Verify v_coreId_u8 is 4"); 
  
  TestStepAddActionExpected( chActionText, chExpectedText );  
  }
  
  A_DBGR_VariableRead("v_coreId_u8",coreID);
  if(coreID == 4)
  {
    write("core ID is : %d",coreID);
    break;
  }
  if(cnt == 0)
  {
  snprintf( chActionText, elCount(chActionText), "Run debugger "); 
  snprintf( chExpectedText, elCount(chExpectedText), "Run debugger "); 
  }
  testWaitForTimeout(1000);
  A_DBGR_Go();
  cnt =cnt+1;
 
  }
  cnt =0;
  E_DBGR_VariableCheck("v_crcSts_u8",0,Equal);
}

testcase Verify_Hardware_CRC16_Calculation_Failure_Reporting_Core_5()
{
  /***************************************************************************************************************/    
                                                // Variable Definition
  /***************************************************************************************************************/ 
  

  
  /***************************************************************************************************************/    
                                               // Local Values
  /***************************************************************************************************************/ 
  

  
  /***************************************************************************************************************/    
                                              // Test Case Info
  /***************************************************************************************************************/
  setWriteDbgLevel(DebugOff);
  snprintf( chTestTitle, elCount(chTestTitle), "Verify_Hardware_CRC16_Calculation_Failure_Reporting_Core_5" );
  snprintf( chTestDescription, elCount(chTestDescription), "Purpose:To check the GetHWIO_e_CalcCRC_St(); interface  ");
  TestCaseAddInfo( chTestTitle, "TC_L30SW_Q-37518582", chTestDescription );

  /***************************************************************************************************************/    
                                              // Start of Test Case
  /***************************************************************************************************************/
  
  /***************************************************************************************************************/    
                                              // Test Step 0 PRECONDITIONS
  /***************************************************************************************************************/
  snprintf( chActionText, elCount(chActionText), "Flash the Software and ECU is running "); 
  snprintf( chExpectedText, elCount(chExpectedText), "Ecu is should be in running state"); 
  TestStepAddActionExpected( chActionText, chExpectedText );
  
  A_DBGR_BreakpointDeleteAll();
  A_DBGR_R();
  A_DBGR_Go(); 

  /***************************************************************************************************************/    
                                              // Test Step 1 Set breakpoint in line Test_hwcrc_llsi(); inside "TestApp_Core5_1000ms_MainFunction" function and inside testapp.c file
  /***************************************************************************************************************/
  snprintf( chActionText, elCount(chActionText), "Set Breakpoint in Test_hwcrc_llsi(); "); 
  snprintf( chExpectedText, elCount(chExpectedText), "Verify Breakpoint is Set in Test_hwcrc_llsi();"); 
  //TestStepAddActionExpected( chActionText, chExpectedText );  
  A_DBGR_BreakpointSet("TestApp_Core5_1000ms_MainFunction\\54");  

  A_DBGR_Go();
  
  snprintf( chActionText, elCount(chActionText), "Verify Breakpoint should hit in Test_hwcrc_llsi(); "); 
  snprintf( chExpectedText, elCount(chExpectedText), "Breakpoint hit in Test_hwcrc_llsi(); function"); 
  E_DBGR_BreakpointCheckForHalt("TestApp_Core5_1000ms_MainFunction\\54");
  
  testWaitForTimeout(2000);
  
  snprintf( chActionText, elCount(chActionText), "Delete all breakpoints "); 
  snprintf( chExpectedText, elCount(chExpectedText), "Breakpoints deleted"); 
  TestStepAddActionExpected( chActionText, chExpectedText );
  
  A_DBGR_BreakpointDeleteAll();   
  /***************************************************************************************************************/    
  	                            // Test Step 2 Set a breakpoint at "v_coreId_u8 = (BYTE)GetCoreID();" inside "Test_hwcrc_llsi" function
  /***************************************************************************************************************/
  
  snprintf( chActionText, elCount(chActionText), "Set Breakpoint in v_coreId_u8 = (BYTE)GetCoreID(); "); 
  snprintf( chExpectedText, elCount(chExpectedText), "Verify Breakpoint is Set in v_coreId_u8 = (BYTE)GetCoreID();"); 
  //TestStepAddActionExpected( chActionText, chExpectedText );  
  A_DBGR_BreakpointSet("Test_hwcrc_llsi\\975");  

  A_DBGR_Go();
  testWaitForTimeout(2000);
  snprintf( chActionText, elCount(chActionText), "Verify Breakpoint should hit in v_coreId_u8 = (BYTE)GetCoreID(); "); 
  snprintf( chExpectedText, elCount(chExpectedText), "Breakpoint hit in v_coreId_u8 = (BYTE)GetCoreID(); function"); 
  E_DBGR_BreakpointCheckForHalt("Test_hwcrc_llsi\\975");
  
  /***************************************************************************************************************/    
  	                            // Test Step 3 Verify v_coreId_u8 in trace32 watch window
  /***************************************************************************************************************/
  
   while(1)
  {
  if(cnt == 0)
  {
  snprintf( chActionText, elCount(chActionText), "Verify v_coreId_u8 is 5 "); 
  snprintf( chExpectedText, elCount(chExpectedText), "Verify Verify v_coreId_u8 is 5"); 
  
  TestStepAddActionExpected( chActionText, chExpectedText );  
  }
  
  A_DBGR_VariableRead("v_coreId_u8",coreID);
  if(coreID == 5)
  {
    break;
  }
  if(cnt == 0)
  {
  snprintf( chActionText, elCount(chActionText), "Run debugger "); 
  snprintf( chExpectedText, elCount(chExpectedText), "Run debugger "); 
  }
  A_DBGR_Go();
  testWaitForTimeout(30000);
  
  cnt =cnt+1;
  }
  E_DBGR_VariableCheck("v_crcSts_u8",0,Equal);
  cnt =0;
  snprintf( chActionText, elCount(chActionText), "delete all breakpoints "); 
  snprintf( chExpectedText, elCount(chExpectedText), "delete all breakpoints "); 
  TestStepAddActionExpected( chActionText, chExpectedText );
  A_DBGR_BreakpointDeleteAll();
  /***************************************************************************************************************/    
  	                            // Test Step 4 Set a breakpoint at line"PerfmHWIO_h_CalcCRC ((BYTE)test_HwCrc_CRC32_ethernet_E, v_seed_u32, v_startAddr_u8, v_endAddr_u8);"
  /***************************************************************************************************************/
  snprintf( chActionText, elCount(chActionText), "Set Breakpoint inPerfmHWIO_h_CalcCRC ((BYTE)test_HwCrc_CRC32_ethernet_E, v_seed_u32, v_startAddr_u8, v_endAddr_u8); "); 
  snprintf( chExpectedText, elCount(chExpectedText), "Verify Breakpoint is Set in PerfmHWIO_h_CalcCRC ((BYTE)test_HwCrc_CRC32_ethernet_E, v_seed_u32, v_startAddr_u8, v_endAddr_u8);"); 
  //TestStepAddActionExpected( chActionText, chExpectedText );  
  A_DBGR_BreakpointSet("Test_hwcrc_llsi\\990");  

  A_DBGR_Go();
  
  snprintf( chActionText, elCount(chActionText), "Verify Breakpoint should hit in v_crcSts_u8 = GetHWIO_e_CalcCRC_St(); "); 
  snprintf( chExpectedText, elCount(chExpectedText), "Breakpoint hit in v_crcSts_u8 = GetHWIO_e_CalcCRC_St(); function"); 
  E_DBGR_BreakpointCheckForHalt("Test_hwcrc_llsi\\990");
  
  while(1)
  {
  if(cnt == 0)
  {
  snprintf( chActionText, elCount(chActionText), "Verify v_coreId_u8 is 5 "); 
  snprintf( chExpectedText, elCount(chExpectedText), "Verify Verify v_coreId_u8 is 5"); 
  
  TestStepAddActionExpected( chActionText, chExpectedText );  
  }
  
  A_DBGR_VariableRead("v_coreId_u8",coreID);
  if(coreID == 5)
  {
    write("core ID is : %d",coreID);
    break;
  }
  if(cnt == 0)
  {
  snprintf( chActionText, elCount(chActionText), "Run debugger "); 
  snprintf( chExpectedText, elCount(chExpectedText), "Run debugger "); 
  }
  testWaitForTimeout(1000);
  A_DBGR_Go();
  cnt =cnt+1;
 
  }
  cnt =0;
  A_DBGR_BreakpointDeleteAll();
  
   /***************************************************************************************************************/    
  	                            // Test Step 5 Set a breakpoint at line"v_crcSts_u8 = GetHWIO_e_CalcCRC_St();"" inside Test_hwcrc_llsi"
  /***************************************************************************************************************/
  snprintf( chActionText, elCount(chActionText), "Set Breakpoint in v_crcSts_u8 = GetHWIO_e_CalcCRC_St();"" inside Test_hwcrc_llsi "); 
  snprintf( chExpectedText, elCount(chExpectedText), "Verify Breakpoint is Set in v_crcSts_u8 = GetHWIO_e_CalcCRC_St();"" inside Test_hwcrc_llsi"); 
//  TestStepAddActionExpected( chActionText, chExpectedText );  
  A_DBGR_BreakpointSet("Test_hwcrc_llsi\\992");  

  A_DBGR_Go();
  
  snprintf( chActionText, elCount(chActionText), "Verify Breakpoint should hit in v_crcSts_u8 = GetHWIO_e_CalcCRC_St(); "); 
  snprintf( chExpectedText, elCount(chExpectedText), "Breakpoint hit in v_crcSts_u8 = GetHWIO_e_CalcCRC_St(); function"); 
  E_DBGR_BreakpointCheckForHalt("Test_hwcrc_llsi\\992");
  while(1)
  {
  if(cnt == 0)
  {
  snprintf( chActionText, elCount(chActionText), "Verify v_coreId_u8 is 5 "); 
  snprintf( chExpectedText, elCount(chExpectedText), "Verify Verify v_coreId_u8 is 5"); 
  
  TestStepAddActionExpected( chActionText, chExpectedText );  
  }
  
  A_DBGR_VariableRead("v_coreId_u8",coreID);
  if(coreID == 5)
  {
    write("core ID is : %d",coreID);
    break;
  }
  if(cnt == 0)
  {
  snprintf( chActionText, elCount(chActionText), "Run debugger "); 
  snprintf( chExpectedText, elCount(chExpectedText), "Run debugger "); 
  }
  testWaitForTimeout(1000);
  A_DBGR_Go();
  cnt =cnt+1;
 
  }
  cnt =0;
  E_DBGR_VariableCheck("v_crcSts_u8",3,Equal);
  
  snprintf( chActionText, elCount(chActionText), "Delete all breakpoints "); 
  snprintf( chExpectedText, elCount(chExpectedText), "Breakpoints deleted"); 
  TestStepAddActionExpected( chActionText, chExpectedText );
  A_DBGR_BreakpointDeleteAll();
  /***************************************************************************************************************/    
  	                            // Test Step 6 Set a breakpoint after the line"v_sigVal_u32 = GetHWIO_g_CalcCRC_Sig();"
  /***************************************************************************************************************/
  snprintf( chActionText, elCount(chActionText), "Set Breakpoint in v_crcSts_u8 = GetHWIO_e_CalcCRC_St();"" inside Test_hwcrc_llsi "); 
  snprintf( chExpectedText, elCount(chExpectedText), "Verify Breakpoint is Set in v_crcSts_u8 = GetHWIO_e_CalcCRC_St();"" inside Test_hwcrc_llsi"); 
//  TestStepAddActionExpected( chActionText, chExpectedText );  
  A_DBGR_BreakpointSet("Test_hwcrc_llsi\\1018");  

  A_DBGR_Go();
  testWaitForTimeout(1000);
  snprintf( chActionText, elCount(chActionText), "Verify Breakpoint should hit in v_crcSts_u8 = GetHWIO_e_CalcCRC_St(); "); 
  snprintf( chExpectedText, elCount(chExpectedText), "Breakpoint hit in v_crcSts_u8 = GetHWIO_e_CalcCRC_St(); function"); 
  E_DBGR_BreakpointCheckForHalt("Test_hwcrc_llsi\\1018");
  while(1)
  {
  if(cnt == 0)
  {
  snprintf( chActionText, elCount(chActionText), "Verify v_coreId_u8 is 5 "); 
  snprintf( chExpectedText, elCount(chExpectedText), "Verify Verify v_coreId_u8 is 5"); 
  
  TestStepAddActionExpected( chActionText, chExpectedText );  
  }
  
  A_DBGR_VariableRead("v_coreId_u8",coreID);
  if(coreID == 5)
  {
    write("core ID is : %d",coreID);
    break;
  }
  if(cnt == 0)
  {
  snprintf( chActionText, elCount(chActionText), "Run debugger "); 
  snprintf( chExpectedText, elCount(chExpectedText), "Run debugger "); 
  }
  testWaitForTimeout(3000);
  A_DBGR_Go();
  cnt =cnt+1;
 
  }
  cnt =0;
  E_DBGR_VariableCheck("v_sigVal_u32",0,Equal);
  snprintf( chActionText, elCount(chActionText), "Delete all breakpoints "); 
  snprintf( chExpectedText, elCount(chExpectedText), "Breakpoints deleted"); 
  TestStepAddActionExpected( chActionText, chExpectedText );
  A_DBGR_BreakpointDeleteAll();
  /***************************************************************************************************************/    
  	                            // Test Step 7 Set a breakpoint at line"v_crcSts_u8 = GetHWIO_e_CalcCRC_St();"" inside Test_hwcrc_llsi"
  /***************************************************************************************************************/
  snprintf( chActionText, elCount(chActionText), "Set Breakpoint in v_crcSts_u8 = GetHWIO_e_CalcCRC_St();"" inside Test_hwcrc_llsi "); 
  snprintf( chExpectedText, elCount(chExpectedText), "Verify Breakpoint is Set in v_crcSts_u8 = GetHWIO_e_CalcCRC_St();"" inside Test_hwcrc_llsi"); 
//  TestStepAddActionExpected( chActionText, chExpectedText );  
  A_DBGR_BreakpointSet("Test_hwcrc_llsi\\1039");  

  A_DBGR_Go();
  
  snprintf( chActionText, elCount(chActionText), "Verify Breakpoint should hit in v_crcSts_u8 = GetHWIO_e_CalcCRC_St(); "); 
  snprintf( chExpectedText, elCount(chExpectedText), "Breakpoint hit in v_crcSts_u8 = GetHWIO_e_CalcCRC_St(); function"); 
  E_DBGR_BreakpointCheckForHalt("Test_hwcrc_llsi\\1039");
  while(1)
  {
  if(cnt == 0)
  {
  snprintf( chActionText, elCount(chActionText), "Verify v_coreId_u8 is 5 "); 
  snprintf( chExpectedText, elCount(chExpectedText), "Verify Verify v_coreId_u8 is 5"); 
  
  TestStepAddActionExpected( chActionText, chExpectedText );  
  }
  
  A_DBGR_VariableRead("v_coreId_u8",coreID);
  if(coreID == 5)
  {
    write("core ID is : %d",coreID);
    break;
  }
  if(cnt == 0)
  {
  snprintf( chActionText, elCount(chActionText), "Run debugger "); 
  snprintf( chExpectedText, elCount(chExpectedText), "Run debugger "); 
  }
  testWaitForTimeout(1000);
  A_DBGR_Go();
  cnt =cnt+1;
 
  }
  cnt =0;
  E_DBGR_VariableCheck("v_crcSts_u8",0,Equal);
}

