/*@!Encoding:1252*/
/*!
* @defgroup tscPDU tscPDU
* @defgroup PDU PDU
* @ingroup testSupportLib
* @{
* @addtogroup tscPDU
* @{
*/ 

variables
{
  
  
  
  
  // This debug flag will be used to enable/disable the debug messages in all functions of the current module
  // 0x00 - No debug messages displayed (only function calls).
  // 0x01 - Only function call messages displayed (this will always displayed).
  // 0x02 - Function parameter + 0x01.
  // 0x04 - Internal function actions + 0x01 and 0x02.
  // 0xFF - All of the above (function calls, function parameters, internal function actions).
  const byte tsc_bPDU_GlobalDebugFlag = 0x01;
}


/*! @}*/
/*! @}*/
/*!
*   \file
*   \ingroup testSupportLib
*   \brief PDU test support library constants.
*/