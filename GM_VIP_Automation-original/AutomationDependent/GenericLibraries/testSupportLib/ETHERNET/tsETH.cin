/*@!Encoding:1252*/
/*!
* @defgroup tsETH tsETH
* @defgroup ETH ETH
* @ingroup testSupportLib
* @{
* @addtogroup tsETH
* @{
*/ 
includes
{
  #include "..\..\controlLib\ETHERNET\cETH.cin"
}

variables
{
  byte bts_ETH_DebugFlags = 0;// used for internal debug
  const byte pc_bGlobalDebugFlag = 0x00;
}

/*! \fn void A_ETH_SetBusContext(char aETHbusName[])
*  \brief Function to set the bus context for ETH channel
*  \param[in] aETHbusName - ETH channel name
*
* Change History: 
* Date(DD.MM.YY)        Author          Change info                                                          
*   
* 12.09.18              CiCo        Created and implemented
*/
void A_ETH_SetBusContext(char aETHbusName[])
{
  byte bDebugFlag;
  char chAction[cc_ETHmaxMsgInfoLength];
  char chPassText[cc_ETHmaxMsgInfoLength];
  char chFailText[cc_ETHmaxMsgInfoLength];
  char chMsgInfo[cc_ETHmaxMsgInfoLength];
  long lResult;
  byte bResultAction; 
 
  bDebugFlag = bts_ETH_DebugFlags;
  lResult		= cc_eETHretVal_NOK;
  bResultAction = cc_eETHretVal_NOK;

  writeDbgLevel( DebugFuncCalls, "Function A_ETH_SetBusContext called.");   
#if TOOL_MAJOR_VERSION <= 15
  if( bDebugFlag & (byte) DebugFuncParam )
    writeDbgLevel( DebugFuncParam, "Params: aETHbusName %s", aETHbusName );
  
  snprintf(chAction, elcount(chAction), "Set the bus context for ETH channel name: %s", aETHbusName);
  bResultAction = bFctn_REPORTAction(chAction);
  if(bResultAction)
  {
    if ( 0 < strlen(aETHbusName) )
	  {
		  lResult = lFcnt_ETH_SetBusContext( aETHbusName, chMsgInfo);
      if( bDebugFlag & (byte) DebugFuncInternal )
        writeDbgLevel( DebugFuncInternal, "lFcnt_ETH_SetBusContext: Return: %d, MessageInfo: %s", lResult, chMsgInfo );
      if( cc_eETHretVal_OK == lResult)
        vFctn_REPORTActionEvaluation(chMsgInfo, PASS);
      else
        vFctn_REPORTActionEvaluation(chMsgInfo, FAIL);   
    }
	  else
	  {
      snprintf(chFailText, elCount(chFailText), "Empty ETH bus name requested." ); 
		  vFctn_REPORTActionEvaluation(chFailText, FAIL);
	  }
  }
#else
  snprintf(chMsgInfo, elcount(chMsgInfo), "Function deprecated");
  vFctn_REPORTStepEvaluation( chMsgInfo, FAIL);
#endif
}

/*! \fn void E_ETH_ComparePacketPayloadData( long aEthChannel, struct cv_stETHPacket st_aPacket, word aTimeToWait, byte aCompareData[], enum eCompareType aCompareType, enum cc_eETHPacketType aPacketType)
*  \brief Function to compare the received Eth packet payload in a specific time with the requested.
*  \param[in] aEthChannel - channel number
*  \param[in] st_aPacket - struct for Eth packet(see definition of cv_stETHPacket)
*  \param[in] aTimeToWait - time in ms, if 0 - no timeout controlling
*  \param[in] aCompareData - data for compare
*  \param[in] aCompareType - type of compare [Equal - for equal; NotEqual - for not equal]
*  \param[in] aPacketType  - type of Eth packet [available types: cc_eETHpacket_TCP - for TCP packets; cc_eETHpacket_UDP - for UDP packets]
*
* Change History: 
* Date(DD.MM.YY)        Author          Change info                                                          
*   
* 01.11.23               RC        Created and implemented.
*/
void E_ETH_ComparePacketPayloadData( long aEthChannel, struct cv_stETHPacket st_aPacket, word aTimeToWait, byte aCompareData[], enum eCompareType aCompareType, enum cc_eETHPacketType aPacketType)
{
  byte bDebugFlag;
  char chPassText[cc_ETHmaxMsgInfoLength];
  char chMsgInfo[cc_ETHmaxMsgInfoLength];
  long lFctnRet;
  byte bStorePayload[cc_eETHPacketMaxLength_UDP];

  bDebugFlag = bts_ETH_DebugFlags;
  lFctnRet = cc_eETHretVal_ERR;
  
  writeDbgLevel( DebugFuncCalls, "Entered E_ETH_ComparePacketPayloadData.");
#if TOOL_MAJOR_VERSION <= 15
  if( bDebugFlag & (byte) DebugFuncParam )
    writeDbgLevel( DebugFuncParam, "Params: Channel: %d \n SourceIP: %s \n DestinationIP: %s \n SourcePort: %d \n DestinationPort: %d \n aTimeToWait: %d", 
                   aEthChannel, st_aPacket.cv_chSrcIP, st_aPacket.cv_chDestIP, st_aPacket.cv_dwSrcPort, st_aPacket.cv_dwDestPort, aTimeToWait );  

  if(cc_eETHpacket_TCP == aPacketType) // check type of Eth packet
    lFctnRet = lFcnt_ETH_WaitAndGetTCPdata( aEthChannel, st_aPacket, aTimeToWait, bStorePayload, chMsgInfo);
  else if(cc_eETHpacket_UDP == aPacketType)
    lFctnRet = lFcnt_ETH_WaitAndGetUDPdata( aEthChannel, st_aPacket, aTimeToWait, bStorePayload, chMsgInfo);
  else
    snprintf(chMsgInfo, elcount(chMsgInfo), "Type of Eth packet unsupported: 0x%x .", aPacketType);

  if( bDebugFlag & (byte) DebugFuncInternal )
    writeDbgLevel( DebugFuncInternal, "lFcnt_ETH_WaitAndGetTCPdata/ lFcnt_ETH_WaitAndGetUDPdata: Return: %d, MessageInfo: %s", lFctnRet, chMsgInfo );

  if( cc_eETHretVal_NOK <= lFctnRet )// check for successfull execution of lFcnt_ETH_WaitAndGetTCPdata/ lFcnt_ETH_WaitAndGetUDPdata
  {
    switch (aCompareType)
    {
      byte bFctnRet;
      bFctnRet = cc_eETHretVal_NOK;
      
      case Equal: // in case equal is requested
        bFctnRet = bFctn_CONV_CompareByteArrays( bStorePayload, aCompareData, lFctnRet, chMsgInfo);
        if( bDebugFlag & (byte) DebugFuncInternal )
          writeDbgLevel( DebugFuncInternal, "Equal: bFctn_CONV_CompareByteArrays: Return Value: %d, Info message: %s", bFctnRet, chMsgInfo );
        if( bFctnRet )
        {
          snprintf(chPassText,elcount(chPassText), "Payload data received for Eth packet( %s ) on channel %d (SrcIP- %s -, DestIP- %s -, SrcPort- %d -, DestPort - %d -) is identical with the expected one.", st_aPacket.cv_chPacketName, aEthChannel, st_aPacket.cv_chSrcIP, st_aPacket.cv_chDestIP, st_aPacket.cv_dwSrcPort, st_aPacket.cv_dwDestPort);
          vFctn_REPORTStepEvaluation(chPassText, PASS); // compare OK
        }
        else
        {
          vFctn_REPORTStepEvaluation( chMsgInfo, FAIL); // compare NOK
        }
        break;
      case NotEqual: // in case not equal is requested
        bFctnRet = bFctn_CONV_CompareByteArrays( bStorePayload, aCompareData, lFctnRet, chMsgInfo);
        if( bDebugFlag & (byte) DebugFuncInternal )
          writeDbgLevel( DebugFuncInternal, "NotEqual: bFctn_CONV_CompareByteArrays: Return Value: %d, Info message: %s", bFctnRet, chMsgInfo );
        if(!bFctnRet)
        {
          snprintf(chPassText,elcount(chPassText), "Payload data received for Eth packet( %s ) on channel %d (SrcIP- %s -, DestIP- %s -, SrcPort- %d -, DestPort - %d -) is different than the requested. ", st_aPacket.cv_chPacketName, aEthChannel, st_aPacket.cv_chSrcIP, st_aPacket.cv_chDestIP, st_aPacket.cv_dwSrcPort, st_aPacket.cv_dwDestPort);
          vFctn_REPORTStepEvaluation(chPassText, PASS); // compare OK
        }
        else
        {
          vFctn_REPORTStepEvaluation( chMsgInfo, FAIL); // compare NOK
        }
        
        break;
      default:
        snprintf(chMsgInfo, elcount(chMsgInfo), "Function support compare mode only for equal or not equal see definition of enum cc_eCompareType!!! ");
        vFctn_REPORTStepEvaluation( chMsgInfo, FAIL); // compare NOK
        break;
    }// end of switch/case
  }// end of if cc_eETHretVal_NOK <= lFctnRet
  else
  {
    vFctn_REPORTStepEvaluation( chMsgInfo, FAIL); // failed because of getting Eth packet
  }
#else
  snprintf(chMsgInfo, elcount(chMsgInfo), "Function deprecated");
  vFctn_REPORTStepEvaluation( chMsgInfo, FAIL);
#endif
}

/*! \fn void E_ETH_WaitForPacket(long aEthChannel, struct cv_stETHPacket st_aPacket, word aTimeToWait, enum cc_eETHArpOp aArpOp, enum cc_eETHPacketType aPacketType)
*  \brief Function which check the presence of an Eth packet in a specific time. 
*  \param[in] aEthChannel   - Eth channel number
*  \param[in] st_aPacket    - struct for Eth packet(see definition of cv_stETHPacket )
*  \param[in] aTimeToWait   - time in ms, if 0 - no timeout controlling
*  \param[in] aArpOp        - Eth arp operation (if the type of Eth packet 'aPacketType' is not cc_eETHpacket_ARP, this param will be ignored) (see definition of enum cc_eETHArpOp)
*  \param[in] aPacketType   - type of Eth packet [available types: cc_eETHpacket_TCP - for TCP packets; cc_eETHpacket_UDP - for UDP packets; cc_eETHpacket_ARP - for ARP packets;]
*
* Change History: 
* Date(DD.MM.YY)        Author          Change info                                                          
*   
* 01.11.23               RC        Created and implemented.
*/
void E_ETH_WaitForPacket(long aEthChannel, struct cv_stETHPacket st_aPacket, word aTimeToWait, enum cc_eETHArpOp aArpOp, enum cc_eETHPacketType aPacketType)
{
  byte bDebugFlag;
  char chMsgInfo[cc_ETHmaxMsgInfoLength];
  long lFctnRet;

  bDebugFlag = bts_ETH_DebugFlags;
  lFctnRet = cc_eETHretVal_ERR;
  
  writeDbgLevel(DebugFuncCalls, "Entered E_ETH_WaitForPacket.");
#if TOOL_MAJOR_VERSION <= 15
  if( bDebugFlag & (byte) DebugFuncParam )
    writeDbgLevel( DebugFuncParam, "Params: Channel: %d \n SourceIP: %s \n DestinationIP: %s \n SourcePort: %d \n DestinationPort: %d \n aTimeToWait: %d", 
                   aEthChannel, st_aPacket.cv_chSrcIP, st_aPacket.cv_chDestIP, st_aPacket.cv_dwSrcPort, st_aPacket.cv_dwDestPort, aTimeToWait );  
				   
  if(cc_eETHpacket_UDP == aPacketType) // check type of Eth packet
    lFctnRet = lFcnt_ETH_WaitForUDPpacket(aEthChannel, st_aPacket, aTimeToWait, chMsgInfo);
  else if(cc_eETHpacket_ARP == aPacketType)
    lFctnRet = lFcnt_ETH_WaitForArPpacket(aEthChannel, st_aPacket, aTimeToWait, aArpOp, chMsgInfo);
  else if(cc_eETHpacket_TCP == aPacketType)
    lFctnRet = lFcnt_ETH_WaitForTCPpacket(aEthChannel, st_aPacket, aTimeToWait, chMsgInfo);
  else
    snprintf(chMsgInfo, elcount(chMsgInfo), "Type of Eth packet unsupported: 0x%x .", aPacketType);

  if( bDebugFlag & (byte) DebugFuncInternal )
    writeDbgLevel( DebugFuncInternal, "lFcnt_ETH_WaitForUDPpacket/ lFcnt_ETH_WaitForArPpacket/ lFcnt_ETH_WaitForTCPpacket: Return: %d, MessageInfo: %s", lFctnRet, chMsgInfo );  
  if(cc_eETHretVal_NOK < lFctnRet) // check for successfull execution of lFcnt_ETH_WaitForUDPpacket/ lFcnt_ETH_WaitForArPpacket/ lFcnt_ETH_WaitForTCPpacket
    vFctn_REPORTStepEvaluation(chMsgInfo, PASS);
  else
    vFctn_REPORTStepEvaluation(chMsgInfo, FAIL);
#else
  snprintf(chMsgInfo, elcount(chMsgInfo), "Function deprecated");
  vFctn_REPORTStepEvaluation( chMsgInfo, FAIL);
#endif

}

/*! \fn void E_ETH_WaitForPacket(struct cv_stETHPacket aETHpacket, char aNetworkName[], dword aTimeout, enum cc_ePacketPresence aPresentAbsent)
*  \brief Function Wait and check if a signal is send with a specific raw content (This function can be used for signals with more than 32 bits length).
*  \param[in]  aETHpacket           - ethernet packet(see definition of aETHpacket, any combination of members are allowed)
*  \param[in]  aNetworkName         - Name of the network on which the check should be made
*  \param[in]  aPresentAbsent       - Desired state of the packet(Present or Not Present)
*
* Change History: 
* Date(DD.MM.YY)        Author          Change info                                                          
*   
*  08.11.23              CiCo        Created and implemented based of CANoe >15
*/
void E_ETH_WaitForPacket(struct cv_stETHPacket aETHpacket, char aNetworkName[], dword aTimeout, enum cc_ePacketPresence aPresentAbsent)
{
  char chPassText[250];
  char chFailText[250];
  char chMappedResponseInfo[250];
  long lResult;
  byte bDebugFlag;

  //Initialization of local variables
  lResult  = NotOk;
  bDebugFlag = DebugOff;
  writeDbgLevel (DebugFuncCalls, "Function E_ETH_WaitForPacket entered.");
#if TOOL_MAJOR_VERSION > 15 
  lResult = lFctn_ETH_WaitForPacket(aETHpacket, aNetworkName, aTimeout, aPresentAbsent, chMappedResponseInfo);
  if (Ok == lResult)
    vFctn_REPORTStepEvaluation(chMappedResponseInfo, PASS);
  else
    vFctn_REPORTStepEvaluation(chMappedResponseInfo, FAIL); 
#else
  snprintf(chMsgInfo, elcount(chMsgInfo), "Function available from CANoe Version > 15");
  vFctn_REPORTStepEvaluation( chMsgInfo, FAIL);
#endif
}

/*! \fn void E_ETH_ComparePacketData(struct cv_stETHPacket aETHpacket, char aNetworkName[], dword aTimeout, byte aCompareData[], enum eCompareType aCompareType)
*  \brief Function to compare the received Eth packet payload data in a specific time with the requested.
*  \param[in] aNetworkName - network name
*  \param[in] aETHpacket - struct for Eth packet (see definition of cv_stETHPacket)
*  \param[in] aTimeout - time in ms, if 0 - no timeout controlling
*  \param[in] aCompareData - data for compare
*  \param[in] aCompareType - supported type of compare [Equal - for equal; NotEqual - for not equal]
*
*  \note - supported transport protocol from IPv4 header: TCP and UDP
*
* Change History: 
* Date(DD.MM.YY)        Author          Change info                                                          
*   
* 23.11.23               RC        Created and implemented based of CANoe >15
* 18.12.23               RC        Arrays comparison was simplified.
*/
void E_ETH_ComparePacketData(struct cv_stETHPacket aETHpacket, char aNetworkName[], dword aTimeout, byte aCompareData[], enum eCompareType aCompareType)
{
  byte bDebugFlag;
  char chPassText[cc_ETHmaxMsgInfoLength];
  char chMsgInfo[cc_ETHmaxMsgInfoLength];
  long lFctnRet;
  byte bOutputData[cc_eETHPacketMaxLength_UDP];
  byte bFctnRet;

  bDebugFlag = bts_ETH_DebugFlags;
  lFctnRet = cc_eETHretVal_ERR;
  bFctnRet = Error;
  
  writeDbgLevel(DebugFuncCalls, "Function E_ETH_ComparePacketData called.");
#if TOOL_MAJOR_VERSION > 15
  lFctnRet = lFcnt_ETH_WaitAndGetPacketData(aETHpacket, aNetworkName, aTimeout, bOutputData, chMsgInfo);

  if( bDebugFlag & (byte) DebugFuncInternal )
    writeDbgLevel( DebugFuncInternal, "lFcnt_ETH_WaitAndGetPacketData returned: %d, MessageInfo: %s", lFctnRet, chMsgInfo );

  if( cc_eETHretVal_NOK < lFctnRet )// check for successfull execution of lFcnt_ETH_WaitAndGetPacketData
  {
    bFctnRet = bFctn_CONV_CompareByteArrays(bOutputData, aCompareData, lFctnRet, chMsgInfo);
    if (bFctnRet && (Equal == aCompareType))// if arrays are identical and identical is expected
    {
      snprintf(chPassText,elcount(chPassText), "Data received on network %s for ETH Packet (SrcMAC: %s, DestMAC: %s, SrcIP: %s, DestIP: %s, SrcPort: %d, DestPort: %d) is identical with the expected one.", aNetworkName, aETHpacket.ch_sMAC, aETHpacket.ch_dMAC ,aETHpacket.ch_sIP, aETHpacket.ch_dIP, aETHpacket.dw_sPort, aETHpacket.dw_dPort);
      vFctn_REPORTStepEvaluation(chPassText, PASS);
    }
    else if (!bFctnRet && (NotEqual == aCompareType))// if arrays are not identical and not identical is expected
    {
      snprintf(chPassText,elcount(chPassText), "Data received on network %s for ETH Packet (SrcMAC: %s, DestMAC: %s, SrcIP: %s, DestIP: %s, SrcPort: %d, DestPort: %d) is NOT identical with the expected one.", aNetworkName, aETHpacket.ch_sMAC, aETHpacket.ch_dMAC ,aETHpacket.ch_sIP, aETHpacket.ch_dIP, aETHpacket.dw_sPort, aETHpacket.dw_dPort);
      vFctn_REPORTStepEvaluation(chPassText, PASS);
    }
    else
      vFctn_REPORTStepEvaluation(chMsgInfo, FAIL);
  }// end of if cc_eETHretVal_NOK < lFctnRet
  else
    vFctn_REPORTStepEvaluation(chMsgInfo, FAIL);// data access problems / errors
#else
  snprintf(chMsgInfo, elcount(chMsgInfo), "Function available from CANoe Version > 15");
  vFctn_REPORTStepEvaluation( chMsgInfo, FAIL);
#endif
}

/*! \fn void E_ETH_WaitForArpPacket(struct cv_stETHPacket aETHpacket, char aNetworkName[], dword aTimeout, enum cc_eETHArpOp aArpOp, enum cc_ePacketPresence aPresentAbsent)
*  \brief Function which check the presence of an ETH ARP packet in a specific time.
*  \param[in]  aETHpacket           - ethernet packet (see definition of struct cv_stETHPacket)
*  \param[in]  aNetworkName         - name of the network on which the check should be made
*  \param[in]  aTimeout             - time in ms, if 0 - no timeout controlling
*  \param[in]  aArpOp               - ARP operation type of the desired packet (see definition of enum cc_eETHArpOp)
*  \param[in]  aPresentAbsent       - desired state of the packet, Present or Absent (see definition of enum cc_ePacketPresence)
*
*  \note - the message "Elapsed time=5ms (max=5ms)" from test report can be disabled if you uncheck the box "Resume of complex wait instructions" from XML Test Module Configuration
*
* Change History: 
* Date(DD.MM.YY)        Author          Change info                                                          
*   
*  8.1.24                RC        Created and implemented based of CANoe >15
*/
void E_ETH_WaitForArpPacket(struct cv_stETHPacket aETHpacket, char aNetworkName[], dword aTimeout, enum cc_eETHArpOp aArpOp, enum cc_ePacketPresence aPresentAbsent)
{
  char chMappedResponseInfo[250];
  long lResult;
  byte bDebugFlag;

  lResult  = cc_eETHretVal_ERR;
  bDebugFlag = bts_ETH_DebugFlags;
  writeDbgLevel (DebugFuncCalls, "Function E_ETH_WaitForArpPacket() called.");
#if TOOL_MAJOR_VERSION > 15
  lResult = lFctn_ETH_WaitForArpPacket(aETHpacket, aNetworkName, aTimeout, aArpOp, aPresentAbsent, chMappedResponseInfo);
  if (cc_eETHretVal_OK == lResult)
    vFctn_REPORTStepEvaluation(chMappedResponseInfo, PASS);
  else
    vFctn_REPORTStepEvaluation(chMappedResponseInfo, FAIL);  
#else
  snprintf(chMsgInfo, elcount(chMsgInfo), "Function available from CANoe Version > 15");
  vFctn_REPORTStepEvaluation( chMsgInfo, FAIL);
#endif
}

/*! \fn E_ETH_CheckChannelLinkStatus(char aPortName, enum eETHLinkStatus aStatus)
*  \brief Function that will check the link status for a given portname for a network based bus
*  \param[in] aPortName[]        - name for the eth port as it is on configurations
*  \param[in] aExpStatus[]       - status to be checked (see enum eETHLinkStatus)
* Change History: 
* Date(DD.MM.YY)        Author          Change info                                                          
*  26.10.23             CiCo            Created and implemented.
*/
void E_ETH_CheckChannelLinkStatus(char aPortName[], enum cc_eETHLinkStatus aExpStatus)
{
  byte bDebugFlag;
  char chTempText[258];
  long lRecvStatus; 
  ethernetPort ep_port;

  bDebugFlag = pc_bGlobalDebugFlag;
  snprintf(chTempText,elcount(chTempText),"");
  
  writeDbgLevel(DebugFuncCalls, "Entered E_ETH_CheckChannelLinkStatus().");
  
  ep_port = lookupEthernetPort(aPortName);
  lRecvStatus = ethGetLinkStatus(ep_port);
  
  if ( (byte)DebugFuncInternal & bDebugFlag)
    writeDbgLevel (DebugFuncInternal, "ethGetLinkStatus return: %d", lRecvStatus);
  
  if( -1 == lRecvStatus ){
    snprintf(chTempText, elcount(chTempText), "FAIL: Read link status failed.");
    vFctn_REPORTStepEvaluation(chTempText, FAIL);  
  }
  else if( lRecvStatus == aExpStatus){
    snprintf(chTempText,elcount(chTempText), "PASS: %s link status is %s as expected.", aPortName, cc_chLinkStatus[aExpStatus]);
    vFctn_REPORTStepEvaluation(chTempText, PASS); 
  }
  else{
    snprintf(chTempText,elcount(chTempText), "FAIL: %s link status is %s expected: %s", aPortName, lRecvStatus, cc_chLinkStatus[lRecvStatus], cc_chLinkStatus[aExpStatus]);
    vFctn_REPORTStepEvaluation(chTempText, FAIL); 
  }
}

/*! \fn A_ETH_SetLinkStatus(char aPortName, enum eETHLinkStatus aStatus)
*  \brief Function that will set the link status for a given portname
*  \param[in] aPortName[]        - name for the eth port as it is on configurations
*  \param[in] aLink[]            - link to be set(see enum eETHLinkStatus)
* Change History: 
* Date(DD.MM.YY)        Author          Change info                                                          
*  26.10.23             CiCo            Created and implemented.
*/
void A_ETH_SetLinkStatus(char aPortName[], enum cc_eETHLinkStatus aLink)
{
  byte bDebugFlag;
  char chTempText[258];
  long lRetval;
  byte bResultAction;
  ethernetPort ep_port;
  bDebugFlag = pc_bGlobalDebugFlag;
  snprintf(chTempText,elcount(chTempText),"");
  
  writeDbgLevel(DebugFuncCalls, "Entered A_ETH_SetLinkStatus().");
  ep_port = lookupEthernetPort(aPortName);
  lRetval = ethSetLinkStatus(ep_port, aLink);
  
  snprintf(chTempText,elcount(chTempText),"Set link status for %s port to %s", aPortName, cc_chLinkStatus[aLink] );  
  
  bResultAction = bFctn_REPORTAction( chTempText ); // add the action text in the report file  
  if( Ok == bResultAction ){
    if (Ok == lRetval){
      snprintf(chTempText,elcount(chTempText),"Link for %s port was set to %s", aPortName, cc_chLinkStatus[aLink] );
      vFctn_REPORTActionEvaluation(chTempText, PASS);
    }
    else{
      snprintf(chTempText,elcount(chTempText),"FAIL: Unable to set link status for %s port to %s. RetVal: %d", aPortName, cc_chLinkStatus[aLink], lRetval);
      vFctn_REPORTActionEvaluation(chTempText, FAIL);
    }
  }
}

/*! @}*/
/*! @}*/
/*!
*   \file
*   \ingroup testSupportLib
*   \brief Ethernet test support library.
*/