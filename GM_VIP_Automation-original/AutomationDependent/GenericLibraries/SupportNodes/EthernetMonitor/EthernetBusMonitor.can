/*@!Encoding:1252*/
includes
{
  #include "..\..\controlLib\ETHERNET\cvETH.cin"
  #include "..\..\controlLib\ETHERNET\ccETH.cin"
  #include "..\..\baseLib\COMMON\bcCOMMON.cin"
}

variables
{
  long lPortSrc;
  long lPortDest;
  char apiMessageTest[250];
  byte bEthBusMonitor_DebugFlags = 0;// used for internal debug
}

on start
{
  setWriteDbgLevel(@sysvar::TestMainPanel_Variables::DebugLevel);
}

on ethernetPacket *
{
  int iEthPacketType;
  int iIPv4Protocol;
  long lLength;
  dword dwSrcIP;
  dword dwDestIP;
  long lArpOperation;
  byte bDataTCP[cc_eETHPacketMaxLength_TCP];
  byte bDataUDP[cc_eETHPacketMaxLength_UDP];
  byte bPaketFlags;
  char cSrcIP[50];// for debug purpouse
  char cDestIP[50];// for debug purpouse
  byte bDebugFlag;
  
  bDebugFlag = bEthBusMonitor_DebugFlags;
  
  writeDbgLevel(DebugFuncCalls, "on ethernetPacket * event called.");
  
  if( cc_eETHBusMonitor_Start == @sysvar::EthBusMonitor::EthPaketData::Flags::EthSearchMsg)// start searching for the packet
  {
    if((byte)DebugFuncInternal & bDebugFlag)
      writeDbgLevel(DebugFuncInternal , "on ethernetPacket *: Start Searching Packet on eth channel %d", @sysvar::EthBusMonitor::EthPaketData::Content::EthChannelNumber);  
    
    if( this.msgChannel == @sysvar::EthBusMonitor::EthPaketData::Content::EthChannelNumber )// enter only for desired channel number
    {
      iEthPacketType = this.type;// link layer 
      if (EthGetLastError() == 0)// no errors on link layer
      {
        if( cc_eETHpacket_IPV4 == iEthPacketType )// ipv4 type
        {
          if( cc_eETHpacket_UDP == @sysvar::EthBusMonitor::EthPaketData::Flags::EthExpectedProtocol)// enter only if tester want to get the UDP packet
          {
            iIPv4Protocol = this.ipv4.protocol;
            if((byte)DebugFuncInternal & bDebugFlag)
              writeDbgLevel(DebugFuncInternal , "on ethernetPacket *: Type of eth IPV4 packet: %x ", iIPv4Protocol);  
            
            if( iIPv4Protocol == cc_eETHpacket_UDP) // wait for udp packet
            { 
              if((byte)DebugFuncInternal & bDebugFlag)
                writeDbgLevel(DebugFuncInternal , "on ethernetPacket *: UDP Packet requested"); 
              dwSrcIP = this.ipv4.source;// get the source IP of UDP packet
              dwDestIP = this.ipv4.destination;// get the destination IP of UDP packet
              lPortSrc = this.udp.source;// get the source port of UDP packet
              lPortDest = this.udp.destination;// get the destination port of UDP packet
              IpGetAddressAsString(dwSrcIP, cSrcIP, elCount(cSrcIP));
              IpGetAddressAsString(dwDestIP, cDestIP, elCount(cDestIP));
              if((byte)DebugFuncInternal & bDebugFlag)
                writeDbgLevel(DebugFuncInternal ,"on ethernetPacket *: UDP Packet: srcIP(%s), destIP(%s), srcPort(%d), destPort(%d)",cSrcIP,  cDestIP, lPortSrc, lPortDest);  
              
              if( /* compare if the udp packet is the desired one */
                  lPortSrc  == @sysvar::EthBusMonitor::EthPaketType::UDP::SrcPort && 
                  lPortDest == @sysvar::EthBusMonitor::EthPaketType::UDP::DestPort && 
                  swapDWord(dwSrcIP)  == @sysvar::EthBusMonitor::EthPaketType::IPv4::SourceIP &&
                  swapDWord(dwDestIP) == @sysvar::EthBusMonitor::EthPaketType::IPv4::DestinationIP
                )
              {  
                if( cc_eETHBusMonitor_Start == @sysvar::EthBusMonitor::EthPaketData::Flags::EthGetPacketTime )// in case that time monitor is requested
                {
                  @sysvar::EthBusMonitor::EthPaketData::Content::PacketTime = this.time_ns;
                  if((byte)DebugFuncInternal & bDebugFlag)
                    writeDbgLevel(DebugFuncInternal , "on ethernetPacket *: UDP packet time :%lld ", this.time_ns); 
                }
                lLength = this.udp.GetData(0, bDataUDP, cc_eETHPacketMaxLength_UDP);
                sysSetVariableData(sysvar::EthBusMonitor::EthPaketType::UDP::Payload, bDataUDP, lLength );// transfer data to sysvar
                if((byte)DebugFuncInternal & bDebugFlag)
                  writeDbgLevel(DebugFuncInternal , "on ethernetPacket *: UDP packet length copyed to sysvar::EthBusMonitor::EthPaketType::UDP::Payload :%d ",lLength); 
                @sysvar::EthBusMonitor::EthPaketData::Content::EthBytesCopied = lLength;// transfer payload length to sysvar
                @sysvar::EthBusMonitor::EthPaketData::Flags::EthExpectedMessage =~ @sysvar::EthBusMonitor::EthPaketData::Flags::EthExpectedMessage;// inform tester that the desired packet was received               
              }
              else
              {
               // TBD do nothing
              }
            }
          }
          else if ( cc_eETHpacket_TCP == @sysvar::EthBusMonitor::EthPaketData::Flags::EthExpectedProtocol) //enter only if tester want to get the TCP packet
          {
            if((byte)DebugFuncInternal & bDebugFlag)
              writeDbgLevel(DebugFuncInternal , "on ethernetPacket *: TCP Packet requested"); 

            iIPv4Protocol = this.ipv4.protocol;
            if((byte)DebugFuncInternal & bDebugFlag)
              writeDbgLevel(DebugFuncInternal , "on ethernetPacket *: Type of eth IPV4 packet: %x ", iIPv4Protocol); 
            
            if( iIPv4Protocol == cc_eETHpacket_TCP) // wait for udp packet
            { 
              dwSrcIP = this.ipv4.source;// get the source IP of TCP packet
              dwDestIP = this.ipv4.destination;// get the destination IP of TCP packet
              lPortSrc = this.tcp.source;// get the source port of TCP packet
              lPortDest = this.tcp.destination;// get the destination port of TCP packet
              bPaketFlags = this.tcp.flags;// get the flags of TCP packet
              IpGetAddressAsString(dwSrcIP, cSrcIP, elCount(cSrcIP));
              IpGetAddressAsString(dwDestIP, cDestIP, elCount(cDestIP));
              if((byte)DebugFuncInternal & bDebugFlag)
                writeDbgLevel(DebugFuncInternal , "on ethernetPacket *: TCP Packet: srcIP(%s), destIP(%s), srcPort(%d), destPort(%d), TCP flags(%X)",cSrcIP,  cDestIP, lPortSrc, lPortDest, bPaketFlags); 

              if( /* compare if the tcp packet is the desired one */
                  lPortSrc == @sysvar::EthBusMonitor::EthPaketType::TCP::SrcPort && 
                  lPortDest == @sysvar::EthBusMonitor::EthPaketType::TCP::DestPort && 
                  swapDWord(dwSrcIP)  == @sysvar::EthBusMonitor::EthPaketType::IPv4::SourceIP &&
                  swapDWord(dwDestIP) == @sysvar::EthBusMonitor::EthPaketType::IPv4::DestinationIP &&
                  0x18 == bPaketFlags// PSHa and ACK message flags
                )
              {  
                if( cc_eETHBusMonitor_Start == @sysvar::EthBusMonitor::EthPaketData::Flags::EthGetPacketTime )
                {
                  @sysvar::EthBusMonitor::EthPaketData::Content::PacketTime = this.time_ns;
                  if((byte)DebugFuncInternal & bDebugFlag)
                    writeDbgLevel(DebugFuncInternal , "on ethernetPacket *: TCP packet time :%lld ",this.time_ns); 
                }
                lLength = this.tcp.GetData(0, bDataTCP, cc_eETHPacketMaxLength_TCP);
                sysSetVariableData(sysvar::EthBusMonitor::EthPaketType::TCP::Payload, bDataTCP, lLength );// transfer data to sysvar TBD evaluate if the data was successfully copied
                if((byte)DebugFuncInternal & bDebugFlag)
                  writeDbgLevel(DebugFuncInternal , "on ethernetPacket *: TCP packet length copyed to sysvar::EthBusMonitor::EthPaketType::TCP::Payload :%d ",lLength); 
                
                @sysvar::EthBusMonitor::EthPaketData::Content::EthBytesCopied = lLength;// transfer payload length to sysvar
                @sysvar::EthBusMonitor::EthPaketData::Flags::EthExpectedMessage =~ @sysvar::EthBusMonitor::EthPaketData::Flags::EthExpectedMessage;// inform tester that the desired packet was received               
              }
            }
          }
          else
          {
            // TBD do nothing
          }
        }//  end of if ipv4
        else if ( cc_eETHpacket_ARP == iEthPacketType )// arp type
        {
          if( cc_eETHpacket_ARP == @sysvar::EthBusMonitor::EthPaketData::Flags::EthExpectedProtocol ) // enter only if tester want to get the ARP packet
          {
            if((byte)DebugFuncInternal & bDebugFlag)
              writeDbgLevel(DebugFuncInternal , "on ethernetPacket *: ARP Packet requested"); 
                        
            dwSrcIP = this.arp.protSourceAddr;// sender protocol address
            dwDestIP = this.arp.protDestinationAddr;// target protocol address
            lArpOperation = this.arp.operation;// operation of the arp packet
            IpGetAddressAsString(dwSrcIP, cSrcIP, elCount(cSrcIP));
            IpGetAddressAsString(dwDestIP, cDestIP, elCount(cDestIP));
            if((byte)DebugFuncInternal & bDebugFlag)
              writeDbgLevel(DebugFuncInternal , "on ethernetPacket *: ARP Packet: srcIP(%s), destIP(%s), ARP Operation(%X)",cSrcIP,  cDestIP, lArpOperation); 

            if( /* compare if the arp packet is the desired one */
                @sysvar::EthBusMonitor::EthPaketType::ARP::SourceIP == swapDWord(dwSrcIP) &&
                @sysvar::EthBusMonitor::EthPaketType::ARP::DestinationIP == swapDWord(dwDestIP) &&
                @sysvar::EthBusMonitor::EthPaketType::ARP::ArpOperation == lArpOperation
              )
            {
              if((byte)DebugFuncInternal & bDebugFlag)
                writeDbgLevel(DebugFuncInternal , "on ethernetPacket *: ARP Packet was found.");
              // inform tester that the desired packet was received
              @sysvar::EthBusMonitor::EthPaketData::Flags::EthExpectedMessage =~ @sysvar::EthBusMonitor::EthPaketData::Flags::EthExpectedMessage;
            }
          }
        }// end of if ARP
      }// end of if EthGetLastError
    }// end of channel interface selection
  }// end of EthSearchMsg
}

on sysvar TestMainPanel_Variables::DebugLevel
{
  setWriteDbgLevel(@this);
}

on sysvar_update sysvar::EthBusMonitor::EthPaketData::Content::EthChannelName
{
  char cChannelName[250] ="";
  byte bDebugFlag;
  
  bDebugFlag = bEthBusMonitor_DebugFlags;
  @sysvar::EthBusMonitor::EthPaketData::Flags::EthLastAPIError = cc_eETHretVal_ERR;
  
  writeDbgLevel(DebugFuncCalls , "Entered on sysvar::EthBusMonitor::EthPaketData::Content::EthChannelName event.");
  
  sysGetVariableString(this, cChannelName, elCount(cChannelName));

  if((byte)DebugFuncInternal & bDebugFlag)  
    writeDbgLevel(DebugFuncInternal , "sysvar::EthBusMonitor::EthPaketData::Content::EthChannelName value requested to %s", cChannelName );
  
  if( cc_eETHretVal_OK ==  LOC_Eth_SetBusContext( cChannelName ))
  {
    if((byte)DebugFuncInternal & bDebugFlag)
      writeDbgLevel(DebugFuncInternal , "sysvar::EthBusMonitor::EthPaketData::Content::EthChannelName: LOC_Eth_SetBusContext returned ok.", cChannelName );
    @sysvar::EthBusMonitor::EthPaketData::Flags::EthLastAPIError = cc_eETHretVal_OK;
  }
  else
  {
    @sysvar::EthBusMonitor::EthPaketData::Flags::EthLastAPIError = cc_eETHretVal_NOK;
  }
}

on sysvar_update sysvar::EthBusMonitor::EthPaketData::Flags::EthAPIFunctionCall
{
  long lRetValue;
  byte bDebugFlag;
  
  bDebugFlag = bEthBusMonitor_DebugFlags;
  @sysvar::EthBusMonitor::EthPaketData::Flags::EthLastAPIError = -1;
  
  writeDbgLevel(DebugFuncCalls , "Entered on sysvar::EthBusMonitor::EthPaketData::Flags::EthAPIFunctionCall");
    
  switch (@this)
  {
    case 1 : // LOC_Eth_SetBusContext
      break;
    case 2: // LOC_Eth_LinkUpDown 
       lRetValue = lFctn_ETH_SetLinkUpDown( @sysvar::EthBusMonitor::EthPaketData::Content::EthChannelNumber, @sysvar::EthBusMonitor::EthPaketData::Flags::LinkStatus );
       @sysvar::EthBusMonitor::EthPaketData::Flags::EthLastAPIError = lRetValue;
       if((byte)DebugFuncInternal & bDebugFlag)
         writeDbgLevel(DebugFuncInternal , "sysvar::EthBusMonitor::EthPaketData::Flags::EthAPIFunctionCall: LOC_Eth_LinkUpDown ret val- %d", @sysvar::EthBusMonitor::EthPaketData::Flags::EthLastAPIError);
      break;
      
    default:
      break;
  }
}

on sysvar_update sysvar::EthBusMonitor::EthPaketData::Content::EthApiMessage
{
  byte bDebugFlag;
  
  bDebugFlag = bEthBusMonitor_DebugFlags;
  
  writeDbgLevel(DebugFuncCalls , "Entered on sysvar::EthBusMonitor::EthPaketData::Content::EthApiMessage");
  sysGetVariableString(this, apiMessageTest, elCount(apiMessageTest));
  if((byte)DebugFuncInternal & bDebugFlag)
    writeDbgLevel(DebugFuncInternal , "sysvar::EthBusMonitor::EthPaketData::Content::EthApiMessage Info: %s", apiMessageTest);
}

long LOC_Eth_SetBusContext(char aBusContextName[])
{
  dword dwEthContext;
  byte bDebugFlag;
  char cFcntMsg[cc_ETHmaxMsgInfoLength];
  
  bDebugFlag = bEthBusMonitor_DebugFlags;
  dwEthContext = cc_eETHretVal_NOK;
  
  sysSetVariableString( sysvar::EthBusMonitor::EthPaketData::Content::EthApiMessage, "");
  writeDbgLevel(DebugFuncCalls , "Function LOC_Eth_SetBusContext called.");
  
  dwEthContext = GetBusNameContext(aBusContextName);
  
  if ( cc_eETHretVal_NOK == dwEthContext )
  {
    snprintf(cFcntMsg, elCount(cFcntMsg),"Error: Cannot determine context for bus: %s", aBusContextName);
    if((byte)DebugFuncInternal & bDebugFlag)
      writeDbgLevel(DebugFuncInternal , "LOC_Eth_SetBusContext: %s", cFcntMsg);
    
    sysSetVariableString( sysvar::EthBusMonitor::EthPaketData::Content::EthApiMessage, cFcntMsg);
    return cc_eETHretVal_NOK;
  }
  else
  {
    dwEthContext = setBusContext( dwEthContext );
    if((byte)DebugFuncInternal & bDebugFlag)
      writeDbgLevel(DebugFuncInternal , "LOC_Eth_SetBusContext context for %s channel: %d",aBusContextName, dwEthContext);
    if( cc_eETHretVal_OK != dwEthContext )
    {
      if((byte)DebugFuncInternal & bDebugFlag)
        writeDbgLevel(DebugFuncInternal , "LOC_Eth_SetBusContext bus context was set!");
      
      snprintf(cFcntMsg, elCount(cFcntMsg),"Bus context set succesfully to %s ",aBusContextName );
      sysSetVariableString( sysvar::EthBusMonitor::EthPaketData::Content::EthApiMessage, cFcntMsg); 
      return cc_eETHretVal_OK;
    }
    else
    {
      snprintf(cFcntMsg, elCount(cFcntMsg),"Error seting context for eth bus %s", aBusContextName);
      if((byte)DebugFuncInternal & bDebugFlag)
        writeDbgLevel(DebugFuncInternal , "LOC_Eth_SetBusContext: %s", cFcntMsg);
      
      sysSetVariableString( sysvar::EthBusMonitor::EthPaketData::Content::EthApiMessage, cFcntMsg);
      return cc_eETHretVal_ERR;
    }
  }
}

/*! \fn int lFctn_ETH_SetLinkUpDown( long aEthChannel, long aStatus )
*  \brief Function to set the link of a specific ethernet channel
*  \param[in] aEthChannel - channel number
*  \param[in] aStatus - desired link status 
*  \return 0 - Success
*  \return 1 - Invalid channel
*  \return 2 - Read configuration failed
*  \return 3 - Link down failed
*  \return 4 - Link up failed
*  \return 5 - Restore bypass failed
*  \return 6 - Invalid link state
*
* Change History: 
* Date(DD.MM.YY)        Author          Change info                                                          
*   
* 31.08.18              CiCo        Created and implemented.
* 31.08.23              RC          Write() replaced with writeDbgLevel().
*/
long lFctn_ETH_SetLinkUpDown ( long aEthChannel, long aStatus )
{
  long lRetVal;
  byte bDebugFlag;
  
  bDebugFlag = bEthBusMonitor_DebugFlags;
  lRetVal = 0;

  writeDbgLevel(DebugFuncCalls, "Function lFctn_ETH_SetLinkUpDown called.");

  if((byte)DebugFuncParam & bDebugFlag)
    writeDbgLevel(DebugFuncParam, "lFctn_ETH_SetLinkUpDown: aEthChannel - %d - aStatus - %d", aEthChannel, aStatus);
  
  lRetVal = ethSetLinkStatus( aEthChannel, aStatus );
  if((byte)DebugFuncInternal & bDebugFlag) 
    writeDbgLevel(DebugFuncInternal , "lFctn_ETH_SetLinkUpDown: RetVal: %d", lRetVal);

  return lRetVal;
}