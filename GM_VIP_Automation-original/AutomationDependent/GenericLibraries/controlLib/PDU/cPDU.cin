/*@!Encoding:1252*/
/*!
* @defgroup cPDU cPDU
* @defgroup PDU PDU
* @ingroup controlLib
* @{
* @addtogroup cPDU
* @{
*/ 

includes
{
  #include "ccPDU.cin"
  #include "cvPDU.cin"
}

/*! \fn long lFctn_PDU_WaitForAutosarPDUByName(dbPDU* aPDUNameFromDB, dword aTimeout, char aPDUPresenceInfo[])
*  \brief Function that evaluates if a PDU name is received in a specific time or not.
*  \param[in]   aPDUNameFromDB          - Name of the Autosar PDU from the arxml database.
*  \param[in]   aTimeout                - Maximum wait time to check if the PDU is absent or not.
*  \param[out]  aPDUPresenceInfo        - Extra information regarding the function output (displayed in the test report).
* 
*  \return  0   - Unexpected presence of the Autosar PDU(present instead of absent / absent instead of present).
*  \return  1   - The presence of the Autosar PDU is as expected.
*  \return -1   - An error occurred (general error).
*
* Change History: 
* Date(DD.MM.YY)        Author          Change info                                                          
*  20.05.2019           CrJu            Created and implemented
*/

long lFctn_PDU_WaitForAutosarPDUByName(dbPDU* aPDUNameFromDB, dword aTimeout, char aPDUPresenceInfo[])
{
  long lResult_WaitForPDU;
  byte bDebugFlag;
  byte bResult_SetContext;
  
  // Initialization of local variables
  bDebugFlag = cc_bPDU_GlobalDebugFlag;
  
  writeDbgLevel (DebugFuncCalls, "Function lFctn_PDU_WaitForPDUByName() called.");

  if((byte)DebugFuncParam & bDebugFlag)
    writeDbgLevel (DebugFuncParam, "Parameters: PDU* aPDUNameFromDB, dword aTimeout --%d--", aTimeout);  
  
  // If the timeout is zero use a default value for timeout
  if (0 >= aTimeout)
  {
    aTimeout = cc_dwPDU_DefaultWaitTime;
    if ((byte)DebugFuncInternal & bDebugFlag)
      writeDbgLevel (DebugFuncInternal, "The specified wait time is invalid. Using the default value: %d ms instead of 0 ms.", cc_dwPDU_DefaultWaitTime);
  }

  // Wait for Autosar PDU
  lResult_WaitForPDU = TestWaitForPDU(aPDUNameFromDB, 0, aTimeout); //flag1 is set to 0
  
  if(Ok == lResult_WaitForPDU) // Event occureed
  {
    snprintf(aPDUPresenceInfo, elCount(aPDUPresenceInfo), "The specified Autosar PDU is PRESENT and has arrived within: %d ms.", aTimeout);
    return Ok;
  }
  else
  {
    if(NotOk == lResult_WaitForPDU) // PDU is absent due to timeout
    {
      snprintf(aPDUPresenceInfo, elCount(aPDUPresenceInfo), "The specified Autosar PDU is ABSENT and did not arrive within: %d ms.", aTimeout);
      return NotOk;
    }
    else // Negative value means an Internal error occurred
    {
      snprintf(aPDUPresenceInfo, elCount(aPDUPresenceInfo), "Could not check the presence of the specified Autosar PDU because of the following internal error: %d.", lResult_WaitForPDU);
      return Error;
    }
  }
}

/*! \fn long lFctn_PDU_WaitForFrPDUByName(dbFrPDU* aFrPDUNameFromDB, dword aTimeout, char aBusContext[], char aFrPDUPresenceInfo[])
*  \brief Function that evaluates if a FrPDU name is received in a specific time or not.
*  \param[in]   aFrPDUNameFromDB        - Name of the Autosar FrPDU from the arxml database.
*  \param[in]   aTimeout                - Maximum wait time to check if the PDU is absent or not.
*  \param[out]  aFrPDUPresenceInfo      - Extra information regarding the function output (displayed in the test report).
* 
*  \return  0   - Unexpected presence of the Autosar PDU(present instead of absent / absent instead of present).
*  \return  1   - The presence of the Autosar PDU is as expected.
*  \return -1   - An error occurred
*
* Change History: 
* Date(DD.MM.YY)        Author          Change info                                                          
*  24.05.2019           CrJu            Created and implemented
*/

long lFctn_PDU_WaitForFrPDUByName(dbFrPDU* aFrPDUNameFromDB, dword aTimeout, char aFrPDUPresenceInfo[])
{
  long lResult_WaitForFrPDU;
  byte bDebugFlag;
  byte bResult_SetContext;
  
  // Initialization of local variables
  bDebugFlag = cc_bPDU_GlobalDebugFlag;
  
  writeDbgLevel (DebugFuncCalls, "Function lFctn_PDU_WaitForFrPDUByName() called.");
  
  if((byte)DebugFuncParam & bDebugFlag)
    writeDbgLevel (DebugFuncParam, "Parameters: PDU* aPDUNameFromDB, dword aTimeout --%d--, aTimeout");  
  
  // If the timeout is zero use a default value for timeout
  if (0 >= aTimeout)
  {
    aTimeout = cc_dwPDU_DefaultWaitTime;
    if ((byte)DebugFuncInternal & bDebugFlag)
      writeDbgLevel (DebugFuncInternal, "The specified wait time is invalid. Using the default value: %d ms instead of 0 ms.", cc_dwPDU_DefaultWaitTime);
  }
   
  // Wait for Autosar PDU
  lResult_WaitForFrPDU = testWaitForFrPDU(aFrPDUNameFromDB, aTimeout);

  if(Ok == lResult_WaitForFrPDU) // Event occureed
  {
    snprintf(aFrPDUPresenceInfo, elCount(aFrPDUPresenceInfo), "The specified Autosar FrPDU is PRESENT and has arrived within: %d ms.", aTimeout);
    return Ok;
  }
  else
  {
    if(NotOk == lResult_WaitForFrPDU) // PDU is absent due to timeout
    {
      snprintf(aFrPDUPresenceInfo, elCount(aFrPDUPresenceInfo), "The specified Autosar FrPDU is ABSENT and did not arrive within: %d ms.", aTimeout);
      return NotOk;
    }
    else // Negative value means an Internal error occurred
    {
      snprintf(aFrPDUPresenceInfo, elCount(aFrPDUPresenceInfo), "Could not check the presence of the specified Autosar PDU because of the following internal error: %d.", lResult_WaitForFrPDU);
      return Error;
    }
  }
}

/*! \fn int iFctn_PDU_GetData(dbPDU* aPDUNameFromDB, byte aArrayToStorePayloadData[], dword aWaitingTime, word &aPayloadSize, char aBusContext[], char aGetPDUDataInfo[])
*  \brief Function that waits a specific time for the arrival of provided PDU name and store its payload data in the output array.
*  \param[in]    aPDUNameFromDB            - Name of the Autosar PDU from the arxml database.
*  \param[in]    aArrayToStorePayloadData  - The byte array in which the payload data is copied.
*  \param[in]    aWaitingTime              - Maximum wait time, in miliseconds, to check if the Autosar PDU arrives or not.
*  \param[out]   aPayloadSize              - The payload size.
*  \param[in]    aBusContext               - The bus context.
*  \param[out]   aGetPDUDataInfo           - Extra information regarding the function output (displayed in the test report).
* 
*  \return  0   - Output array size is incorrect.
*  \return  1   - The Autosar PDU arrived and data is copied successfully in the output array.
*  \return  -1  - An error occurred (check the debug / Error Code).
*
* Change History: 
* Date(DD.MM.YY)        Author          Change info                                                          
* 22.01.19              GrAn            Created and implemented
*/

int iFctn_PDU_GetData(dbPDU* aPDUNameFromDB, byte aArrayToStorePayloadData[], dword aWaitingTime, word &aPayloadSize, char aBusContext[], char aGetPDUDataInfo[])
{
  int iReturnValue;
  long lResultJoinPDUEvent;
  long lResultGetPDUData;
  long lResultWaitForPDUEvent;
  word wIndex;
  pdu * PDUDummyPDU;
  char chHexPayloadData[500];
  word wSizeOfOutputArray;
  byte bDebugFlag;
  byte bResult_SetContext;
  char chPrintBusContext[25];
  byte bResultPrint;

  iReturnValue = 0;
  bDebugFlag = cc_bPDU_GlobalDebugFlag;
  aPayloadSize = 0;
  
  writeDbgLevel (DebugFuncCalls, "Function iFctn_PDU_GetData() called.");
  
  //Setting the bus Context
  bResult_SetContext = bFctn_BUS_SetContext(aBusContext);
  
  //Reset Printed Strings - if it used big names for bus context the messages written in the report must be reset first
  strncat(chPrintBusContext,"",0);

  bResultPrint = bFctn_CONV_GetSubString(aBusContext, 0, tsc_wPrintBusContextChars - 1, chPrintBusContext);

  writeDbgLevel(cc_eCANDebugFuncInternal,"chPrintBusContext is %s",chPrintBusContext);
  
  //Check if the bus context name is wrong
  if (bResult_SetContext == NotOk)
  {
    snprintf(aGetPDUDataInfo, elcount(aGetPDUDataInfo),"The bus context %s does not exists. Check the name in function call aBusContext. ",chPrintBusContext);
    writeDbgLevel (cc_eCANDebugFuncInternal, "Bus Name %s is wrong.",chPrintBusContext);
    return NotOk;
  }
  
  // If the timeout is zero use a default value for timeout
  if (0 >= aWaitingTime) 
  {
    aWaitingTime = cc_dwPDU_DefaultWaitTime;
    if ( (byte)DebugFuncInternal & bDebugFlag)
      writeDbgLevel (DebugFuncInternal, "The specified wait time is invalid. Using the default value: %d ms instead of 0 ms.", aWaitingTime);
  }
  
  lResultJoinPDUEvent    = testJoinPDUEvent(aPDUNameFromDB,0);             // Test if the Autosar PDU name is found on bus
  lResultWaitForPDUEvent = TestWaitForAnyJoinedEvent(aWaitingTime);        // Wait to complete the join event
  vFctn_CONV_SetAllByteArrElemToSpecificVal(aArrayToStorePayloadData, 0);  // clear the array
  
  // if Autosar PDU is received within the waiting time, try to access the data
  if ( (0 < lResultJoinPDUEvent) && (lResultJoinPDUEvent == lResultWaitForPDUEvent) )
  {
    lResultGetPDUData = testGetWaitPDUData(lResultWaitForPDUEvent, PDUDummyPDU); // store the Autosar PDU data in the local dummy Autosar PDU
    
    if ( 0 == lResultGetPDUData ) // data was successfully stored in the dummy Autosar PDU
    {
      aPayloadSize        = PDUDummyPDU.PduLength;
      wSizeOfOutputArray  = elcount(aArrayToStorePayloadData);
      
      if (wSizeOfOutputArray < aPayloadSize) // The output array is too small
      {
        snprintf(aGetPDUDataInfo, elCount(aGetPDUDataInfo), "Size of the Autosar PDU payload: %d bytes. Size of ouput array: %d bytes (should be smaller than: %d ). Resize the array.", aPayloadSize, wSizeOfOutputArray, aPayloadSize);
        if ( (byte)DebugFuncInternal & bDebugFlag)
          writeDbgLevel (DebugFuncInternal, aGetPDUDataInfo);
        iReturnValue = NotOk;
      }
      else // Copy the AUTOSAR PDU payload data in the output array
      {
        for (wIndex=0; wIndex < aPayloadSize; wIndex++)
        {
          aArrayToStorePayloadData[wIndex] = PDUDummyPDU.byte(wIndex);
        }

        // Convert bytes array to string and print it
        if (bFctn_CONV_ByteArrayToSpecificNumberBaseString(aArrayToStorePayloadData, cc_eCONV_Hex," 0x", chHexPayloadData, aPayloadSize))
        {
          snprintf(aGetPDUDataInfo, elCount(aGetPDUDataInfo), "Payload: %d bytes, copied in output array: 0x%s", aPayloadSize, chHexPayloadData);
          if ( (byte)DebugFuncInternal & bDebugFlag)
            writeDbgLevel (DebugFuncInternal, aGetPDUDataInfo);
          iReturnValue = Ok;
        }
        else // else return error
        {
          snprintf(aGetPDUDataInfo, elCount(aGetPDUDataInfo), "Payload: %d bytes, were copied in the output array but the string conversion function has failed", aPayloadSize);
          if ( (byte)DebugFuncInternal & bDebugFlag)
            writeDbgLevel (DebugFuncInternal, aGetPDUDataInfo);
          iReturnValue = Error;
        }
      }
    }
    else // could not access the data of the Autosar PDU
    {
      snprintf(aGetPDUDataInfo, elCount(aGetPDUDataInfo), "Data access could not be executed, the last event was not a Autosar PDU event.");
      if ( (byte)DebugFuncInternal & bDebugFlag )
        writeDbgLevel (DebugFuncInternal, aGetPDUDataInfo);
      iReturnValue = Error;
    }
  }
  else // Autosar PDU did not arrive or could not add the test event
  {
    snprintf(aGetPDUDataInfo, elCount(aGetPDUDataInfo), "The specified Autosar PDU did not arrive within: %dms or an internal error has occurred.", aWaitingTime);
    if ( (byte)DebugFuncInternal & bDebugFlag)
      writeDbgLevel (DebugFuncInternal, "TestJoinPDUEvent(aPDUNameFromDB) return: %i, TestWaitForAnyJoinedEvent(aWaitingTime) return: %i.", lResultJoinPDUEvent, lResultWaitForPDUEvent);
    iReturnValue = Error;
  }

  if ( (byte)DebugFuncInternal & bDebugFlag )
    writeDbgLevel (cc_eCANDebugFuncInternal, "iFctn_PDU_GetData() return: %i.", iReturnValue);
  
  return iReturnValue;
}

/*! \fn int iFctn_PDU_GetFrData(dbFrPDU* aFrPDUNameFromDB, byte aArrayToStorePayloadData[], dword aWaitingTime, word &aPayloadSize, char aGetFrPDUDataInfo[])
*  \brief Function that waits a specific time for the arrival of provided PDU name and store its payload data in the output array.
*  \param[in]    aFrPDUNameFromDB           - Name of the FrPDU from the arxml database.
*  \param[out]    aArrayToStorePayloadData  - The byte array in which the payload data is copied.
*  \param[in]    aWaitingTime               - Maximum wait time, in miliseconds, to check if the Autosar PDU arrives or not.
*  \param[out]   aPayloadSize               - The payload size.
*  \param[out]   aGetFrPDUDataInfo          - Extra information regarding the function output (displayed in the test report).
* 
*  \return   0  - Output array size is incorrect.
*  \return   1  - The FrPDU arrived and data is copied successfully in the output array.
*  \return  -1  - An error occurred (check the debug / Error Code).
*
* Change History: 
* Date(DD.MM.YY)        Author          Change info                                                          
* 22.01.19              GrAn            Created and implemented
* 08.08.19              CrJu            Update the function for FrPDUs
*/

int iFctn_PDU_GetFrData(dbFrPDU* aFrPDUNameFromDB, byte aArrayToStorePayloadData[], dword aWaitingTime, word &aPayloadSize, char aGetFrPDUDataInfo[])
{
  int iReturnValue;
  long lResultJoinFrPDUEvent;
  long lResultGetFrPDUData;
  long lResultWaitForFrPDUEvent;
  word wIndex;
  frPDU DummyFrPDU;
  char chHexPayloadData[500];
  word wSizeOfOutputArray;
  byte bDebugFlag;
  byte bResultPrint;

  iReturnValue = 0;
  bDebugFlag = cc_bPDU_GlobalDebugFlag;
  aPayloadSize = 0;
  
  writeDbgLevel (DebugFuncCalls, "Function iFctn_PDU_GetFrData() called.");
  
  // If the timeout is zero use a default value for timeout
  if (0 >= aWaitingTime) 
  {
    aWaitingTime = cc_dwPDU_DefaultWaitTime;
    if ( (byte)DebugFuncInternal & bDebugFlag)
      writeDbgLevel (DebugFuncInternal, "The specified wait time is invalid. Using the default value: %d ms instead of 0 ms.", aWaitingTime);
  }
  
  lResultJoinFrPDUEvent    = testJoinFrPDUEvent(aFrPDUNameFromDB);         // Test if the FrPDU name is found on bus
  lResultWaitForFrPDUEvent = TestWaitForAnyJoinedEvent(aWaitingTime);      // Wait to complete the join event
  vFctn_CONV_SetAllByteArrElemToSpecificVal(aArrayToStorePayloadData, 0);  // clear the array
  
  // if FrPDU is received within the waiting time, try to access the data
  if ( (0 < lResultJoinFrPDUEvent) && (lResultJoinFrPDUEvent == lResultWaitForFrPDUEvent) )
  {
    lResultGetFrPDUData = testGetWaitFrPDUData(lResultWaitForFrPDUEvent, DummyFrPDU); // store the FrPDU data in the local dummy FrPDU
    
    if ( 0 == lResultGetFrPDUData ) // data was successfully stored in the dummy FrPDU
    {
      aPayloadSize        = DummyFrPDU.fr_PayloadLength;
      wSizeOfOutputArray  = elcount(aArrayToStorePayloadData);
      
      if (wSizeOfOutputArray < aPayloadSize) // The output array is too small
      {
        snprintf(aGetFrPDUDataInfo, elCount(aGetFrPDUDataInfo), "Error: Size of the Autosar PDU payload: %d bytes. Size of ouput array: %d bytes (should be smaller than: %d ). Resize the array.", aPayloadSize, wSizeOfOutputArray, aPayloadSize);
        if ( (byte)DebugFuncInternal & bDebugFlag)
          writeDbgLevel (DebugFuncInternal, aGetFrPDUDataInfo);
        iReturnValue = NotOk;
      }
      else // Copy the FrPDU payload data in the output array
      {
        for (wIndex=0; wIndex < aPayloadSize; wIndex++)
        {
          aArrayToStorePayloadData[wIndex] = DummyFrPDU.byte(wIndex);
        }

        // Convert bytes array to string and print it
        if (bFctn_CONV_ByteArrayToSpecificNumberBaseString(aArrayToStorePayloadData, cc_eCONV_Hex," 0x", chHexPayloadData, aPayloadSize))
        {
          snprintf(aGetFrPDUDataInfo, elCount(aGetFrPDUDataInfo), "Payload: %d bytes, copied in output array: 0x%s", aPayloadSize, chHexPayloadData);
          if ( (byte)DebugFuncInternal & bDebugFlag)
            writeDbgLevel (DebugFuncInternal, aGetFrPDUDataInfo);
          iReturnValue = Ok;
        }
        else // else return error
        {
          snprintf(aGetFrPDUDataInfo, elCount(aGetFrPDUDataInfo), "Error: Payload: %d bytes, were copied in the output array but the string conversion function has failed", aPayloadSize);
          if ( (byte)DebugFuncInternal & bDebugFlag)
            writeDbgLevel (DebugFuncInternal, aGetFrPDUDataInfo);
          iReturnValue = Error;
        }
      }
    }
    else // could not access the data of the FrPDU
    {
      snprintf(aGetFrPDUDataInfo, elCount(aGetFrPDUDataInfo), "Error: Data access could not be executed, the last event was not a Autosar PDU event.");
      if ( (byte)DebugFuncInternal & bDebugFlag )
        writeDbgLevel (DebugFuncInternal, aGetFrPDUDataInfo);
      iReturnValue = Error;
    }
  }
  else // FrPDU did not arrive or could not add the test event
  {
    snprintf(aGetFrPDUDataInfo, elCount(aGetFrPDUDataInfo), "Error: The specified Autosar PDU did not arrive within: %dms or an internal error has occurred.", aWaitingTime);
    if ( (byte)DebugFuncInternal & bDebugFlag)
      writeDbgLevel (DebugFuncInternal, "TestJoinPDUEvent(aPDUNameFromDB) return: %i, TestWaitForAnyJoinedEvent(aWaitingTime) return: %i.", lResultJoinFrPDUEvent, lResultWaitForFrPDUEvent);
    iReturnValue = Error;
  }

  if ( (byte)DebugFuncInternal & bDebugFlag )
    writeDbgLevel (cc_eCANDebugFuncInternal, "iFctn_PDU_GetData() return: %i.", iReturnValue);
  
  return iReturnValue;
}

/*! \fn long lFctn_PDU_WaitForFrPDUDataByName(dbPDU* aFrPDUNameFromDB, byte aExpectedPayloadData[], dword aWaitingTime, char aFrPDUDataCompareInfo[])
*  \brief Function that checks if a Autosar PDU is received in a specific time or not, with the expected Equal/NotEqual payload data.
*  \param[in]   aPDUNameFromDB          - Name of the Autosar FrPDU from the arxml database.
*  \param[in]   aExpectedPayloadData    - Byte array with the exact size and desired content of what the received payload should be identical.
*  \param[in]   aWaitingTime            - Maximum wait time, in milliseconds, to check if the Autosar PDU arrives or not.
*  \param[out]  aPDUDataCompareInfo     - Extra information regarding the function output (displayed in the test report).
* 
*  \return  0   - The payload data which arrived is identified as NOT equal with the expected one.
*  \return  1   - The payload data which arrived is identified as equal with the expected one.
*  \return  -1  - The provided array(aExpectedPayloadData) is larger than the maimum allowed payload: 254 / FrPDU did not arrive / Data from FrPDU was not extracted
*
* Change History: 
* Date(DD.MM.YY)        Author          Change info                                                          
* 07.06.19              CrJu            Created and implemented
*/

long lFctn_PDU_WaitForFrPDUDataByName(dbFrPDU* aFrPDUNameFromDB, byte aExpectedPayloadData[], dword aWaitingTime, char aFrPDUDataCompareInfo[])
{
  long lReturnValue;
  long lResultGetFrPDUData;
  long lResultWaitForFrPDU;
  byte bResultConversion;
  byte bIndex;
  frPDU frPduFrame;
  char chLastReceivedPayloadData[1000];
  byte bDebugFlag;
  byte bCompareFlag;
  byte bArrivedFlag;
  qword qwTimeLeftToWait;
  qword qwTimeAfterFrPDUArrived;

  lReturnValue = 0;
  bDebugFlag = cc_bPDU_GlobalDebugFlag;
  bArrivedFlag = 0;
  bResultConversion = 0;
  
  writeDbgLevel (DebugFuncCalls, "Function lFctn_PDU_WaitForFrPDUDataByName() called.");
  
  // The provided array should not be larger than the maximum allowed payload: 254.
  if ( 254 < elcount(aExpectedPayloadData)) 
  {
    snprintf(aFrPDUDataCompareInfo, elcount(aFrPDUDataCompareInfo), "The size of the expected payload array is: %d. It should be no larger than the maximum allowed payload size: 254.", elcount(aExpectedPayloadData));
    return Error;
  }
  
  // If the timeout is zero use a default value for timeout
  if(aWaitingTime == 0)
  {
    aWaitingTime = cc_dwPDU_DefaultWaitTime;
    if ((byte)DebugFuncInternal & bDebugFlag)
      writeDbgLevel (DebugFuncInternal, "The specified wait time is invalid. Using the default value: %d ms instead of 0 ms.", cc_dwPDU_DefaultWaitTime);
  }
  
  qwTimeLeftToWait = aWaitingTime * cc_qwTransformNSInMS; // Convert the wait time to NS in order to calculate the elapsed time (required by: TestGetLastWaitElapsedTimeNS())
  
  // Check if Waiting Time does not elapse at all
  while((qwTimeLeftToWait / cc_qwTransformNSInMS) > 0)
  {
    lResultWaitForFrPDU = TestWaitForFrPDU (aFrPDUNameFromDB, (qwTimeLeftToWait / cc_qwTransformNSInMS));
    qwTimeAfterFrPDUArrived = testGetLastWaitElapsedTimeNS(); // Save the time in which the FrPDU was found
    
    // A FrPDU with the searched name was found
    if(Ok == lResultWaitForFrPDU)
    {
      //Set the arrivedFlag to 1, in order to know that the FrPDU has arrive at least once
      bArrivedFlag = 1;
      //Extract the data in a local FrPDU
      lResultGetFrPDUData = TestGetWaitFrPDUData(frPduFrame);
      
      //Set CompareFlag to 1, in order to verify if the data extracted is equal with the expected one
      bCompareFlag = 1;
      if(NotOk == lResultGetFrPDUData) //Data extracted succesffully
      {
        if(elCount(aExpectedPayloadData) != frPduFrame.fr_PayloadLength)
        {
          //The length of the expected data and te FrPDU is different
          snprintf(aFrPDUDataCompareInfo, elCount(aFrPDUDataCompareInfo), "Can not compare the arrays: The size of the expected payload byte array: %d, must be identical with the frame's Payload size: %d.", elCount(aExpectedPayloadData), frPduFrame.fr_PayloadLength);
          return Error;
        }
        else //The length of the expected data and the FrPDU is identical
        {
          for(bIndex = 0; bIndex < elCount(aExpectedPayloadData); bIndex++)
          {
            if(aExpectedPayloadData[bIndex] != frPduFrame.byte(bIndex))
            {
              //The elements are different
              bCompareFlag = 0;
            }
          }
          //The FrPDU has the expected data
          if(bCompareFlag != 0)
          {
            bFctn_CONV_ConvertByteArrayToString(aExpectedPayloadData, chLastReceivedPayloadData);
            snprintf(aFrPDUDataCompareInfo, elCount(aFrPDUDataCompareInfo),"The specified FrPDU has arrived with the expected Payload: 0x%s.", chLastReceivedPayloadData);
            return Ok;
          }
          else
          {
            snprintf(aFrPDUDataCompareInfo, elCount(aFrPDUDataCompareInfo),"The specified FrPDU has arrived and his Payload is identified as NOT equal with the expected one.");
            lReturnValue = NotOk;
          }
        }
      }
      else // The data of the FrPDU could not be extracted
      {
        snprintf(aFrPDUDataCompareInfo, elCount(aFrPDUDataCompareInfo),"The data of the arrived FrPDU could not be extracted in the last %ld ns. (The last event was not a FlexRay PDU event)", qwTimeLeftToWait);
        return Error;
      }
    }
    else if(lResultWaitForFrPDU == NotOk) // FrPDU has not arrived
    {
      // FrPDU didn't arrive in the entire waiting period
      if(bArrivedFlag == 0)
      {
        snprintf(aFrPDUDataCompareInfo, elcount(aFrPDUDataCompareInfo), "The specified FrPDU did not arrive within the wait time: %dms.", aWaitingTime);
        lReturnValue = Error;
      }
      else // FrPDU has arrived at least once. A message is already stored in "aFrPDUDataCompareInfo"
      {
        lReturnValue = NotOk;
      }
    }
    else // An internal Error of the TestWaitForFrPDU primitive occured
    {
        snprintf(aFrPDUDataCompareInfo, elcount(aFrPDUDataCompareInfo), "The primitive TestWaitForFrPDU() reported an error: %d. Verify the errors list.", lResultWaitForFrPDU);
        return Error;
    }
    // Calculate the time remaining until the wait time elapses completely
    qwTimeLeftToWait = qwTimeLeftToWait - qwTimeAfterFrPDUArrived;
  }
  
  return lReturnValue;
}

/*! \fn int lFctn_PDU_SendFrPDU(dbFrPDU* aFrPDUName, byte aPayloadToBeSent[], byte aNrOfSendingRequests, byte aFlexRayCluster, enum eFlexRayChannels aChannel, char aFrPDUDataCompareInfo[])
*  \brief Function that sends a dynamic FlexRay frame with the desired payload data, on the specified cluster and channel (A or B).
*  \param[in]   aFrPDUName              - The dynamic frame which is going to be sent.
*  \param[in]   aPayloadToBeSent        - Byte array with the desired payload to be sent with the dynamic frame (payload length is determined from the size of the array, which should not be greater than 254 bytes).
*  \param[in]   aNrOfSendingRequests    - How many times the FrPDU to be transmitted. ( N>0: The PDU is transmitted at least n times / -1: The PDU is transmitted in every configured slot / 0: The PDU's default value is transmitted )
*  \param[in]   aFlexRayCluster         - The cluster of the FlexRay protocol. Ex: 1(CH_Flexray), 2(CH_Flexray2).
*  \param[in]   aChannel                - The channel of the flexray (Ex: A or B).
*  \param[out]  aFrPDUDataCompareInfo   - Extra information regarding the function output (displayed in the test report).
* 
*  \return  0   - The FrPDU has not been sent, due to possible configuration problems 
*  \return  1   - The FrPDU has been successfully sent with the payload from the array, on the specified cluster/channel.
*  \return -1   - Error, the channel is not available, the slot ID is not in the dynamic segment or the conversion function failed / The length of the payload you want to set is bigger than the payload length of FrPDU 
*
*  \note  - If a FrPDU is already on the BUS, it can not be resend for a specific number of times.
*         - The defaul value can not be tested, or it is 0
*
* Change History: 
* Date(DD.MM.YY)        Author          Change info                                                       
* 19.06.19              CrJu            Created and implemented
*/

long lFctn_PDU_SendFrPDU(FrPDU* aFrPDUName, byte aPayloadToBeSent[], byte aNrOfSendingRequests, byte aFlexRayCluster, enum eFlexRayChannels aChannel, char aFrPDUSentInfo[])
{
  long lReturnValue;
  byte bIndex;
  byte bDebugFlag;
  char chSentPayloadData[100];
  frConfiguration frCfg_FRClusterParams;
  
  bDebugFlag = cc_bPDU_GlobalDebugFlag;
  lReturnValue = NotOk;
  
  writeDbgLevel (DebugFuncCalls, "Function lFctn_PDU_SendFrPDU() called.");
  
  // The provided array should not be larger than the FrPDU payload length
  if( elCount(aPayloadToBeSent) > aFrPDUName.FR_PDULength )
  {
    snprintf(aFrPDUSentInfo, elCount(aFrPDUSentInfo), "Error: The length of the payload you want to set: %d, is bigger than the payload length: %d, of the FrPDU.", elCount(aPayloadToBeSent), aFrPDUName.FR_PDULength);
    return Error;
  }
  
  // The provided array should not be larger than the maximum allowed payload: 254.
  if ( 254 < elcount(aPayloadToBeSent)) 
  {
    snprintf(aFrPDUSentInfo, elcount(aFrPDUSentInfo), "Error: The size of the expected payload array is: %d. It should be no larger than the maximum allowed payload size: 254.", elcount(aPayloadToBeSent));
    return Error;
  }
  
  // The provided array should not be larger than the maximum allowed payload: 254.
  if ( -1 > aNrOfSendingRequests) 
  {
    snprintf(aFrPDUSentInfo, elcount(aFrPDUSentInfo), "Error: The parameter 'aNrOfSendingRequests' can only be: -1 / 0 / >0.");
    return Error;
  }
  
  // Get the properties of the specified cluster
  frGetConfiguration((int)aFlexRayCluster, frCfg_FRClusterParams); 
  
  if ( (aChannel < ChannelAB) // FrPDU should not be sent on both channels(A+B) at the same time (possible configuration issues).
     &&(0 < frCfg_FRClusterParams.FRBaudrate) ) // If baudrate of the specified cluster is 0 it is either undefined or not correctly configured.
  {
    aFrPDUName.MsgChannel = aFlexRayCluster; // Set the cluster on which FrPDU is going to be sent. Ex: 1(CH_FlexRay), 2(CH_FlexRay2).
    aFrPDUName.FR_ChannelMask = aChannel; // Set the channel of the physical transmission. Ex: A or B.
    
    //reset the payload of the FrPDU
    for(bIndex = 0; bIndex < aFrPDUName.FR_PDULength; bIndex++)
    {
      aFrPDUName.byte(bIndex) = 0;
    }
    
    //If you want to set another value than the default one for the FrPDU
    if( aNrOfSendingRequests != 0)
    {
      if ( (byte)DebugFuncInternal & bDebugFlag )
        writeDbgLevel (DebugFuncInternal, "The function should set the FrPDU on the desired payload and send it on the bus.");
      
      //set the payload of the FrPDU with the desired content
      for(bIndex = 0; bIndex < elCount(aPayloadToBeSent); bIndex++)
      {
        aFrPDUName.byte(bIndex) = aPayloadToBeSent[bIndex];
      }
    }
    else if ( aNrOfSendingRequests == 0 )
    {
      if ( (byte)DebugFuncInternal & bDebugFlag )
        writeDbgLevel (DebugFuncInternal, "The function should set the FrPDU on his default value and send it on the bus.");
    }
    
    //The FrPDU is submitted for transmission
    frSetSendPDU(aFrPDUName);
    
    //Update the PDU payload
    frUpdatePDU(aFrPDUName, 1, aNrOfSendingRequests);
    
    bFctn_CONV_ConvertByteArrayToString(aPayloadToBeSent, chSentPayloadData);
    
    if ( ChannelA == aChannel )
      snprintf(aFrPDUSentInfo, elcount(aFrPDUSentInfo), "FrPDU is successfully sent on Cluster: %d, Ch. A, with payload: 0x%s.", aFlexRayCluster, chSentPayloadData);
    else // Channel B
      snprintf(aFrPDUSentInfo, elcount(aFrPDUSentInfo), "FrPDU is successfully sent on Cluster: %d, Ch. B, with payload: 0x%s.", aFlexRayCluster, chSentPayloadData);
         
    lReturnValue = Ok;
  }
  else// Sub-Channel A+B is or undefined cluster used (possible configuration issues in this context)
  {
    snprintf(aFrPDUSentInfo, elcount(aFrPDUSentInfo), "Due to possible configuration problems, FrPDU is not allowed to be sent on both Ch. A+B (can be sent individually) or on undefined Cluster: %d.", aFlexRayCluster);
    if ( (byte)DebugFuncInternal & bDebugFlag )
      writeDbgLevel (DebugFuncInternal, aFrPDUSentInfo);
    lReturnValue = NotOk;
  }
  
  return lReturnValue;
}

/*! \fn int iFctn_PDU_WaitForDataByName(dbPDU* aPDUNameFromDB, byte aExpectedPayloadData[], enum eCompareType aExpectedCompareAction, dword aWaitingTime, char aBusContext[], char aPDUDataCompareInfo[])
*  \brief Function that checks if a Autosar PDU is received in a specific time or not, with the expected Equal/NotEqual payload data.
*  \param[in]   aPDUNameFromDB          - Name of the Autosar PDU from the arxml database.
*  \param[in]   aExpectedPayloadData    - Byte array with the exact size and desired content of what the received payload should be identical/different (depending on the aExpectedCompareAction).
*  \param[in]   aExpectedCompareAction  - The compare action between the provided array and received payload: Equal or NotEqual.
*  \param[in]   aWaitingTime            - Maximum wait time, in milliseconds, to check if the Autosar PDU arrives or not.
*  \param[in]   aBusContext             - The bus context.
*  \param[out]  aPDUDataCompareInfo   - Extra information regarding the function output (displayed in the test report).
* 
*  \return  0   - Unexpected content arrived, Autosar PDU did not arrive at all or the size of the array is not correct.
*  \return  1   - The payload data which arrived is as expected (based on aExpectedCompareAction: 0-Equal/1-NotEqual).
*  \return  -1  - Conversion has failed or another error occurred (check the Error Code).
*
* Change History: 
* Date(DD.MM.YY)        Author          Change info                                                          
* 28.01.19              GrAn            Created and implemented
*/

int iFctn_PDU_WaitForDataByName(dbPDU* aPDUNameFromDB, byte aExpectedPayloadData[], enum eCompareType aExpectedCompareAction, dword aWaitingTime, char aBusContext[], char aPDUDataCompareInfo[])
{
  int iResult;
  byte bIdenticalPayloadFound;
  byte bReturnConvert;
  byte bReceivedPayloadData[255];//The PayLoad data length is not restricted 
  qword qwTimeLeftToWait;
  int iReturn_GetPayloadData;
  char chCompareArrayInfo[300];
  byte bPDUArrivedFlag;
  word wPayloadSize;
  char chLastReceivedPayloadData[100];
  byte bDebugFlag;
  
  iResult = 0;
  bIdenticalPayloadFound = 0;
  iReturn_GetPayloadData = 0;
  bPDUArrivedFlag = 0;
  bDebugFlag = cc_bPDU_GlobalDebugFlag;
  
  writeDbgLevel (cc_eCANDebugFuncCalls , "Function iFctn_PDU_WaitForDataByName() called.");
  
  // If the timeout is zero use a default value for timeout
  if (0 >= aWaitingTime) 
  {
    aWaitingTime = cc_dwPDU_DefaultWaitTime;
    if ( (byte)DebugFuncInternal & bDebugFlag)
      writeDbgLevel (DebugFuncInternal, "The specified wait time is invalid. Using the default value: %d ms instead of 0 ms.", aWaitingTime);
  }
  
  qwTimeLeftToWait = aWaitingTime * cc_qwTransformNSInMS; // Convert the wait time to NS in order to calculate the elapsed time (required by: TestGetLastWaitElapsedTimeNS())
  /*No limit used for the lenth of Payload of the Autosar PDU*/
  
  // Try to get the payload data as long as: identical payload data did not arrive AND the wait time did not reach 0
  while ( (NotOk == bIdenticalPayloadFound) && (0 < qwTimeLeftToWait) )
  {
    if ( 0 != (dword)(qwTimeLeftToWait / cc_qwTransformNSInMS) ) // check if the time left to wait for the Autosar PDU payload, has passed or not
      iReturn_GetPayloadData = iFctn_PDU_GetData(aPDUNameFromDB, bReceivedPayloadData, (dword)(qwTimeLeftToWait/cc_qwTransformNSInMS), wPayloadSize, aBusContext, aPDUDataCompareInfo);
   else // Wait the remaining time (1 ms)
      iReturn_GetPayloadData = iFctn_PDU_GetData(aPDUNameFromDB, bReceivedPayloadData, 1, wPayloadSize, aBusContext, aPDUDataCompareInfo);
    
    if ( (0 != wPayloadSize) && (Ok == iReturn_GetPayloadData) ) // Autosar PDU has arrived
    {
      if ( elCount(aExpectedPayloadData) != wPayloadSize ) // The size of the expected and arrived payload should not be different (comparing will fail in this case)
      {
        snprintf(aPDUDataCompareInfo, elcount(aPDUDataCompareInfo), "The size of the expected payload byte array: %d, must be identical with the Autosar PDU's Payload size: %d.", elcount(aExpectedPayloadData), wPayloadSize);
        if ( (byte)DebugFuncInternal & bDebugFlag )
          writeDbgLevel (cc_eCANDebugFuncInternal, "Function iFctn_PDU_GetData() returns: %d. Byte array size: %d, payload received size: %d (should be the same size).", NotOk, elCount(aExpectedPayloadData), wPayloadSize);
        return NotOk;
      }
      // Compare the expected data with the received payload
      bIdenticalPayloadFound = bFctn_CONV_CompareByteArrays(aExpectedPayloadData, bReceivedPayloadData, elCount(aExpectedPayloadData), chCompareArrayInfo); 
      bPDUArrivedFlag = Ok; // Flag used to check if the Autosar PDU has arrived at least once
      
      if ( 24 > wPayloadSize ) // Limit the display of payload, in the test report, to maximum 24 bytes.
        bReturnConvert = bFctn_CONV_ConvertByteArrayToStringByDLC(bReceivedPayloadData, chLastReceivedPayloadData, wPayloadSize);
      else
        bReturnConvert = bFctn_CONV_ConvertByteArrayToStringByDLC(bReceivedPayloadData, chLastReceivedPayloadData, 24);
   }
    // Calculate the time remaining until the wait time elapses completely (reaches 0)
        qwTimeLeftToWait = qwTimeLeftToWait - (qword)TestGetLastWaitElapsedTimeNS();
    
    // STOP LOOP conditions: Autosar PDU with identical data arrived or the wait time has elapsed (reaches 0)
   if ( (Ok == bIdenticalPayloadFound) || (0 == qwTimeLeftToWait) )
      break;
 } // End WHILE
  
  if ( Ok == bPDUArrivedFlag ) // Autosar PDU has arrived at least once (proceed to check if it arrived with expected content or not)
  {
    if ( Ok == bReturnConvert ) // Check if the conversion: byte array to string, is done successfully 
    {
      // Check if the comparing action is as expected
      if ( ((NotOk == bIdenticalPayloadFound) && (NotEqual == aExpectedCompareAction)) // arrays are NOT equal and it was expected to be that way
        || ((Ok == bIdenticalPayloadFound) && (Equal == aExpectedCompareAction)) ) // arrays are equal and it was expected to be that way
      {
        if ( NotEqual == aExpectedCompareAction ) // Autosar PDU arrived and it is NOT identical, as expected
          snprintf(aPDUDataCompareInfo, elcount(aPDUDataCompareInfo), "As expected, Autosar PDU arrived with DIFFERENT data.");
        else // Autosar PDU arrived and it is identical, as expected
          snprintf(aPDUDataCompareInfo, elcount(aPDUDataCompareInfo), "As expected, Autosar PDU arrived with IDENTICAL data: 0x%s(24 bytes display limit)", chLastReceivedPayloadData);
        iResult = Ok;
      }
      else // Autosar PDU arrived but data was NOT as expected
      {
        if ( NotEqual == aExpectedCompareAction ) // Autosar PDU arrived and it is identical, as NOT expected
          snprintf(aPDUDataCompareInfo, elcount(aPDUDataCompareInfo), "Did not expect to receive identical payload data. Received: 0x%s(24 bytes display limit)", chLastReceivedPayloadData);
        else // Autosar PDU arrived but was not expecting to be identical
          snprintf(aPDUDataCompareInfo, elcount(aPDUDataCompareInfo), "Did not expect to receive different payload data. %s",chCompareArrayInfo);
        iResult = NotOk;
      }
    }
    else // Failed to convert the array to string
    {
      snprintf(aPDUDataCompareInfo, elcount(aPDUDataCompareInfo), "Could not convert to string the received/expected payload array. bFctn_CONVConvertByteArrToStringByLength() return: %d.", bReturnConvert); 
      iResult = Error;
    }
  }
  else // Autosar PDU did not arrive at all
  {
    snprintf(aPDUDataCompareInfo, elcount(aPDUDataCompareInfo), "The specified Autosar PDU did not arrive within the wait time: %dms.", aWaitingTime);
    iResult = NotOk;
  }

  if ( (byte)DebugFuncInternal & bDebugFlag )
    writeDbgLevel (cc_eCANDebugFuncInternal, "iFctn_PDU_WaitForDataByName() return: %i (Additional info: %s)", iResult, aPDUDataCompareInfo);
  return iResult;
}

/*! \fn int iFctn_PDU_VerifyCycleTime(dbPDU* aPDUNameFromDB, dword aNumberOfSampleTimes, dword aPDUCycleTimeMS, byte aPermittedTimeDiffPerCent, char aBusContext[], char aPDUVerifyCyclicTime[])
*  \brief Function that checks if an Autosar PDU cycle time is in a given range [aPDUCycleTimeMS - (aPDUCycleTimeMS * aPermittedTimeDiffPerCent/100), aPDUCycleTimeMS + (aPDUCycleTimeMS * aPermittedTimeDiffPerCent/100)] or not for a given number sample times.
*  \param[in]   aPDUNameFromDB                   - Name of the Autosar PDU from the arxml database.
*  \param[in]   aNumberOfSampleTimes             - The number of samples time to test that the cycle time of Autosar PDU is in range or not
*  \param[in]   aPDUCycleTimeMS                  - The FrPDU cycle time you want to check
*  \param[in]   aPermittedTimeDiffPerCent        - The permitted time difference of the upper and lower limit of the cycle time range (per cent).
*  \param[in]   aBusContext                      - The bus context.
*  \param[out]  aPDUVerifyCyclicTime             - Extra information regarding the function output (displayed in the test report).
* 
*  \return  0   - The  permitted time difference value is wrong, the given cycle time value is wrong, the bus context name is wrong, or the cycle time is not in given range or the number of sample times is wrong .
*  \return  1   - The cycle time is in given range.
*  \return  -1  - The Autosar PDU does not been received on the bus or an internal error occurred.
*
* Change History: 
* Date(DD.MM.YY)        Author          Change info                                                          
* 04.02.19              GrAn            Created and implemented
* 06.02.19              GrAn            The implementation is changed. Use a cycle time from database and the number of samples time to be waited instead of the given time to wait. 
*/

int iFctn_PDU_VerifyCycleTime(dbPDU* aPDUNameFromDB, dword aNumberOfSampleTimes, dword aPDUCycleTimeMS, byte aPermittedTimeDiffPerCent, char aBusContext[], char aPDUVerifyCyclicTime[])
{
  //Local Variables
  int iResult;
  float fFirstHitPDU;
  float fCycleTimePDUFromBus;
  long lResultJoinPDUEvent_FirstHit;
  long lResultWaitForPDUEvent_FirstHit;
  long lResultJoinPDUEvent_EndSampleTime;
  long lResultWaitForPDUEvent_EndSampleTime;
  byte bResult_SetContext;
  char chPrintBusContext[25];
  byte bResultPrint;
  byte bDebugFlag;
  dword dwIterationIndex;
  float fMinCycleTime;
  float fMaxCycleTime;
  
  //Initialization part
  iResult = 0;
  bDebugFlag = cc_bPDU_GlobalDebugFlag;
  
  writeDbgLevel (cc_eCANDebugFuncCalls , "Function iFctn_PDU_VerifyCycleTime() called.");
  
  //Setting the bus Context
  bResult_SetContext = bFctn_BUS_SetContext(aBusContext);
  
  //Reset Printed Strings - if it used big names for bus context the messages written in the report must be reset first
  strncat(chPrintBusContext,"",0);

  bResultPrint = bFctn_CONV_GetSubString(aBusContext, 0, tsc_wPrintBusContextChars - 1, chPrintBusContext);

  writeDbgLevel(cc_eCANDebugFuncInternal,"chPrintBusContext is %s",chPrintBusContext);
  
  //Check if the bus context name is wrong
  if (bResult_SetContext == NotOk)
  {
    snprintf(aPDUVerifyCyclicTime, elcount(aPDUVerifyCyclicTime),"The bus context %s does not exists. Check the name in function call aBusContext. ",chPrintBusContext);
    writeDbgLevel (cc_eCANDebugFuncInternal, "Bus Name %s is wrong.",chPrintBusContext);
    return NotOk;
  }
  
  if (aNumberOfSampleTimes <= 0)//if the number of samples time is zero or smaller than zero report an error
  {
    snprintf(aPDUVerifyCyclicTime, elCount(aPDUVerifyCyclicTime), "The number of samples time is wrong. It is zero or smaller than zero.");
    if ( (byte)DebugFuncInternal & bDebugFlag)
      writeDbgLevel (DebugFuncInternal, aPDUVerifyCyclicTime);
    return NotOk;
  }
  
  if (aPDUCycleTimeMS <= 0)//if the cycle time is zero or smaller than zero report an error
  {
    snprintf(aPDUVerifyCyclicTime, elCount(aPDUVerifyCyclicTime), "The cycle time value is wrong. It is zero or smaller than zero.");
    if ( (byte)DebugFuncInternal & bDebugFlag)
      writeDbgLevel (DebugFuncInternal, aPDUVerifyCyclicTime);
    return NotOk;
  }
  
  if ((aPermittedTimeDiffPerCent < 1) || (aPermittedTimeDiffPerCent > 100))//the permitted precent is wrong
  {
    snprintf(aPDUVerifyCyclicTime, elCount(aPDUVerifyCyclicTime), "The permitted precent %d is wrong. It must be bigger than zero and smaller than 101.",aPermittedTimeDiffPerCent);
    if ( (byte)DebugFuncInternal & bDebugFlag)
      writeDbgLevel (DebugFuncInternal, aPDUVerifyCyclicTime);
    return NotOk;
  }
  
  //Calculate the lower and upper boundaries for the cycle time
  fMinCycleTime = aPDUCycleTimeMS - (float)(aPermittedTimeDiffPerCent * aPDUCycleTimeMS / 100.00);
  fMaxCycleTime = aPDUCycleTimeMS + (float)(aPermittedTimeDiffPerCent * aPDUCycleTimeMS / 100.00);
  
  if ( (byte)DebugFuncInternal & bDebugFlag)
    writeDbgLevel (DebugFuncInternal, "The lower limit for cycle time is %6.2f and the upper limit is %6.2f.", fMinCycleTime, fMaxCycleTime);
  
  //First hit of PDU - Take the first time when the Autosar PDU is received
  lResultJoinPDUEvent_FirstHit    = testJoinPDUEvent(aPDUNameFromDB,0);         // Test if the Autosar PDU name is found on bus
  lResultWaitForPDUEvent_FirstHit = TestWaitForAnyJoinedEvent((dword)_ceil(fMaxCycleTime));        // Wait to complete the join event

  // if Autosar PDU is received within the waiting time, take the first hit point of the PDU
  if ( (0 < lResultJoinPDUEvent_FirstHit) && (lResultJoinPDUEvent_FirstHit == lResultWaitForPDUEvent_FirstHit) )
  {
    fFirstHitPDU = testGetLastWaitElapsedTimeNS() / cc_qwTransformNSInMS;//Transform the measure unit of time from NS in MS
      
    if ( (byte)DebugFuncInternal & bDebugFlag)
      writeDbgLevel (DebugFuncInternal, "The Autosar PDU is received first time on %6.2f ms", fFirstHitPDU);
  }
  else
  {
    snprintf(aPDUVerifyCyclicTime, elCount(aPDUVerifyCyclicTime), "The specified Autosar PDU did not arrive within: %6.2f ms or an internal error has occurred.", fMaxCycleTime);
    if ( (byte)DebugFuncInternal & bDebugFlag)
      writeDbgLevel (DebugFuncInternal, "TestJoinPDUEvent(aPDUNameFromDB) return: %i, TestWaitForAnyJoinedEvent(aWaitingTime) return: %i.", lResultJoinPDUEvent_FirstHit, lResultWaitForPDUEvent_FirstHit);
    return Error;
  }
  
  for (dwIterationIndex = 0; dwIterationIndex < aNumberOfSampleTimes; dwIterationIndex ++ )//wait the given number of samples
  {
    //End Sample hit point
    lResultJoinPDUEvent_EndSampleTime = testJoinPDUEvent(aPDUNameFromDB,0);         // Test if the Autosar PDU name is found on bus
    lResultWaitForPDUEvent_EndSampleTime = TestWaitForAnyJoinedEvent((dword)_ceil(fMaxCycleTime));        // Wait to complete the join event
  
    // if Autosar PDU is received within the waiting time, take the cycle time of the PDU
    if ( (0 < lResultJoinPDUEvent_EndSampleTime) && (lResultJoinPDUEvent_EndSampleTime == lResultWaitForPDUEvent_EndSampleTime) )
    {
      fCycleTimePDUFromBus = testGetLastWaitElapsedTimeNS() / cc_qwTransformNSInMS;//Transform the measure unit of time from NS in MS
       
      if ( (byte)DebugFuncInternal & bDebugFlag)
        writeDbgLevel (DebugFuncInternal, "The Autosar PDU is received on the end of the sample time on %6.2f ms", fCycleTimePDUFromBus);
    }
    else
    {
      snprintf(aPDUVerifyCyclicTime, elCount(aPDUVerifyCyclicTime), "The specified Autosar PDU did not arrive within: %6.2f ms or an internal error has occurred. The transmission of the Autosar PDU may be is not cyclic.", fMaxCycleTime);
      if ( (byte)DebugFuncInternal & bDebugFlag)
        writeDbgLevel (DebugFuncInternal, "TestJoinPDUEvent(aPDUNameFromDB) return: %i, TestWaitForAnyJoinedEvent(aWaitingTime) return: %i.", lResultJoinPDUEvent_EndSampleTime, lResultWaitForPDUEvent_EndSampleTime);
      return Error;
    }
  
    //Compare if the cycle time from the bus is in range of the expected cycle time boundaries [aMinAbsCycleTime,aMaxAbsCycleTime]
    if ((fCycleTimePDUFromBus >= fMinCycleTime) && (fCycleTimePDUFromBus <= fMaxCycleTime))
    {
      snprintf(aPDUVerifyCyclicTime, elCount(aPDUVerifyCyclicTime), "The cycle time of the Autosar PDU %6.2f ms is in range of the expected cyclical times given [%6.2f,%6.2f]", fCycleTimePDUFromBus, fMinCycleTime, fMaxCycleTime);
        if ( (byte)DebugFuncInternal & bDebugFlag)
          writeDbgLevel (DebugFuncInternal, aPDUVerifyCyclicTime);
      iResult = Ok;
    }
    else//the cycle time is not in range of given values
    {
      snprintf(aPDUVerifyCyclicTime, elCount(aPDUVerifyCyclicTime), "The cycle time of the Autosar PDU %6.2f ms is NOT in range of the expected cyclical times given [%6.2f,%6.2f]", fCycleTimePDUFromBus, fMinCycleTime, fMaxCycleTime);
      if ( (byte)DebugFuncInternal & bDebugFlag)
        writeDbgLevel (DebugFuncInternal, aPDUVerifyCyclicTime);
      return NotOk;
    }
  }

  if ( (byte)DebugFuncInternal & bDebugFlag )
    writeDbgLevel (cc_eCANDebugFuncInternal, "iFctn_PDU_VerifyCycleTime() return: %i (Additional info: %s)", iResult, aPDUVerifyCyclicTime);
  return iResult;
}

/*! \fn long lFctn_PDU_VerifyCycleTimeForFrPDU(dbFrPDU* aFrPDUNameFromDB, dword aNumberOfSampleTimes, dword aFrPDUCycleTimeMS, byte aPermittedTimeDiffPerCent, char aFrPDUVerifyCyclicTime[])
*  \brief Function that checks if an FrPDU cycle time is in a given range [aFrPDUCycleTimeMS - (aFrPDUCycleTimeMS * aPermittedTimeDiffPerCent/100), aFrPDUCycleTimeMS + (aFrPDUCycleTimeMS * aPermittedTimeDiffPerCent/100)] or not for a given number sample times.
*  \param[in]   aFrPDUNameFromDB                 - Name of the FrPDU from the arxml database.
*  \param[in]   aNumberOfSampleTimes             - The number of samples time to test that the cycle time of Autosar PDU is in range or not
*  \param[in]   aFrPDUCycleTimeMS                - The FrPDU cycle time you want to check
*  \param[in]   aPermittedTimeDiffPerCent        - The permitted time difference of the upper and lower limit of the cycle time range (per cent).
*  \param[out]  aFrPDUVerifyCyclicTime           - Extra information regarding the function output (displayed in the test report).
* 
*  \return  0   - The cycle time is not in given range.
*  \return  1   - The cycle time is in given range.
*  \return -1   - The  permitted time difference value is wrong, the given cycle time value is wrong, the FrPDU does not been received on the bus, the number of sample times is wrong or an internal error occurred.
*
* Change History: 
* Date(DD.MM.YY)        Author          Change info                                                          
* 17.07.19              CrJu            Created and implemented
*/

long lFctn_PDU_VerifyCycleTimeForFrPDU(dbFrPDU* aFrPDUNameFromDB, dword aNumberOfSampleTimes, dword aFrPDUCycleTimeMS, byte aPermittedTimeDiffPerCent, char aFrPDUVerifyCyclicTime[])
{
  //Local Variables
  long lResult;
  float fFirstHitFrPDU;
  float fCycleTimeFrPDUFromBus;
  long lResultJoinFrPDUEvent_FirstHit;
  long lResultWaitForFrPDUEvent_FirstHit;
  long lResultJoinFrPDUEvent_EndSampleTime;
  long lResultWaitForFrPDUEvent_EndSampleTime;
  byte bDebugFlag;
  dword dwIterationIndex;
  float fMinCycleTime;
  float fMaxCycleTime;
  
  //Initialization part
  lResult = 0;
  bDebugFlag = cc_bPDU_GlobalDebugFlag;
  
  writeDbgLevel (cc_eCANDebugFuncCalls , "Function lFctn_PDU_VerifyCycleTimeForFrPDU() called.");
  
  if (aNumberOfSampleTimes <= 0)//if the number of samples time is zero or smaller than zero report an error
  {
    snprintf(aFrPDUVerifyCyclicTime, elCount(aFrPDUVerifyCyclicTime), "The number of samples time is wrong. It is zero or smaller than zero.");
    if ( (byte)DebugFuncInternal & bDebugFlag)
      writeDbgLevel (DebugFuncInternal, aFrPDUVerifyCyclicTime);
    return Error;
  }
  
  if (aFrPDUCycleTimeMS <= 0)//if the cycle time is zero or smaller than zero report an error
  {
    snprintf(aFrPDUVerifyCyclicTime, elCount(aFrPDUVerifyCyclicTime), "The cycle time value is wrong. It is zero or smaller than zero.");
    if ( (byte)DebugFuncInternal & bDebugFlag)
      writeDbgLevel (DebugFuncInternal, aFrPDUVerifyCyclicTime);
    return Error;
  }
  
  if ((aPermittedTimeDiffPerCent < 1) || (aPermittedTimeDiffPerCent > 100))//the permitted precent is wrong
  {
    snprintf(aFrPDUVerifyCyclicTime, elCount(aFrPDUVerifyCyclicTime), "The permitted precent %d is wrong. It must be bigger than zero and smaller than 101.",aPermittedTimeDiffPerCent);
    if ( (byte)DebugFuncInternal & bDebugFlag)
      writeDbgLevel (DebugFuncInternal, aFrPDUVerifyCyclicTime);
    return Error;
  }
  
  //Calculate the lower and upper boundaries for the cycle time
  fMinCycleTime = aFrPDUCycleTimeMS - (float)(aPermittedTimeDiffPerCent * aFrPDUCycleTimeMS / 100.00);
  fMaxCycleTime = aFrPDUCycleTimeMS + (float)(aPermittedTimeDiffPerCent * aFrPDUCycleTimeMS / 100.00);
  
  if ( (byte)DebugFuncInternal & bDebugFlag)
    writeDbgLevel (DebugFuncInternal, "The lower limit for cycle time is %6.2f and the upper limit is %6.2f.", fMinCycleTime, fMaxCycleTime);
  
  //First hit of FrPDU - Take the first time when the FrPDU is received
  lResultJoinFrPDUEvent_FirstHit    = testJoinFrPDUEvent(aFrPDUNameFromDB);                   // Test if the FrPDU name is found on bus
  lResultWaitForFrPDUEvent_FirstHit = TestWaitForAnyJoinedEvent((dword)_ceil(fMaxCycleTime)); // Wait to complete the join event

  // if FrPDU is received within the waiting time, take the first hit point of the PDU
  if ( (0 < lResultJoinFrPDUEvent_FirstHit) && (lResultJoinFrPDUEvent_FirstHit == lResultWaitForFrPDUEvent_FirstHit) )
  {
    fFirstHitFrPDU = testGetLastWaitElapsedTimeNS() / cc_qwTransformNSInMS;//Transform the measure unit of time from NS in MS
    
    if ( (byte)DebugFuncInternal & bDebugFlag)
      writeDbgLevel (DebugFuncInternal, "The FrPDU is received first time on %6.2f ms", fFirstHitFrPDU);
  }
  else
  {
    snprintf(aFrPDUVerifyCyclicTime, elCount(aFrPDUVerifyCyclicTime), "The specified FrPDU did not arrive within: %6.2f ms or an internal error has occurred.", fMaxCycleTime);
    if ( (byte)DebugFuncInternal & bDebugFlag)
      writeDbgLevel (DebugFuncInternal, "TestJoinPDUEvent(aPDUNameFromDB) return: %i, TestWaitForAnyJoinedEvent(aWaitingTime) return: %i.", lResultJoinFrPDUEvent_FirstHit, lResultWaitForFrPDUEvent_FirstHit);
    return Error;
  }
  
  for (dwIterationIndex = 0; dwIterationIndex < aNumberOfSampleTimes; dwIterationIndex ++ )//wait the given number of samples
  {
    //End Sample hit point
    lResultJoinFrPDUEvent_EndSampleTime = testJoinFrPDUEvent(aFrPDUNameFromDB);                      // Test if the FrPDU name is found on bus
    lResultWaitForFrPDUEvent_EndSampleTime = TestWaitForAnyJoinedEvent((dword)_ceil(fMaxCycleTime)); // Wait to complete the join event
    
    // if FrPDU is received within the waiting time, take the cycle time of the FrPDU
    if ( (0 < lResultJoinFrPDUEvent_EndSampleTime) && (lResultJoinFrPDUEvent_EndSampleTime == lResultWaitForFrPDUEvent_EndSampleTime) )
    {
      fCycleTimeFrPDUFromBus = testGetLastWaitElapsedTimeNS() / cc_qwTransformNSInMS;//Transform the measure unit of time from NS in MS
      
      if ( (byte)DebugFuncInternal & bDebugFlag)
        writeDbgLevel (DebugFuncInternal, "The FrPDU is received on the end of the sample time on %6.2f ms", fCycleTimeFrPDUFromBus);
    }
    else
    {
      snprintf(aFrPDUVerifyCyclicTime, elCount(aFrPDUVerifyCyclicTime), "The specified FrPDU did not arrive within: %6.2f ms or an internal error has occurred. The transmission of the FrPDU may be is not cyclic.", fMaxCycleTime);
      if ( (byte)DebugFuncInternal & bDebugFlag)
        writeDbgLevel (DebugFuncInternal, "TestJoinFrPDUEvent(aFrPDUNameFromDB) return: %i, TestWaitForAnyJoinedEvent(aWaitingTime) return: %i.", lResultJoinFrPDUEvent_EndSampleTime, lResultWaitForFrPDUEvent_EndSampleTime);
      return Error;
    }
  
    //Compare if the cycle time from the bus is in range of the expected cycle time boundaries [aMinAbsCycleTime,aMaxAbsCycleTime]
    if ((fCycleTimeFrPDUFromBus >= fMinCycleTime) && (fCycleTimeFrPDUFromBus <= fMaxCycleTime))
    {
      snprintf(aFrPDUVerifyCyclicTime, elCount(aFrPDUVerifyCyclicTime), "The cycle time of the FrPDU %6.2f ms is in range of the expected cyclical times given [%6.2f,%6.2f]", fCycleTimeFrPDUFromBus, fMinCycleTime, fMaxCycleTime);
        if ( (byte)DebugFuncInternal & bDebugFlag)
          writeDbgLevel (DebugFuncInternal, aFrPDUVerifyCyclicTime);
      lResult = Ok;
    }
    else//the cycle time is not in range of given values
    {
      snprintf(aFrPDUVerifyCyclicTime, elCount(aFrPDUVerifyCyclicTime), "The cycle time of the FrPDU %6.2f ms is NOT in range of the expected cyclical times given [%6.2f,%6.2f]", fCycleTimeFrPDUFromBus, fMinCycleTime, fMaxCycleTime);
      if ( (byte)DebugFuncInternal & bDebugFlag)
        writeDbgLevel (DebugFuncInternal, aFrPDUVerifyCyclicTime);
      return NotOk;
    }
  }

  if ( (byte)DebugFuncInternal & bDebugFlag )
    writeDbgLevel (cc_eCANDebugFuncInternal, "lFctn_PDU_VerifyCycleTimeForFrPDU() return: %i (Additional info: %s)", lResult, aFrPDUVerifyCyclicTime);
  return lResult;
}

/*! @}*/
/*! @}*/
/*!
*   \file
*   \ingroup controlLib
*   \brief Library for handling PDU functionality.
*/