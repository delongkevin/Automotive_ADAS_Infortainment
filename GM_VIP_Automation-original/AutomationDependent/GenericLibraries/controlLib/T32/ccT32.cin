/*@!Encoding:1252*/
//  ====================================================
//   VEONEER - Constants for T32
//  ====================================================
//
//  File name: ccT32.cin
//
//  Created(DD.MM.YYYY): 04.05.2022
//
//  Description: Constants for T32 library
//          
//  --------------------------------------------------------------------

variables
{
  //T32 state
 enum eT32State {
    T32_State_Down = 0,
    T32_State_Halted = 1,
    T32_State_Stopped = 2,
    T32_State_Running = 3
  };

 enum eBitStatus{
  eNotSet = 0,
  eSet = 1
  };

  // This debug flag will be used to enable/disable the debug messages in all functions of the current module
  // 0x00 - No debug messages displayed (only function calls).
  // 0x01 - Only function call messages displayed (this will always displayed).
  // 0x02 - Function parameter + 0x01.
  // 0x04 - Internal function actions + 0x01 and 0x02.
  // 0xFF - All of the above (function calls, function parameters, internal function actions).
  const byte cc_bT32_GlobalDebugFlag = 0x01;

  const dword cc_dwT32_MaxTimeout = 3000;//ms

}

 