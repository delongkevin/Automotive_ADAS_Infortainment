/*@!Encoding:1252*/
/*!
* @defgroup cCAN cCAN
* @defgroup CAN CAN
* @ingroup controlLib
* @{
* @addtogroup cCAN
* @{
*/ 


includes
{
  #include "cvCAN.cin"
}

/*! \fn int iFctn_CAN_WaitForMessagebyID(dword aMsgID, dword aTimeout, enum cc_ePresentAbsentCAN aPresentAbsent, char aBusContext[], char aMappedResponse[])
*  \brief Function evaluate if a can messageID is present on the bus in a specific time or not
*  \param[in] aMsgID           - ID of message
*  \param[in] aTimeout         - Max wait time for the message (in milliseconds).
*  \param[in] aPresentAbsent   - Absent = Expects message to be absent, Present = Expects message to be present
*  \param[in] aBusContext      - The bus name context
*  \param[out] aMappedResponse - The send response that will be printed on the report
* 
*  \return 0  (NotOk)  - if the message is present/absent on CAN as not expected 
*  \return 1  (Ok)     - if the message is present/absent on CAN as expected
*  \return -1 (Error)  - if the function was not executed OK / the bus context was not set ok
*
* Change History: 
* Date(DD.MM.YY)        Author          Change info                                                          
*   
* 06.07.18              GrAn        Created and implemented
* 01.10.18              GrAn        Resolve some remarks after tests done for this function.
* 17.11.18              GrAn        Add the parameter aMappedResponse, which will send response that will be printed on the report
* 26.08.19              CrJu        Added new debug levels / Changed the returns to be only 0(NotOk), 1(Ok) and -1(Error) / Eliminate some conversions
*/

int iFctn_CAN_WaitForMessagebyID(dword aMsgID, dword aTimeout, enum cc_ePresentAbsentCAN aPresentAbsent, char aBusContext[], char aMappedResponse[])
{
  long lResult_WaitPrimitive;
  byte bResult_SetContext;
  int iReturnValue;
  char chPrintBusContext[26];
  byte bDebugFlag;
  dword dwTimeoutUsed;
  
  iReturnValue = NotOk;
  bResult_SetContext = NotOk;
  bDebugFlag = cc_bCAN_GlobalDebugFlag;
  
  writeDbgLevel (DebugFuncCalls , "Function iFctn_CAN_WaitForMessagebyID called.");
  
  if((byte)DebugFuncParam & bDebugFlag)
    writeDbgLevel (DebugFuncParam, "Parameters: dword aMsgID: -- 0x%x  --, dword aTimeout: -- %d --, cc_ePresentAbsentCAN aPresentAbsent --%d--, char aBusContext[] --%s--", aMsgID, aTimeout, aPresentAbsent,aBusContext);  
  
  //Setting the bus Context
  bResult_SetContext = bFctn_BUS_SetContext(aBusContext);
  if((byte)DebugFuncInternal & bDebugFlag)
    writeDbgLevel(DebugFuncInternal,"Bus context is succesfully set to: %s.", chPrintBusContext);
    
  //Print in the raport the entire bus context or just the first 25 characters
  bFctn_CONV_GetSubString(aBusContext, 0, tsc_wPrintBusContextChars - 1, chPrintBusContext);
  
  //Check if the bus context name is wrong
  if (bResult_SetContext == NotOk)
  {
    snprintf(aMappedResponse, elcount(aMappedResponse), "The bus context %s does not exists. Check the name in function call aBusContext.", chPrintBusContext);
    if((byte)DebugFuncInternal & bDebugFlag)
      writeDbgLevel(DebugFuncInternal, aMappedResponse);
    return Error;
  }
  
  //If the timeout is zero use a default value for timeout
  if (0 == aTimeout)
  {
    aTimeout = cc_wDefaultTimeout;
  }
  
  //Wait for message
  lResult_WaitPrimitive = testWaitForMessage(aMsgID, aTimeout);

  if (((Present == aPresentAbsent ) && (Ok == lResult_WaitPrimitive))//expect message to be present
     || //OR
     ((Absent == aPresentAbsent) && (NotOk == lResult_WaitPrimitive)))//expect message to be absent 
  {
    if ((Present == aPresentAbsent ) && (Ok == lResult_WaitPrimitive))//The message was present on the bus as expected
    {
      if((byte)DebugFuncInternal & bDebugFlag)
        writeDbgLevel(DebugFuncInternal, "Message 0x%X arrived in %d ms, as expected on requested bus %s.", aMsgID, aTimeout, chPrintBusContext);
      snprintf(aMappedResponse, elcount(aMappedResponse), "Message 0x%X arrived in %d ms, as expected on requested bus %s.", aMsgID, aTimeout, chPrintBusContext);
    }
    else//The message was absent on the bus as expected
    {
      if((byte)DebugFuncInternal & bDebugFlag)
        writeDbgLevel(DebugFuncInternal, "Message 0x%X did not arrive in %d ms, as expected on requested bus %s.", aMsgID, aTimeout, chPrintBusContext);
      snprintf(aMappedResponse, elcount(aMappedResponse), "Message 0x%X did not arrive in %d ms, as expected on requested bus %s.", aMsgID, aTimeout, chPrintBusContext);
    }
    iReturnValue = Ok;
  }
  else//not expected
  {
    if (lResult_WaitPrimitive < NotOk) //An general error occured in function.
    {
      snprintf(aMappedResponse, elcount(aMappedResponse), "A general error occured in primitive function: testWaitForMessage(). The error code return is -- %d --.", lResult_WaitPrimitive);
      iReturnValue = Error;
    }
    else //Message is absent when expected to be present OR message is present when expected to be absent 
    {
      if ((Present == aPresentAbsent ) && (NotOk == lResult_WaitPrimitive))//The message was present on the bus which was not expected
      {
        if((byte)DebugFuncInternal & bDebugFlag)
          writeDbgLevel(DebugFuncInternal, "Message 0x%X did not arrive in %d ms, which was not expected on requested bus %s.", aMsgID, aTimeout, chPrintBusContext);
        snprintf(aMappedResponse, elcount(aMappedResponse), "Message 0x%X did not arrive in %d ms, which was not expected on requested bus %s.", aMsgID, aTimeout, chPrintBusContext);
      }
      else//The message was present on the bus that was not expected
      {
        if((byte)DebugFuncInternal & bDebugFlag)
          writeDbgLevel(DebugFuncInternal, "Message 0x%X arrived in %d ms, which was not expected on requested bus %s.", aMsgID, aTimeout, chPrintBusContext);
        snprintf(aMappedResponse, elcount(aMappedResponse), "Message 0x%X arrived in %d ms, which was not expected on requested bus %s.", aMsgID, aTimeout, chPrintBusContext);
      }
      iReturnValue = NotOk;
    }
  }
  
  writeDbgLevel (DebugFuncInternal, "Function iFctn_CAN_WaitForMessagebyID returned: -- %d --.", iReturnValue);
  return iReturnValue;
}

/*! \fn int iFctn_CAN_WaitForMessagebyName(dbMsg* aMessageName, dword aTimeout, cc_ePresentAbsentCAN aPresentAbsent, char aMappedResponse[])
*  \brief Function evaluates if a can message based on database is present on the bus in a specific time or not
*  \param[in] aMessageName     - Name of message from database
*  \param[in] aTimeout         - Wait time for the message.
*  \param[in] aPresentAbsent   - Absent = Expects message to be absent, Present = Expects message to be present
*  \param[out] aMappedResponse - The send response that will be printed on the report
* 
*  \return  1  (Ok)    - if the message is present/absent on CAN, as expected
*  \return  0  (NotOk) - Message absent when expected to be present OR message present when expected to be absent
*  \return  -1 (Error) -Internal error occurred
*
*  \note 
*         - The aMessage parameter must be sent in following structure: [Data Base Name] :: [Data Base Node] :: Message Name \n
*         (example: CANCluster_PrivA(Data Base Name - optional) :: Tester(Data Base Node-optional) :: Test_frame1(Message Name).
*         - The optional attributes must be used if messages with the same name are present on different data bases/CAN nodes.
*
* Change History: 
* Date(DD.MM.YY)        Author          Change info                                                          
*   
* 06.07.18              GrAn        Created and implemented
* 01.10.18              GrAn        Resolve some remarks after tests done for this function.
* 27.08.19              CrJu        Refactoring the code and added a new parameter: aMappedResponse
*/

int iFctn_CAN_WaitForMessagebyName(dbMsg* aMessageName, dword aTimeout, enum cc_ePresentAbsentCAN aPresentAbsent, char aMappedResponse[])
{
  byte bDebugFlag;
  long lResult_WaitPrimitive;;
  int iReturnValue;
  
  //Initialization of local variables
  iReturnValue = NotOk;
  bDebugFlag = cc_bCAN_GlobalDebugFlag;
  
  writeDbgLevel (DebugFuncCalls, "Function iFctn_CAN_WaitForMessagebyName called.");
  
  if((byte)DebugFuncParam & bDebugFlag)
    writeDbgLevel (DebugFuncParam, "Parameters: dbMsg* aMessageName: -- The seartched message --, dword aTimeout: -- %d --, cc_ePresentAbsentCAN aPresentAbsent --%d--. ", aTimeout, aPresentAbsent);  
  
  //if the timeout is zero use a default value for timeout
  if (0 == aTimeout)
  {
    aTimeout = cc_wDefaultTimeout;
  }
  
  //Wait for message
  lResult_WaitPrimitive = testWaitForMessage(aMessageName, aTimeout);

  if (((Present == aPresentAbsent) && (Ok == lResult_WaitPrimitive))//Expect message to be present
     ||//OR
     (Absent == aPresentAbsent) && (NotOk == lResult_WaitPrimitive))//Expect message to be absent
  {
    if ((Present == aPresentAbsent ) && (Ok == lResult_WaitPrimitive))//The message was present as expected
    {
      if((byte)DebugFuncInternal & bDebugFlag)
        writeDbgLevel(DebugFuncInternal, "The message has arrived in %d ms, as expected.", aTimeout);
      snprintf(aMappedResponse, elcount(aMappedResponse), "The message has arrived in %d ms, as expected.", aTimeout);
    }
    else//The message was absent, as expected
    {
      if((byte)DebugFuncInternal & bDebugFlag)
        writeDbgLevel(DebugFuncInternal, "The message has not arrive in %d ms, as expected.", aTimeout);
      snprintf(aMappedResponse, elcount(aMappedResponse), "The message has not arrive in %d ms, as expected.", aTimeout);
    }
    iReturnValue = Ok;    
  }
	else//not expected
	{
    if (lResult_WaitPrimitive < NotOk)//Internal error
    {
      if((byte)DebugFuncInternal & bDebugFlag)
        writeDbgLevel(DebugFuncInternal, "A general error occured in primitive function: testWaitForMessage(). The error code return is -- %d --.", lResult_WaitPrimitive);
      snprintf(aMappedResponse, elcount(aMappedResponse), "A general error occured in primitive function: testWaitForMessage(). The error code return is -- %d --.", lResult_WaitPrimitive);
      iReturnValue = Error;  
    }
    else//Message absent when expected to be present OR message present when expected to be absent
    {
      if ((Present == aPresentAbsent ) && (NotOk == lResult_WaitPrimitive))//The message was present which was not expected
      {
        if((byte)DebugFuncInternal & bDebugFlag)
          writeDbgLevel(DebugFuncInternal, "The message has not arrive in %d ms, which was not expected.", aTimeout);
        snprintf(aMappedResponse, elcount(aMappedResponse), "The message has not arrive in %d ms, which was not expected.", aTimeout);
      }
      else//The message was present, but that was not expected
      {
        if((byte)DebugFuncInternal & bDebugFlag)
          writeDbgLevel(DebugFuncInternal, "The message has arrived in %d ms, which was not expected.", aTimeout);
        snprintf(aMappedResponse, elcount(aMappedResponse), "The message has arrived in %d ms, which was not expected.", aTimeout);
      }
      iReturnValue = NotOk;
    }
  }
  
  if((byte)DebugFuncInternal & bDebugFlag)
    writeDbgLevel (DebugFuncInternal, "Function iFctn_CAN_WaitForMessagebyName returned: -- %d --.", iReturnValue);
  return iReturnValue;
}

/*! \fn long lFctn_CAN_EnableMessage(dword aMsgID, char aBusContext[])
*  \brief Function enables sending of a message from database on a specific CAN bus.
*  \param[in] aMsgID      - ID of message from database.
*  \param[in] aBusContext - the bus name context
*
*  \return  0 (NotOk) - if message could not be enabled.
*  \return  1 (Ok)    - if message is enabled.
*  \return -1 (Error) - name of the bus context is wrong.
*
*  \note 
*         - This function can be used just for dbc messages.
*
* Change History: 
* Date(DD.MM.YY)        Author          Change info                                                          
*   
*  06.07.18              GrAn        Created and implemented
*  27.08.19              CrJu        Refactoring the code, added new debug levels
*/

long lFctn_CAN_EnableMessage(dword aMsgID, char aBusContext[])
{
  long lResult;
  byte bDebugFlag;
  byte bResult_SetContext;
  
  lResult = NotOk;
  bDebugFlag = cc_bCAN_GlobalDebugFlag;
  
  writeDbgLevel (DebugFuncCalls , "Function lFctn_CAN_EnableMessage called.");
  
  if((byte)DebugFuncParam & bDebugFlag)
    writeDbgLevel (DebugFuncParam, "Parameters: dword aMsgID: -- 0x%x --, char aBusContext --%s--.", aMsgID, aBusContext);   
  
  //Setting the bus Context
  bResult_SetContext = bFctn_BUS_SetContext(aBusContext);

  //Check if the bus context name is wrong
  if (bResult_SetContext == NotOk)
  {
    if((byte)DebugFuncInternal & bDebugFlag)
      writeDbgLevel (DebugFuncInternal, "The bus context %s does not exists. Check the name in function call aBusContext.", aBusContext);
    return Error;
  }

  lResult = TestEnableMsg(aMsgID); 
  
  //Succes. The primitive was executed with no errors
  if(lResult == NotOk)
  {
    lResult = Ok;
  }
  else//General error occured.
  {
    lResult = NotOk;
  }
    
  if((byte)DebugFuncInternal & bDebugFlag)
    writeDbgLevel (DebugFuncInternal, "Function lFctn_CAN_EnableMessage returned: -- %d --.", lResult);
  return lResult;
}

/*! \fn long lFctn_CAN_DisableMessage(dword aMsgID, char aBusContext[])
*  \brief Function disales sending of a message from database on a specific CAN bus.
*  \param[in] aMsgID      - ID of message from database.
*  \param[in] aBusContext - The bus name context
*
*  \return  0 (NotOk) - if message could not be disbaled.
*  \return  1 (Ok)    - if message is disabled.
*  \return -1 (Error) - name of the bus context is wrong.
*
*  \note
*         - This function can be used just for dbc messages.
*
* Change History: 
* Date(DD.MM.YY)        Author          Change info                                                          
*   
*  06.07.18              GrAn        Created and implemented
*  28.08.19              CrJu        Refactoring the code, added new debug levels
*/

long lFctn_CAN_DisableMessage(dword aMsgID, char aBusContext[])
{
  long lResult;
  byte bDebugFlag;
  byte bResult_SetContext;
  
  lResult = NotOk;
  bDebugFlag = cc_bCAN_GlobalDebugFlag;
  
  writeDbgLevel (DebugFuncCalls, "Function bFctn_CAN_DisableMessage called.");
  
  if((byte)DebugFuncParam & bDebugFlag)
    writeDbgLevel (DebugFuncParam, "Parameters: dword aMsgID: -- 0x%x --, char aBusContext[] --%s--.", aMsgID, aBusContext);     

  //Setting the bus Context
  bResult_SetContext = bFctn_BUS_SetContext(aBusContext);
 
  //Check if the bus context name is wrong
  if (bResult_SetContext == NotOk)
  {
    if((byte)DebugFuncInternal & bDebugFlag)
      writeDbgLevel (DebugFuncInternal, "The bus context %s does not exists. Check the name in function call aBusContext.", aBusContext);
    return Error;
  }
  
  lResult = TestDisableMsg(aMsgID); 

  //Succes. The primitive was executed with no errors
  if(lResult == NotOk)
  {
    lResult = Ok;
  }
  else//General error occured.
  {  
    lResult = NotOk;
  }
  
  if((byte)DebugFuncInternal & bDebugFlag)
    writeDbgLevel (DebugFuncInternal, "Function lFctn_CAN_DisableMessage returned: -- %d --.", lResult);
  return lResult;
}

/*! \fn long lFctn_CAN_SetBaudrate(long aCANChannel, float aBaudrate)
*  \brief Function that sets the baudrate for requested CAN channel
*  \param[in] aCANChannel - Number of CAN channel.
*  \param[in] aBaudrate   - The new value of the baudrate.
*
*  \return  0 (NotOk) - if the baudrate cannot be set
*  \return  1 (Ok)    - if the baudrate was set
*  \return -1 (Error) - if CAN channel is wrong / general error
*
* Change History: 
* Date(DD.MM.YY)        Author          Change info                                                          
*   
*  06.07.18              GrAn        Created and implemented
*  01.10.18              GrAn        Change the implementation for availability of CAN channel.
*  19.11.18              GrAn        Add more writeDbgLevel() for a easier debugging of function.
*  29.08.19              CrJu        Refactoring the code, added new debug levels
*/

long lFctn_CAN_SetBaudrate(long aCANChannel, float aBaudrate)
{
  long lResult;
  CANSettings CSettings;
  long lReturn_GetFunction;
  byte bDebugFlag;
  
  lResult = NotOk;
  bDebugFlag = cc_bCAN_GlobalDebugFlag;
  
  writeDbgLevel (DebugFuncCalls , "Function lFctn_CAN_SetBaudrate called.");
  
  if((byte)DebugFuncParam & bDebugFlag)
    writeDbgLevel (DebugFuncParam, "Parameters: long aCANChannel: -- %d --, float aBaudrate --%12.2f--.", aCANChannel, aBaudrate);    
  
  lReturn_GetFunction = canGetConfiguration(aCANChannel,CSettings);

  //Test if the canGetConfiguration primitive was executed OK
  if (NotOk == lReturn_GetFunction)
  {
    if((byte)DebugFuncInternal & bDebugFlag)
      writeDbgLevel (DebugFuncInternal, "Function canGetConfiguration() has failed. The return is: -- %d --.", lReturn_GetFunction);
    return Error;
  }
  
  //The channel number must be between 1 and 32
  if ((aCANChannel > cc_wMaxCANChannel) || (aCANChannel < cc_eCAN_ONE))
  {
    if((byte)DebugFuncInternal & bDebugFlag)
      writeDbgLevel (DebugFuncInternal, "The CAN Channel is not available: --%d--. It must be between 1 and 32.", aCANChannel);
    return Error;
  }
  
  //BaudRate take the new value
  CSettings.baudrate = aBaudrate;
  
  lResult = canSetConfiguration(aCANChannel, CSettings) ;
  
  if(lResult)
  {
    if((byte)DebugFuncInternal & bDebugFlag)
      writeDbgLevel (DebugFuncInternal, "The baudrate was set. Function lFctn_CAN_SetBaudrate returned: -- %d --.", lResult);
    return Ok;
  }
  else
  {
    if((byte)DebugFuncInternal & bDebugFlag)
      writeDbgLevel (DebugFuncInternal, "The baudrate was not set. Function lFctn_CAN_SetBaudrate returned: -- %d --.", lResult);    
    return NotOk;
  }
}

/*! \fn byte lFctn_CAN_SendMessage(dword aMsgID, byte aBytesToBeSend[], byte aMsgDLC, word aCANChannel)
*  \brief Function that sends a CAN message with the maximum length of 8 bytes on required CAN channel.
*  \param[in] aMsgID         - The ID of message that will be sent.
*  \param[in] aBytesToBeSend - content of message to be sent.
*  \param[in] aMsgDLC        - number of bytes to be send (max. 8 bytes).
*  \param[in] aCANChannel    - required CAN channel.
*
*  \return  1 (Ok)    - if the message was sent succesful
*  \return -1 (Error) - if the call of function is wrong / CAN channel is wrong
*
* Change History: 
* Date(DD.MM.YY)        Author          Change info                                                          
*   
*  06.07.18              GrAn        Created and implemented
*  01.10.18              GrAn        Change the implementation for availability of CAN channel.
*  19.11.18              GrAn        Add more writeDbgLevel() for a easier debugging of function.
*  11.01.19              GrAn        A comparision between the length of input array and message DLC is added.
*  02.09.19              CrJu        Refactoring the code, added new debug levels.
*  14.11.19              CrJu        Added the read and verification of INI file and eliminate an unuseful condition(aMsgDLC > elCount(aBytesToBeSend) .
*/

long lFctn_CAN_SendMessage(dword aMsgID, byte aBytesToBeSend[], byte aMsgDLC, word aCANChannel)
{
  message* msgMessageToBeSent;
  long lCANChannelAvailable;
  char chIniFilePath[250];
  byte bLastIniFileUsed;
  int iPosOfBytes;
  byte bDebugFlag;
  
  lCANChannelAvailable = 0;
  bLastIniFileUsed = 0;
  bDebugFlag = cc_bCAN_GlobalDebugFlag;
  
  writeDbgLevel (DebugFuncCalls , "Function lFctn_CAN_SendMessage called.");
  
  if((byte)DebugFuncParam & bDebugFlag)
    writeDbgLevel (DebugFuncParam, "Parameters: dword aMsgID: -- 0x%x --, byte aMsgDLC -- %d --, word aCANChannel --%d--.", aMsgID, aMsgDLC, aCANChannel);  
  
  //Read the value of the parameter 'CANChannelsAvailable' from INI File
  bLastIniFileUsed = bFctn_READFILELastINIused(chIniFilePath); 
    
  lCANChannelAvailable = lFctn_READFILEiniParameterNumber(chIniFilePath, "CANChannelsAvailable", "CAN_COMMUNICATION");
  
  //The CAN Channel is unavailable or ini path is not given
  if (( aCANChannel > lCANChannelAvailable) || (Ok != bLastIniFileUsed))
  {
    if((byte)DebugFuncInternal & bDebugFlag)
      writeDbgLevel (DebugFuncInternal, "The CAN Channel is unavailable or an error occured in the INI file. Check the last INI file used.");
    return Error;
  }
  
  //The aMsgDLC must be maximum 8 bytes and bigger than zero
  if ((aMsgDLC > cc_bCANMaxNumberOfBytes) || (aMsgDLC < 0))
  {
    if((byte)DebugFuncInternal & bDebugFlag)
      writeDbgLevel(DebugFuncInternal, "The message DLC given is bigger than 8 bytes(max of CAN supported), or smaller than 0. Function returned: -- %d --.", Error);
    return Error;
  }
  
  //The channel number must be between 1 and 32
  if ((aCANChannel > cc_wMaxCANChannel)||(aCANChannel < cc_eCAN_ONE))
  {
    if((byte)DebugFuncInternal & bDebugFlag)
      writeDbgLevel (DebugFuncInternal, "The CAN channel number is not in the given range (1-32). Function returned: -- %d --.", Error);
    return Error;
  }
  
  //Set the ID of the message to be send
  msgMessageToBeSent.id = aMsgID;
  //Set the CAN Channel where to be send
  msgMessageToBeSent.msgChannel = aCANChannel;
  
  //Set the data bytes of the message to be send
  if (aMsgDLC <= elCount(aBytesToBeSend))//if the DLC is smaller than the number of bytes to be send, copy the message DLC number of bytes
  {
    //Set the DLC of the message to be send
    msgMessageToBeSent.DLC = aMsgDLC;
    
    for (iPosOfBytes = 0; iPosOfBytes < aMsgDLC; iPosOfBytes++)
    {
       msgMessageToBeSent.byte(iPosOfBytes) = (byte)aBytesToBeSend[iPosOfBytes];
    }
  }
  else//else, copy the number of bytes to be send
  {
    //Set the DLC of the message to be send
    msgMessageToBeSent.DLC = elCount(aBytesToBeSend);
    
    for (iPosOfBytes = 0; iPosOfBytes < elCount(aBytesToBeSend); iPosOfBytes++)
    {    
       msgMessageToBeSent.byte(iPosOfBytes) = (byte)aBytesToBeSend[iPosOfBytes];
    }
  }
  
  //Send the formed message on the bus
  output(msgMessageToBeSent);
  
  if((byte)DebugFuncInternal & bDebugFlag)
    writeDbgLevel (DebugFuncInternal, "Function lFctn_CAN_SendMessage Return -- %d --.", Ok);
  return Ok;
}

/*! \fn byte lFctn_CAN_SendMessage(dword aMsgID, byte aBytesToBeSend[], byte aMsgDataLength, word aCANChannel, enum cc_eCanTYPE aType_CAN)
*  \brief Function that sends a CAN or CAN_FD message with the maximum length of 8 bytes, respective 64 bytes on required CAN channel.
*  \param[in] aMsgID         - The ID of message that will be sent.
*  \param[in] aBytesToBeSend - Content of message to be sent.
*  \param[in] aMsgDataLength - The length of the message. (On noraml CAN, it is equivalent with the DLC of the message. For CAN: max 8bytes. For CAN_FD: max 64bytes)
*  \param[in] aCANChannel    - Required CAN channel.
*  \param[in] aType_CAN      - The CAN type you want to used: cc_eCAN_NORMAL / cc_eCAN_FD
*
*  \return  1 (Ok)    - if the message was sent succesful
*  \return -1 (Error) - if the call of function is wrong / CAN channel is wrong
*
* Change History: 
* Date(DD.MM.YY)        Author          Change info                                                          
*   
*  11.11.19              CrJu        Created and implemented
*/

long lFctn_CAN_SendMessage(dword aMsgID, byte aBytesToBeSend[], byte aMsgDataLength, word aCANChannel, enum cc_eCanTYPE aType_CAN)
{
  message* msgMessageToBeSent;
  long lCANChannelAvailable;
  char chIniFilePath[250];
  byte bLastIniFileUsed;
  int iPosOfBytes;
  byte bDebugFlag;
  
  lCANChannelAvailable = 0;
  bLastIniFileUsed = 0;
  bDebugFlag = cc_bCAN_GlobalDebugFlag;
  
  writeDbgLevel (DebugFuncCalls, "Function lFctn_CAN_SendMessage called.");
  
  if((byte)DebugFuncParam & bDebugFlag)
    writeDbgLevel (DebugFuncParam, "Parameters: dword aMsgID: -- 0x%x --, byte aMsgDataLength -- %d --, word aCANChannel --%d--, enum aType_CAN --%d--(0- CAN normal, 1- CAN FD).", aMsgID, aMsgDataLength, aCANChannel, aType_CAN);  
  
  //Read the las INI file used
  bLastIniFileUsed = bFctn_READFILELastINIused(chIniFilePath); 
    
  //Read the value of the parameter 'CANChannelsAvailable' from INI File
  lCANChannelAvailable = lFctn_READFILEiniParameterNumber(chIniFilePath, "CANChannelsAvailable", "CAN_COMMUNICATION");
  
  //The CAN Channel is unavailable or ini path is not given
  if (( aCANChannel > lCANChannelAvailable) || (Ok != bLastIniFileUsed))
  {
    if((byte)DebugFuncInternal & bDebugFlag)
      writeDbgLevel (DebugFuncInternal, "The CAN Channel is unavailable or an error occured in the INI file. Check the last INI file used.");
    return Error;
  }
  
  //The channel number must be between 1 and 32
  if ((aCANChannel > cc_wMaxCANChannel)||(aCANChannel < cc_eCAN_ONE))
  {
    if((byte)DebugFuncInternal & bDebugFlag)
      writeDbgLevel (DebugFuncInternal, "The CAN channel number is not in the given range (1-32). Function returned: -- %d --.", Error);
    return Error;
  }
  
  //Set the ID of the message to be send
  msgMessageToBeSent.id = aMsgID;
  //Set the CAN Channel where to be send
  msgMessageToBeSent.msgChannel = aCANChannel;
  
  if(aType_CAN == cc_eCAN_NORMAL) //Use the NORMAL CAN
  {
    //The Message Data Length must be maximum 8 bytes and bigger than zero
    if ((aMsgDataLength > cc_bCANMaxNumberOfBytes) || (aMsgDataLength < 0))
    {
      if((byte)DebugFuncInternal & bDebugFlag)
        writeDbgLevel(DebugFuncInternal, "The message data length given is bigger than 8 bytes(max of CAN supported) , or smaller than 0. Function returned: -- %d --.", Error);
      return Error;
    }
  }
  else//Use the CAN FD
  {
    //The Message Data Length must be maximum 64 bytes and bigger than zero
    if ((aMsgDataLength > cc_bCANFDMaxNumberOfBytes) || (aMsgDataLength < 0))
    {
      if((byte)DebugFuncInternal & bDebugFlag)
        writeDbgLevel(DebugFuncInternal, "The message data length given is bigger than 64 bytes(max of CAN_FD supported), or smaller than 0. Function returned: -- %d --.", Error);
      return Error;
    }
    
    //Set the specific selectors for CAN FD
    msgMessageToBeSent.FDF = 1;
    msgMessageToBeSent.BRS = 1;
  }
  
  //Set the data bytes of the message to be send
  if (aMsgDataLength <= elCount(aBytesToBeSend))//if the DLC is smaller than the number of bytes to be send, copy the message DLC number of bytes
  {
    msgMessageToBeSent.DataLength = aMsgDataLength;
    
    for (iPosOfBytes = 0; iPosOfBytes < aMsgDataLength; iPosOfBytes++)
    {
      msgMessageToBeSent.byte(iPosOfBytes) = (byte)aBytesToBeSend[iPosOfBytes];
    }
  }
  else//else, copy the number of bytes to be send
  {
    //Set the Message data length of the message to be send
    msgMessageToBeSent.DataLength = elCount(aBytesToBeSend);
    
    for (iPosOfBytes = 0; iPosOfBytes < elCount(aBytesToBeSend); iPosOfBytes++)
    {
      msgMessageToBeSent.byte(iPosOfBytes) = (byte)aBytesToBeSend[iPosOfBytes];
    }
  }
  
  //Send the formed message on the bus
  output(msgMessageToBeSent);
  
  if((byte)DebugFuncInternal & bDebugFlag)
    writeDbgLevel (DebugFuncInternal, "Function lFctn_CAN_SendMessage Return -- %d --.", Ok);
  
  return Ok;
}

/*! \fn long lFctn_CAN_SendBurstMessage(dword aMsgID, byte aBytesToBeSend[], dword aTimeBetweenFrames, byte aDataLengthOfMessage, word aCANChannel)
*  \brief Function for sending specific volume of bytes more than 8 bytes.
*  \param[in] aMsgID               - The ID of message that will be sent.
*  \param[in] aBytesToBeSend       - content of messages to be sent.
*  \param[in] aTimeBetweenFrames   - time waited between frames
*  \param[in] aDataLengthOfMessage - DLC of message (maximum 8 bytes)
*  \param[in] aCANChannel          - Required CAN channel.
*
*
*  \return  1 (Ok)    - if the message was sent succesful
*  \return -1 (Error) - if the message was not sent succesfully / the call of function is wrong or CAN channel is wrong
*
* Change History: 
* Date(DD.MM.YY)        Author          Change info                                                          
*   
*  06.07.18              GrAn        Created and implemented
*  19.11.18              GrAn        Add more writeDbgLevel() for a easier debugging of function.
*  05.09.19              CrJu        Refactoring the code, added new debug levels.
*  21.11.19              CrJu        Eliminate the return of "NotOk".
*/

long lFctn_CAN_SendBurstMessage(dword aMsgID, byte aBytesToBeSend[], dword aTimeBetweenFrames, byte aDataLengthOfMessage, word aCANChannel)
{
  qword qwNoSplitIndividualMessages;
  qword qwPosOfBytesMsgForm;
  byte bArrayToBeFormed[8];
  byte bLastMessageDLC;
  long lReturn_SendMessage;
  word wElementsCopied;
  byte bDebugFlag;
  
  //Initioalization of local variables
  lReturn_SendMessage = NotOk;
  wElementsCopied = 0;
  bDebugFlag = cc_bCAN_GlobalDebugFlag;
  
  writeDbgLevel (DebugFuncCalls, "Function iFctn_CAN_SendBurstMessage called.");
  
  if((byte)DebugFuncParam & bDebugFlag)
    writeDbgLevel (DebugFuncParam, "Parameters: dword aMsgID: -- 0x%X --, byte aDataLengthOfMessage -- %d --, word aCANChannel --%d--.", aMsgID,aDataLengthOfMessage,aCANChannel);  
    
  //The aMsgDLC must be maximum 8 bytes and bigger than zero
  if ((aDataLengthOfMessage > cc_bCANMaxNumberOfBytes) || (aDataLengthOfMessage <= 0))
  {
    if((byte)DebugFuncInternal & bDebugFlag)
      writeDbgLevel(DebugFuncInternal, "The message DLC given is bigger than 8 bytes, or smaller than 0. Function returned: -- %d --.", Error);
    return Error;
  }

  //The channel number must be between 1 and 32
  if ((aCANChannel > cc_wMaxCANChannel)||(aCANChannel < cc_eCAN_ONE))
  {
    if((byte)DebugFuncInternal & bDebugFlag)
      writeDbgLevel (DebugFuncInternal, "The CAN channel number is not in the given range (1-32). Function returned: -- %d --.", Error);
    return Error;
  }
  
  //Variables that stored the number of full messages send with aDataLengthOfMessage bytes
  qwNoSplitIndividualMessages = elCount (aBytesToBeSend) / aDataLengthOfMessage;
  //Store the last message DLC
  bLastMessageDLC = elCount (aBytesToBeSend) % aDataLengthOfMessage;

  //The individual messages with aDataLengthOfMessage number of bytes are formed and send
  for (qwPosOfBytesMsgForm = 0; qwPosOfBytesMsgForm <= qwNoSplitIndividualMessages; qwPosOfBytesMsgForm++)
  {
    if (qwPosOfBytesMsgForm < qwNoSplitIndividualMessages)
    {
      //Form the messages to be sent
      wElementsCopied = wFctn_CONV_CopyByteArrayToByteArray (aBytesToBeSend, qwPosOfBytesMsgForm * aDataLengthOfMessage, aDataLengthOfMessage, bArrayToBeFormed);

      //if an error occurs on copy function reports the problem
      if (NotOk == wElementsCopied)
      {
        if((byte)DebugFuncInternal & bDebugFlag)
          writeDbgLevel (DebugFuncInternal, "Warning! An error occured while tring to form the messages to be sent. Possibly loss of data.");
      }
      
      //Send the individual messages
      lReturn_SendMessage = lFctn_CAN_SendMessage(aMsgID, bArrayToBeFormed, aDataLengthOfMessage, aCANChannel);
      
      //if an error occurs reports the problem
      if (Error == lReturn_SendMessage)
      {
        if((byte)DebugFuncInternal & bDebugFlag)
          writeDbgLevel (DebugFuncInternal, "An error occured in control function lFctn_CAN_SendMessage(). Check his error code. Function returned: -- %d --.", Error);
        return Error;
      }

      //if time to wait is different than zero and it is not the last frame to be send, wait the given time
      if ((0 != aTimeBetweenFrames)
          &&((0 != bLastMessageDLC)
          ||(qwPosOfBytesMsgForm != (qwNoSplitIndividualMessages-1))))
      {
        testWaitForTimeout(aTimeBetweenFrames);
      }
    }
    else
    {
      //The individual message with less aDataLengthOfMessage number of bytes is formed and send
      if (0 != bLastMessageDLC)
      {
        //Form the message to be sent
        wElementsCopied = wFctn_CONV_CopyByteArrayToByteArray (aBytesToBeSend ,qwPosOfBytesMsgForm * aDataLengthOfMessage, bLastMessageDLC, bArrayToBeFormed);
              
        //if an error occurs on copy function reports the problem
        if (NotOk == wElementsCopied)
        {
          if((byte)DebugFuncInternal & bDebugFlag)
            writeDbgLevel (DebugFuncInternal, "Warning! An error occured while tring to form the messages to be sent. Possibly loss of data.");
        }
        
        //Send the message
        lReturn_SendMessage = lFctn_CAN_SendMessage(aMsgID, bArrayToBeFormed, bLastMessageDLC, aCANChannel );
        
        //if an error occurs reports the problem
        if (Error == lReturn_SendMessage)
        {
          if((byte)DebugFuncInternal & bDebugFlag)
            writeDbgLevel (DebugFuncInternal, "An error occured in control function lFctn_CAN_SendMessage(). Check his error code. Function returned: -- %d --.", Error);
          return Error;
        }
      }
    }
  }
  
  if((byte)DebugFuncInternal & bDebugFlag)
    writeDbgLevel (DebugFuncInternal, "Function lFctn_CAN_SendBurstMessage lReturn_SendMessage -- %d --.", lReturn_SendMessage);
  return lReturn_SendMessage;
}

/*! \fn long lFctn_CAN_SendBurstMessage(dword aMsgID, byte aBytesToBeSend[], dword aTimeBetweenFrames, byte aDataLengthOfMessage, word aCANChannel, enum cc_eCanTYPE aType_CAN)
*  \brief Function for sending specific volume of bytes more than 8 bytes.
*  \param[in] aMsgID               - The ID of message that will be sent.
*  \param[in] aBytesToBeSend       - content of messages to be sent.
*  \param[in] aTimeBetweenFrames   - time waited between frames
*  \param[in] aDataLengthOfMessage - Length of message (maximum: 8 bytes on NORMAL CAN / 64 bytes on CAN FD)
*  \param[in] aCANChannel          - Required CAN channel.
*  \param[in] aType_CAN            - The CAN type you want to used: cc_eCAN_NORMAL / cc_eCAN_FD
*
*
*  \return  1 (Ok)    - if the message was sent succesful
*  \return  0 (NotOk) - if the message was not sent succesfully
*
* Change History: 
* Date(DD.MM.YY)        Author          Change info                                                          
*   
*  06.07.18              GrAn        Created and implemented
*  19.11.18              GrAn        Add more writeDbgLevel() for a easier debugging of function.
*  05.09.19              CrJu        Refactoring the code, added new debug levels.
*  18.11.19              CrJu        Update the function for using also CAN_FD functionality. Eliminate some conditions which are already verified in the control function: lFctn_CAN_SendMessage().
*/

long lFctn_CAN_SendBurstMessage(dword aMsgID, byte aBytesToBeSend[], dword aTimeBetweenFrames, byte aDataLengthOfMessage, word aCANChannel, enum cc_eCanTYPE aType_CAN)
{
  qword qwNoSplitIndividualMessages;
  qword qwPosOfBytesMsgForm;
  byte bArrayToBeFormed[64];
  byte bLastMessageDLC;
  long lReturn_SendMessage;
  word wElementsCopied;
  byte bDebugFlag;
  
  //Initioalization of local variables
  lReturn_SendMessage = NotOk;
  wElementsCopied = 0;
  bDebugFlag = cc_bCAN_GlobalDebugFlag;
  
  writeDbgLevel (DebugFuncCalls, "Function iFctn_CAN_SendBurstMessage called.");
  
  if((byte)DebugFuncParam & bDebugFlag)
    writeDbgLevel (DebugFuncParam, "Parameters: dword aMsgID: -- 0x%X --, byte aDataLengthOfMessage -- %d --, word aCANChannel --%d--.", aMsgID, aDataLengthOfMessage, aCANChannel);  
  
  //Variables that stored the number of full messages send with aDataLengthOfMessage bytes
  qwNoSplitIndividualMessages = elCount (aBytesToBeSend) / aDataLengthOfMessage;
  //Store the last message DLC
  bLastMessageDLC = elCount (aBytesToBeSend) % aDataLengthOfMessage;

  //The individual messages with aDataLengthOfMessage number of bytes are formed and send
  for (qwPosOfBytesMsgForm = 0; qwPosOfBytesMsgForm <= qwNoSplitIndividualMessages; qwPosOfBytesMsgForm++)
  {
    if (qwPosOfBytesMsgForm < qwNoSplitIndividualMessages)
    {
      //Form the messages to be sent
      wElementsCopied = wFctn_CONV_CopyByteArrayToByteArray (aBytesToBeSend, qwPosOfBytesMsgForm * aDataLengthOfMessage, aDataLengthOfMessage, bArrayToBeFormed);

      //if an error occurs on copy function reports the problem
      if (NotOk == wElementsCopied)
      {
        if((byte)DebugFuncInternal & bDebugFlag)
          writeDbgLevel (DebugFuncInternal, "Warning! An error occured while tring to form the messages to be sent. Possibly loss of data.");
      }
      
      //Send the individual messages
      lReturn_SendMessage = lFctn_CAN_SendMessage(aMsgID, bArrayToBeFormed, aDataLengthOfMessage, aCANChannel, aType_CAN);
      
      //if an error occurs reports the problem
      if (Error == lReturn_SendMessage)
      {
        if((byte)DebugFuncInternal & bDebugFlag)
          writeDbgLevel (DebugFuncInternal, "An error occured in control function lFctn_CAN_SendMessage(). Check his error code. Function returned: -- %d --.", Error);
        return Error;
      }

      //if time to wait is different than zero and it is not the last frame to be send, wait the given time
      if ((0 != aTimeBetweenFrames)
          &&((0 != bLastMessageDLC)
          ||(qwPosOfBytesMsgForm != (qwNoSplitIndividualMessages-1))))
      {
        testWaitForTimeout(aTimeBetweenFrames);
      }
    }
    else
    {
      //The individual message with less aDataLengthOfMessage number of bytes is formed and send
      if (0 != bLastMessageDLC)
      {
        //Form the message to be sent
        wElementsCopied = wFctn_CONV_CopyByteArrayToByteArray (aBytesToBeSend ,qwPosOfBytesMsgForm * aDataLengthOfMessage, bLastMessageDLC, bArrayToBeFormed);
              
        //if an error occurs on copy function reports the problem
        if (NotOk == wElementsCopied)
        {
          if((byte)DebugFuncInternal & bDebugFlag)
            writeDbgLevel (DebugFuncInternal, "Warning! An error occured while tring to form the messages to be sent. Possibly loss of data.");
        }
        
        //Send the message
        lReturn_SendMessage = lFctn_CAN_SendMessage(aMsgID, bArrayToBeFormed, bLastMessageDLC, aCANChannel, aType_CAN);
        
        //if an error occurs reports the problem
        if (Error == lReturn_SendMessage)
        {
          if((byte)DebugFuncInternal & bDebugFlag)
            writeDbgLevel (DebugFuncInternal, "An error occured in control function lFctn_CAN_SendMessage(). Check his error code. Function returned: -- %d --.", Error);
          return Error;
        }
      }
    }
  }
  
  if((byte)DebugFuncInternal & bDebugFlag)
    writeDbgLevel (DebugFuncInternal, "Function lFctn_CAN_SendBurstMessage lReturn_SendMessage -- %d --.", lReturn_SendMessage);
  return lReturn_SendMessage;
}
    
/*! \fn int iFctn_CAN_CycleTimeCheckByMessageID(dword aMsgID, dword aWaitingTime, float aMinCycleTime, float aMaxCycleTime, char aBusContext[], char aCycleTimeCheckInfo[])
*  \brief Function verify the cyclicality of a message between the entered limits.
*  \param[in] aMsgID               - ID of message
*  \param[in] aWaitingTime         - Time duration of a check
*  \param[in] aMinCycleTime        - Maximum time for message cycle.
*  \param[in] aMaxCycleTime        - Minimum time for message cycle.
*  \param[in] aBusContext          - The specific bus context
*  \param[out] aCycleTimeCheckInfo - Extra information regarding the function output (displayed in the test report).
*
*  \return  0 (NotOk)  - if message cycle time is violated.
*  \return  1 (Ok)     - if message is in cycle time.
*  \return  -1 (Error) - if cycle time check could not be done / name of the bus context is wrong / the used value timeout or limits are wrong (too small)
*
*  \note
*          - Event is generated if the time between sends of message is smaller than aMinAbsCycleTime and aMaxAbsCycleTime (example: if Message cycle \n
*            time is 50ms and difference between aMinAbsCycleTime and aMaxAbsCycleTime is 60ms the event is not generated)
*  \note 
*          - If the limits (aMinAbsCycleTime or/and aMaxAbsCycleTime) are zero, this function does not check those limits.
*
*
* Change History: 
* Date(DD.MM.YY)        Author          Change info                                                          
*   
*  06.07.18              GrAn        Created and implemented
*  19.11.18              GrAn        Change the name of function. The return value data type is int.
*  10.09.19              CrJu        Refactoring the code, added new debug levels.
*/

int iFctn_CAN_CycleTimeCheckByMessageID (dword aMsgID, dword aWaitingTime, float aMinCycleTime, float aMaxCycleTime, char aBusContext[], char aCycleTimeCheckInfo[])
{
  dword dwResult_CheckCycleTime;
  int iReturnValue;
  byte bDebugFlag;
  byte bResult_SetContext;
  
  bDebugFlag = cc_bCAN_GlobalDebugFlag;
  
  writeDbgLevel (DebugFuncCalls, "Function iFctn_CAN_CycleTimeCheckByMessageID called.");

  //Setting the bus Context
  bResult_SetContext = bFctn_BUS_SetContext(aBusContext);
  
  // Constraints of the time values
  if ( (0 == aWaitingTime) // The waiting time should not be: 0
    || (0 == aMinCycleTime && 0 == aMaxCycleTime) // Both of the cycle times to check must not be: 0 at the same time
    || (0 > aMinCycleTime || 0 > aMaxCycleTime) ) // None of the cycle times is allowed to have a negative value
  {
    snprintf(aCycleTimeCheckInfo, elcount(aCycleTimeCheckInfo), "Wait time(%dms) or both of the specified cycle times (min: %6.2f, max: %6.2f) should NOT be 0ms or negative.", aWaitingTime, aMinCycleTime, aMaxCycleTime);
    iReturnValue = Error;
  }
  else if ((0 == aMinCycleTime && (float)aWaitingTime - aMaxCycleTime < 0)   // If min cycle is 0, the wait time should be at least the same as the max cycle
         ||(0 == aMaxCycleTime && (float)aWaitingTime - aMinCycleTime < 0) ) // If max cycle is 0, the wait time should be at least the same as the min cycle
  {
    snprintf(aCycleTimeCheckInfo, elcount(aCycleTimeCheckInfo), "If one cycle time is: 0ms (min: %6.2f, max: %6.2f) the wait time (%dms) must be at least equal to the highest value.", aMinCycleTime, aMaxCycleTime, aWaitingTime);
    iReturnValue = Error;
  }
  else if ( (aMaxCycleTime < aMinCycleTime) // Cycle times are !=0 but the max cycle time is less than the min cycle time)
          ||((float)aWaitingTime - aMaxCycleTime < 0) ) // The waiting time should be at least equal or greater than aMaxCycleTime
  {
    snprintf(aCycleTimeCheckInfo, elcount(aCycleTimeCheckInfo), "If min and max cycle times are greater than 0ms, it is necessary that: (aMaxCycleTime)%6.2f >= %6.2f(aMinCycleTime).", aMaxCycleTime, aMinCycleTime);
    iReturnValue = Error;
  }
  else if (bResult_SetContext == NotOk)
  {
    if((byte)DebugFuncInternal & bDebugFlag)
      writeDbgLevel (DebugFuncInternal, "ERROR: The BUS context was not set succesfully.");
    iReturnValue = Error;
  }
  else // Time values are valid
  {
    //Check the occurences of cyclic messages
    dwResult_CheckCycleTime = ChkStart_MsgAbsCycleTimeViolation((long)aMsgID, aMinCycleTime, aMaxCycleTime);
  
    //check was created successfully
	  if(dwResult_CheckCycleTime > 0)
	  {
		  TestAddCondition(dwResult_CheckCycleTime); //Check whether the specified condition was already broken (at least one time the condition was not fulfilled).
      TestWaitForTimeout(aWaitingTime);  //Wait the specified time
    
      if (0 == testCheckCondition(dwResult_CheckCycleTime))  /*Condition was not broken (all checks were OK) */
      {
        snprintf(aCycleTimeCheckInfo, elcount(aCycleTimeCheckInfo), "Message 0x%X was found within the wait time: %dms, with the expected cycle time between Min=%6.2f and Max=%6.2f.", aMsgID, aWaitingTime, aMinCycleTime, aMaxCycleTime);
        iReturnValue = Ok;
      }
      else//Condition was broken (at least one time the condition was not fulfilled).
      {
        snprintf(aCycleTimeCheckInfo, elcount(aCycleTimeCheckInfo), "Message 0x%X did NOT arrive at all within the wait time: %dms, or it violated the cycle times Min=%6.2f and Max=%6.2f.", aMsgID, aWaitingTime, aMinCycleTime, aMaxCycleTime);
        iReturnValue = NotOk;
      }
      
      //Remove the event object that was added as condition
      TestRemoveCondition(dwResult_CheckCycleTime);
	  }
	  else//An error occurred
    {
      snprintf(aCycleTimeCheckInfo, elcount(aCycleTimeCheckInfo), "Check could not be created and must not be referenced. ChkStart_MsgAbsCycleTimeViolation() return: %d.", dwResult_CheckCycleTime);
      iReturnValue = Error;
    }
  }
    
  // Display the message of the function, for debugging porpose
  if ( (byte)DebugFuncInternal & bDebugFlag )
      writeDbgLevel (DebugFuncInternal, aCycleTimeCheckInfo);

  if ( (byte)DebugFuncInternal & bDebugFlag )
    writeDbgLevel (DebugFuncInternal, "iFctn_CAN_CycleTimeCheckByMessageID() return: %i.", iReturnValue);
  
  return iReturnValue;
}

/*! \fn int iFctn_CAN_CycleTimeCheckByMessageName(dbMsg* aMessageName, dword aWaitingTime, float aMinCycleTime, float aMaxCycleTime, char aBusContext[], char aCycleTimeCheckInfo[])
*  \brief Function waits for a specific message to be sent on CAN.
*  \param[in] aMessageName         - Name of message from database
*  \param[in] aWaitingTime         - Wait time for the message.
*  \param[in] aMinCycleTime        - Maximum time for message cycle.
*  \param[in] aMaxCycleTime        - Minimum time for message cycle.
*  \param[in] aBusContext          - The specific bus context
*  \param[out] aCycleTimeCheckInfo - Extra information regarding the function output (displayed in the test report).
*
*  \return   0 (NotOk) - if message cycle time is violated.
*  \return   1 (Ok)    - if message is in cycle time.
*  \return  -1 (Error) - if cycle time check could not be done / name of the bus context is wrong / the used value timeout or limits are wrong (too small)
*
*  \note 
*         - Event is generated if the time between sends of message is smaller than aMinAbsCycleTime and aMaxAbsCycleTime (example: if Message cycle \n
*          time is 50ms and difference between aMinAbsCycleTime and aMaxAbsCycleTime is 60ms the event is not generated)
*  \note 
*         - If the limits (aMinAbsCycleTime or/and aMaxAbsCycleTime) are zero, this function does not check those limits.
*  \note 
*         - The aMessageName parameter must be called in following way: [Data Base Name] :: [Data Base Node] :: Message Name \n
*           (example: CANCluster_PrivA(Data Base Name - optional) :: Tester(Data Base Node-optional) :: Test_frame1(Message Name).
*  \note
*         - The optional attributes (specified on "[", "]") must be used if messages with the same name are present on different data bases/CAN nodes.
*
* Change History: 
* Date(DD.MM.YY)        Author          Change info                                                          
*   
*  06.07.18              GrAn        Created and implemented
*  19.11.18              GrAn        Change the name of function. The return value data type is int.
*  10.09.19              CrJu        Refactoring the code, added new debug levels.
*/

int iFctn_CAN_CycleTimeCheckByMessageName(dbMsg* aMessageName, dword aWaitingTime, float aMinCycleTime, float aMaxCycleTime, char aBusContext[], char aCycleTimeCheckInfo[])
{
  byte bDebugFlag;
  byte bResult_SetContext;
  dword dwResult_CheckCycleTime;
  int iReturnValue;
  
  iReturnValue = NotOk;
  bDebugFlag = cc_bCAN_GlobalDebugFlag;
  
  writeDbgLevel (DebugFuncCalls , "Function iFctn_CAN_CycleTimeCheckByMessageName called.");

  //Setting the bus Context
  bResult_SetContext = bFctn_BUS_SetContext(aBusContext);
  
  // Constraints of the time values
  if ( (0 == aWaitingTime) // The waiting time should not be: 0
    || (0 == aMinCycleTime && 0 == aMaxCycleTime) // Both of the cycle times to check must not be: 0 at the same time
    || (0 > aMinCycleTime || 0 > aMaxCycleTime) ) // None of the cycle times is allowed to have a negative value
  {
    snprintf(aCycleTimeCheckInfo, elcount(aCycleTimeCheckInfo), "Wait time(%dms) or both of the specified cycle times (min: %6.2f, max: %6.2f) should NOT be 0ms or negative.", aWaitingTime, aMinCycleTime, aMaxCycleTime);
    iReturnValue = Error;
  }
  else if ((0 == aMinCycleTime && (float)aWaitingTime - aMaxCycleTime < 0)   // If min cycle is 0, the wait time should be at least the same as the max cycle
         ||(0 == aMaxCycleTime && (float)aWaitingTime - aMinCycleTime < 0) ) // If max cycle is 0, the wait time should be at least the same as the min cycle
  {
    snprintf(aCycleTimeCheckInfo, elcount(aCycleTimeCheckInfo), "If one cycle time is: 0ms (min: %6.2f, max: %6.2f) the wait time (%dms) must be at least equal to the highest value.", aMinCycleTime, aMaxCycleTime, aWaitingTime);
    iReturnValue = Error;
  }
  else if ( (aMaxCycleTime < aMinCycleTime) // Cycle times are !=0 but the max cycle time is less than the min cycle time)
          ||((float)aWaitingTime - aMaxCycleTime < 0) ) // The waiting time should be at least equal or greater than aMaxCycleTime
  {
    snprintf(aCycleTimeCheckInfo, elcount(aCycleTimeCheckInfo), "If min and max cycle times are greater than 0ms, it is necessary that: (aMaxCycleTime)%6.2f >= %6.2f(aMinCycleTime).", aMaxCycleTime, aMinCycleTime);
    iReturnValue = Error;
  }
  else if (bResult_SetContext == NotOk)
  {
    if((byte)DebugFuncInternal & bDebugFlag)
      writeDbgLevel (DebugFuncInternal, "ERROR: The BUS context was not set succesfully.");
    iReturnValue = Error;
  }
  else // Time values are valid
  {
    //Check the occurences of cyclic messages
    dwResult_CheckCycleTime = ChkStart_MsgAbsCycleTimeViolation(aMessageName, aMinCycleTime, aMaxCycleTime);
  
    //check was created successfully
	  if(dwResult_CheckCycleTime > 0)
	  {
		  TestAddCondition(dwResult_CheckCycleTime); //Check whether the specified condition was already broken (at least one time the condition was not fulfilled).
      TestWaitForTimeout(aWaitingTime);  //Wait the specified time
    
      if (0 == testCheckCondition(dwResult_CheckCycleTime))  /*Condition was not broken (all checks were OK) */
      {
        snprintf(aCycleTimeCheckInfo, elcount(aCycleTimeCheckInfo), "Message was found within the wait time: %dms, with the expected cycle time between Min=%6.2f and Max=%6.2f.", aWaitingTime, aMinCycleTime, aMaxCycleTime);
        iReturnValue = Ok;
      }
      else//Condition was broken (at least one time the condition was not fulfilled).
      {
        snprintf(aCycleTimeCheckInfo, elcount(aCycleTimeCheckInfo), "Message did NOT arrive at all within the wait time: %dms, or it violated the cycle times Min=%6.2f and Max=%6.2f.", aWaitingTime, aMinCycleTime, aMaxCycleTime);
        iReturnValue = NotOk;
      }
      
      //Remove the event object that was added as condition
      TestRemoveCondition(dwResult_CheckCycleTime);
	  }
	  else//An error occurred
    {
      snprintf(aCycleTimeCheckInfo, elcount(aCycleTimeCheckInfo), "Check could not be created and must not be referenced. ChkStart_MsgAbsCycleTimeViolation() return: %d.", dwResult_CheckCycleTime);
      iReturnValue = Error;
    }
  }
    
  // Display the message of the function, for debugging porpose
  if ( (byte)DebugFuncInternal & bDebugFlag )
      writeDbgLevel (DebugFuncInternal, aCycleTimeCheckInfo);

  if ( (byte)DebugFuncInternal & bDebugFlag )
    writeDbgLevel (DebugFuncInternal, "iFctn_CAN_CycleTimeCheckByMessageID() return: %i.", iReturnValue);
  
  return iReturnValue;
}

/*! \fn long lFctn_CAN_GetMessageDatabyID(dword aMsgID, char aBusContext[], dword aTimeToWaitForMessage, byte aOutputData[], dword &aNumberOfBytesCopied )
*  \brief Function Gets the content for a searched message ID on required bus context.
*  \param[in]  aMsgID                - ID of message from database
*  \param[in]  aBusContext           - The bus context
*  \param[in]  aTimeToWaitForMessage - Max time to wait for message.
*  \param[out] aOutputData           - The Message payload.
*  \param[out] aNumberOfBytesCopied  - Number of bytes copied
*
*  \return 0 (NotOk)  - if message cannot be found
*  \return 1 (Ok)     - if the function is executed successfully
*  \return -1 (Error) - if bus name was wrong / The output array is wrong
*
* Change History: 
* Date(DD.MM.YY)        Author          Change info                                                          
*   
*  06.07.18              GrAn        Created and implemented
*  01.10.18              GrAn        Resolve some remarks after tests done for this function.
*  19.11.18              GrAn        Add more writeDbgLevel() for a easier debugging of function.
*  04.09.19              CrJu        Refactoring the code, added new debug levels.
*  12.11.19              CrJu        Changed the selector for the length of the message. Use: DataLength, instead of DLC, for using this fctn in CAN_FD.
*  12.11.19              CrJu        Eliminate the condition regarding the length for aOutputData[].
*/

long lFctn_CAN_GetMessageDatabyID(dword aMsgID, char aBusContext[], dword aTimeToWaitForMessage, byte aOutputData[], dword &aNumberOfBytesCopied )
{
  message * msgEventMessage;
  long lResult;
  byte bResult_SetContext;
  long lResultJoin;
  long lResultGetData;
  long lTestWait;
  byte bPosOfBytes;
  byte bDebugFlag;
  
  //Initialization of local variable
  lResult = NotOk;
  bResult_SetContext = NotOk;
  lTestWait = 0;
  lResultGetData = 0;
  aNumberOfBytesCopied = 0;
  bDebugFlag = cc_bCAN_GlobalDebugFlag;
  
  writeDbgLevel (DebugFuncCalls, "Function lFctn_CAN_GetMessageDatabyID called.");
  
  if ((byte)DebugFuncParam & bDebugFlag)
    writeDbgLevel (DebugFuncParam, "Parameters: dword aMsgID: --0x%X --, char aBusContext[]: -- %s --, dword aTimeToWaitForMessage: --%d-- ", aMsgID, aBusContext, aTimeToWaitForMessage);
 
  //Reset the output array to 0
  vFctn_CONV_SetAllByteArrElemToSpecificVal(aOutputData, 0);
  
  //Setting the bus Context
  bResult_SetContext = bFctn_BUS_SetContext(aBusContext);
  
  //Check if the bus context name is wrong
  if (bResult_SetContext == NotOk)
  {
    if ((byte)DebugFuncInternal & bDebugFlag)
      writeDbgLevel (DebugFuncInternal, "Error: The bus context was not set succesfully.");
    return Error;  
  }
  
  if (0 == aTimeToWaitForMessage)//if the timeout is zero use a default value for timeout
  {
    aTimeToWaitForMessage = cc_wDefaultTimeout;
    if ((byte)DebugFuncInternal & bDebugFlag)
      writeDbgLevel (DebugFuncInternal, "The specified wait time is invalid. Using the default value: %d ms instead of 0 ms.", cc_wDefaultTimeout);
  }
  
  //Tests if the message with required ID was found on bus
  lResultJoin = TestJoinMessageEvent(aMsgID);
  
  //Wait to complete the join events
  lTestWait= TestWaitForAnyJoinedEvent(aTimeToWaitForMessage);

  //if events was succesfully completed, copy the bytes
  if ((lResultJoin > NotOk) && (lTestWait > NotOk))
  {
    //Register the message content
    lResultGetData = TestGetWaitEventMsgData(lTestWait, msgEventMessage);
    
    if (0 == lResultGetData)//If data access was succesful
    {
      if (elcount (aOutputData) < msgEventMessage.DataLength)//The output array is too small
      {
        if ((byte)DebugFuncInternal & bDebugFlag)
          writeDbgLevel (DebugFuncInternal, "Error: The output array is too small for the message DLC.");
        return Error;
      }
      
      for (bPosOfBytes = 0; bPosOfBytes < msgEventMessage.DataLength; bPosOfBytes++)
      {
        aOutputData[bPosOfBytes] = msgEventMessage.byte(bPosOfBytes);
      }
      
      aNumberOfBytesCopied = msgEventMessage.DataLength;
      
      //The message was received
      lResult = Ok;
    }
    else
    {
      //The message was not received on the bus
      if ((byte)DebugFuncInternal & bDebugFlag)
        writeDbgLevel (DebugFuncInternal, "Failed: Data access could not be executed.");
      lResult = NotOk;
    }
  }
  else
  {
    //The events was not succesfully completed
    if ((byte)DebugFuncInternal & bDebugFlag)
      writeDbgLevel (DebugFuncInternal, "Failed: The events was not succesfully completed. Check the error code of function TestWaitForAnyJoinedEvent(): -%d-.", lTestWait);
    lResult = NotOk;
  }
  
  if ((byte)DebugFuncInternal & bDebugFlag)
    writeDbgLevel (DebugFuncInternal, "Function lFctn_CAN_GetMessageDatabyID lResult -- %d --.", lResult);
  return lResult;
}

/*! \fn byte lFctn_CAN_WaitForMessageDatabyID(dword aMsgID, char aBusContext[], dword aTimeToWaitForMessage, byte aCompareBytesArray[], char aMappedResponseInfo[])
*  \brief Function Wait and check if a message is send on a required bus context with an expected content
*  \param[in]  aMsgID                - ID of message
*  \param[in]  aBusContext           - The bus context
*  \param[in]  aTimeToWaitForMessage - Max time to wait for message.
*  \param[in]  aCompareBytesArray    - The array of bytes to be compared.
*  \param[out] aMappedResponseInfo   - the send response that will be printed on the report
*
*  \return  0 (NotOk) - if message with the searched content cannot be found
*  \return  1 (Ok)    - if message with the searched content was found
*  \return -1 (Error) - If the number of elements of the input array is too big
*
* Change History: 
* Date(DD.MM.YY)        Author          Change info                                                          
*   
*  02.09.19              CrJu           Created and implemented
*/

long lFctn_CAN_WaitForMessageDatabyID(dword aMsgID, char aBusContext[], dword aTimeToWaitForMessage, byte aCompareBytesArray[], char aMappedResponseInfo[])
{
  long lResult;
  char chOutputString[50];
  byte bGetData[8];
  dword dwNumberOfBytesCopied;
  qword qwTimeDiff;
  long lReturn_GetMessageData;
  char chPrintBusContext[26];
  char chCompareArrayInfo[100];
  byte bFoundFlag;
  byte bDebugFlag;
  
  lResult = NotOk;
  lReturn_GetMessageData = NotOk;
  bFoundFlag = NotOk;
  bDebugFlag = cc_bCAN_GlobalDebugFlag;
  
  writeDbgLevel (DebugFuncCalls, "Function lFctn_CAN_WaitForMessageDatabyID called.");
  
  if ((byte)DebugFuncParam & bDebugFlag)
    writeDbgLevel (DebugFuncParam, "Parameters: dword aMsgID: --0x%x --, char aBusContext[]: -- %s --, dword aTimeToWaitForMessage: --%d-- ", aMsgID, chPrintBusContext, aTimeToWaitForMessage);
  
  //Print in the raport the entire bus context or just the first 25 characters
  bFctn_CONV_GetSubString(aBusContext, 0, tsc_wPrintBusContextChars - 1, chPrintBusContext);
  
  if (0 == aTimeToWaitForMessage)//if the timeout is zero use a default value for timeout
  {
    aTimeToWaitForMessage = cc_wDefaultTimeout;
    if ((byte)DebugFuncInternal & bDebugFlag)
      writeDbgLevel (DebugFuncInternal, "The specified wait time is invalid. Using the default value: %d ms instead of 0 ms.", cc_wDefaultTimeout);
  }
  
  qwTimeDiff = aTimeToWaitForMessage * cc_qwTransformNSInMS;//Initialize the Time Difference with the maximum time to wait in NS
 
  //If the number of elements of the input array is too big, return an error
  if (elcount(aCompareBytesArray) > cc_bCANMaxNumberOfBytes)
  {
    snprintf(aMappedResponseInfo, elcount(aMappedResponseInfo), "The number of elements of input array is %d and it is too big. The length of CAN message must be not more than %d.", elcount(aCompareBytesArray), tsc_bNoMaxOfBytes);
    if ((byte)DebugFuncInternal & bDebugFlag)
      writeDbgLevel (DebugFuncInternal, "Error: %s", aMappedResponseInfo);
    return Error;
  }
  
  //if the timeout do not pass and the content was not found verify the bus
  while (qwTimeDiff > 0)
  {
    //Check if the message was send on bus and get message data bytes, if the timeout was not reached
    if (0 != (dword)(qwTimeDiff/cc_qwTransformNSInMS))
    {
      lReturn_GetMessageData = lFctn_CAN_GetMessageDatabyID(aMsgID, aBusContext, (dword)(qwTimeDiff/cc_qwTransformNSInMS), bGetData, dwNumberOfBytesCopied);
    }
    else//Wait the remaining time (1 ms)
    {
      lReturn_GetMessageData = lFctn_CAN_GetMessageDatabyID(aMsgID, aBusContext, 1, bGetData, dwNumberOfBytesCopied);
    }
    
    //The message was send on bus
    if (Ok == lReturn_GetMessageData)
    {
      //Set the found flag to 1
      bFoundFlag = Ok;
      
      //Convert the found data of the message to a string
      bFctn_CONV_ConvertByteArrayToStringByDLC(bGetData, chOutputString, dwNumberOfBytesCopied);
      
      //verify that the input byte array parameter has the same elements as the message on the bus
      if(dwNumberOfBytesCopied != elCount(aCompareBytesArray))
      {
        snprintf(aMappedResponseInfo, elcount(aMappedResponseInfo), "The input byte array parameter has not the same elements as the message on the bus.(%d elements compare to %d).", elCount(aCompareBytesArray), dwNumberOfBytesCopied);
        if ((byte)DebugFuncInternal & bDebugFlag)
          writeDbgLevel (DebugFuncInternal, "");
        lResult = NotOk;
      }
      else
      {
        lResult = bFctn_CONV_CompareByteArrays(bGetData, aCompareBytesArray, dwNumberOfBytesCopied, chCompareArrayInfo); 
      
        //The message was found with the expected data. Exit the function
        if(lResult == Ok)
        {
          snprintf(aMappedResponseInfo, elcount(aMappedResponseInfo), "The message 0x%X was found with the expected data --%s-- on bus: %s. \n%s", aMsgID, chOutputString, chPrintBusContext, chCompareArrayInfo);
          if ((byte)DebugFuncInternal & bDebugFlag)
            writeDbgLevel (DebugFuncInternal, "The message 0x%X was found with the expected data --%s-- on bus: %s. \n%s", aMsgID, chOutputString, chPrintBusContext, chCompareArrayInfo);
          return Ok;
        }
        else//The message was found, but the data is not equal with the expected one
        { 
          snprintf(aMappedResponseInfo, elcount(aMappedResponseInfo), "The message 0x%X was found with different data then expected --%s-- on bus: %s. \n%s", aMsgID, chOutputString, chPrintBusContext, chCompareArrayInfo);
          if ((byte)DebugFuncInternal & bDebugFlag)
            writeDbgLevel (DebugFuncInternal, "The message 0x%X was found with different data then expected --%s-- on bus: %s. \n%s", aMsgID, chOutputString, chPrintBusContext, chCompareArrayInfo);
          lResult = NotOk;
        }
      }
    }
    else 
    {
      //The lFctn_CAN_GetMessageDatabyID function returned an error.
      if(lReturn_GetMessageData == Error)
      {
        snprintf(aMappedResponseInfo, elcount(aMappedResponseInfo), "An error appeared in the lFctn_CAN_GetMessageDatabyID() function. Check his error code.");
        if ((byte)DebugFuncInternal & bDebugFlag)
          writeDbgLevel (DebugFuncInternal, "An error appeared in the lFctn_CAN_GetMessageDatabyID() function. Check his error code.");
        return Error; 
      }
      
      if(bFoundFlag == NotOk)//Save this info if the message has not appeared on the bus yet
      {
        snprintf(aMappedResponseInfo, elcount(aMappedResponseInfo), "The message 0x%X was not found on bus: --%s--.", aMsgID, chPrintBusContext);
      }
      lResult = NotOk;
    }
    //Calculate the time remaining until timeout expired
    qwTimeDiff = qwTimeDiff - (qword)TestGetLastWaitElapsedTimeNS();
  }
  
  if ((byte)DebugFuncInternal & bDebugFlag)
    writeDbgLevel (DebugFuncInternal, "Function lFctn_CAN_WaitForMessageDatabyID lResult -- %d --.", lResult);
  return lResult;
}

/*! \fn byte lFctn_CAN_WaitForMessageDatabyID(dword aMsgID, char aBusContext[], dword aTimeToWaitForMessage, byte aCompareBytesArray[], enum cc_eCanTYPE aType_CAN, char aMappedResponseInfo[])
*  \brief Function Wait and check if a message is send on a required bus context with an expected content.
*  \param[in]  aMsgID                - ID of message.
*  \param[in]  aBusContext           - The bus context.
*  \param[in]  aTimeToWaitForMessage - Max time to wait for message.
*  \param[in]  aCompareBytesArray    - The array of bytes to be compared.
*  \param[in]  aType_CAN             - The CAN type you want to used: cc_eCAN_NORMAL / cc_eCAN_FD.
*  \param[out] aMappedResponseInfo   - the send response that will be printed on the report.
*
*  \return  0 (NotOk) - if message with the searched content cannot be found
*  \return  1 (Ok)    - if message with the searched content was found
*  \return -1 (Error) - If the number of elements of the input array is too big
*
* Change History: 
* Date(DD.MM.YY)        Author          Change info                                                          
*   
*  12.11.19              CrJu           Created and implemented
*/

long lFctn_CAN_WaitForMessageDatabyID(dword aMsgID, char aBusContext[], dword aTimeToWaitForMessage, byte aCompareBytesArray[], enum cc_eCanTYPE aType_CAN, char aMappedResponseInfo[])
{
  long lResult;
  char chOutputString[50];
  byte bGetData[64];
  dword dwNumberOfBytesCopied;
  qword qwTimeDiff;
  long lReturn_GetMessageData;
  char chPrintBusContext[26];
  char chCompareArrayInfo[100];
  byte bFoundFlag;
  byte bDebugFlag;
  
  lResult = NotOk;
  lReturn_GetMessageData = NotOk;
  bFoundFlag = NotOk;
  bDebugFlag = cc_bCAN_GlobalDebugFlag;
  
  writeDbgLevel (DebugFuncCalls, "Function lFctn_CAN_WaitForMessageDatabyID called.");
  
  if ((byte)DebugFuncParam & bDebugFlag)
    writeDbgLevel (DebugFuncParam, "Parameters: dword aMsgID: --0x%x --, char aBusContext[]: -- %s --, dword aTimeToWaitForMessage: --%d-- ", aMsgID, chPrintBusContext, aTimeToWaitForMessage);
  
  //Print in the raport the entire bus context or just the first 25 characters
  bFctn_CONV_GetSubString(aBusContext, 0, tsc_wPrintBusContextChars - 1, chPrintBusContext);
  
  if (0 == aTimeToWaitForMessage)//if the timeout is zero use a default value for timeout
  {
    aTimeToWaitForMessage = cc_wDefaultTimeout;
    if ((byte)DebugFuncInternal & bDebugFlag)
      writeDbgLevel (DebugFuncInternal, "The specified wait time is invalid. Using the default value: %d ms instead of 0 ms.", cc_wDefaultTimeout);
  }
  
  qwTimeDiff = aTimeToWaitForMessage * cc_qwTransformNSInMS;//Initialize the Time Difference with the maximum time to wait in NS
 
  if(aType_CAN == cc_eCAN_NORMAL) //NORMAL CAN used
  {
    //If the number of elements of the input array is too big, return an error
    if (elcount(aCompareBytesArray) > cc_bCANMaxNumberOfBytes)
    {
      snprintf(aMappedResponseInfo, elcount(aMappedResponseInfo), "The number of elements of input array is %d and it is too big. The length of CAN message must be not more than %d.", elcount(aCompareBytesArray), cc_bCANMaxNumberOfBytes);
      if ((byte)DebugFuncInternal & bDebugFlag)
        writeDbgLevel (DebugFuncInternal, "Error: %s", aMappedResponseInfo);
      return Error;
    }
  }
  else //CAN FD used
  {
    //If the number of elements of the input array is too big, return an error
    if (elcount(aCompareBytesArray) > cc_bCANFDMaxNumberOfBytes)
    {
      snprintf(aMappedResponseInfo, elcount(aMappedResponseInfo), "The number of elements of input array is %d and it is too big. The length of CAN FD message must be not more than %d.", elcount(aCompareBytesArray), cc_bCANFDMaxNumberOfBytes);
      if ((byte)DebugFuncInternal & bDebugFlag)
        writeDbgLevel (DebugFuncInternal, "Error: %s", aMappedResponseInfo);
      return Error;
    }
  }
  
  //if the timeout do not pass and the content was not found verify the bus
  while (qwTimeDiff > 0)
  {
    //Check if the message was send on bus and get message data bytes, if the timeout was not reached
    if (0 != (dword)(qwTimeDiff/cc_qwTransformNSInMS))
    {
      lReturn_GetMessageData = lFctn_CAN_GetMessageDatabyID(aMsgID, aBusContext, (dword)(qwTimeDiff/cc_qwTransformNSInMS), bGetData, dwNumberOfBytesCopied);
    }
    else//Wait the remaining time (1 ms)
    {
      lReturn_GetMessageData = lFctn_CAN_GetMessageDatabyID(aMsgID, aBusContext, 1, bGetData, dwNumberOfBytesCopied);
    }
    
    //The message was send on bus
    if (Ok == lReturn_GetMessageData)
    {
      //Set the found flag to 1
      bFoundFlag = Ok;
      
      //Convert the found data of the message to a string
      bFctn_CONV_ConvertByteArrayToStringByDLC(bGetData, chOutputString, dwNumberOfBytesCopied);
      
      //verify that the input byte array parameter has the same elements as the message on the bus
      if(dwNumberOfBytesCopied != elCount(aCompareBytesArray))
      {
        snprintf(aMappedResponseInfo, elcount(aMappedResponseInfo), "The input byte array parameter has not the same elements as the message on the bus.(%d elements compare to %d).", elCount(aCompareBytesArray), dwNumberOfBytesCopied);
        if ((byte)DebugFuncInternal & bDebugFlag)
          writeDbgLevel (DebugFuncInternal, "");
        lResult = NotOk;
      }
      else
      {
        lResult = bFctn_CONV_CompareByteArrays(bGetData, aCompareBytesArray, dwNumberOfBytesCopied, chCompareArrayInfo); 
      
        //The message was found with the expected data. Exit the function
        if(lResult == Ok)
        {
          snprintf(aMappedResponseInfo, elcount(aMappedResponseInfo), "The message 0x%X was found with the expected data --%s-- on bus: %s. \n%s", aMsgID, chOutputString, chPrintBusContext, chCompareArrayInfo);
          if ((byte)DebugFuncInternal & bDebugFlag)
            writeDbgLevel (DebugFuncInternal, "The message 0x%X was found with the expected data --%s-- on bus: %s. \n%s", aMsgID, chOutputString, chPrintBusContext, chCompareArrayInfo);
          return Ok;
        }
        else//The message was found, but the data is not equal with the expected one
        { 
          snprintf(aMappedResponseInfo, elcount(aMappedResponseInfo), "The message 0x%X was found with different data then expected --%s-- on bus: %s. \n%s", aMsgID, chOutputString, chPrintBusContext, chCompareArrayInfo);
          if ((byte)DebugFuncInternal & bDebugFlag)
            writeDbgLevel (DebugFuncInternal, "The message 0x%X was found with different data then expected --%s-- on bus: %s. \n%s", aMsgID, chOutputString, chPrintBusContext, chCompareArrayInfo);
          lResult = NotOk;
        }
      }
    }
    else 
    {
      //The lFctn_CAN_GetMessageDatabyID function returned an error.
      if(lReturn_GetMessageData == Error)
      {
        snprintf(aMappedResponseInfo, elcount(aMappedResponseInfo), "An error appeared in the lFctn_CAN_GetMessageDatabyID() function. Check his error code using debug functions.");
        if ((byte)DebugFuncInternal & bDebugFlag)
          writeDbgLevel (DebugFuncInternal, "An error appeared in the lFctn_CAN_GetMessageDatabyID() function. Check his error code using debug functions.");
        return Error; 
      }
      
      if(bFoundFlag == NotOk)//Save this info if the message has not appeared on the bus yet
      {
        snprintf(aMappedResponseInfo, elcount(aMappedResponseInfo), "The message 0x%X was not found on bus: --%s--.", aMsgID, chPrintBusContext);
      }
      lResult = NotOk;
    }
    //Calculate the time remaining until timeout expired
    qwTimeDiff = qwTimeDiff - (qword)TestGetLastWaitElapsedTimeNS();
  }
  
  if ((byte)DebugFuncInternal & bDebugFlag)
    writeDbgLevel (DebugFuncInternal, "Function lFctn_CAN_WaitForMessageDatabyID lResult -- %d --.", lResult);
  return lResult;
}

/*! \fn long lFctn_CAN_SendBurstMessage(dword aMsgID[], byte aBytesToBeSend[], dword aTimeBetweenFrames, byte aDataLengthOfMessage, word aCANChannel)
*  \brief Function for sending specific volume of bytes more than 8 bytes on specific CAN messages ID
*  \param[in] aMsgID               - The array of ID of message that will be sent.
*  \param[in] aBytesToBeSend       - Content of messages to be sent.
*  \param[in] aTimeBetweenFrames   - Time waited between frames (If it's 0, the messages will be transfered as fast as possible)
*  \param[in] aDataLengthOfMessage - DLC of message (maximum 8 bytes)
*  \param[in] aCANChannel          - Required CAN channel.
*
*  \return  1 (Ok)    - if the message was sent succesfully
*  \return  0 (NotOk) - if the messages could not be succesfully sent
*  \return -1 (Error) - the aMsgDLC is wrong (smaller than 0 or bigger than 8) / the CAN Channel number is wrong.       
*
*  \note 
*          - If the aTimeBetweenFrames = 0, and the messages will be transfered as fast as possbile, if two messages will be send at the same time on CAN, his property is to send the one with the smaller ID first.
*
* Change History: 
* Date(DD.MM.YY)        Author          Change info                                                          
*   
*  06.07.18              GrAn        Created and implemented
*  19.11.18              GrAn        Add more writeDbgLevel() for a easier debugging of function.
*  12.09.19              CrJu        Refactoring the code, added new debug levels.
*/

long lFctn_CAN_SendBurstMessage(dword aMsgID[], byte aBytesToBeSend[], dword aTimeBetweenFrames, byte aDataLengthOfMessage, word aCANChannel)
{
  byte bDebugFlag;
  byte bLastMessageDLC;
  byte bArrayToBeFormed[8];
  word wCopiedElements;
  long lReturn_SendMessage;
  qword qwMsgIDPos;
  qword qwPosOfBytesMsgForm;
  qword qwNoSplitIndividualMessages;
  
  //Initialization of variables
  bDebugFlag = cc_bCAN_GlobalDebugFlag;
  qwMsgIDPos = 0;
  wCopiedElements = 0;
  lReturn_SendMessage = NotOk;
  
  writeDbgLevel (DebugFuncCalls, "Function lFctn_CAN_SendBurstMessage() called.");
  
  if ((byte)DebugFuncParam & bDebugFlag)
    writeDbgLevel (DebugFuncParam, "Parameters: dword aTimeBetweenFrames --%d--, byte aDataLengthOfMessage --%d--, word aCANChannel --%d--.", aTimeBetweenFrames, aDataLengthOfMessage, aCANChannel);   

  //The aMsgDLC must be maximum 8 bytes and bigger than zero
  if ((aDataLengthOfMessage > cc_bCANMaxNumberOfBytes) || (aDataLengthOfMessage <= 0))
  {
    if((byte)DebugFuncInternal & bDebugFlag)
      writeDbgLevel(DebugFuncInternal, "The message DLC given is bigger than 8 bytes, or smaller than 0. Function returned: -- %d --.", Error);
    return Error;
  }

  //The channel number must be between 1 and 32
  if ((aCANChannel > cc_wMaxCANChannel) || (aCANChannel < cc_eCAN_ONE))
  {
    if((byte)DebugFuncInternal & bDebugFlag)
      writeDbgLevel (DebugFuncInternal, "The CAN channel number is not in the given range (1-32). Function returned: -- %d --.", Error);
    return Error;
  }
  
  //Variables that stored the number of full messages send with aDataLengthOfMessage bytes
  qwNoSplitIndividualMessages = elCount (aBytesToBeSend) / aDataLengthOfMessage;
  //Store the last message DLC
  bLastMessageDLC = elCount (aBytesToBeSend) % aDataLengthOfMessage;
  
  //The individual messages with aDataLengthOfMessage number of bytes are formed and send
  for (qwPosOfBytesMsgForm = 0; qwPosOfBytesMsgForm <= qwNoSplitIndividualMessages; qwPosOfBytesMsgForm++)
  {
    if (qwPosOfBytesMsgForm < qwNoSplitIndividualMessages)
    {
      //Form the messages to be sent
      wCopiedElements = wFctn_CONV_CopyByteArrayToByteArray (aBytesToBeSend ,qwPosOfBytesMsgForm * aDataLengthOfMessage, aDataLengthOfMessage, bArrayToBeFormed  );
        
      //if an error occurs on copy function reports the problem
      if (NotOk == wCopiedElements)
      {
        if((byte)DebugFuncInternal & bDebugFlag)
          writeDbgLevel (DebugFuncInternal, "Warning! An error occured while tring to form the messages to be sent. Possibly loss of data.");
      }
        
      //Send the individual messages
      lReturn_SendMessage = lFctn_CAN_SendMessage(aMsgID[qwMsgIDPos], bArrayToBeFormed, aDataLengthOfMessage, aCANChannel);
      
      //if an error occurs reports the problem
      if (Error == lReturn_SendMessage)
      {
        if((byte)DebugFuncInternal & bDebugFlag)
          writeDbgLevel (DebugFuncInternal, "Error! The message could not be sent.");
        return NotOk;
      }
          
      //if time to wait is different than zero and it is not the last frame to be send, wait the given time
      if ((0 != aTimeBetweenFrames)
         &&((0 != bLastMessageDLC)
         ||(qwPosOfBytesMsgForm != (qwNoSplitIndividualMessages-1))))
      {
        testWaitForTimeout(aTimeBetweenFrames);
      }
          
      //Handles the array of messages 
      if ((elCount(aMsgID) -1 ) == qwMsgIDPos)
      {
        qwMsgIDPos = 0;
      }
      else
      {
        qwMsgIDPos++;
      }
    }
    else //Verify if there are still remaining bytes to be send
    {
      //The individual message with less aDataLengthOfMessage number of bytes is formed and send
      if (0 != bLastMessageDLC)
      {
        //Form the message to be sent
        wCopiedElements = wFctn_CONV_CopyByteArrayToByteArray (aBytesToBeSend ,qwPosOfBytesMsgForm * aDataLengthOfMessage,  bLastMessageDLC, bArrayToBeFormed);
            
        //if an error occurs on copy function reports the problem
        if (NotOk == wCopiedElements)
        {
          if((byte)DebugFuncInternal & bDebugFlag)
            writeDbgLevel (DebugFuncInternal, "Warning! An error occured while tring to form the messages to be sent. Possibly loss of data.");
        }
            
        //Send the message
        lReturn_SendMessage = lFctn_CAN_SendMessage(aMsgID[qwMsgIDPos], bArrayToBeFormed, bLastMessageDLC, aCANChannel );
            
        //if a error occurs reports the problem
        if (Error == lReturn_SendMessage)
        {
          if((byte)DebugFuncInternal & bDebugFlag)
            writeDbgLevel (DebugFuncInternal, "Error! The message could not be sent.");
          return NotOk;
        }
      }
    }
  }
  
  //return the status of function execution
  if((byte)DebugFuncInternal & bDebugFlag)
    writeDbgLevel (DebugFuncInternal, "Function iFctn_CAN_SendBurstMessage lReturn_SendMessage -- %d --.", lReturn_SendMessage);
  return lReturn_SendMessage;
}

/*! \fn byte bFctn_CAN_DeleteLog (char aFilePath[])
*  \brief Function delete a log file
*  \param[in] aFilePath - The file path to the log results
*
*  \return 1 (Ok) - if the log file could be deleted
*  \return 0 (NotOk) - if the log file could not be deleted
*
*  \note 
*         - To start to logg information, first call the  function A_CAN_StartLoggingMessages.
*  \note 
*          - Use File path like: C:\\Test\\LogMessages.csv.
*
* Change History: 
* Date(DD.MM.YY)        Author          Change info                                                          
*   
*  06.07.18              GrAn        Created and implemented
*  16.10.18              GrAn        Add the close of command line window after the file is deleted.
*  19.11.18              GrAn        Remove open and close procedure part.
*  16.09.19              CrJu        Added new debug levels.
*/

byte bFctn_CAN_DeleteLog (char aFilePath[])
{
  byte bResult;
  byte bDebugFlag;
  char chSendText[200];
  
  //Initialization of local variables
  bResult = NotOk;
  bDebugFlag = cc_bCAN_GlobalDebugFlag;
  
  writeDbgLevel (DebugFuncCalls, "Function bFctn_CAN_DeleteLog called.");
  
  if ((byte)DebugFuncParam & bDebugFlag)
    writeDbgLevel (DebugFuncParam, "Parameters: char aFilePath[] --%s-- ", aFilePath);
  
  //reset local string which will store the command part
  snprintf(chSendText, elcount(chSendText), "");
  
  //Add to text send to command line the close window command and the file path
  strncat(chSendText, aFilePath, elcount(aFilePath));
  strncat(chSendText, " &exit", elcount(aFilePath) + elcount(" &exit"));
  
  //Execute delete file command and close window from command line
  //1 - if the command was successfully started, else 0.
  bResult = sysExecCmd("del", chSendText);
  
  if ((byte)DebugFuncInternal & bDebugFlag)
    writeDbgLevel (DebugFuncInternal, "Function bFctn_CAN_DeleteLog bResult -- %d --.", bResult);
  
  return bResult;
}


/*! \fn int iFctn_CAN_StartLoggingMessages(dword aArrayMessageIDs[], byte aChannelNumber, int64 aNumberOfLogEntries, char aStartLoggingMsgInfo[])
*  \brief Function that enables the CAN Message Logging functionality, based on a specified filter (MsgID's and ChannelNr).
*  \param[in]   aArrayMessageIDs      - Array with the Message ID's which are going to be logged (if first element of the array is 0, all messages are logged).
*  \param[in]   aChannelNumber        - The channel/cluster number where the message(s) is expected to arrive (if 0, it will log every occurrence of the MsgID, regardless of the cluster it arrives).
*  \param[in]   aNumberOfLogEntries   - The maximum number of how many message(s) log entries is expected to arrive ( > 0 and recommended to not go over 500.000 as it could influence the environment and memory allocation).
*  \param[out]  aStartLoggingMsgInfo  - Extra information regarding the function output (displayed in the test report).
* 
*  \return  0   - Invalid MsgIDs within the array.
*  \return  1   - Successfully enabled the logging mechanism and valid parameters were provided.
*  \return  -1  - Error, could not enable the logging mechanism (already enabled or expected log entries is 0) or another error occurred.
*
*  \note
*   - Even though dynamic memory allocation is used for the buffer structure array, a limit of maximum: 500.000 entries should suffice in order to avoid excessive memory allocation. \n
*
* Change History: 
* Date(DD.MM.YY)        Author          Change info                                                          
* 02.04.19              RoBi            Created and implemented
*/

int iFctn_CAN_StartLoggingMessages(dword aArrayMessageIDs[], byte aChannelNumber, int64 aNumberOfLogEntries, char aStartLoggingMsgInfo[])
{
  int iReturnValue;
  byte bDebugFlag;
  word wIndexCopyMsgIDs;
  
  iReturnValue = Ok;
  bDebugFlag = cc_bCAN_GlobalDebugFlag;
  
  writeDbgLevel (DebugFuncCalls, "Function iFctn_CAN_StartLoggingMessages() called.");
  
  // Check if logging functionality is not already enabled AND if expected number of log entries is > 0
  if ( (0 == cv_bCAN_LoggingStatus && 0 == cv_i64CAN_LoggingBufferIndex && 0 == cv_strCAN_MessageLoggingBuffer.size())
    && (0 < aNumberOfLogEntries) )
  {
    // Populate the global array with the MessageID's which are going to be logged (if first element is 0, log all messages)
    for (wIndexCopyMsgIDs = 0; wIndexCopyMsgIDs < elcount(aArrayMessageIDs); wIndexCopyMsgIDs++)
    {
      if ( 0 < aArrayMessageIDs[wIndexCopyMsgIDs] )
        cv_dwCAN_LogMessageIDsArray[aArrayMessageIDs[wIndexCopyMsgIDs]] = aArrayMessageIDs[wIndexCopyMsgIDs];
      else if ( 0 == wIndexCopyMsgIDs && 0 == aArrayMessageIDs[0] ) // If first element of the array is 0, don't continue copying as all messages are going to be logged
      { // Copy only the first element into the global array, as it means that all messages will be logged
        cv_dwCAN_LogMessageIDsArray[aArrayMessageIDs[wIndexCopyMsgIDs]] = aArrayMessageIDs[wIndexCopyMsgIDs];
        break;
      }
      else // Invalid MessageID number, 0 is not identified as first array element
      {
        snprintf(aStartLoggingMsgInfo, elCount(aStartLoggingMsgInfo), "MsgID: %d, specified in message filter array, on position: %d, is incorrect. 0 is allowed only on 1st position.", aArrayMessageIDs[wIndexCopyMsgIDs], wIndexCopyMsgIDs);
        if ( (byte)DebugFuncInternal & bDebugFlag )
          writeDbgLevel(DebugFuncInternal, aStartLoggingMsgInfo);
        cv_dwCAN_LogMessageIDsArray.clear(); // free any memory allocated
        iReturnValue = NotOk;
        break;
      }
    }
    
    // Proceed only if correct MessageID's were provided
    if ( Ok == iReturnValue ) 
    { 
      // Init the rest of the global variables and prepare the structure to start logging
      cv_i64CAN_LoggingBufferIndex = 0; // Logging buffer Index, used to insert data in the structure
      cv_bCAN_LogChannelNr = aChannelNumber; // Global channel number used (if 0, log all MessageID(s), regardless of which cluster they arrive)
      cv_i64CAN_ExpectedNumberOfLogEntries = aNumberOfLogEntries; // Global maximum expected number of logged MessageID(s) arrival
      cv_strCAN_MessageLoggingBuffer.clear(); // To be sure the structure is empty, clear any previously allocated memory 
      cv_bCAN_LoggingStatus = 1; // Global status of the logging mechanism: 0 - Disabled, 1 - Enabled
      
      snprintf(aStartLoggingMsgInfo, elCount(aStartLoggingMsgInfo), "CAN Logging Started. Expecting:%I64u arrivals, for the specified MessageID(s), on Channel: %d(if 0, log all).", aNumberOfLogEntries, aChannelNumber);
      if ( (byte)DebugFuncInternal & bDebugFlag )
        writeDbgLevel(DebugFuncInternal, aStartLoggingMsgInfo);
      // iReturnValue = Ok; // already set on this value, at init step
    }
  }
  else // Logging is already enabled or expected log entries is 0
  {
    snprintf(aStartLoggingMsgInfo, elCount(aStartLoggingMsgInfo), "Logging functionality is already enabled(use A_CAN_StopLoggingMessages() to stop and save the logged content) or expected aNumberOfLogEntries is < 1.");
    if ( (byte)DebugFuncInternal & bDebugFlag )
      writeDbgLevel(DebugFuncInternal, aStartLoggingMsgInfo);
    iReturnValue = Error;
  }
  
  if ( (byte)DebugFuncInternal & bDebugFlag )
    writeDbgLevel (DebugFuncInternal, "iFctn_CAN_StartLoggingMessages() return: %i.", iReturnValue);
  
  return iReturnValue;
}


/*! \fn int iFctn_CAN_StopLoggingMessages(struct cv_strCAN_LoggingBuffer aStrArrayToSaveLoggedData[], int64 &aNumberOfMessagesLogged, char aStopLoggingMsgInfo[])
*  \brief Function that disables the CAN message logging mechanism (disabling the logging functionality is only possible if it has been previously enabled).
*  \param[in]   aStrArrayToSaveLoggedData - Structure where the logged data is dumped from the back-end buffer.
*  \param[out]  aNumberOfMessagesLogged   - Number of messages logged and copied within the provided output structure.
*  \param[out]  aStopLoggingMsgInfo       - Extra information regarding the function output (displayed in the test report).
* 
*  \return  0   - Provided output structure is not large enough.
*  \return  1   - Successfully disabled the CAN message logging mechanism and copied the buffer data to the provided output structure.
*  \return  -1  - Error, logging was not previously enabled, there is no data logged in the buffer or an inconsistency exists between the buffer index and structure size.
*
*  \note
*   - Disabling is successfully done only if it was previously enabled, provided output structure is large enough and number of frames logged is > 0.
*
* Change History: 
* Date(DD.MM.YY)        Author          Change info                                                          
* 02.04.19              RoBi            Created and implemented
*/

int iFctn_CAN_StopLoggingMessages(struct cv_strCAN_LoggingBuffer aStrArrayToSaveLoggedData[], int64 &aNumberOfMessagesLogged, char aStopLoggingMsgInfo[])
{
  int iReturnValue;
  byte bDebugFlag;
  qword qwIndexCopyBufferData;
  byte bPayloadIndex;
  
  iReturnValue = NotOk;
  bDebugFlag = cc_bCAN_GlobalDebugFlag;
  qwIndexCopyBufferData = 0;
  aNumberOfMessagesLogged = 0;
  
  writeDbgLevel (DebugFuncCalls, "Function iFctn_CAN_StopLoggingMessages() called.");
  
  // Regardless if logging functionality is currently enabled/disabled there should exist data within the buffer
  if ( 0 < cv_i64CAN_LoggingBufferIndex && cv_i64CAN_LoggingBufferIndex == cv_strCAN_MessageLoggingBuffer.size())
  {
    // Check if the provided output structure is large enough
    if ( elCount(aStrArrayToSaveLoggedData) >= cv_i64CAN_LoggingBufferIndex )
    {
      // Store the total number of logged messages
      aNumberOfMessagesLogged = cv_i64CAN_LoggingBufferIndex;

      for ( int64 i64BufferIndex: cv_strCAN_MessageLoggingBuffer )
      {
        // Copy the logged data from the buffer into to the output structure
        aStrArrayToSaveLoggedData[qwIndexCopyBufferData].cv_dwCAN_MessageID = cv_strCAN_MessageLoggingBuffer[i64BufferIndex].cv_dwCAN_MessageID;
        aStrArrayToSaveLoggedData[qwIndexCopyBufferData].cv_bCAN_Channel = cv_strCAN_MessageLoggingBuffer[i64BufferIndex].cv_bCAN_Channel;
        aStrArrayToSaveLoggedData[qwIndexCopyBufferData].cv_i64CAN_TimeStamp = cv_strCAN_MessageLoggingBuffer[i64BufferIndex].cv_i64CAN_TimeStamp;
        aStrArrayToSaveLoggedData[qwIndexCopyBufferData].cv_bCAN_DLC = cv_strCAN_MessageLoggingBuffer[i64BufferIndex].cv_bCAN_DLC;
        // Copy the payload data
        for(bPayloadIndex = 0; bPayloadIndex < cv_strCAN_MessageLoggingBuffer[i64BufferIndex].cv_bCAN_DLC; bPayloadIndex++)
          aStrArrayToSaveLoggedData[qwIndexCopyBufferData].cv_bCAN_PayloadData[bPayloadIndex] = cv_strCAN_MessageLoggingBuffer[i64BufferIndex].cv_bCAN_PayloadData[bPayloadIndex];
        
        qwIndexCopyBufferData++;
      }
      
      snprintf(aStopLoggingMsgInfo, elCount(aStopLoggingMsgInfo), "Successfully stopped CAN Message logging. Copied: %I64d log entries to the provided output structure array.", cv_i64CAN_LoggingBufferIndex);
      if ( (byte)DebugFuncInternal & bDebugFlag )
        writeDbgLevel(DebugFuncInternal, aStopLoggingMsgInfo);
      iReturnValue = Ok;
    }
    else // Provided structure is not large enough
    {
      snprintf(aStopLoggingMsgInfo, elCount(aStopLoggingMsgInfo), "Provided output structure size: %ld, is not large enough. Need at least: %I64d.", elCount(aStrArrayToSaveLoggedData), cv_i64CAN_LoggingBufferIndex);
      if ( (byte)DebugFuncInternal & bDebugFlag )
        writeDbgLevel(DebugFuncInternal, aStopLoggingMsgInfo);
      iReturnValue = NotOk;
    }
  }
  else // There is no data in the buffer to copy to the output structure
  {
    snprintf(aStopLoggingMsgInfo, elCount(aStopLoggingMsgInfo), "There is no data logged in the buffer or an inconsistency exists between the buffer index and structure size.");
    if ( (byte)DebugFuncInternal & bDebugFlag )
      writeDbgLevel(DebugFuncInternal, aStopLoggingMsgInfo);
    iReturnValue = Error;
  }
  
  // Free up any allocated memory and set the global variables to init values
  cv_strCAN_MessageLoggingBuffer.clear();
  cv_dwCAN_LogMessageIDsArray.clear();
  cv_i64CAN_LoggingBufferIndex = 0;
  cv_bCAN_LoggingStatus = 0;
  cv_bCAN_LogChannelNr = 0;
  cv_i64CAN_ExpectedNumberOfLogEntries = 0;
  
  if ( (byte)DebugFuncInternal & bDebugFlag )
    writeDbgLevel (DebugFuncInternal, "iFctn_CAN_StopLoggingMessages() return: %i.", iReturnValue);
  
  return iReturnValue;
}


/* on message *
*  This function is used to intercept all messages from the CAN BUS and based on a message filter, it stores their data in a structure which serves as a container.
*
*
* Change History: 
* Date(DD.MM.YY)        Author          Change info                                                          
* 02.04.19              RoBi            Created and implemented
*/
on message *
{
  byte bPayloadIndex;

  // Check if logging is active
  if ( 1 == cv_bCAN_LoggingStatus )
  {
    // Filter conditions (based on these, it is decided if the arrived message is saved within the log buffer or not)
    if ( (cv_dwCAN_LogMessageIDsArray.containsKey(0) || cv_dwCAN_LogMessageIDsArray.containsKey(this.id)) // log all MsgIDs if first element is 0 OR check if the ID of the arrived message is present within the filter array
      && (0 == cv_bCAN_LogChannelNr || this.msgChannel == cv_bCAN_LogChannelNr) )// if channel is 0 log all clusters OR if cluster is as expected
    {
      // Insert Message data into the log buffer
      cv_strCAN_MessageLoggingBuffer[cv_i64CAN_LoggingBufferIndex].cv_dwCAN_MessageID = this.id;
      cv_strCAN_MessageLoggingBuffer[cv_i64CAN_LoggingBufferIndex].cv_bCAN_Channel = this.msgChannel;
      cv_strCAN_MessageLoggingBuffer[cv_i64CAN_LoggingBufferIndex].cv_i64CAN_TimeStamp = this.time_ns / 1000;
      cv_strCAN_MessageLoggingBuffer[cv_i64CAN_LoggingBufferIndex].cv_bCAN_DLC = this.dlc;
      // Copy the payload data
      for(bPayloadIndex = 0; bPayloadIndex < this.dlc; bPayloadIndex++)
        cv_strCAN_MessageLoggingBuffer[cv_i64CAN_LoggingBufferIndex].cv_bCAN_PayloadData[bPayloadIndex] = this.byte(bPayloadIndex);
      
      // Increment the buffer index
      cv_i64CAN_LoggingBufferIndex++;
      
      // Check if the number of specified expected Log Entries has been reached and automatically stop the logging functionality
      if ( cv_i64CAN_LoggingBufferIndex >= cv_i64CAN_ExpectedNumberOfLogEntries )
        cv_bCAN_LoggingStatus = 0; // Stop Logging
      
      // Debug:
      //write("Logging: %I64d out of %I64u", cv_i64CAN_LoggingBufferIndex, cv_i64CAN_ExpectedNumberOfLogEntries);
      //write("Time: %I64d, Channel: %d, ID: %d, DLC: %d", this.time_ns / 1000, this.msgChannel, this.id, this.dlc);
    }
  }
}

/*! \fn int iFctn_CAN_SaveLogDataToCSVFile(char aAbsoluteCSVFilePath[], struct cv_strCAN_LoggingBuffer aLogDataToSaveInCSV[], int64 aNrOfLogEntriesToWriteInCSV, char aSaveLogDataInfo[])
*  \brief Function that saves in a CSV file, the specified number of log entries from the already populated CAL message log structure.
*  \param[in]   aAbsoluteCSVFilePath        - The absolute path to the CSV file. Only .csv extension allowed (Example: C:\\UserName\\Desktop\\MyLogFile.csv).
*  \param[in]   aLogDataToSaveInCSV         - Structure from where the specified CAN message log entries are extracted and written in the CSV file (has to be already populated using: A_CAN_StartLoggingMessages() and A_CAN_StopLoggingMessages()).
*  \param[in]   aNrOfLogEntriesToWriteInCSV - Number of log entries to be written in the CSV file (cannot be 0 or larger than the total size of the array structure: aLogDataToSaveInCSV).
*  \param[out]  aSaveLogDataInfo            - Extra information regarding the function output (displayed in the test report).
* 
*  \return  0   - Incorrect parameters: Structure is empty or smaller than the log entries to copy, path is not absolute or file extension is not .csv.
*  \return  1   - Successfully saved the requested number of log entries, in the CSV file.
*  \return  -1  - Error, cannot write to the CSV file, conversion function failed
*
* Change History: 
* Date(DD.MM.YY)        Author          Change info                                                          
* 02.04.19              RoBi            Created and implemented
*/

int iFctn_CAN_SaveLogDataToCSVFile(char aAbsoluteCSVFilePath[], struct cv_strCAN_LoggingBuffer aLogDataToSaveInCSV[], int64 aNrOfLogEntriesToWriteInCSV, char aSaveLogDataInfo[])
{
  int iReturnValue;
  byte bDebugFlag;
  char chExtractedFileName[250];
  char chRegEx_ExtensionCSV[50] = "^\\w+.*\\.(csv|CSV|Csv|cSv|csV|CSv|cSV|CsV)$";
  dword dwFileHandler;
  int64 i64StrIndex;
  char chTimeStamp[25], chChannel[5], chMsgID[5], chDLC[5], chPayloadData[770];
  byte bResult_ArrayConversion;
  
  iReturnValue = Ok;
  bDebugFlag = cc_bCAN_GlobalDebugFlag;
  dwFileHandler = 0;
  i64StrIndex = 0;
  bResult_ArrayConversion = 0;
  
  writeDbgLevel (DebugFuncCalls, "Function iFctn_CAN_SaveLogDataToCSVFile() called.");
  if ( (byte)DebugFuncParam & bDebugFlag )
    writeDbgLevel (DebugFuncParam, "Parameters: int64 aNrOfLogEntriesToWriteInCSV: --%I64d--, char aAbsoluteCSVFilePath[] --%s--.", aNrOfLogEntriesToWriteInCSV, aAbsoluteCSVFilePath);

  // Check if valid parameters have been provided
  if ( ((aNrOfLogEntriesToWriteInCSV <= elcount(aLogDataToSaveInCSV)) && (0 < aNrOfLogEntriesToWriteInCSV)) // Specified number of log entries is not larger than the total size of the structure
    && (1 == bFctn_READFILEExtractFileName(aAbsoluteCSVFilePath, chExtractedFileName)) // Check if file name is provided and extract it to check its extension
    && (1 == str_match_regex(chExtractedFileName, chRegEx_ExtensionCSV)) // Check if valid .csv file extension is provided
    && (0 < aLogDataToSaveInCSV[0].cv_i64CAN_TimeStamp && 0 < aLogDataToSaveInCSV[0].cv_dwCAN_MessageID && 0 < aLogDataToSaveInCSV[0].cv_bCAN_DLC) ) // at least 1st element needs to be valid
  {
    // Write the column headers in the CSV file
    dwFileHandler = bFctn_READFILEPutStringInAFile(aAbsoluteCSVFilePath, "Time Stamp", 1, dwFileHandler); // store the file handler only once
    if ( 0 < dwFileHandler // File is kept open, therefore the file handler will not change
      && dwFileHandler == bFctn_READFILEPutStringInAFile(aAbsoluteCSVFilePath, "Channel", 1, dwFileHandler)
      && dwFileHandler == bFctn_READFILEPutStringInAFile(aAbsoluteCSVFilePath, "Message ID", 1, dwFileHandler)
      && dwFileHandler == bFctn_READFILEPutStringInAFile(aAbsoluteCSVFilePath, "DLC", 1, dwFileHandler)
      && dwFileHandler == bFctn_READFILEPutStringInAFile(aAbsoluteCSVFilePath, "Payload Data\n", 1, dwFileHandler) )
    {
      // Loop through the specified number of structure elements and write them in the CSV file
      for (i64StrIndex = 0; i64StrIndex < aNrOfLogEntriesToWriteInCSV; i64StrIndex++)
      {
        // Convert numeric values to decimal string, in order to write it individually in the CSV file 
        ltoa(aLogDataToSaveInCSV[i64StrIndex].cv_i64CAN_TimeStamp, chTimeStamp, 10);
        ltoa(aLogDataToSaveInCSV[i64StrIndex].cv_bCAN_Channel, chChannel, 10);
        ltoa(aLogDataToSaveInCSV[i64StrIndex].cv_dwCAN_MessageID, chMsgID, 16);
        ltoa(aLogDataToSaveInCSV[i64StrIndex].cv_bCAN_DLC, chDLC, 10);
        bResult_ArrayConversion = bFctn_CONV_ConvertByteArrayToStringByDLC(aLogDataToSaveInCSV[i64StrIndex].cv_bCAN_PayloadData, chPayloadData, aLogDataToSaveInCSV[i64StrIndex].cv_bCAN_DLC);
        
        // Write the converted numeric values in the CSV file
        if ( 1 == bResult_ArrayConversion // Convert/Prepare payload data in order to be written in the CSV file
          && dwFileHandler == bFctn_READFILEPutStringInAFile(aAbsoluteCSVFilePath, chTimeStamp, 1, dwFileHandler) // Write the time stamp
          && dwFileHandler == bFctn_READFILEPutStringInAFile(aAbsoluteCSVFilePath, chChannel, 1, dwFileHandler) // Write cluster number: 1, 2, 3, etc.
          && dwFileHandler == bFctn_READFILEPutStringInAFile(aAbsoluteCSVFilePath, chMsgID, 1, dwFileHandler) // Write the Message ID
          && dwFileHandler == bFctn_READFILEPutStringInAFile(aAbsoluteCSVFilePath, chDLC, 1, dwFileHandler) // Write the payload length
          && dwFileHandler == bFctn_READFILEPutStringInAFile(aAbsoluteCSVFilePath, chPayloadData, 1, dwFileHandler) // Write payload data
          && dwFileHandler == bFctn_READFILEPutStringInAFile(aAbsoluteCSVFilePath, "\n", 1, dwFileHandler) ) // Insert new line(\n) at the end of the payload data (next time something is written in the file, it starts on a new line)
        {
          // The current structure element data is successfully written in the file
          if ( (byte)DebugFuncInternal & bDebugFlag )
            writeDbgLevel(DebugFuncInternal, "Successfully written in the CSV file, data of structure element: %I64d.", i64StrIndex);
        }
        else // Something went wrong, conversion function failed or could not write content in the CSV file
        {
          snprintf(aSaveLogDataInfo, elCount(aSaveLogDataInfo), "Write iteration for structure element: %I64d has failed. Cannot write to the CSV file (payload array conversion function returned: %d).", i64StrIndex, bResult_ArrayConversion);
          if ( (byte)DebugFuncInternal & bDebugFlag )
            writeDbgLevel(DebugFuncInternal, "Loop iteration / Structure element: %I64d \nchTimeStamp: %s \nchChannel: %s \nchMessageID: %s \nchDLC: %s \nchPayloadData: %s", i64StrIndex, chTimeStamp, chChannel, chMsgID, chDLC, chPayloadData);
          iReturnValue = Error;
          break;
        }
      }
      
      // All requested log entries data has been successfully written to the CSV file
      if ( Ok == iReturnValue )
      {
        snprintf(aSaveLogDataInfo, elCount(aSaveLogDataInfo), "Successfully saved: %I64d CAN message log entries, to the specified path, in file: %s.", aNrOfLogEntriesToWriteInCSV, chExtractedFileName);
        if ( (byte)DebugFuncInternal & bDebugFlag )
          writeDbgLevel(DebugFuncInternal, aSaveLogDataInfo);
        iReturnValue = Ok;
      }
      else {} // Data was partially written/saved or not at all, in the CSV file (return value, report message and debug message are already set in the for loop)
    }
    else // Could not write the column header to the CSV file
    {
      snprintf(aSaveLogDataInfo, elCount(aSaveLogDataInfo), "Make sure the CSV file is closed. Could not write the column headers in the provided CSV File: %s.", chExtractedFileName);
      if ( (byte)DebugFuncInternal & bDebugFlag )
        writeDbgLevel(DebugFuncInternal, aSaveLogDataInfo);
      iReturnValue = Error;
    }
  }
  else // Parameter constraints are not respected
  {
    snprintf(aSaveLogDataInfo, elCount(aSaveLogDataInfo), "Check parameters: Structure may be empty, structure is smaller than the log entries to copy, path is not absolute or file extension is not .csv.");
    if ( (byte)DebugFuncInternal & bDebugFlag )
      writeDbgLevel(DebugFuncInternal, aSaveLogDataInfo);
    iReturnValue = NotOk;
  }
  
  // Close the file, regardless if the write action was successfully executed or not
  fileClose(dwFileHandler);
  
  if ( (byte)DebugFuncInternal & bDebugFlag )
    writeDbgLevel (DebugFuncInternal, "iFctn_CAN_SaveLogDataToCSVFile() return: %i.", iReturnValue);
  
  return iReturnValue;
}

/*! @}*/
/*! @}*/
/*!
*   \file
*   \ingroup controlLib
*   \brief Basic CAN functions that use CAPL primitive functions.
*/