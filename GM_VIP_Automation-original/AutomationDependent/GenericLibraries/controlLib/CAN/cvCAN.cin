/*@!Encoding:1252*/
/*!
* @defgroup cvCAN cvCAN
* @defgroup CAN CAN
* @ingroup controlLib
* @{
* @addtogroup cvCAN
* @{
*/ 

includes
{
  #include "ccCAN.cin"
}

variables
{
  // Structure definition, used to store the message logged data
  struct cv_strCAN_LoggingBuffer 
  {
    int64 cv_i64CAN_TimeStamp;
    dword cv_dwCAN_MessageID;
    byte cv_bCAN_Channel;
    byte cv_bCAN_DLC;
    byte cv_bCAN_PayloadData[64];
  } cv_strCAN_MessageLoggingBuffer[int64]; // Using CAPL associative fields/arrays property, dynamically define a structure instance
  
  // Logging buffer Index, used to insert data in the structure
  int64 cv_i64CAN_LoggingBufferIndex = 0;
  // Global status of the logging mechanism: 0 - Disabled, 1 - Enabled
  byte cv_bCAN_LoggingStatus = 0;
  // Global array with the MessageID's which are going to be logged (if first element is 0, log all messages)
  dword cv_dwCAN_LogMessageIDsArray[long]; // linked to: word aArrayMessageIDs[]
  // Global cluster number used (if 0, log array MessageID(s), regardless of which channel they arrive)
  byte cv_bCAN_LogChannelNr = 0; // linked to: byte aChannelNumber
  // Global maximum expected number of Message(s) ID arrival
  int64 cv_i64CAN_ExpectedNumberOfLogEntries = 0; // linked to: int64 aNumberOfLogEntries
}


/*! @}*/
/*! @}*/
/*!
*   \file
*   \ingroup controlLib
*   \brief Library for handling global variables needed for CAN Communication functions.

*/