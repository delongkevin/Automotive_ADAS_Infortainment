/*@!Encoding:1252*/
/*!
* @defgroup cCONVDataConversion cCONVDataConversion
* @defgroup DATA_CONVERSION DATA_CONVERSION
* @ingroup controlLib
* @{
* @addtogroup cCONVDataConversion
* @{
*/

includes
{
  #include "ccCONVDataConversion.cin"
}

/*! \fn byte bFctn_CONV_ConvertDiagReqToString(diagRequest *aDiagReq, char aStringOutput[])
*  \brief Function that converts BCD values coded with four bits each to a string (character array) that is suitable for printing (NOTE: Function overloading)
*  \param[in]  aDiagReq 			- Diagnostic request will be converted to string.
*  \param[out] aStringOutput 	- The string output resulted from the conversion.
* 
*  \return  0 - Not ok, conversion failed.
*  \return  1 - Ok, conversion succesfully done.
*
*  \note
*       -Example: aDiagReq: 0x10 01 is converted to aStringOutput: 0x10 01
*
* Change History: 
* Date(DD.MM.YY)        Author          Change info                                                          
*  
*  09.06.11             VS/dsa          First Revision.
*  04.07.18             RoBi            Refactoring code.
*  26.11.18             RoBi            Changed data type of Index, from int(signed) to word(unsigned).
*  20.07.20             CrJu            In case of a smaller output string, the conversion will be until the length of the output string.
*/

byte bFctn_CONV_ConvertDiagReqToString(diagRequest *aDiagReq, char aStringOutput[])
{
  byte bDebugFlag;
  byte bPrimitiveRaw[4095];
  char chTempText[50];
  long lSize;
  word wIndex;
  byte bResult;
  
  bResult = NotOk;
  bDebugFlag = ccCONV_GlobalDebugFlag;
  
  writeDbgLevel(DebugFuncCalls, "Function bFctn_CONV_ConvertDiagReqToString() called.");
  
  // Get the number of bytes of the request
  lSize = DiagGetPrimitiveData(aDiagReq, bPrimitiveRaw, elcount(bPrimitiveRaw));
  
  // Clear any previous existing data in the provided array
  snprintf(aStringOutput, elcount(aStringOutput), "");

  // Check if the complete Diag Request will fit within the provided output string array
  if( cc_eCONV_ZERO <= lSize )
  {
    //Check if the size of the request is bigger than the output string
    if( lSize > (elCount(aStringOutput)-2))
    {
      //Make conversion for only the number of elements that contain the output string
      lSize = elCount(aStringOutput)-2;
    }
    
    // Insert a hex prefix at the beginning of the request: 0x
    snprintf(aStringOutput, elcount(aStringOutput),"0x");
    
    // Proceed to convert the request and store it within the output string array
    for(wIndex = cc_eCONV_ZERO; wIndex < lSize; wIndex++)
    {
      if ( wIndex == (lSize - 1) )
        snprintf(chTempText,elcount(chTempText),"%02X", bPrimitiveRaw[wIndex]);
      else
        snprintf(chTempText,elcount(chTempText),"%02X ", bPrimitiveRaw[wIndex]);
      
      strncat(aStringOutput, chTempText, elcount(aStringOutput));
    }
    
    if ( (byte)DebugFuncInternal & bDebugFlag)
      writeDbgLevel(DebugFuncInternal, "Size correct: %d. Finished processing the array.", lSize);
    bResult = Ok;
  }
  else
  {
    if ( (byte)DebugFuncInternal & bDebugFlag)
      writeDbgLevel(DebugFuncInternal, "An error code appeared: %d. Check it from documentation of 'DiagGetPrimitiveData' function.", lSize);
    bResult = NotOk;
  }
  
   return bResult;
}


/*! \fn byte bFctn_CONV_ConvertByteArrayToString(byte aRawData[],  char aOutHexStr[])
*  \brief 	Converts byte array to a hex encoded strings array.
*  \param[in]  aRawData 		- A byte array the will be converted into a hex string.
*  \param[out] aOutHexStr 	- A char array that upon success will contain the converted Hex string(The length must be at least elCount(aRawData)*3).
* 
*  \note
*       -Example: aRawData: 0xAA, 0xBB, 0xCC is converted to aOutHexStr: AA BB CC
*
*  \return  0 - Not ok, conversion failed.
*  \return  1 - Ok, conversion succesfully done.
* Change History: 
* Date(DD.MM.YY)        Author          Change info                                                          
*  
*  25.05.08             AEE/jml         First Revision.
*  13.07.18             RoBi            Refactoring code.
*  26.07.19             CrJu            Added a new condition, in order to convert the all byte array.
*/

byte bFctn_CONV_ConvertByteArrayToString(byte aRawData[], char aOutHexStr[])
{
  byte bDebugFlag;
  qword qwIndex;
  qword qwHexLength;
  qword qwByteArrIndex;
  byte bTempVal;
  byte bFlagInsertSpace;
  byte bResult;
  char chTempStr[10];
   
  bFlagInsertSpace = cc_eCONV_ZERO; // init with adding whitespace disabled
  bResult = NotOk;   // init with conversion failed
  bDebugFlag = ccCONV_GlobalDebugFlag;
  
  writeDbgLevel(DebugFuncCalls, "Function bFctn_CONV_ConvertByteArrayToString() called.");

  // Reset output array
  for (qwIndex = 0; qwIndex < elcount(aOutHexStr); qwIndex++)
  {
    aOutHexStr[qwIndex] = 0;
  }
   
  // get the hex length
  qwHexLength = elcount(aRawData) * 2;

  //check that the supplied output array can hold the hex string 
  if ( elcount(aOutHexStr) < (elCount(aRawData)* 3))
  {
    if ( (byte)DebugFuncInternal & bDebugFlag)
      writeDbgLevel(DebugFuncInternal, "ERROR: Char array too small, Hex Data is %lld but aOutHexStr only contains %d elements!", qwHexLength, elcount(aOutHexStr));
    bResult = NotOk;
  }
  else 
  {
    //All checks went fine, convert data
    for (qwIndex = 0; qwIndex < qwHexLength; qwIndex++)
    {
      // The byte index to use for accessing aRawData
      qwByteArrIndex = qwIndex / 2;

      // Use the modulo operator % to check if this is an even or odd iteration
      // For even iterations just shift the most significant four bits four positions to the right
      // For odd iterations filter out the least significant four bits, no shift needed
      if (0 == (qwIndex % 2))
      {
        bTempVal = (long)(aRawData[qwByteArrIndex] >> 4);
      }
      else
      {
        bTempVal = (long)(aRawData[qwByteArrIndex] & 0x0F);
      }
	    // Debug purpose
      //writeDbgLevel(DebugFuncInternal,"bFctn_CONV_ConvertByteArrayToString(): aRawData = %X", aRawData[wByteArrIndex]);
      //writeDbgLevel(DebugFuncInternal,"bFctn_CONV_ConvertByteArrayToString(): bTempVal = %X", bTempVal);

       // Convert value to a temp string and add space between bytes ( example: byte1(00)"whitespace"byte2(FF) )
	    if ( cc_eCONV_ZERO == bFlagInsertSpace || qwIndex == (qwHexLength - 1))
	    {
		    // don't insert white space
		    snprintf( chTempStr, elcount(chTempStr), "%X", bTempVal );
		    bFlagInsertSpace = 1;
	    }
	    else
	    {
        // insert a space between bytes
        snprintf( chTempStr, elcount(chTempStr), "%X ", bTempVal );
        bFlagInsertSpace = 0;
      }
      
      // VS/dsa: Build output string. Note: Since each value is appended at the end of the string, we must start the iteration
      // with the most significant value
      strncat(aOutHexStr, chTempStr, elcount(aOutHexStr));
    }
    
    bResult = Ok; //conversion OK
  }
   
  if ( (byte)DebugFuncInternal & bDebugFlag)
    writeDbgLevel(DebugFuncInternal, "bFctn_CONV_ConvertByteArrayToString() return: %d.", bResult);
   
  return bResult;
}

/*! \fn byte bFctn_CONV_ConvertByteArrayToDiagObject(byte aDiagCustomReqArray[], diagRequest * aOuputCustomReqCreated)
*  \brief 	Converts byte array to a custom request diagnostic object.
*  \param[in]  aDiagCustomReqArray      - A byte array that will be converted into a diagnostic object.
*  \param[out] aOuputCustomReqCreated   - A Diagnostic Object that upon success will contain the converted byte array.
* 
*  \return  0 - Not ok, conversion failed.
*  \return  1 - Ok, conversion succesfully done.
*
*  \note 
*   - It is required that A_DIAG_SetTarget(char aECUName[]) is previously called, else -98 error code is returned (handle not assigned to a diag object). 
*
* Change History: 
* Date(DD.MM.YY)        Author          Change info                                                          
*  
*  17.07.18             RoBi            First Revision.
*  20.11.18             RoBi            Added condition to check return values of diagResize() and DiagSetPrimitiveData()
*/

byte bFctn_CONV_ConvertByteArrayToDiagObject(byte aDiagCustomReqArray[], diagRequest * aOuputCustomReqCreated)
{
  byte bDebugFlag;
  byte bResult;

  bResult = NotOk; 
  bDebugFlag = ccCONV_GlobalDebugFlag;

  writeDbgLevel(DebugFuncCalls, "Function bFctn_CONV_ConvertByteArrayToDiagObject() called.");
  if ( (byte)DebugFuncInternal & bDebugFlag)
    writeDbgLevel(DebugFuncInternal, "Array with: %d elements provided. Using DiagSetPrimitiveData() to convert it to a diag object.", elCount(aDiagCustomReqArray)); 

  if ( 0 == diagResize(aOuputCustomReqCreated, elCount(aDiagCustomReqArray)) // resize successfully done
    && 0 < DiagSetPrimitiveData(aOuputCustomReqCreated, aDiagCustomReqArray, elCount(aDiagCustomReqArray)) ) // returns nr. of bytes copied
  {
    if ( (byte)DebugFuncInternal & bDebugFlag)
	    writeDbgLevel(DebugFuncInternal, "SUCCESS: Finished processing the array - custom request is created.");
    bResult = Ok;
  }
  else
  {
    if ( (byte)DebugFuncInternal & bDebugFlag)
	    writeDbgLevel(DebugFuncInternal, "ERROR: Could not resize/copy the data. It is necessary that A_DIAG_SetTarget(char aECUName[]) has been previously called.");
    bResult = NotOk;
  }
  
  if ( (byte)DebugFuncInternal & bDebugFlag)
    writeDbgLevel(DebugFuncInternal, "bFctn_CONV_ConvertByteArrayToDiagObject() return: %d.", bResult);

  return bResult;
}

/*! \fn byte bFctn_CONV_ConvertDwordArrayToString(dword aInputArray[], char aOutputString[])
*  \brief 	Converts dword array to a string.
*  \param[in]  aInputArray 			- A dword array the will be converted into a diagnostic object.
*  \param[out] aOutputString 		- A string that upon success will contain the converted dword array.
* 
*  \return  0 - Not ok, conversion failed.
*  \return  1 - Ok, conversion succesfully done.
*
*  \note
*       -Example: aInputArray: 0xAAAA, 0xBB, 0xCC is converted to aOutputString: AAAA BB CC
*
* Change History: 
* Date(DD.MM.YY)        Author          Change info                                                          
*  
*  17.07.18             GrAn        	First Revision.
*  03.07.19             CrJu          Refactoring the code / added a new condition, in order to convert the all byte array.
*/

byte bFctn_CONV_ConvertDwordArrayToString(dword aInputArray[], char aOutputString[])
{
  byte bResult;
  byte bDebugFlag;
  qword qwInputPos;
  char chTempStr[20];

  bResult = NotOk; 
  bDebugFlag = ccCONV_GlobalDebugFlag;

  writeDbgLevel(DebugFuncCalls, "Function bFctn_CONV_ConvertDwordArrayToString() called.");
  
  //(Eight characters per byte + separation char per byte except the last one) + one termination char
  if ( elCount(aOutputString) >= (elCount(aInputArray) * 9) )
  {
    if ( (byte)DebugFuncInternal & bDebugFlag)
	    writeDbgLevel(DebugFuncInternal, "Array with: %d elements provided.", elCount(aInputArray)); 

    //Convert messages id array to string 
    strncat(aOutputString,"",0);//Reset the output array
    
    for (qwInputPos = 0; qwInputPos < elcount(aInputArray); qwInputPos++)
    {
      if(qwInputPos != (elcount(aInputArray) - 1))
      {
        ltoa(aInputArray[qwInputPos], chTempStr, 16);
        strncat(aOutputString, chTempStr, elcount(aOutputString) + elcount(chTempStr));
        strncat(aOutputString, " ", elcount(aOutputString) + elcount(" "));
      }
      else //do not insert white space after the last converted element
      {
        ltoa(aInputArray[qwInputPos], chTempStr, 16);
        strncat(aOutputString, chTempStr, elcount(aOutputString) + elcount(chTempStr));
      }
    }
    
    if ( (byte)DebugFuncInternal & bDebugFlag)
      writeDbgLevel(DebugFuncInternal, "SUCCESS: Finished processing the array.");
    
    bResult = Ok;
  }
  else
  {
    if ( (byte)DebugFuncInternal & bDebugFlag)
	    writeDbgLevel(DebugFuncInternal, "ERROR: The output string array is to small. It requires: (Eight characters per byte + separation char per byte except the last one) + one termination char'.");
    bResult = NotOk;
  }
  
  if ( (byte)DebugFuncInternal & bDebugFlag)
    writeDbgLevel(DebugFuncInternal, "bFctn_CONV_ConvertDwordArrayToString() return: %d.", bResult);

  return bResult;
}


/*! \fn word wFctn_CONV_CopyByteArrayToByteArray(byte aInputArray[], dword aStartPos, word aCopiedElements, byte aOutputArray[])
*  \brief 	Copies a given number of elements from aInputArray to aOutputArray
*  \param[in]  aInputArray      - Source dword array
*  \param[in] aStartPos         - Starting position from where to copy
*  \param[in] aCopiedElements   - How many elements to be copied
*  \param[out] aOutputArray     - Destination dword array
* 
*  \return   0 - Notok, copy action was failed or no bytes were copied
*  \return > 0 - Ok, copy action was succesfully done (number of elements copied).
*
* Change History: 
* Date(DD.MM.YY)        Author          Change info                                                          
*  
*  17.07.18             GrAn            First Revision.
*  02.07.19             CrJu            Added a new condition, in order to prevent a violation of the array range
*/

word wFctn_CONV_CopyByteArrayToByteArray(byte aInputArray[], dword aStartPos, word aCopiedElements, byte aOutputArray[])
{
  word wResult;
  byte bDebugFlag;
  dword dwInputPos;

  wResult = NotOk; 
  bDebugFlag = ccCONV_GlobalDebugFlag;

  writeDbgLevel(DebugFuncCalls, "Function wFctn_CONV_CopyByteArrayToByteArray() called.");
  
  //Check that start position value is less than the length of input array, the start position plus number of copied elements is less than the length of the input array 
  //and number of copied elements are less the length of output array
  if ((aStartPos <= elCount(aInputArray)) && (aCopiedElements <= elcount(aOutputArray)) && (aStartPos + aCopiedElements <= elcount(aInputArray)))
  {
    if ( (byte)DebugFuncInternal & bDebugFlag)
	    writeDbgLevel(DebugFuncInternal, "Array with: %d elements provided.", elCount(aInputArray)); 
    
    wResult = 0;
    //Copies the elements from input array
    for (dwInputPos = aStartPos; dwInputPos< aStartPos +  aCopiedElements ; dwInputPos++)
    {
      aOutputArray[dwInputPos - aStartPos] = aInputArray [dwInputPos];
      //Store the number of elements copied
      wResult++;
    }
    
    if ( (byte)DebugFuncInternal & bDebugFlag)
      writeDbgLevel(DebugFuncInternal, "SUCCESS: Finished processing the array.");
  }
  else
  {
    if ( (byte)DebugFuncInternal & bDebugFlag)
	    writeDbgLevel(DebugFuncInternal, "ERROR in wFctn_CONVByteArrayToByteArray function. ");
    wResult = NotOk;
  }
  
  if ( (byte)DebugFuncInternal & bDebugFlag)
    writeDbgLevel(DebugFuncInternal, "wFctn_CONVByteArrayToByteArray() return: %d.", wResult);

  return wResult;
}

/*! \fn byte bFctn_CONV_ConvertByteArrToStringByLength(byte aRawData[], qword aMaxElementsCopied, char aOutHexStr[])
*  \brief 	Converts a byte array to a hex encoded strings array (if the length of input array is bigger than aMaxElementsCopied, converts first aMaxElementsCopied elements).
*  \param[in]  aRawData	          - A byte array the will be converted into a hex string.
*  \param[in] aMaxElementsCopied  - Maximum number of elements converted (if the length of input array is bigger than aMaxElementsCopied, converts first aMaxElementsCopied elements).
*  \param[out] aOutHexStr         - A char array that upon success will contain the converted Hex string.
* 
*  \return  0 - Not ok, conversion failed.
*  \return  1 - Ok, conversion succesfully done.
*  \return  6 - Warning, not all the elements were copied
*
* Change History: 
* Date(DD.MM.YY)        Author          Change info                                                          
*  
*  25.05.08             AEE/jml         First Revision.
*  13.07.18             GrAn            Refactoring code.
*/

byte bFctn_CONV_ConvertByteArrToStringByLength(byte aRawData[], qword aMaxElementsCopied, char aOutHexStr[])
{
   qword qwIndex;
   qword qwHexLength;
   qword qwByteArrIndex;
   byte bTempVal;
   byte bResult;
   byte bDebugFlag;
   char chTempStr[10];
   qword qwMinLength;
   
   // Init to failed
   bResult = NotOk;   // conversion failed
   bDebugFlag = ccCONV_GlobalDebugFlag;
   
   writeDbgLevel(DebugFuncCalls, "Function bFctn_CONV_ConvertByteArrToStringByLength() called.");

   // Reset output array
   for (qwIndex = 0; qwIndex < elcount(aOutHexStr); qwIndex++)
   {
      aOutHexStr[qwIndex] = 0;
   }
   
   // get the hex length
   qwHexLength = elcount(aRawData) * 2;
  
  if (aMaxElementsCopied >= qwHexLength)
  {
    qwMinLength = qwHexLength;
  }
  else
  {
    qwMinLength = aMaxElementsCopied;
  }
  
  //check that the supplied output array can hold the hex string 
  if ( elcount(aOutHexStr) <  qwMinLength )
  {
    if ( (byte)DebugFuncInternal & bDebugFlag)
	    writeDbgLevel(DebugFuncInternal, "ERROR: Char array to small, Hex Data is %d but aOutHexStr only contains %d elements!", qwHexLength, elcount(aOutHexStr));
	  bResult = NotOk;
  }
  else 
  {  
    //The input array has more than aMaxElementsCopied elements
    if (qwHexLength >= aMaxElementsCopied)
    {
      //All checks went fine, convert data
      for (qwIndex = 0; qwIndex < aMaxElementsCopied; qwIndex++)
      {
        // The byte index to use for accessing aRawData
        qwByteArrIndex = qwIndex / 2;

        // Use the modulo operator % to check if this is an even or odd iteration
        // For even iterations just shift the most significant four bits four positions to the right
        // For odd iterations filter out the least significant four bits, no shift needed
        if (0 == (qwIndex % 2))
        {
          bTempVal = (long)(aRawData[qwByteArrIndex] >> 4);
        }
        else
        {
          bTempVal = (long)(aRawData[qwByteArrIndex] & 0x0F);
        }
        
        // Debug Purpose
        //writeDbgLevel(DebugFuncInternal,"bFctn_CONV_ConvertByteArrayToString(): aRawData = %X", aRawData[wByteArrIndex]);
        //writeDbgLevel(DebugFuncInternal,"bFctn_CONV_ConvertByteArrayToString(): bTempVal = %X", bTempVal);

        // Convert value to a temp string. 
        snprintf( chTempStr, elcount(chTempStr), "%X", bTempVal );
         
        // VS/dsa: Build output string. Note: Since each value is appended at the end of the string, we must start the iteration
        // with the most significant value
        strncat(aOutHexStr, chTempStr, elcount(aOutHexStr));
      }
      
      bResult = cc_eCONV_WARNING_ELEMENTS_NOT_COPIED; //conversion warning
    }
    else
    {
      bResult = bFctn_CONV_ConvertByteArrayToString(aRawData,aOutHexStr);
    }
  }
  
  if ( (byte)DebugFuncInternal & bDebugFlag)
    writeDbgLevel(DebugFuncInternal, "bFctn_CONV_ConvertByteArrToStringByLength() return: %d.", bResult); 
  
  return bResult;
}


/*! \fn byte bFctn_CONV_CopyByteArray(byte aSourceArray[], byte aDestinationArray[], byte aNoOfBytesToCopy)
*  \brief Function that will copy an array from source to destination, the number of bytes specified, starting from 0.
*  \param[in]  	aSourceArray 	      - The source array to copy from.
*  \param[out]  aDestinationArray 	- The destination array to copy into.
*  \param[in]  	aNoOfBytesToCopy    - The number of bytes to copy from source to destination.
*
*  \return  0 - Not ok, conversion failed.
*  \return  1 - Ok, conversion succesfully done.
*
* Change History: 
* Date(DD.MM.YY)        Author          Change info                                                          
*  
*  20.08.18             RoBi            Created and implemented.
*/

byte bFctn_CONV_CopyByteArray(byte aSourceArray[], byte aDestinationArray[], byte aNoOfBytesToCopy)
{
  byte bResult;
  byte bDebugFlag;
  byte bIndexArray;

  bResult = NotOk;
  bDebugFlag = ccCONV_GlobalDebugFlag;
  
  writeDbgLevel(DebugFuncCalls, "Function bFctn_CONV_CopyByteArray() called.");
  
  // Copy the specified number of elements only if the destination array is large enough 
  // and only if the source array has at least the number of specified number of elements to copy
  if ( aNoOfBytesToCopy <= elCount(aDestinationArray) && aNoOfBytesToCopy <= elCount(aSourceArray) )
  {
    for (bIndexArray=0; bIndexArray < aNoOfBytesToCopy; bIndexArray++)
    {
      aDestinationArray[bIndexArray] = aSourceArray[bIndexArray];
    }
    
    if ( (byte)DebugFuncInternal & bDebugFlag)
	    writeDbgLevel(DebugFuncInternal, "SUCCESS: %d elements have been copied in the output array.", aNoOfBytesToCopy);
    
    bResult = Ok;
  }
  else
  {
    if ( (byte)DebugFuncInternal & bDebugFlag)
	    writeDbgLevel(DebugFuncInternal, "FAILED: Destination array is not large enough or there are less elements in the source array than you wish to copy !");
    bResult = NotOk;
  }
  
  if ( (byte)DebugFuncInternal & bDebugFlag)
    writeDbgLevel(DebugFuncInternal, "bFctn_CONV_CopyByteArray() return: %d.", bResult);
  
  return bResult;
}


/*! \fn byte bFctn_CONV_CompareByteArrays(byte aByteArr1[], byte aByteArr2[], dword aCompareLength)
*  \brief Function that will compare a specified number of elements, between 2 byte arrays.
*  \param[in]  	aByteArr1           - The first byte array which will be compared.
*  \param[in]   aByteArr2           - The second byte array which will be compared.
*  \param[in]  	aCompareLength      - The number of elements to compare between the byte arrays.
*  \param[out]  aCompareArrayInfo   - Additional information regarding the first encountered element and position that is different (useful in detailing the report).
*
*  \return  1 - Ok, the arrays are identical.
*  \return  0 - Not ok, the arrays are not identical or an error occurred.
*
* Change History: 
* Date(DD.MM.YY)        Author          Change info                                                          
*  
*  05.10.09             AnJo            Created and implemented.
*  18.10.09             AnJo            Updated array bounds check.
*  30.08.18             RoBi            Refactoring code.
*  14.02.19             RoBi            Updated the message displayed when compared data is not identical.
*/

byte bFctn_CONV_CompareByteArrays(byte aByteArr1[], byte aByteArr2[], dword aCompareLength, char aCompareArrayInfo[])
{
  byte bResult;
  byte bDebugFlag;
  dword dwArrayIndex;

  bResult = Ok;
  bDebugFlag = DebugFuncInternal;

  writeDbgLevel(DebugFuncCalls, "Function bFctn_CONV_CompareByteArrays() called.");

  // verify length of arrays
  if ( elcount(aByteArr1) < aCompareLength || elcount(aByteArr2) < aCompareLength )
  {
	  snprintf(aCompareArrayInfo, elCount(aCompareArrayInfo), "Error, trying to compare byte arrays outside array size (length to compare is larger than the array)!");
	  if ( (byte)DebugFuncInternal & bDebugFlag)
	    writeDbgLevel(DebugFuncInternal, aCompareArrayInfo);
    bResult = NotOk;
  }

  // only compare the bytes if not exceeding array boundries
  if ( Ok == bResult)
  { // start comparing the elements
    for ( dwArrayIndex = 0; dwArrayIndex < aCompareLength; dwArrayIndex++ )
    {
      if ( aByteArr1[dwArrayIndex] != aByteArr2[dwArrayIndex] ) 
      {
        snprintf(aCompareArrayInfo, elCount(aCompareArrayInfo), "Data NOT identical. Value on position: %d, is: 0x%X and expecting: 0x%X !", dwArrayIndex, aByteArr1[dwArrayIndex], aByteArr2[dwArrayIndex]);
        if ( (byte)DebugFuncInternal & bDebugFlag)
          writeDbgLevel(DebugFuncInternal, aCompareArrayInfo);
        bResult = NotOk;
        break;
      }
    }
  }
  
  if ( (byte)DebugFuncInternal & bDebugFlag)
    writeDbgLevel(DebugFuncInternal, "bFctn_CONV_CompareByteArrays() return: %d.", bResult);

  if(bResult == Ok)
    snprintf(aCompareArrayInfo, elCount(aCompareArrayInfo), "Data of the two arrays is identical. Number of elements compared: %d.", aCompareLength);
        
  return bResult;
}

/*! \fn byte bFctn_CONV_CompareQWordArrays(qword aQWordArr1[], qword aQWordArr2[], dword aCompareLength, char aCompareArrayInfo[])
*  \brief Function that will compare a specified number of elements, between 2 qWord arrays.
*  \param[in]   aQWordArr1          - The first qWord array which will be compared.
*  \param[in]   aQWordArr2           - The second qWord array which will be compared.
*  \param[in]   aCompareLength      - The number of elements to compare between the qWord arrays.
*  \param[out]  aCompareArrayInfo   - Additional information regarding the first encountered element and position that is different (useful in detailing the report).
*
*  \return  1 - Ok, the arrays are identical.
*  \return  0 - Not ok, the arrays are not identical or an error occurred.
*
* Change History: 
* Date(DD.MM.YY)        Author          Change info                                                          
*  
*  17.10.18             RoBi            Created and implemented.
*/

byte bFctn_CONV_CompareQWordArrays(qword aQWordArr1[], qword aQWordArr2[], dword aCompareLength, char aCompareArrayInfo[])
{
  byte bResult;
  byte bDebugFlag;
  dword dwArrayIndex;

  bResult = Ok;
  bDebugFlag = ccCONV_GlobalDebugFlag;

  writeDbgLevel(DebugFuncCalls, "Function bFctn_CONV_CompareQWordArrays() called.");

  // verify length of arrays
  if ( elcount(aQWordArr1) < aCompareLength || elcount(aQWordArr2) < aCompareLength )
  {
	  snprintf(aCompareArrayInfo, elCount(aCompareArrayInfo), "Error, trying to compare qWord arrays outside array size (length to compare is larger than the array) !");
	  if ( (byte)DebugFuncInternal & bDebugFlag)
	    writeDbgLevel(DebugFuncInternal, aCompareArrayInfo);
    bResult = NotOk;
  }

  // only compare the bytes if not exceeding array boundries
  if ( Ok == bResult)
  { // start comparing the elements
    for ( dwArrayIndex = 0; dwArrayIndex < aCompareLength; dwArrayIndex++ )
    {
      if ( aQWordArr1[dwArrayIndex] != aQWordArr2[dwArrayIndex] ) 
      {
		    snprintf(aCompareArrayInfo, elCount(aCompareArrayInfo), "Data is not identical. Value on position: %d, is different. Array1 value: 0x%I64X, array2 value: 0x%I64X !", dwArrayIndex, aQWordArr1[dwArrayIndex], aQWordArr2[dwArrayIndex]);
	      if ( (byte)DebugFuncInternal & bDebugFlag)
		      writeDbgLevel(DebugFuncInternal, aCompareArrayInfo);
        bResult = NotOk;
        break;
      }
    } 
  }

  if ( (byte)DebugFuncInternal & bDebugFlag)
    writeDbgLevel(DebugFuncInternal, "bFctn_CONV_CompareQWordArrays() return: %d.", bResult);

  return bResult;
}


/*! \fn byte bFctn_CONV_ByteArrayToSpecificNumberBaseString(byte aRawByteArrayData[], enum cc_eNumberBaseCONV aNumberBase, char aSeparationChar[], char aOutputString[], dword aNumberOfBytes2Conv)
*  \brief Function that will convert byte array elements to a specific number base string (ex: Binary, Decimal, Hex).
*  \param[in]  	aRawByteArrayData     - The byte array to convert.
*  \param[in]  	aNumberBase           - Number base to be used when conversion is done to string (cc_eCONV_Binary = 2, cc_eCONV_Decimal = 10, cc_eCONV_Hex = 16).
*  \param[in]  	aSeparationChar       - A string to add between each byte, may be empty (Empty: "", Whitespace: " ", Hex: "0x").
*  \param[in]  	aOutputString         - A character array that upon success will contain the converted values (based on the specified number base).
*  \param[in]  	aNumberOfBytes2Conv   - How many elements from the byte array will be converted to string.
*
*  \return  1 - Ok, conversion successfully done.
*  \return  0 - Not ok, error during the conversion phase.
*
*  \note 
*     -Example: byte array 0xAA, 0xBB, 0xCC, 0xDD, 0xEE is converted in:
*               -decimal: 170 187 204 221 238
*               -binary: 10101010+10111011+11001100+11011101+11101110
*               -hexa: aa+bb+cc+dd+ee
* Change History: 
* Date(DD.MM.YY)        Author          Change info                                                          
*  
*  05.10.09             AnJo            Created and implemented.
*  18.10.09             AnJo            Updated array bounds check.
*  30.08.18             RoBi            Refactoring code.
*/

byte bFctn_CONV_ByteArrayToSpecificNumberBaseString(byte aRawByteArrayData[], enum cc_eNumberBaseCONV aNumberBase, char aSeparationChar[], char aOutputString[], dword aNumberOfBytes2Conv)
{
   byte bResult;
   byte bDebugFlag;
   word wByteArrIndex;
   byte bNumberOfCharsNeeded; 
   char aTemporaryString[10];

   // VS/dsa: Init to success
   bResult = Ok;
   wByteArrIndex = cc_eCONV_ZERO;
   bNumberOfCharsNeeded = cc_eCONV_ZERO;
   bDebugFlag = ccCONV_GlobalDebugFlag;

   writeDbgLevel(DebugFuncCalls, "Function bFctn_CONV_ByteArrayToSpecificNumberBaseString() called.");
   
   // VS/dsa: Reset output string
   snprintf(aOutputString, elcount(aOutputString), "");
  
   // VS/dsa: Check that the supplied output array can hold all byte values and a string terminator character  
   switch (aNumberBase)
   {
      case cc_eCONV_Binary:
        // VS/dsa: One character required per bit, i.e eight characters per byte + X separation chars per byte + one termination char
        bNumberOfCharsNeeded = ((aNumberOfBytes2Conv * (8 + strlen(aSeparationChar))) + 1);
      break;

      case cc_eCONV_Decimal:
        // VS/dsa: Up to three characters required per byte (since max value for a byte is 255 in decimal notation) 
        // + X separation chars per byte + one termination char

        bNumberOfCharsNeeded = ((aNumberOfBytes2Conv * (3 + strlen(aSeparationChar))) + 1);
        // FlBl debug Check value correct
      break;

      case cc_eCONV_Hex:
         // VS/dsa: Two characters required per byte + X separation chars per byte + one termination char
         bNumberOfCharsNeeded = ((aNumberOfBytes2Conv * (2 + strlen(aSeparationChar))) + 1);
      break;

      default:
        // VS/dsa: Should never get here since an enum is used, but handle it anyway...
		    if ( (byte)DebugFuncInternal & bDebugFlag)
			    writeDbgLevel(DebugFuncInternal, "ERROR: Number base: %d, not supported. Check enum cc_eNumberBaseCONV for valid values !", aNumberBase);
        bResult = NotOk;
      break;
   }
   

   if(elcount(aOutputString) < bNumberOfCharsNeeded)
   {
	    if ( (byte)DebugFuncInternal & bDebugFlag)
		    writeDbgLevel(DebugFuncInternal, "ERROR: Input parameters do not match, aRawByteArrayData contains %d elements and aOutputString only %d (Need %d elements) !", elcount(aRawByteArrayData), elcount(aOutputString), bNumberOfCharsNeeded);	  
      bResult = NotOk;
   }
   else
   {
      //VS/dsa: All checks went fine, convert data
      for (wByteArrIndex = 0; wByteArrIndex < aNumberOfBytes2Conv; wByteArrIndex++)
      {
        // Debug Purpose:
        // if ( (byte)DebugFuncInternal & bDebugFlag)
		//   writeDbgLevel(DebugFuncInternal,"bFctn_CONV_ByteArrayToSpecificNumberBaseString: aRawByteArrayData = %X", aRawByteArrayData[wByteArrIndex]);
         
        // VS/dsa: Convert value to a temp string.
        ltoa((long)aRawByteArrayData[wByteArrIndex], aTemporaryString, aNumberBase);
         
        // VS/dsa: If more than one byte element, append separation string
        if (0 < wByteArrIndex)
        {
          strncat(aOutputString, aSeparationChar, elcount(aOutputString));
        }
         
        //If aNumberBase == cc_eCONV_Hex add 0 to numbers smaller than 0x10
        if((aNumberBase == cc_eCONV_Hex) && (aRawByteArrayData[wByteArrIndex] < 0x10))
        {
          strncat(aOutputString, "0", elcount(aOutputString));
        }

        // VS/dsa: Build output string. 
        strncat(aOutputString, aTemporaryString, elcount(aOutputString));
      }
  }
  
  if ( (byte)DebugFuncInternal & bDebugFlag)
    writeDbgLevel(DebugFuncInternal, "bFctn_CONV_ByteArrayToSpecificNumberBaseString() return: %d.", bResult);
  
  return bResult;
}

/*! \fn byte bFctn_CONV_InsertNewArrElemOnPosX_QWord(qword aValueToInsert, dword aInsertOnPosition, qword aQWordArr[], char aInsertInfo[])
*  \brief Function that will shift by 1 position, to the right, the existing array elements (starting with aInsertOnPosition) and insert a new element, on the specified position (last element will be lost). 
*  \param[in]  	aValueToInsert 	    - The value which will be inserted in the array.
*  \param[in]   aInsertOnPosition   - The position on which the new value will be inserted in the array.
*  \param[out]  aQWordArr           - The array in which the specified value will be inserted on the position.
*  \param[out]  aInsertInfo         - Additional information regarding the process of inserting the new element and shifting the others (useful in detailing the report).
*
*  \return  1 - Ok, the arrays are identical.
*  \return  0 - Not ok, the arrays are not identical or an error occurred.
*
*  \note 
*     - The last element in the array will be discarded/lost, because when inserting a new value on the position, all of the elements will shift by one position to the right.
*
*  Change History: 
*  Date(DD.MM.YY)        Author          Change info                                                          
*  14.11.18              RoBi            Created and implemented.
*/ 

byte bFctn_CONV_InsertNewArrElemOnPosX_QWord(qword aValueToInsert, dword aInsertOnPosition, qword aQWordArr[], char aInsertInfo[])
{
  byte bResult;
  byte bDebugFlag;
  dword dwArrayIndex;
  qword qwBackUpValue;
  dword dwArraySize;

  bResult = Ok;
  bDebugFlag = ccCONV_GlobalDebugFlag;
  dwArraySize = elcount(aQWordArr);
  
  writeDbgLevel(DebugFuncCalls, "Function bFctn_CONV_InsertNewArrElemOnPosX_QWord() called.");

  // Position must be in the array range
  if ( aInsertOnPosition >= dwArraySize )
  {
	  snprintf(aInsertInfo, elCount(aInsertInfo), "Error, cannot insert the value on a position which is out of range !");
	  if ( (byte)DebugFuncInternal & bDebugFlag)
	    writeDbgLevel(DebugFuncInternal, aInsertInfo);
    return NotOk;
  }
  else // insert value only if not exceeding array boundries
  {
    // start shifting the elements to the right
    for ( dwArrayIndex = dwArraySize-1; dwArrayIndex > aInsertOnPosition; dwArrayIndex-- )
    {
	    aQWordArr[dwArrayIndex] = aQWordArr[dwArrayIndex-1];
    }
	
	  // elements shifted to the right, insert the element on desired position
	  aQWordArr[aInsertOnPosition] = aValueToInsert;
    
    snprintf(aInsertInfo, elCount(aInsertInfo), "SUCCES: Inserted on position: %ld of the array the value: 0x%X", aInsertOnPosition, aValueToInsert);
    bResult = Ok;
  }

  if ( (byte)DebugFuncInternal & bDebugFlag)
    writeDbgLevel(DebugFuncInternal, "bFctn_CONV_InsertNewArrElemOnPosX_QWord() return: %d.", bResult);

  return bResult;
}

/*! \fn byte bFctn_CONV_GetSubString(char aSourceString, word aStartPos, word aStopPos, char aOutputSubString[])
*  \brief 	Function that will get a sub string from a source char array, based on the specified start and stop position.
*  \param[in]  	aSourceString     - The input string to get a substring from.
*  \param[in]   aStartPos         - The position to start at (counting from aSourceString[0]).
*  \param[in]   aStopPos          - The position to stop at (counting from aSourceString[0]).
*  \param[out]  aOutputSubString  - The output sub string.
*
*  \return  1 - Ok, sub string was successfully copied.
*  \return  0 - Not ok, range invalid or the output array is not large enough.
*
*  \note 
*     - Counting starts from 0. The range aStartPos == aStopPos will return an empty array (if need only 1 char, use aStartPos = 1 and aStopPos = aStartPos + 1). \n
*     - If aStopPos < aStartPos, it will consider that aStopPos = elcount(aSourceString). Basically, it will extract sub string from valid start position until the end of the string.
*
*  Change History: 
*  Date(DD.MM.YY)        Author          Change info                                                          
*  21.11.18              RoBi            Created and implemented.
*/ 

byte bFctn_CONV_GetSubString(char aSourceString[], word aStartPos, word aStopPos, char aOutputSubString[])
{
  byte bResult;
  byte bDebugFlag;
  word wJindex;
  word wIndex;
  
  bResult = Ok;
  bDebugFlag = ccCONV_GlobalDebugFlag;
  wIndex = 0;
  wJindex = 0;

  writeDbgLevel(DebugFuncCalls, "Function bFctn_CONV_GetSubString() called.");

  // Reset output array
  for (wIndex = 0; wIndex < elcount(aOutputSubString); wIndex++)
  {
    aOutputSubString[wIndex] = 0;
  }
  
  // Check the input data
  if ( aStopPos < aStartPos ) // stop position is smaller than start position (range invalid)
  {
    if ( (byte)DebugFuncInternal & bDebugFlag)
	    writeDbgLevel(DebugFuncInternal, "WARNING: aStopPos is smaller than aStartPos. aStopPos is set to size of aSourceString: %d.", elcount(aSourceString));
    aStopPos = elcount(aSourceString);
  }
  else if ( aStartPos > elcount(aSourceString) - 1 || aStartPos == aStopPos ) // trying to copy from outside of the source array or no char at all
  {
    if ( (byte)DebugFuncInternal & bDebugFlag)
	    writeDbgLevel(DebugFuncInternal, "ERROR: The aOutputSubString will be empty (aStartPos > elcount(aSourceString) or aStartPos == aStopPos).");
    bResult = NotOk;
  }
  else if ( elcount(aOutputSubString) < (aStopPos-aStartPos + 1) ) // range is valid but the output array is not large enough 
  {
	  if ( (byte)DebugFuncInternal & bDebugFlag)
	    writeDbgLevel(DebugFuncInternal, "ERROR: Output array is too small. Requested sub string is: %d, but aOutputSubString can only hold: %d elements!", (aStopPos - aStartPos + 1), elcount(aOutputSubString));
	  bResult = NotOk;
  }
  
  // Copy the SubString to the output parameter
  if ( Ok == bResult )
  {
    for (wIndex = aStartPos; wIndex < aStopPos; wIndex++)
    {
      aOutputSubString[wJindex] = aSourceString[wIndex];
      if ( '\0' == aSourceString[wIndex] ) 
        break;  //stop if end of source string is reached
      wJindex++;
    }
    
    // Terminate aOutputSubString
    aOutputSubString[wJindex] = '\0';
  }

  if ( (byte)DebugFuncInternal & bDebugFlag)
    writeDbgLevel(DebugFuncInternal, "bFctn_CONV_GetSubString() return: %d.", bResult);

  return bResult;
}

/*! \fn void vFctn_CONV_SetAllByteArrElemToSpecificVal(byte aInputArray[], byte aValueToBeSet)
*  \brief Function that will set all of the array elements to the specified value.
*  \param[out]  aInputArray     - The byte array which will be modified.
*  \param[in]   aValueToBeSet   - The value which will be set on all of the arrays elements.
*
*  \return No Return.
*
* Change History: 
* Date(DD.MM.YY)        Author          Change info                                                          
* 11.01.19              RoBi            Created and implemented
*/

void vFctn_CONV_SetAllByteArrElemToSpecificVal(byte aInputArray[], byte aValueToBeSet)
{
  dword dwIndex;
	byte bDebugFlag;
  
	bDebugFlag = ccCONV_GlobalDebugFlag;
  
  writeDbgLevel (DebugFuncCalls , "Function vFctn_CONV_SetAllByteArrElemToSpecificVal() called.");

  // loop through all of the elements and set the specified value
  for (dwIndex = 0; dwIndex < elcount(aInputArray); dwIndex++)
  {
    aInputArray[dwIndex] = aValueToBeSet;
    if ( (byte)DebugFuncInternal & bDebugFlag)
      writeDbgLevel (DebugFuncInternal, "Set value of aInputArray[%d] = %d.", dwIndex, aValueToBeSet); 
  }
}

/*! \fn byte bFctn_CONV_ConvertByteArrayToStringByDLC(byte aRawData[], char aOutHexStr[], dword aByteDLC)
*  \brief Converts the exactly number of bytes(given in aByteDLC) from a byte array to a hex encoded strings array.
*  \param[in]  aRawData 		- A byte array the will be converted into a hex string.
*  \param[out] aOutHexStr 	- A char array that upon success will contain the converted Hex string. (It must be at least 3 times bigger then the aByteDLC).
*  \param[in]  aByteDLC     - The number of bytes to convert.
*
*  \return  0 - Not ok, conversion failed.
*  \return  1 - Ok, conversion succesfully done.
*
*  \note
*       -Example: aRawData: 0xAA, 0xBB, 0xCC, 0xDD with aByteDLC = 3 is converted to aOutHexStr: AA BB CC
*
* Change History:
* Date(DD.MM.YY)        Author          Change info                                                          
*  
*  13.07.18             RoBi            For function: bFctn_CONV_ConvertByteArrayToString
*  09.01.19             CrJu            Update: added a new parameter, in order to convert exactly number of bytes 
*/

byte bFctn_CONV_ConvertByteArrayToStringByDLC(byte aRawData[], char aOutHexStr[], dword aByteDLC)
{
  byte bDebugFlag;
  qword qwIndex;
  qword qwHexLength;
  qword qwByteArrIndex;
  byte bTempVal;
  byte bFlagInsertSpace;
  byte bResult;
  char chTempStr[10];
   
  bFlagInsertSpace = cc_eCONV_ZERO; // init with adding whitespace disabled
  bResult = NotOk; // init with conversion failed
  bDebugFlag = ccCONV_GlobalDebugFlag;
  
  writeDbgLevel(DebugFuncCalls, "Function bFctn_CONV_ConvertByteArrayToStringByDLC() called.");

  // Reset output array
  for (qwIndex = 0; qwIndex < elcount(aOutHexStr); qwIndex++)
  {
    aOutHexStr[qwIndex] = 0;
  }
   
  // get the hex length
  qwHexLength = aByteDLC * 2;
  
  if(aByteDLC > elCount(aRawData))
  {
    if ( (byte)DebugFuncInternal & bDebugFlag)
      writeDbgLevel(DebugFuncInternal, "ERROR: Number of bytes to convert: %d are bigger than the number of bytes from the input string: %d!", aByteDLC, elCount(aRawData));
    return NotOk;
  }
  
  //check that the supplied output array can hold the hex string 
  if (elcount(aOutHexStr) < (aByteDLC * 3))
  {
    if ( (byte)DebugFuncInternal & bDebugFlag)
      writeDbgLevel(DebugFuncInternal, "ERROR: Char array too small, Hex Data is %d but aOutHexStr only contains %d elements!", qwHexLength, elcount(aOutHexStr));
    bResult = NotOk;
  }
  else
  {
    //All checks went fine, convert data
    for (qwIndex = 0; qwIndex < qwHexLength; qwIndex++)
    {
      // The byte index to use for accessing aRawData
      qwByteArrIndex = qwIndex / 2;

      // Use the modulo operator % to check if this is an even or odd iteration
      // For even iterations just shift the most significant four bits four positions to the right
      // For odd iterations filter out the least significant four bits, no shift needed
      if (0 == (qwIndex % 2))
      {
        bTempVal = (long)(aRawData[qwByteArrIndex] >> 4);
      }
      else
      {
        bTempVal = (long)(aRawData[qwByteArrIndex] & 0x0F);
      }
	    // Debug purpose
      //writeDbgLevel(DebugFuncInternal,"bFctn_CONV_ConvertByteArrayToStringByDLC(): aRawData = %X", aRawData[qwByteArrIndex]);
      //writeDbgLevel(DebugFuncInternal,"bFctn_CONV_ConvertByteArrayToStringByDLC(): bTempVal = %X", bTempVal);
      
      // Convert value to a temp string and add space between bytes ( example: byte1(00)"whitespace"byte2(FF) )
	    if ( cc_eCONV_ZERO == bFlagInsertSpace )
	    {
		    // don't insert white space
		    snprintf( chTempStr, elcount(chTempStr), "%X", bTempVal );
		    bFlagInsertSpace = 1;
	    }
	    else
	    {
        // insert white space
        snprintf( chTempStr, elcount(chTempStr), "%X ", bTempVal );
        bFlagInsertSpace = 0;
      }

      // VS/dsa: Build output string. Note: Since each value is appended at the end of the string, we must start the iteration
      // with the most significant value
      strncat(aOutHexStr, chTempStr, elcount(aOutHexStr));
    }
    
    bResult = Ok; //conversion OK
  }
   
  if ( (byte)DebugFuncInternal & bDebugFlag)
    writeDbgLevel(DebugFuncInternal, "bFctn_CONV_ConvertByteArrayToStringByDLC() return: %d.", bResult);
   
  return bResult;
}

/*! \fn byte bFctn_CONV_ConvertStringToSignedDataType(char aInputString[], enum eDataTypes aDataType, int64& aSignedOutValue, char aConversionInformation[])
*  \brief Function that will convert a string to a specific data type.
*  \param[in]  aInputString           - The string which will be converted.
*  \param[in]  aDataType              - The data type you want to convert the input string.
*  \param[out] aSignedOutValue        - The converted value.
*  \param[out] aConversionInformation - Extra information regarding the function output.
*
*  \return  1  - The conversion is fine.
*  \return  0  - An error occurred - check aConversionInformation.
*
*  \note  - Data Types that are recommanded to use for this function are the signed ones: Type_Int, Type_Long, Type_Int64
*         - Example: for a string like this "123 456", the function will convert until the first whitespace, '123'
*
* Change History: 
* Date(DD.MM.YY)        Author          Change info                                                          
* 12.08.19              CrJu            Created and implemented
*/

byte bFctn_CONV_ConvertStringToSignedDataType(char aInputString[], enum eDataTypes aDataType, int64& aSignedOutValue, char aConversionInformation[])
{
	byte bDebugFlag;
  byte bResult;
  
  bResult = 0;
	bDebugFlag = ccCONV_GlobalDebugFlag;
  
  writeDbgLevel (DebugFuncCalls , "Function bFctn_CONV_ConvertStringToSignedDataType() called.");
  
  if(strlen(aInputString) == 0)
  {
    snprintf(aConversionInformation, elCount(aConversionInformation), "ERROR: The string is empty.");
    if ((byte)DebugFuncInternal & bDebugFlag)
      writeDbgLevel(DebugFuncInternal, "ERROR: The string is empty.");
    return NotOk;
  }
  
  //make the conversion first, then compare the result with the specified data type size
  aSignedOutValue = _atoi64(aInputString);
  
  //The string can’t be converted to a number. It is the largest positive/negative number in case of overflow.
  if (aSignedOutValue == 0)
  {
    snprintf(aConversionInformation, elCount(aConversionInformation), "ERROR: The string can’t be converted to a number. It is the largest positive/negative number in case of overflow.");
    bResult = NotOk;
  }
  else //The conversion is fine
  {
    //verify if the converted number is in size of the desired type data
    switch(aDataType)
    {
      case Type_Int:
        if(aSignedOutValue > (_pow(2, 16) - 1) || aSignedOutValue < (-1) * (_pow(2, 16) - 1))
        {
          snprintf(aConversionInformation, elCount(aConversionInformation), "ERROR: The string is too big for an INT conversion.");
          if ((byte)DebugFuncInternal & bDebugFlag)
            writeDbgLevel(DebugFuncInternal, "ERROR: The string is too big for an INT conversion");
          return NotOk;
        }
        break;
      
      case Type_Long:
        if(aSignedOutValue > (_pow(2, 32) - 1) || aSignedOutValue < (-1) * (_pow(2, 32) - 1))
        {
          snprintf(aConversionInformation, elCount(aConversionInformation), "ERROR: The string is too big for a LONG conversion.");
          if ((byte)DebugFuncInternal & bDebugFlag)
            writeDbgLevel(DebugFuncInternal, "ERROR: The string is too big for a LONG conversion");
          return NotOk;
        }
        break;
      
      case Type_Int64:
        //no verification of length is required here
        break;
      
      default:
        snprintf(aConversionInformation, elCount(aConversionInformation), "ERROR: This function is used for signed data types. Try to use: int, long or int64.");
        if ((byte)DebugFuncInternal & bDebugFlag)
          writeDbgLevel(DebugFuncInternal, "ERROR: This function is used for signed data types. Try to use: int, long or int64.");
        return NotOk;
        break; 
    }
    
    //The converted value is in the size of the specified data type
    snprintf(aConversionInformation, elCount(aConversionInformation), "SUCCES: The conversion from string to the specified DATA TYPE was succesfully. The number is: %lld.", aSignedOutValue);
    if ((byte)DebugFuncInternal & bDebugFlag)
      writeDbgLevel(DebugFuncInternal, "SUCCES: The conversion from string to the specified DATA TYPE was succesfully. The number is: %lld.", aSignedOutValue);
    bResult = Ok;
  }
  
  if ((byte)DebugFuncInternal & bDebugFlag)
    writeDbgLevel(DebugFuncInternal, "bFctn_CONV_ConvertStringToSignedDataType() return: %d.", bResult);
  
  return bResult;
}

/*! \fn byte bFctn_CONV_ConvertStringToUnsignedDataType(char aInputString[], enum eDataTypes aDataType, qword& aUnsignedOutValue, char aConversionInformation[])
*  \brief Function that will convert a string to a specific data type.
*  \param[in]  aInputString           - The string which will be converted.
*  \param[in]  aDataType              - The data type you want to convert the input string.
*  \param[out] aUnsignedOutValue      - The converted value.
*  \param[out] aConversionInformation - Extra information regarding the function output.
*
*  \return  1  - The conversion is fine.
*  \return  0  - An error occurred - check aConversionInformation.
*
*  \note  - Data Types that are recommanded to use for this function are the unsigned ones: Type_Byte, Type_Word, Type_Dword, Type_Qword
*         - Example: for a string like this "123 456", the function will convert until the first whitespace, '123'
*
* Change History: 
* Date(DD.MM.YY)        Author          Change info                                                          
* 13.08.19              CrJu            Created and implemented
*/

byte bFctn_CONV_ConvertStringToUnsignedDataType(char aInputString[], enum eDataTypes aDataType, qword& aUnsignedOutValue, char aConversionInformation[])
{
	byte bDebugFlag;
  int iResult;
  
  iResult = 0;
	bDebugFlag = ccCONV_GlobalDebugFlag;
  
  writeDbgLevel (DebugFuncCalls , "Function bFctn_CONV_ConvertStringToUnsignedDataType() called.");
  
  //make the conversion first, then compare the result with the specified data type size
  iResult = strtoull(aInputString, aUnsignedOutValue);
  
  if(iResult == -1)
  {
    snprintf(aConversionInformation, elCount(aConversionInformation), "ERROR: An overflow occurs.");
    if ((byte)DebugFuncInternal & bDebugFlag)
      writeDbgLevel(DebugFuncInternal, "ERROR: An overflow occurs.");
    return NotOk;
  }
  else if(iResult == -2)
  {
    snprintf(aConversionInformation, elCount(aConversionInformation), "ERROR: The string is empty.");
    if ((byte)DebugFuncInternal & bDebugFlag)
      writeDbgLevel(DebugFuncInternal, "ERROR: The string is empty.");
    return NotOk;
  }
  else if(iResult == 0)
  {
    snprintf(aConversionInformation, elCount(aConversionInformation), "ERROR: Invalid string provided.");
    if ((byte)DebugFuncInternal & bDebugFlag)
      writeDbgLevel(DebugFuncInternal, "ERROR: Invalid array provided.");
    return NotOk;
  }
  else
  {
    //verify if the converted number is in size of the desired type data
    switch(aDataType)
    {
      case Type_Byte:
        if(aUnsignedOutValue > (_pow(2, 8) - 1))
        {
          snprintf(aConversionInformation, elCount(aConversionInformation), "ERROR: The string is too big for a BYTE conversion.");
          if ((byte)DebugFuncInternal & bDebugFlag)
            writeDbgLevel(DebugFuncInternal, "ERROR: The string is too big for a BYTE conversion");
          return NotOk;
        }
        break;
      
      case Type_Word:
        if(aUnsignedOutValue > (_pow(2, 16) - 1))
        {
          snprintf(aConversionInformation, elCount(aConversionInformation), "ERROR: The string is too big for a WORD conversion.");
          if ((byte)DebugFuncInternal & bDebugFlag)
            writeDbgLevel(DebugFuncInternal, "ERROR: The string is too big for a WORD conversion");
          return NotOk;
        }
        break;
      
      case Type_Dword:
        if(aUnsignedOutValue > (_pow(2, 32) - 1))
        {
          snprintf(aConversionInformation, elCount(aConversionInformation), "ERROR: The string is too big for a DWORD conversion.");
          if ((byte)DebugFuncInternal & bDebugFlag)
            writeDbgLevel(DebugFuncInternal, "ERROR: The string is too big for a DWORD conversion");
          return NotOk;
        }
        break;
      
      case Type_Qword:
        //no verification of length is required here
        break;
      
      default:
        snprintf(aConversionInformation, elCount(aConversionInformation), "ERROR: This function is used for unsigned data types. Try to use: byte, word, dword or qword.");
        if ((byte)DebugFuncInternal & bDebugFlag)
          writeDbgLevel(DebugFuncInternal, "ERROR: This function is used for signed data types. Try to use: byte, word, dword or qword.");
        return NotOk;
        break;
    }
    
    //The converted value is in the size of the specified data type
    snprintf(aConversionInformation, elCount(aConversionInformation), "SUCCES: The conversion from string to the specified DATA TYPE was succesfully.");
    if ((byte)DebugFuncInternal & bDebugFlag)
      writeDbgLevel(DebugFuncInternal, "SUCCES: The conversion from string to the specified DATA TYPE was succesfully.");
    iResult = Ok;
  }
  
  if ((byte)DebugFuncInternal & bDebugFlag)
    writeDbgLevel(DebugFuncInternal, "bFctn_CONV_ConvertStringToUnsignedDataType() return: %d.", iResult);
  
  return iResult;
}

/*! \fn byte bFctn_CONV_ConvertStringToFloatingNumber(char aInputString[], double& aFloatingPointOutValue, char aConversionInformation[])
*  \brief Function that will convert a string to a floating point number.
*  \param[in]  aInputString                - The string which will be converted.
*  \param[out] aFloatingPointOutValue      - The converted value.
*  \param[out] aConversionInformation      - Extra information regarding the function output.
*
*  \return  1  - The conversion is fine.
*  \return  0  - An error occurred - check aConversionInformation.
*
*  \note  - Data Types that are recommanded to use for this function are the floating point ones: Type_Float and Type_Double.
*         - The input string must have the format: [whitespace][sign][digits][.digits][(d|D|e|E)[sign]digits], where d/D/e/E are exponents
*         - Example: ~"-1.23" is converted to 1.23
*                    ~"2.4E3" is converted to 2400 (2400 = 2.4 * E^3 = 2.4 * 10^3) 
*
* Change History: 
* Date(DD.MM.YY)        Author          Change info                                                          
* 14.08.19              CrJu            Created and implemented
*/

byte bFctn_CONV_ConvertStringToFloatingNumber(char aInputString[], double& aFloatingPointOutValue, char aConversionInformation[])
{
	byte bDebugFlag;
  int iResult;
  
  iResult = 0;
	bDebugFlag = ccCONV_GlobalDebugFlag;
  
  writeDbgLevel (DebugFuncCalls , "Function bFctn_CONVConvertStringToFloatingDataType() called.");
  
  //make the conversion
  iResult = strtod(aInputString, aFloatingPointOutValue);
  
  if(iResult == -1)
  {
    snprintf(aConversionInformation, elCount(aConversionInformation), "ERROR: An overflow occurs.");
    if ((byte)DebugFuncInternal & bDebugFlag)
      writeDbgLevel(DebugFuncInternal, "ERROR: An overflow occurs.");
    iResult = NotOk;
  }
  else if(iResult == -2)
  {
    snprintf(aConversionInformation, elCount(aConversionInformation), "ERROR: The string is empty.");
    if ((byte)DebugFuncInternal & bDebugFlag)
      writeDbgLevel(DebugFuncInternal, "ERROR: The string is empty.");
    iResult = NotOk;
  }
  else if(iResult == 0)
  {
    snprintf(aConversionInformation, elCount(aConversionInformation), "ERROR: Invalid string provided.");
    if ((byte)DebugFuncInternal & bDebugFlag)
      writeDbgLevel(DebugFuncInternal, "ERROR: Invalid array provided.");
    iResult = NotOk;
  }
  else //The conversion was okay
  {
    snprintf(aConversionInformation, elCount(aConversionInformation), "SUCCES: The conversion from string to a floating point number was succesfully. The number is: %10.10f.", aFloatingPointOutValue);
    if ((byte)DebugFuncInternal & bDebugFlag)
      writeDbgLevel(DebugFuncInternal, "SUCCES: The conversion from string to a floating point number was succesfully. The number is: %10.15f.", aFloatingPointOutValue);
    iResult = Ok;
  }
  
  if ((byte)DebugFuncInternal & bDebugFlag)
    writeDbgLevel(DebugFuncInternal, "bFctn_CONV_ConvertStringToFloatingNumber() return: %d.", iResult);
  
  return iResult;
}

/*! \fn dword dwFctn_CONV_FindCharPosInStr( char aInputString[], char aCharToFind, dword aOutBuffer[])
*  \brief Function that will find a char and save his position in an output array.
*  \param[in]  	aInputString     - Requested string
*  \param[in]   aCharToFind      - Charachter to find
*  \param[out]  aOutBuffer       - Array with the position wher the requested char was found in string
*
*  \return  0    - Zero finds in the requested string
*  \return  >0   - Number of finds in the requested string
*
*  Change History: 
*  Date(DD.MM.YY)        Author          Change info                                                          
*  14.08.19              CiCo            Created and implemented.
*/ 

dword dwFctn_CONV_FindCharPosInStr( char aInputString[], char aCharToFind, dword aOutBuffer[])
{
  dword dwInputIndex ;
  dword dwOutIndex;
  byte bDebugFlag;
  
  dwOutIndex = 0;
	bDebugFlag = ccCONV_GlobalDebugFlag;
  
  writeDbgLevel (DebugFuncCalls , "Function dwFcnt_CONV_FindCharPosInStr() called.");

  for(dwInputIndex = 0; dwInputIndex < strlen(aInputString); dwInputIndex++)
  {
    if( aCharToFind == aInputString[ dwInputIndex ])
    {
      aOutBuffer[ dwOutIndex ] = dwInputIndex;
      dwOutIndex++;
    }
  }
  
  if ((byte)DebugFuncInternal & bDebugFlag)
    writeDbgLevel(DebugFuncInternal, "dwFcnt_CONV_FindCharPosInStr() return: %d.", dwOutIndex);
  
  return dwOutIndex;
}

/*! \fn long lFctn_CONV_RemoveCharFromString(char aCharToRemove, char aInputString[], char aOutString[])
*  \brief Function that will parse a string and will removed the desire characther
*  \param[in]  	aCharToRemove     - Character to be removed
*  \param[in]   aInputString      - Input string
*  \param[out]  aOutString        - Output string without the removed character, should not be smallest then the input string
*
*  \return -1   - Output array is small then the input
*  \return >0   - Length of the new string
*
*  Change History: 
*  Date(DD.MM.YY)        Author          Change info                                                          
*  14.08.19              CiCo            Created and implemented.
*/

long lFctn_CONV_RemoveCharFromString(char aCharToRemove, char aInputString[], char aOutString[])
{
	byte bTempByte;
  byte bDebugFlag;
	dword dwIndexInputString, dwIndexOutputString;
  
  dwIndexOutputString = 0;
	bDebugFlag = ccCONV_GlobalDebugFlag;
  
  writeDbgLevel (DebugFuncCalls , "Function lFctn_CONV_RemoveCharFromString() called.");
  
  //Return error due the output size to small
  if( strlen(aInputString) > elcount(aOutString) )
  {
    if ((byte)DebugFuncInternal & bDebugFlag)
      writeDbgLevel(DebugFuncInternal, "ERROR: The output string is too small. It must be higher then: %d.", strlen(aInputString));
    return Error;
  }
  
	for (dwIndexInputString = 0; dwIndexInputString < strlen( aInputString ); dwIndexInputString++)
	{
  	if( (byte) aInputString[dwIndexInputString] != aCharToRemove )
		{
	  	aOutString[ dwIndexOutputString ] = aInputString[ dwIndexInputString ];
			dwIndexOutputString++;
		}
	}
  
  //Terminate output
	aOutString[dwIndexOutputString]='\0';
    
  if ((byte)DebugFuncInternal & bDebugFlag)
    writeDbgLevel(DebugFuncInternal, "lFctn_CONV_RemoveCharFromString() return: %d.", dwIndexOutputString);
  
	return dwIndexOutputString;// return the new size of the output
}

/*! \fn byte bFctn_CONV_ConvertByteArrToWordLength(byte aHexRawData[], enum eWordType aTypeOfConversion, qword& aOutDWord)
*  \brief 	Convert a byte array to a word/dword/qword element.
*  \param[in]  	aHexRawData       - The byte array to convert.
*  \param[in]   aTypeOfConversion - Select the type to convert: Type_Word / Type_Dword / Type_Qword
*  \param[out]  aOutDWord         - The converted element.
*
*  \return  1  - Conversion went fine.
*  \return  0  - An error occured.
*
*  \note  - Data Types that are recommanded to use for this function are the signed ones: Type_Word, Type_Dword, Type_Qword
*         - Example: ~"0xAB 0xCD" is converted to 0xABCD
*                    ~"0x1 0x2" is converted to 0x102
*                    ~"0x1 0x02" is also converted to 0x102
*
*  Change History: 
*  Date(DD.MM.YY)        Author          Change info                                                          
*  17.10.19               CiCo           Created and implemented.
*/ 

byte bFctn_CONV_ConvertByteArrToWordLength(byte aHexRawData[], enum eDataTypes aTypeOfConversion, qword& aOutDWord)
{
  int iBytePos;
  byte bWordlength;
  byte bDebugFlag;
  
  bDebugFlag = ccCONV_GlobalDebugFlag;
  
  writeDbgLevel (DebugFuncCalls , "Function bFctn_CONV_ConvertByteArrToWordLength() called.");
  
  switch(aTypeOfConversion)
  {
    case Type_Word:
      //assign the bWordlength the word length: 2
      bWordlength = 2;
      break;
      
    case Type_Dword:
      //assign the bWordlength the dword length: 4
      bWordlength = 4;
      break;
      
    case Type_Qword:
      //assign the bWordlength the qword length: 8
      bWordlength = 8;
      break;
      
    default:
      if ((byte)DebugFuncInternal & bDebugFlag)
        writeDbgLevel(DebugFuncInternal, "ERROR: Only word/dword/qword data type is allowed on this function.");
      return NotOk;
  }
  
  if ( bWordlength <  elcount(aHexRawData))
  {
    if ((byte)DebugFuncInternal & bDebugFlag)
      writeDbgLevel(DebugFuncInternal, "ERROR: The input byte array should not be greater then the length of the WordTypeLength you want to convert.");
    return NotOk;
  }
  else
  {
    aOutDWord = 0;
    for(iBytePos=0; iBytePos < elcount(aHexRawData) ;iBytePos++)
    {
      aOutDWord = aOutDWord << 8;
      aOutDWord = aOutDWord + aHexRawData[iBytePos];
    }

    if ((byte)DebugFuncInternal & bDebugFlag)
      writeDbgLevel(DebugFuncInternal, "bFctn_CONV_ConvertByteArrToWordLength() return: %d.", Ok);
    
    return Ok;
   }
}

/*! \fn byte bFctn_CONV_ConvertStringToBCD (char aInputString[], byte aBCDOutputArray[], char aConversionInformation[])
*  \brief 	Function that will convert a string to BCD (binary-coded decimal) array.
*  \param[in]  aInputString           - The string which will be converted.
*  \param[out] aBCDOutputArray        - The converted array.
*  \param[out] aConversionInformation - Extra information regarding the function output.
*
*  \return  1  - The conversion is fine.
*  \return  0  - An error occurred - check aConversionInformation.
*
*  \note  - The Input String should not contain illegal characters like: '@$%^'
*         - Example: ~"191" is converted to 000110010001
*                    ~"55" is converted to 01010101
*
* Change History: 
* Date(DD.MM.YY)        Author          Change info                                                          
* 16.12.19              CrJu            Created and implemented
*/

byte bFctn_CONV_ConvertStringToBCD(char aInputString[], byte aBCDOutputArray[], char aConversionInformation[])
{
  byte bLastDigit;
	byte bDebugFlag;
  int iIndex;
  int iAfterIndex;
  int64 i64Result;
  int iSizeOfTheArray;
  byte aBinaryAuxiliarArray[500];
  
  i64Result = 0;
  iIndex = 0;
	bDebugFlag = ccCONV_GlobalDebugFlag;
  
  writeDbgLevel (DebugFuncCalls, "Function bFctn_CONV_ConvertStringToBCD() called.");
  
  if(elCount(aBCDOutputArray) < strlen(aInputString) * 4)
  {
    snprintf(aConversionInformation, elCount(aConversionInformation), "ERROR: The output array is not big enough to sustain the element from the input string. (Must be at least: 4*strlen(aInputString))");
    if ((byte)DebugFuncInternal & bDebugFlag)
      writeDbgLevel(DebugFuncInternal, aConversionInformation); 
    return NotOk;
  }
  
  //Convert the string to a number which is big enough 
  i64Result = _atoi64(aInputString);
  
  if(i64Result == NotOk)
  {
    snprintf(aConversionInformation, elCount(aConversionInformation), "ERROR: The string can’t be converted to a number. It is the largest positive/negative number in case of overflow.");
    if ((byte)DebugFuncInternal & bDebugFlag)
      writeDbgLevel(DebugFuncInternal, aConversionInformation); 
    return NotOk;
  }
  else
  {
    // There are still digits in the number
    while(i64Result > 0)
    {
      // Extract the last digit of the number
      bLastDigit = i64Result % 10;
    
      // If the Digit is bigger than 0 OR the NIBBLE is not full, convert the digit OR add '0' to the nibble
      while((bLastDigit > 0) || (iIndex % 4 != 0))
      {
        // If the digit was already converted and it was smaller than 8(decimal), add '0' until the nibble is full (until iIndex % 4 == 0)
        if(bLastDigit < 0)
        {
          aBinaryAuxiliarArray[iIndex] = 0;
          iIndex++;
        }
        else // Convert the digit to binary and add every bit to the array
        {
          aBinaryAuxiliarArray[iIndex] = bLastDigit % 2;
          bLastDigit = bLastDigit / 2;
          iIndex++;
        }
      }
    
      // Cut the last digit which was already converted
      i64Result = i64Result / 10;
    }
  
    // Save the size of the binary array
    iSizeOfTheArray = iIndex;
  
    // Reorder the output array in order to begin with the first digit
    for(iAfterIndex = 0; iAfterIndex < iSizeOfTheArray; iAfterIndex++)
    {
      aBCDOutputArray[iAfterIndex] = aBinaryAuxiliarArray[iIndex-1];
      iIndex--;
    }
  }
  
  snprintf(aConversionInformation, elCount(aConversionInformation), "SUCCES: No problems occured. The string was converted to a binary array succesfully.");
  if ((byte)DebugFuncInternal & bDebugFlag)
    writeDbgLevel(DebugFuncInternal, aConversionInformation); 
  return Ok;
}

/*! \fn word wFctn_CONV_CopyByteArrayToByteArray(byte aInputArray[], dword aInputStartPos, word aCopiedElements, byte aOutputArray[], dword aOutputStartPos )
*  \brief 	Copies a given number of elements from aInputArray to aOutputArray, given the start position for aInputArray and the aOutputArray.
*  \param[in]  aInputArray      - Source dword array
*  \param[in] aInputStartPos    - Starting position from where to copy
*  \param[in] aOutputStartPos   - Starting position where to copy the InputArray
*  \param[in] aCopiedElements   - How many elements to be copied
*  \param[out] aOutputArray     - Destination dword array
* 
*  \return   0 - Notok, copy action was failed or no bytes were copied
*  \return > 0 - Ok, copy action was succesfully done (number of elements copied).
*
* Change History: 
* Date(DD.MM.YY)        Author          Change info                                                          
*  
*  05.02.20             CrJu            Created and implemented.
*/

word wFctn_CONV_CopyByteArrayToByteArray(byte aInputArray[], dword aInputStartPos, word aCopiedElements, byte aOutputArray[], dword aOutputStartPos )
{
  word wResult;
  byte bDebugFlag;
  dword dwInputPos;

  wResult = NotOk; 
  bDebugFlag = ccCONV_GlobalDebugFlag;
  
  writeDbgLevel(DebugFuncCalls, "Function wFctn_CONV_CopyByteArrayToByteArray() called.");
  
  //Check that start position value is less than the length of input array, the start position plus number of copied elements is less than the length of the input array 
  //and number of copied elements are less the length of output array
  //The start position of the output array to not be bigger than the output array and also, this position + number of elements to copy to be smaller than the output array 
  if ((aInputStartPos <= elCount(aInputArray)) && (aCopiedElements <= elcount(aOutputArray)) && (aInputStartPos + aCopiedElements <= elcount(aInputArray)) 
       && (aOutputStartPos <= elCount(aOutputArray)) && (aOutputStartPos + aCopiedElements <= elCount(aOutputArray)))
  {
    if ( (byte)DebugFuncInternal & bDebugFlag)
	    writeDbgLevel(DebugFuncInternal, "Array with: %d elements provided. Input StartPos: %d, Output StartPos: %d, Number of elements to be copied: %d.", elCount(aInputArray), aInputStartPos, aOutputStartPos, aCopiedElements); 
    
    wResult = 0;
    //Copies the elements from input array
    for (dwInputPos = aInputStartPos; dwInputPos < aInputStartPos + aCopiedElements; dwInputPos++)
    {
      aOutputArray[aOutputStartPos] = aInputArray[dwInputPos];
      //Store the number of elements copied
      wResult++;
      aOutputStartPos++;
    }
    
    if ( (byte)DebugFuncInternal & bDebugFlag)
      writeDbgLevel(DebugFuncInternal, "SUCCESS: Finished processing the array.");
  }
  else
  {
    if ( (byte)DebugFuncInternal & bDebugFlag)
	    writeDbgLevel(DebugFuncInternal, "ERROR in wFctn_CONVByteArrayToByteArray function. Array with: %d elements provided. Input StartPos: %d, Output StartPos: %d, Number of elements to be copied: %d.", elCount(aInputArray), aInputStartPos, aOutputStartPos, aCopiedElements); 
    wResult = NotOk;
  }
  
  if ( (byte)DebugFuncInternal & bDebugFlag)
    writeDbgLevel(DebugFuncInternal, "wFctn_CONVByteArrayToByteArray() return: %d.", wResult);

  return wResult;
}

/*! \fn byte bFctn_CONV_ConvertUnsignedByteToSignedByte(byte aUnsignedByte[], int &aSignedByte)
*  \brief 	Convert an unsigned byte to signed byte, using two's complement method.
*  \param[in]  	aUnsignedByte       - The unsigned byte to convert.
*  \param[in]   aSignedByte         - The converted signed byte.
*
*  \return  1  - Conversion went fine.
*  \return  0  - An error occured due to conversion.
*
*  \note  - If MSB = 1, aSignedByte will be the complement of the aUnsignedByte number in decimal
*         - If MSB = 0, aSignedByte will be the aUnsignedByte number in decimal
*
*         - Only ONE byte can be converted
*
*         - Example: Input: 0xCA -> 1100 1010 (MSB = 1) -> flip bits-> results: 0011 0101 -> add +1 -> results: 0011 0110 ->
*                                -> Convert to Decimal -> results: 54 -> negate result : -54
*     
*  Change History: 
*  Date(DD.MM.YY)        Author          Change info                                                          
*  02.04.2020               CrJu           Created and implemented.
*/

byte bFctn_CONV_ConvertUnsignedByteToSignedByte(byte aUnsignedByte, int &aSignedByte)
{
  int iBitPos;
  byte bDebugFlag;
  byte bConvertToBinary;
  byte bConvertToDecimal;
  byte bUnsignedByteArray[1];
  char chBinaryString[250];
  
  bDebugFlag = ccCONV_GlobalDebugFlag;
  bConvertToBinary = 0;
  aSignedByte = 0;
  bUnsignedByteArray[0] = aUnsignedByte;
  
  writeDbgLevel (DebugFuncCalls , "Function bFctn_CONV_ConvertUnsignedByteToSignedByte() called.");
  
  bConvertToBinary = bFctn_CONV_ByteArrayToSpecificNumberBaseString(bUnsignedByteArray, cc_eCONV_Binary, "", chBinaryString, 1);
  
  if(bConvertToBinary == NotOk)
  {
    if ( (byte)DebugFuncInternal & bDebugFlag)
	    writeDbgLevel(DebugFuncInternal, "Error: The conversion in bFctn_CONV_ByteArrayToSpecificNumberBaseString() failed. Check its error code.");
    return NotOk;
  }
  
  if(strlen(chBinaryString) > 8)
  {
    if ( (byte)DebugFuncInternal & bDebugFlag)
	    writeDbgLevel(DebugFuncInternal, "Error: More than one byte was required to convert.");
    return NotOk;
  }
  
  //Verify the Most Significant Byte
  if(chBinaryString[0] == '1' && strlen(chBinaryString) == 8) // If the most signifcant bit is 1, apply 'two's complement' method
  {
    //Flip the numbers
    for(iBitPos = 0; iBitPos < strlen(chBinaryString); iBitPos++)
    {
      if(chBinaryString[iBitPos] == '1')
      {
        chBinaryString[iBitPos] = '0';
      }
      else
      {
        chBinaryString[iBitPos] = '1';
      }
    }
    
    //Convert to decimal. Only 1 byte required
    for(iBitPos = 0; iBitPos < 8; iBitPos++)
    {
      if(chBinaryString[iBitPos] == '1')
      {
        //make conversion from binarry to decimal
        aSignedByte = aSignedByte + _pow(2, 7 - iBitPos);
      }
      else
      {
        //do nothing when Bit is 0
      }
    }
    
    //To fullfil the conversion, add + 1 and make it negative(because MSB = 1)
    aSignedByte += 1;
    aSignedByte *= -1;
  }
  else
  {
    //Convert to decimal. Only 1 byte required
    for(iBitPos = 0; iBitPos < strlen(chBinaryString); iBitPos++)
    {
      if(chBinaryString[iBitPos] == '1')
      {
        //make conversion from binarry to decimal
        aSignedByte = aSignedByte + _pow(2, iBitPos);
      }
      else
      {
        //do nothing when Bit is 0
      }
    }
  }
  
  if ( (byte)DebugFuncInternal & bDebugFlag)
    writeDbgLevel(DebugFuncInternal, "Success: The conversion went fine. Converted number is: %d.", aSignedByte);
  return Ok;
}

/*! \fn byte bFctn_CONV_ConvertWordLengthToByteArr(qword aInput, enum eDataTypes aTypeOfConversion, byte aHexRawData[])
*  \brief 	Convert a word/dword/qword element to byte array.
*  \param[in]  	aInput              - Input data
*  \param[in]   aTypeOfConversion   - Select the type to convert: Type_Word / Type_Dword / Type_Qword
*  \param[out]  aHexRawData         - The byte array output.
*
*  \return  1  - Conversion went fine.
*  \return  0  - An error occured.
*
*  \note  - Data Types that are recommanded to use for this function are the signed ones: Type_Word, Type_Dword, Type_Qword
*         - Example: ~"0xABCD" is converted to [AB, CD] -> byte(0) is CD ; byte(1) is AB
*
*  Change History: 
*  Date(DD.MM.YY)        Author          Change info                                                          
*  26.08.21               CiCo           Created and implemented.
*/ 
byte bFctn_CONV_ConvertWordLengthToByteArr(qword aInput, enum eDataTypes aTypeOfConversion, byte aHexRawData[])
{
  int iBytePos;
  byte bWordlength;
  byte bDebugFlag;
  
  bDebugFlag = ccCONV_GlobalDebugFlag;
  
  writeDbgLevel (DebugFuncCalls , "Function bFctn_CONV_ConvertWordLengthToByteArr() called.");
  
  switch(aTypeOfConversion){
    case Type_Word:
      //assign the bWordlength the word length: 2
      bWordlength = 2;
      break;
      
    case Type_Dword:
      //assign the bWordlength the dword length: 4
      bWordlength = 4;
      break;
      
    case Type_Qword:
      //assign the bWordlength the qword length: 8
      bWordlength = 8;
      break;
      
    default:
      if ((byte)DebugFuncInternal & bDebugFlag)
        writeDbgLevel(DebugFuncInternal, "ERROR: Only word/dword/qword data type is allowed on this function.");
      return NotOk;
  }
  
  if ( bWordlength >  elcount(aHexRawData)){
    if ((byte)DebugFuncInternal & bDebugFlag)
      writeDbgLevel(DebugFuncInternal, "ERROR: The output byte array should not be greater then the length of the WordTypeLength you want to convert.");
    return NotOk;
  }
  else{
    for(iBytePos=0; iBytePos < bWordlength ;iBytePos++){
      aHexRawData[iBytePos] = aInput & 0xFF;
      aInput = aInput >> 8;
      if ((byte)DebugFuncInternal & bDebugFlag)
        writeDbgLevel(DebugFuncInternal, "bFctn_CONV_ConvertWordLengthToByteArr Conversion-> aInput :%LLX, out: %X , Position: %d", aInput);
        writeDbgLevel(DebugFuncInternal, "bFctn_CONV_ConvertWordLengthToByteArr Conversion-> out: %X , Position: %d", aHexRawData[iBytePos], iBytePos);
    }   
    return Ok;
   }
}

/*! \fn void vFctn_CONV_SetAllQwordArrElemToSpecificVal(qword aInputArray[], qword aValueToBeSet)
*  \brief Function that will set all of the array elements to the specified value.
*  \param[out]  aInputArray     - The qword array which will be modified.
*  \param[in]   aValueToBeSet   - The value which will be set on all of the arrays elements.
*
*  \return No Return.
*
* Change History: 
* Date(DD.MM.YY)        Author          Change info                                                          
* 02.11.21              VaBe            Created and implemented
* 17.01.22              VaBe            Updated after review task https://se-got-jira01.semcon.se/jira/browse/SSM-13543
*/
void vFctn_CONV_SetAllQwordArrElemToSpecificVal(qword aInputArray[], qword aValueToBeSet)
{
  dword dwIndex;
	byte bDebugFlag;
  
	bDebugFlag = ccCONV_GlobalDebugFlag;
  
  writeDbgLevel (DebugFuncCalls , "Function vFctn_CONV_SetAllQwordArrElemToSpecificVal() called.");

  // loop through all of the elements and set the specified value
  for (dwIndex = 0; dwIndex < elcount(aInputArray); dwIndex++)
  {
    aInputArray[dwIndex] = aValueToBeSet;
    if ( (byte)DebugFuncInternal & bDebugFlag)
      writeDbgLevel (DebugFuncInternal, "Set value of aInputArray[%d] = %llX.", dwIndex, aValueToBeSet); 
  }
}

/*! \fn void vFctn_CONV_SetAllDwordArrElemToSpecificVal(dword aInputArray[], dword aValueToBeSet)
*  \brief Function that will set all of the array elements to the specified value.
*  \param[out]  aInputArray     - The dword array which will be modified.
*  \param[in]   aValueToBeSet   - The value which will be set on all of the arrays elements.
*
*  \return No Return.
*
* Change History: 
* Date(DD.MM.YY)        Author          Change info                                                          
* 02.11.21              VaBe            Created and implemented
* 17.01.22              VaBe            Updated after review task https://se-got-jira01.semcon.se/jira/browse/SSM-13543
*/
void vFctn_CONV_SetAllDwordArrElemToSpecificVal(dword aInputArray[], dword aValueToBeSet)
{
  dword dwIndex;
	byte bDebugFlag;
  
	bDebugFlag = ccCONV_GlobalDebugFlag;
  
  writeDbgLevel (DebugFuncCalls , "Function vFctn_CONV_SetAllDwordArrElemToSpecificVal() called.");

  // loop through all of the elements and set the specified value
  for (dwIndex = 0; dwIndex < elcount(aInputArray); dwIndex++)
  {
    aInputArray[dwIndex] = aValueToBeSet;
    if ( (byte)DebugFuncInternal & bDebugFlag)
      writeDbgLevel (DebugFuncInternal, "Set value of aInputArray[%d] = %d.", dwIndex, aValueToBeSet); 
  }
}

/*! \fn void vFctn_CONV_SetAllDoubleArrElemToSpecificVal(double aInputArray[], double aValueToBeSet)
*  \brief Function that will set all of the array elements to the specified value.
*  \param[out]  aInputArray     - The byte array which will be modified.
*  \param[in]   aValueToBeSet   - The value which will be set on all of the arrays elements.
*
*  \return No Return.
*
* Change History: 
* Date(DD.MM.YY)        Author          Change info                                                          
* 04.01.22              VaBe            Created and implemented
* 17.01.22              VaBe            Updated after review task https://se-got-jira01.semcon.se/jira/browse/SSM-13543
*/

void vFctn_CONV_SetAllDoubleArrElemToSpecificVal(double aInputArray[], double aValueToBeSet)
{
  dword dwIndex;
	byte bDebugFlag;
  
	bDebugFlag = ccCONV_GlobalDebugFlag;
  
  writeDbgLevel (DebugFuncCalls , "Function vFctn_CONV_SetAllDoubleArrElemToSpecificVal() called.");

  // loop through all of the elements and set the specified value
  for (dwIndex = 0; dwIndex < elcount(aInputArray); dwIndex++)
  {
    aInputArray[dwIndex] = aValueToBeSet;
    if ( (byte)DebugFuncInternal & bDebugFlag)
      writeDbgLevel (DebugFuncInternal, "Set value of aInputArray[%d] = %d.", dwIndex, aValueToBeSet); 
  }
}

/*! \fn void vFctn_CONV_SetAllFloatArrElemToSpecificVal(float aInputArray[], float aValueToBeSet)
*  \brief Function that will set all of the array elements to the specified value.
*  \param[out]  aInputArray     - The byte array which will be modified.
*  \param[in]   aValueToBeSet   - The value which will be set on all of the arrays elements.
*
*  \return No Return.
*
* Change History: 
* Date(DD.MM.YY)        Author          Change info                                                          
* 04.01.22              VaBe            Created and implemented
* 17.01.22              VaBe            Updated after review task https://se-got-jira01.semcon.se/jira/browse/SSM-13543
*/

void vFctn_CONV_SetAllFloatArrElemToSpecificVal(float aInputArray[], float aValueToBeSet)
{
  dword dwIndex;
	byte bDebugFlag;
  
	bDebugFlag = ccCONV_GlobalDebugFlag;
  
  writeDbgLevel (DebugFuncCalls , "Function vFctn_CONV_SetAllFloatArrElemToSpecificVal() called.");

  // loop through all of the elements and set the specified value
  for (dwIndex = 0; dwIndex < elcount(aInputArray); dwIndex++)
  {
    aInputArray[dwIndex] = aValueToBeSet;
    if ( (byte)DebugFuncInternal & bDebugFlag)
      writeDbgLevel (DebugFuncInternal, "Set value of aInputArray[%d] = %d.", dwIndex, aValueToBeSet); 
  }
}


/*! @}*/
/*! @}*/
/*!
*   \file
*   \ingroup controlLib
*   \brief Library for data conversion (Example: diag request to string).
*/