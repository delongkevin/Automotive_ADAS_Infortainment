/*@!Encoding:1252*/

/*!
* @defgroup cPOWReceive cPOWReceive
* @defgroup POWER POWER
* @ingroup controlLib
* @{
* @addtogroup cPOWReceive
* @{
*/ 


includes
{
  #include "..\..\baseLib\RS232\bRS232Receive.cin"
}

/*! \fn byte bFctn_POW_GetCommand(enum cc_eCommandToSend aCommandToSend, double &aValue, char aMappedResponseInfo[])
*  \brief Function sets and send a specific command to the selected Power Supply, in order to get a response from it
*  \param[in] aCommandToSend       - Commands to send can be: eGetStatus, eGetVoltage, eGetCurrent
*  \param[out] aValue              - Value to compare the status, voltage or current. Format: XX.xx V/A or 1/0 for Status
*  \param[out] aMappedResponseInfo - Extra information regarding the function output (displayed in the test report).
*
*  \return 
* 
* Change History: 
* Date(DD.MM.YY)        Author          Change info                                                          
*   
*  23.06.20              CrJu        Created and implemented
*  01.11.23              CiCo        Fix for the QXP power supply
*/

byte bFctn_POW_GetCommand(enum cc_eCommandToSend aCommandToSend, double &aValue, char aMappedResponseInfo[])
{
  char chCMD[50]; 
  char chAnswer[50];
  char chTerminates[4] = "\r\n";
  char chConversionInformation[250];
  byte bResult;
  byte bDebugFlag;
  
  writeDbgLevel (DebugFuncCalls, "Function bFctn_POW_GetCommand called.");
  if((byte)DebugFuncParam & bDebugFlag)
    writeDbgLevel (DebugFuncParam, "Parameters: Command to send: -- %d --.", aCommandToSend);
  
  bResult = NotOk;
  bDebugFlag = NotOk;
  
  if((byte)DebugFuncInternal & bDebugFlag)
    writeDbgLevel (DebugFuncInternal, "Source Type is %d.", cv_bPOWType);
  
  switch (aCommandToSend){
    case eGetVoltage:
    {
      snprintf(aMappedResponseInfo, elCount(aMappedResponseInfo), "Get Power Supply Voltage.");
      if((byte)DebugFuncInternal & bDebugFlag)
        writeDbgLevel (DebugFuncInternal, aMappedResponseInfo);
      snprintf(chCMD, elCount(chCMD), "%s%s", cv_stGenericCommands.chGetVoltage, chTerminates);
      write("chCMD %s",chCMD);
      break;
    }
    case eGetCurrent:
    {
      snprintf(aMappedResponseInfo, elCount(aMappedResponseInfo), "Get Power Supply Current.");
      if((byte)DebugFuncInternal & bDebugFlag)
        writeDbgLevel (DebugFuncInternal, aMappedResponseInfo);
      snprintf(chCMD, elCount(chCMD), "%s%s", cv_stGenericCommands.chGetCurrent, chTerminates); 
      break;
    }
    case eGetStatus:
    {
      snprintf(aMappedResponseInfo, elCount(aMappedResponseInfo), "Get Power Supply Status.");
      if((byte)DebugFuncInternal & bDebugFlag)
        writeDbgLevel (DebugFuncInternal, aMappedResponseInfo);
      snprintf(chCMD, elCount(chCMD), "%s%s", cv_stGenericCommands.chGetStatus, chTerminates);
      break;
    }
    default:
      snprintf(aMappedResponseInfo, elCount(aMappedResponseInfo), "Request command not set. Invalid request. Only getter requests can be used for this function.");
      if((byte)DebugFuncInternal & bDebugFlag)
        writeDbgLevel (DebugFuncInternal, aMappedResponseInfo);
      return NotOk;
  }
  
  if(Ok == bFctn_RS232OpenPort(cv_bPOWPort, cv_iPOWBaudRate, cv_bPOWDataBits, cv_bPOWStopBits, cv_bPOWParity, cv_iPOWFlowControl))
  {
    if(Ok == bFctn_RS232SendData(cv_bPOWPort, chCMD))
    {
      snprintf(aMappedResponseInfo, elCount(aMappedResponseInfo), "Successfully send data on port: %d.", cv_bPOWPort);
      if((byte)DebugFuncInternal & bDebugFlag)
        writeDbgLevel (DebugFuncInternal, aMappedResponseInfo);
      bResult = Ok;
    }
    else
    {
      snprintf(aMappedResponseInfo, elCount(aMappedResponseInfo), "Failed to send data on port: %d. Check the ini. file to be correct.", cv_bPOWPort);
      if((byte)DebugFuncInternal & bDebugFlag)
        writeDbgLevel (DebugFuncInternal, aMappedResponseInfo);
      return NotOk;
    }
  }
  else
  {
    snprintf(aMappedResponseInfo, elCount(aMappedResponseInfo), "Failed to open port: %d. Check the ini. file to be correct.", cv_bPOWPort);
    if((byte)DebugFuncInternal & bDebugFlag)
      writeDbgLevel (DebugFuncInternal, aMappedResponseInfo);
    return NotOk; 
  }
  
  bResult = bFctn_RS232GetData(cv_bPOWPort, chAnswer);  
 
  if( bResult) // Data from response was extacted succesfully
  {
    //if RS232 Power Supply, convert current or voltage
    if(cv_bPOWType != cc_bTypeSCPI)
    {
      if(eGetStatus != aCommandToSend)
      {
        strncpy(chAnswer, chAnswer, 5);
        aValue = iFctn_ConvertFromFixedFormatToMilli(chAnswer);
        
        //Convert the value from mA or mV to A or V
        aValue = (aValue / 1000);
      }
      else if (strncmp(chAnswer, "OUT ON", strlen("OUT ON")) == 0)
      {
        aValue = 1;
        snprintf(aMappedResponseInfo, elCount(aMappedResponseInfo), "Status of Power Supply is ON.");
      }
      else
      {
        aValue = 0;
        snprintf(aMappedResponseInfo, elCount(aMappedResponseInfo), "Status of Power Supply is OFF.");
      }
    }
    else if(cv_bPOWType == cc_bTypeSCPI) //if SCPI source is used, convert current or voltage
    {
      if(eGetStatus != aCommandToSend)
      {
        bFctn_CONV_ConvertStringToFloatingNumber(chAnswer, aValue, chConversionInformation);
      }
      else if (strncmp(chAnswer, "1", strlen("1")) == 0)
      {
        aValue = 1;
        snprintf(aMappedResponseInfo, elCount(aMappedResponseInfo), "Status of Power Supply is ON.");
      }
      else
      {
        aValue = 0;
        snprintf(aMappedResponseInfo, elCount(aMappedResponseInfo), "Status of Power Supply is OFF.");
      }
    }
  }
  else
  {
    snprintf(aMappedResponseInfo, elCount(aMappedResponseInfo), "The receive has not arrived completely on port: %d.", cv_bPOWPort);
    if((byte)DebugFuncInternal & bDebugFlag)
      writeDbgLevel (DebugFuncInternal, aMappedResponseInfo);
    return NotOk; 
  }
  
  if(bFctn_RS232ClosePort(cv_bPOWPort))
  {
    @sysvar::RS232_SYSVariables::sv_RS232PortStatus = Disable; //Set the flag that the port has been closed
  }
  return bResult;
}


/*! @}*/
/*! @}*/
/*!
*   \file
*   \ingroup controlLib
*   \brief Power Supply functions.
*/
