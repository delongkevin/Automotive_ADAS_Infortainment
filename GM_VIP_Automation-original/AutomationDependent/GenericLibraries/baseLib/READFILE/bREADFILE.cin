/*@!Encoding:1252*/
/*!
* @defgroup bREADFILE bREADFILE
* @defgroup READFILE READFILE
* @ingroup baseLib
* @{
* @addtogroup bREADFILE
* @{
*/ 


includes
{
  #include "bcREADFILE.cin"
}

/*! \fn long lFctn_READFILEiniParameterNumber(char aFilePath[], char aEntry[], char aSection[])
*  \brief Function opens an ini file and reads a number entry.
*  \param[in] aFilePath - file path including root.
*  \param[in] aEntry - entry from ini file to be read.
*  \param[in] aSection - section where entry is found.
*
*  \return -1  - Entry read error.
*  \return lReturn  - Value read from entry.
* 
* Change History: 
* Date(DD.MM.YY)        Author          Change info                                                          
* 02.05.18              SeNi            Created and implemented
* 02.11.18              RoBi            Added a flag and conditions to enable/disable writeDbgLevel() 
*/

long lFctn_READFILEiniParameterNumber(char aFilePath[], char aEntry[], char aSection[])
{
  byte bDebugFlag;
  byte bFileHandle;
  long lReturn;
  
  bDebugFlag = bcREADFILE_GlobalDebugFlag;
  lReturn = bc_eREADFILE_ERR;
  
  writeDbgLevel (DebugFuncCalls, "Function lFctn_READFILEiniParameterNumber called");
  if ( (byte)DebugFuncParam & bDebugFlag)
    writeDbgLevel (DebugFuncParam, "Parameters for function lFctn_READFILEiniParameterNumber: file: %s, entry: %s, section: %s.", aFilePath, aEntry, aSection);  
  
  bFileHandle = openFileRead (aFilePath, 0);//mode = 0, the file is opened in ASCII mode
  
  if ( 0 != bFileHandle )//The file was opened successfuly
  {
    lReturn = getProfileInt(aSection, aEntry, bc_eREADFILE_ERR, aFilePath);
    fileClose (bFileHandle);
    
	  if ( (byte)DebugFuncInternal & bDebugFlag)
	  {
	    writeDbgLevel (DebugFuncInternal, "File %s read with success.", aFilePath);
      writeDbgLevel (DebugFuncInternal, "Return value: %d.", lReturn);
	  }
  }
  else//Unable to open and read the file
	{
	  if ( (byte)DebugFuncInternal & bDebugFlag)
      writeDbgLevel (DebugFuncInternal, "Unable to open and read file %s.", aFilePath);
	}
  
  return lReturn;
}

/*! \fn byte bFctn_READFILEiniParameterString(char aFilePath[], char aEntry[], char aSection[], char aReturn[])
*  \brief Function opens an ini file and reads a string entry.
*  \param[in] aFilePath - file path including root.
*  \param[in] aEntry - entry from ini file to be read.
*  \param[in] aSection - section where entry is found.
*  \param[out] aReturn - string that is read.
*  \return  0 	- Can not open file.
*  \return  1 	- Read was successful.
*  \return  2 	- Entry read error.
* 
* Change History: 
* Date(DD.MM.YY)        Author          Change info                                                          
* 02.05.18              SeNi            Created and implemented
* 02.11.18              RoBi            Added a flag and conditions to enable/disable writeDbgLevel() 
*/

byte bFctn_READFILEiniParameterString(char aFilePath[], char aEntry[], char aSection[], char aReturn[])
{
  byte bDebugFlag;
  byte bFileHandle;
  char chMaxParameterStrLength[256];
    
  bDebugFlag = bcREADFILE_GlobalDebugFlag;
  
  writeDbgLevel (DebugFuncCalls, "Function vFctn_READFILEiniParameterString called");
  if ( (byte)DebugFuncParam & bDebugFlag)
    writeDbgLevel (DebugFuncParam, "Parameters for function vFctn_READFILEiniParameterString: file: %s, entry: %s, section: %s.", aFilePath, aEntry, aSection);  
  
  bFileHandle = openFileRead (aFilePath, 0);//mode = 0, the file is opened in ASCII mode

  if ( 0 != bFileHandle )//The file was opened succesfull
  {
    getProfileString (aSection, aEntry, "", chMaxParameterStrLength, elcount(chMaxParameterStrLength), aFilePath);
    fileClose (bFileHandle);
    //The parameter was read successfully
    if((strlen(chMaxParameterStrLength) != 0 )&&(strlen(chMaxParameterStrLength) < elCount (aReturn)))
    {
      strncpy(aReturn,chMaxParameterStrLength,strlen(chMaxParameterStrLength)+1);
      if ( (byte)DebugFuncInternal & bDebugFlag )
	      writeDbgLevel (DebugFuncInternal, "File %s read with success.", aFilePath);
      return bc_eREADFILE_OK;
    }
    else//No String available
    {
      strncpy(aReturn,chMaxParameterStrLength,strlen(chMaxParameterStrLength)+1);
      if ( (byte)DebugFuncInternal & bDebugFlag )
	      writeDbgLevel (DebugFuncInternal, "No string available. Please review file %s.", aFilePath); 
      return bc_eREADFILE_FILE_NOT_SAVED;
    }
  }
  else//Unable to open and read the file
  {
    if ( (byte)DebugFuncInternal & bDebugFlag )
      writeDbgLevel (DebugFuncInternal, "Unable to open and read file %s.", aFilePath);
    return bc_eREADFILE_NOK;
  }
}

/*! \fn byte bFctn_READFILEiniWriteParameterNumber(char aFilePath[], char aEntry[], char aSection[], long aValue)
*  \brief Function opens an ini file and writes a number entry.
*  \param[in] aFilePath - file path including root.
*  \param[in] aEntry - entry from ini file to be read.
*  \param[in] aSection - section where entry is found.
*  \param[in] aValue - value to be written.
*  \return  0 	- Can not open file.
*  \return  1 	- Write was successful.
*  \return  2 	- Could not save file.
* 
* Change History: 
* Date(DD.MM.YY)        Author          Change info                                                          
* 02.05.18              SeNi            Created and implemented
* 02.11.18              RoBi            Added a flag and conditions to enable/disable writeDbgLevel() 
*/

byte bFctn_READFILEiniWriteParameterNumber(char aFilePath[], char aEntry[], char aSection[], long aValue)
{
  byte bDebugFlag;
  byte bFileHandle;
  char chFileName[64];
  char chWritePath[256];
  long lReturn;
  
  bDebugFlag = bcREADFILE_GlobalDebugFlag;
  lReturn = bc_eREADFILE_ERR;
    
  writeDbgLevel (DebugFuncCalls, "Function vFctn_READFILEiniWriteParameterNumber called");
  if ( (byte)DebugFuncParam & bDebugFlag )
    writeDbgLevel (DebugFuncParam, "Parameters for function vFctn_READFILEiniWriteParameterNumber: file: %s, entry: %s, section: %s and value to write %d.", aFilePath, aEntry, aSection, aValue);  
    
  bFileHandle = openFileRead (aFilePath, 0);//mode = 0, the file is opened in ASCII mode

  if ( 0 != bFileHandle )//The file was opened succesfull
  {
    bFctn_READFILEExtractFileName(aFilePath, chFileName);
    bFctn_READFILEExtractFilePath (aFilePath, chWritePath);
    setWritePath(chWritePath);
    lReturn = writeProfileInt(aSection, aEntry, aValue, chFileName);
    fileClose (bFileHandle);
    if(lReturn != 0)//File was saved successfull
    {
      if ( (byte)DebugFuncInternal & bDebugFlag )
	      writeDbgLevel (DebugFuncInternal, "File %s saved with success.", aFilePath);
      return bc_eREADFILE_OK;
    }
    else//File was not saved successfull
    {
      if ( (byte)DebugFuncInternal & bDebugFlag )
	      writeDbgLevel (DebugFuncInternal, "Unexpected error occured. File %s was not saved.", aFilePath);
      return bc_eREADFILE_FILE_NOT_SAVED;
    }
  }
  else//unable to open and read file
  {
    if ( (byte)DebugFuncInternal & bDebugFlag )
      writeDbgLevel (DebugFuncInternal, "Unable to open and read file %s.", aFilePath);
    return bc_eREADFILE_NOK;
  }
}

/*! \fn byte bFctn_READFILEiniWriteParameterString(char aFilePath[], char aEntry[], char aSection[], char aWrite[])
*  \brief Function opens an ini file and writes a string entry.
*  \param[in] aFilePath - file path including root.
*  \param[in] aEntry - entry from ini file to be read.
*  \param[in] aSection - section where entry is found.
*  \param[in] aWrite - string to write.
*  \return  0 	- Cannot open file.
*  \return  1 	- Write was successful.
*  \return  2 	- Could not save file.
* 
* Change History: 
* Date(DD.MM.YY)        Author          Change info                                                          
* 02.05.18              SeNi            Created and implemented
* 02.11.18              RoBi            Added a flag and conditions to enable/disable writeDbgLevel() 
*/

byte bFctn_READFILEiniWriteParameterString(char aFilePath[], char aEntry[], char aSection[], char aWrite[])
{
  byte bDebugFlag;
  byte bFileHandle;
  char chFileName[64];
  char chWritePath[500];
  long lResult;
  
  bDebugFlag = bcREADFILE_GlobalDebugFlag;
  lResult = bc_eREADFILE_ERR;
    
  writeDbgLevel (DebugFuncCalls, "Function vFctn_READFILEiniWriteParameterString called");
  if ( (byte)DebugFuncParam & bDebugFlag )
    writeDbgLevel (DebugFuncParam, "Parameters for function vFctn_READFILEiniWriteParameterString: file: %s, entry: %s, section: %s and text to write: %s.",aFilePath,aEntry,aSection,aWrite);  

  bFileHandle = openFileRead (aFilePath, 0);//mode = 0, the file is opened in ASCII mode
  
  if ( 0 != bFileHandle )//The file was opened succesfull
  {
    bFctn_READFILEExtractFileName(aFilePath, chFileName);
    bFctn_READFILEExtractFilePath (aFilePath, chWritePath);
    setWritePath(chWritePath);
    lResult = writeProfileString(aSection, aEntry, aWrite, chFileName);
    fileClose (bFileHandle);
    if(lResult != 0)//File was saved successfull
    {
      if ( (byte)DebugFuncInternal & bDebugFlag )
	      writeDbgLevel (DebugFuncInternal, "File %s saved with success.", aFilePath); 
      return bc_eREADFILE_OK;
    }
    else//File was not saved successfull
    {
      if ( (byte)DebugFuncInternal & bDebugFlag )
	      writeDbgLevel (DebugFuncInternal, "Unexpected error occurred. File %s was not saved.", aFilePath);
      return bc_eREADFILE_FILE_NOT_SAVED;
    }
  }
  else//unable to open and read file
  {
    if ( (byte)DebugFuncInternal & bDebugFlag )
      writeDbgLevel (DebugFuncInternal, "Unable to open and read file %s.", aFilePath);
    return bc_eREADFILE_NOK;
  }
}

/*! \fn byte bFctn_READFILEExtractFileName(char aPathIn[], char aFileNameOut[])
*  \brief Function extracts the file name from a path.
*  \param[in] aPathIn - file path including root.
*  \param[out] aFileNameOut - file name.
*
*  \return  0 (bc_eREADFILE_NOK) 	- The file path format is wrong.
*  \return  1 (bc_eREADFILE_OK) 	- The file name was extract succesfully.
*
* Change History: 
* Date(DD.MM.YY)        Author          Change info                                                          
* 10.05.18              SeNi            Created and implemented
* 29.10.18              GrAn            Verify that input parameter is valid
* 02.11.18              RoBi            Added a flag and conditions to enable/disable writeDbgLevel() 
*/

byte bFctn_READFILEExtractFileName(char aPathIn[], char aFileNameOut[])
{
  byte bDebugFlag;
  byte bIndex;
  byte bJndex;
  byte bReturnValue;
 
  bDebugFlag = bcREADFILE_GlobalDebugFlag;
  bJndex = 0;
  bIndex = 0;
  bReturnValue = bc_eREADFILE_NOK;
 
  writeDbgLevel (DebugFuncCalls, "Function bFctn_READFILEExtractFileName called");
  if ( (byte)DebugFuncParam & bDebugFlag )
    writeDbgLevel (DebugFuncParam, "Parameters for function bFctn_READFILEExtractFileName: path of file: %s, file name: %s.", aPathIn, aFileNameOut);  
  
  //if the length of the input array is zero, return an error
  if (0 < strlen (aPathIn))
  {
    for(bIndex=strlen(aPathIn); bIndex > 0; bIndex--)//Search in the string to the first slash char
    {
      if(aPathIn[bIndex] == '\\' )
        break;
    }
  
    if ( (byte)DebugFuncInternal & bDebugFlag )
      writeDbgLevel (DebugFuncInternal, "File name starts at index: %d.", bIndex); 
    
	// The slash char was found
  if( bIndex != 0)
  {
    bIndex++;
  }
	else //The slash char was not found
	{
	  return bc_eREADFILE_NOK;
	}
  
  for( bIndex; bIndex < strlen(aPathIn); bIndex++ )
    aFileNameOut[bJndex++] = aPathIn[bIndex];

  aFileNameOut[bJndex++] = '\0';
    
	if ( (byte)DebugFuncInternal & bDebugFlag )
	  writeDbgLevel (DebugFuncInternal, "File name extracted: %s.", aFileNameOut);
    
    bReturnValue = bc_eREADFILE_OK;
  }
  else
  {
    bReturnValue = bc_eREADFILE_NOK;
  }
  
  return bReturnValue;
}

/*! \fn byte bFctn_READFILEExtractFilePath(char aPathIn[], char aPathOut[])
*  \brief Function extracts the file name from a path.
*  \param[in] aPathIn - file path.
*  \param[out] aPathOut - folder path where file is found.
* 
*  \return  0 (bc_eREADFILE_NOK) 	- The file path format is wrong.
*  \return  1 (bc_eREADFILE_OK) 	- The file path was extract succesfully.
*
* Change History: 
* Date(DD.MM.YY)        Author          Change info                                                          
* 10.05.18              SeNi            Created and implemented
* 29.10.18              GrAn            Verify that input parameter is valid
* 02.11.18              RoBi            Added a flag and conditions to enable/disable writeDbgLevel() 
* 25.10.21              CiCo            Fix by adding end NULL character
*/

byte bFctn_READFILEExtractFilePath (char aPathIn[], char aPathOut[])
{
  byte bDebugFlag;
  byte bIndex;
  byte bJndex; 
  byte bReturnValue;
  
  bDebugFlag = bcREADFILE_GlobalDebugFlag;
  bJndex = 0;
  bIndex = 0;
  bReturnValue = bc_eREADFILE_NOK;
  
  writeDbgLevel (DebugFuncCalls, "Function bFctn_READFILEExtractFilePath called");
  if ( (byte)DebugFuncParam & bDebugFlag )
    writeDbgLevel (DebugFuncParam, "Parameters for function bFctn_READFILEExtractFilePath: path of file: %s, path without file: %s.", aPathIn, aPathOut); 

  //if the length of the input array is zero, return an error
  if( bIndex != strlen (aPathIn))
  {  
    for(bIndex=strlen(aPathIn); bIndex > 0; bIndex--)//Search in the string to the first slash char
    {      
      if(aPathIn[bIndex] == '\\' )
        break;
    }
    
    if ( (byte)DebugFuncInternal & bDebugFlag )
	    writeDbgLevel (DebugFuncInternal, "Folder name is until index: %d.", bIndex); 
    
  	// The slash char was found
    if( bIndex != 0)
  	{    
  	  bIndex++;
    }
  	else // The slash char was not found
  	{
  		return bc_eREADFILE_NOK;
  	}
  
    for( bJndex = 0; bJndex < bIndex; bJndex++ )
      aPathOut[bJndex] = aPathIn[bJndex];
    aPathOut[bJndex] = '\0';// set NULL char for a valid string
    
    bReturnValue = bc_eREADFILE_OK;
  }  
  else
  {
    bReturnValue = bc_eREADFILE_NOK;
  }
  
 return bReturnValue;
}


/*! \fn int lFctn_READFILEStringToByte(char aString[], byte aOut[])
*  \brief Function converts character by character (from the provided string) to HEX ASCII and store the values in the byte array.
*  \param[in] aString - input string.
*  \param[out] aOut - byte conversion from string.
*  \return >0 - The number of bytes used in output (including the terminating "\0")
*  \return -1 - Illegal character (e.g. illegal UTF8 code point). 
*  \return -2 - Insufficient buffer space, output array is too small.
*  \return -3 - Internal error. 
*
* Change History: 
* Date(DD.MM.YY)        Author          Change info                                                          
* 10.05.18              SeNi            Created and implemented
* 22.10.18              RoBi            Update brief description, change return type to long, add test condition for EncodeString(), remove un-used variable and rename function
* 01.11.18              RoBi            Replace non-library specific enum/constants with the direct values, add  enable/disable flag for local writeDbgLevel(), use common global enums.
*/

long lFctn_READFILEStringToByte(char aString[], byte aOut[])
{
  byte bDebugFlag;
  long lSize; 
  long lResult;
  
  bDebugFlag = bcREADFILE_GlobalDebugFlag;
  lSize = 0;
  lResult = bc_eREADFILE_NOK;
 
  writeDbgLevel (DebugFuncCalls, "Function lFctn_READFILEStringToByte called");
  if ( (byte)DebugFuncParam & bDebugFlag )
    writeDbgLevel (DebugFuncParam, "Parameters for function lFctn_READFILEStringToByte: string to be converted: %s, byte out parameter", aString); 
  
  lResult = EncodeString(aOut, lSize, elCount(aOut), aString, 65001); // UTF-8 is CP65001 in Windows
  
  // 0: Success, the byte array output and the resulting length encodedSize are valid.
  if ( 0 == lResult)
  {
    if ( (byte)DebugFuncInternal & bDebugFlag )
	    writeDbgLevel (DebugFuncInternal, "String %s is converted to byte array. Size of byte array is: %d.", aString, elCount(aOut));
	  lResult = lSize; 
  }
  else
  {
	  // return one of the following error codes:
	  // -1: Illegal character (e.g. illegal UTF8 code point). 
	  // -2: Insufficient buffer space, output array is too small. 
	  // -3: Internal error. 
	  if ( (byte)DebugFuncInternal & bDebugFlag )
	    writeDbgLevel(DebugFuncInternal, "Internal error occured: %d.", lResult); 
  }
  
  if ( (byte)DebugFuncInternal & bDebugFlag )
    writeDbgLevel(DebugFuncInternal, "lFctn_READFILEStringToByte() return: %d.", lSize); 
  
  return lResult;
}

/*! \fn void lFctn_READFILEConfigurationPath (char aPathOut[])
*  \brief Function returns configuration path.
*  \param[out] aPathOut - folder path where configuration is found.
*  \return >0 - On success this function returns length of the full path name.
*  \return -1 - Failed to get the length of the full path name.
* 
* Change History: 
* Date(DD.MM.YY)        Author          Change info                                                          
* 10.07.18              SeNi            Created and implemented
* 23.10.18              RoBi            Update return values in description, change return type to long and rename function
* 01.11.18              RoBi            Replace non-library specific enum/constants with the direct values, add  enable/disable flag for local writeDbgLevel(), use common global enums.
*/

long lFctn_READFILEConfigurationPath (char aPathOut[])
{
  byte bDebugFlag;
  long lReturn;
  
  bDebugFlag = bcREADFILE_GlobalDebugFlag;
  lReturn = bc_eREADFILE_NOK;

  writeDbgLevel (DebugFuncCalls, "Function lFctn_READFILEConfigurationPath called");

  if ( (byte)DebugFuncParam & bDebugFlag )
    writeDbgLevel (DebugFuncParam, "Parameters: pathOut is the configuration path that is returned."); 
  
  lReturn = getAbsFilePath("", aPathOut, elCount(aPathOut));
  //write("ini path %s %d",aPathOut,lReturn);
  
  if ( (byte)DebugFuncInternal & bDebugFlag )
    writeDbgLevel (DebugFuncInternal, "Configuration path is: -- %s --.", aPathOut); 
  
  return lReturn;
}

/*! \fn byte bFctn_READFILELastINIused(char aLastINI[])
*  \brief Function returns previous ini file, stored in the Default.ini file, used before stopping simulation.
*  \param[out] aLastINI - Previous ini file used.
*  \return  0 	- Error occured while getting last ini path.
*  \return  1 	- Last ini path successfuly read.
* 
* Change History: 
* Date(DD.MM.YY)        Author          Change info                                                          
* 12.07.18              SeNi            Created and implemented
* 24.10.18              RoBi            Update writeDbgLevel message
* 01.11.18              RoBi            Replace non-library specific enum/constants with the direct values, add  enable/disable flag for local writeDbgLevel(), use common global enums.
*/

byte bFctn_READFILELastINIused(char aLastINI[])
{
  char chConfigurationPath[256];
  int iReturn;
  long lResult;
  byte bDebugFlag;
  
  bDebugFlag = bcREADFILE_GlobalDebugFlag;
  
  writeDbgLevel (DebugFuncCalls, "Function bFctn_READFILELastINIused called");
  if ( (byte)DebugFuncParam & bDebugFlag )
    writeDbgLevel (DebugFuncParam, "Parameters: out parameter char aLastINI[].");  
  
  lResult = lFctn_READFILEConfigurationPath(chConfigurationPath);
  
  if( -1 == lResult ) // absolute path was not identified
  {
    if ( (byte)DebugFuncInternal & bDebugFlag )
	    writeDbgLevel (DebugFuncInternal, "Could not get configuration absolute path.");
    return bc_eREADFILE_NOK;
  }
  
  if ( (byte)DebugFuncInternal & bDebugFlag )
    writeDbgLevel (DebugFuncInternal, "Configuration path: -- %s --.", chConfigurationPath);
  
  strncat(chConfigurationPath, "Default.ini", elcount(chConfigurationPath));
  if ( (byte)DebugFuncInternal & bDebugFlag )
    writeDbgLevel (DebugFuncInternal, "Default.ini file from configuration folder: -- %s --.", chConfigurationPath);
  
  iReturn = bFctn_READFILEiniParameterString(chConfigurationPath, "Last_ini_file", "GENERAL", aLastINI);
  
  if( bc_eREADFILE_OK == iReturn )
  {
    if ( (byte)DebugFuncInternal & bDebugFlag )
	    writeDbgLevel (DebugFuncInternal, "Previous ini file used: -- %s --.", aLastINI);
    return bc_eREADFILE_OK;
  }
  else
  {
    if ( (byte)DebugFuncInternal & bDebugFlag )
	    writeDbgLevel (DebugFuncInternal, "Could not read previous ini file. Check Default.ini file or array size is not large enough.");
    return bc_eREADFILE_NOK;
  }
}


/*! \fn byte bFctn_READFILESaveUsedINI(char aPath[])
*  \brief Function saves ini file used before simulation stop.
*  \param[in] aPath - ini file used in current simulation run.
*  \return  0 	- Error occured while saving current ini path.
*  \return  1 	- Last ini path successfuly saved.
*
* Change History: 
* Date(DD.MM.YY)        Author          Change info                                                          
* 12.07.18              SeNi            Created and implemented
* 25.10.18              RoBi            Update writeDbgLevel message
* 01.11.18              RoBi            Replace non-library specific enum/constants with the direct values, add  enable/disable flag for local writeDbgLevel(), use common global enums.
*/

byte bFctn_READFILESaveUsedINI(char aPath[])
{
  byte bDebugFlag;
  char chConfigurationPath[256];
  long lResult;
  int iReturn;
  
  bDebugFlag = bcREADFILE_GlobalDebugFlag;
  
	writeDbgLevel (DebugFuncCalls, "Function bFctn_READFILESaveUsedINI called");
  if ( (byte)DebugFuncParam & bDebugFlag )
	  writeDbgLevel (DebugFuncParam, "No parameters.");  
  
  lResult = lFctn_READFILEConfigurationPath(chConfigurationPath);
  
  if( -1 == lResult ) // absolute path was not identified
  {
	  if ( (byte)DebugFuncInternal & bDebugFlag )
      writeDbgLevel (DebugFuncInternal, "Could not get configuration absolute path.");
    return bc_eREADFILE_NOK;
  }
  
  strncat(chConfigurationPath, "Default.ini", elcount(chConfigurationPath));
  if ( (byte)DebugFuncInternal & bDebugFlag )
    writeDbgLevel (DebugFuncInternal, "Default.ini file from configuration folder: -- %s --.", chConfigurationPath);
  
  iReturn = bFctn_READFILEiniWriteParameterString(chConfigurationPath, "Last_ini_file", "GENERAL", aPath);
  
  if(bc_eREADFILE_OK == iReturn)
  {
    if ( (byte)DebugFuncInternal & bDebugFlag )
	    writeDbgLevel (DebugFuncInternal, "Successfully saved used ini file.");
    return bc_eREADFILE_OK;
  }
  else
  {
    if ( (byte)DebugFuncInternal & bDebugFlag )
	    writeDbgLevel (DebugFuncInternal, "Could not save used ini file.");
    return bc_eREADFILE_NOK;
  }
}

/*! \fn byte bFctn_READFILEPutStringInAFile(char aFilePath[], char aBuff[], long aWriteStatus, dword &aFileHandle)
*  \brief Function used for writing in a file. (This function overwrite the file.)
*  \param[in]  aFilePath	- File path.
*  \param[in]  aBuff	- String to be written.
*  \param[in] aWriteStatus 		- Report the status of write procedure(1 - write and keep the file opened / 0 - write and close the file)
*  \param[out] aFileHandle 		- The file handler
*
*  \return  cc_eREADFILE_NOK(0)	- An error occured (The path is incorrect / The file can not be opened / Can not write 
*  \return  aFileHandle 	- The handler of the currently file
*
* Change History: 
* Date(DD.MM.YY)        Author          Change info 
  28.11.2018            CrJu            Created and implemented
  12.12.2018            CrJu            Update: added more writeDbgLevel, rename some local variables, changed the type of function (from long to byte), update the doxygen part.
*/

byte bFctn_READFILEPutStringInAFile(char aFilePath[], char aBuff[], long aWriteStatus, dword aFileHandle)
{
  byte bDebugFlag;
  long lReturn;
  
  bDebugFlag = bcREADFILE_GlobalDebugFlag;
  lReturn = bc_eREADFILE_NOK;
  
  writeDbgLevel (DebugFuncCalls, "Function bFctn_READFILEPutStringCSV called");
  if ( (byte)DebugFuncParam & bDebugFlag )
    writeDbgLevel (DebugFuncParam, "Parameters for function bFctn_READFILEPutStringCSV: aFilePath --%s--, aBuff --%s--, aWriteStatus --%d--, aFileHandle --%d-- .", aFilePath, aBuff, aWriteStatus, aFileHandle);  
  
  //write in the file and keep it opened
  if(bc_eREADFILE_OK == aWriteStatus)
  {
    //if the file is closed, open it
    if(0 == aFileHandle)
    {
      aFileHandle = dwFctn_READFILEOpenFileWriteMode(aFilePath, bc_eREADFILE_BINARY);
      
      //return error if the file could not be opened
      if(0 == aFileHandle)
      {
        writeDbgLevel (DebugFuncParam, "The file could not be opened.");
        return bc_eREADFILE_NOK;
      }
    }
    
    //write in the file
    lReturn = lFctn_READFILEWriteInFile(aBuff, aFileHandle);
    
    //if the write is not ok, close the file and return NOK
    if(bc_eREADFILE_NOK == lReturn)
    {
      fileClose(aFileHandle);
      aFileHandle = 0;
      writeDbgLevel (DebugFuncParam, "The writting in the file was not successfully and the file was closed.");
      return bc_eREADFILE_NOK;
    }
    //return the Handler of the file
    return aFileHandle;
  }
  // write in the file and close it
  else if (bc_eREADFILE_NOK == aWriteStatus)
  {
      //if the file is closed, open it
      if(0 == aFileHandle)
      {
        aFileHandle = dwFctn_READFILEOpenFileWriteMode(aFilePath, bc_eREADFILE_BINARY);
      
        //return error if the file could not be opened
        if(0 == aFileHandle)
        {
          writeDbgLevel (DebugFuncParam, "The file could not be opened.");
          return bc_eREADFILE_NOK;
        }
      }
      
      //Write in the file
      lReturn = lFctn_READFILEWriteInFile(aBuff, aFileHandle);
      
      //if the write is not ok, close the file and return NOK
      if(bc_eREADFILE_NOK == lReturn)
      {
        fileClose(aFileHandle);
        aFileHandle = 0;
        writeDbgLevel (DebugFuncParam, "The writting in the file was not successfully, the file was closed.");
        return bc_eREADFILE_NOK;
      }
      
      //Close the file and reset the FileHandle to 0. (return Handler = 0, to know that the file was CLOSED)
      fileClose(aFileHandle);
      aFileHandle = 0;
      return aFileHandle;
  }
  //The aWriteStatus is invalid
  else
  {
    writeDbgLevel (DebugFuncParam, "The WriteStatus is invalid.");
    return bc_eREADFILE_NOK;
  }
}

/*! \fn long lFctn_READFILEWriteInFile(char aBuff[], dword aFileHandle)
*  \brief This function write a string in a specific file, given by a file handler.
*  \param[in]  aBuff       - The text you want to write in the file.
*  \param[in]  aFileHandle - The handler of the file where you want to write.
*
*  \return  cc_eREADFILE_NOK(0)     - An error occured
*  \return  lReturn     - The return of the function. (1 - success, 2 - fail)
*
* Change History: 
* Date(DD.MM.YY)        Author          Change info 
  28.11.2018            CrJu            Created and implemented
  12.12.2018            CrJu            Update: added more writeDbgLevel calls, rename some local variables, update the doxygen part, added more comments.
*/

long lFctn_READFILEWriteInFile(char aBuff[], dword aFileHandle)
{
  long lReturn;
  byte bDebugFlag;
  
  bDebugFlag = bcREADFILE_GlobalDebugFlag;
  
  writeDbgLevel (DebugFuncCalls , "Function lFctn_READFILEWriteInFile called.");
  if ( (byte)DebugFuncParam & bDebugFlag )
    writeDbgLevel (DebugFuncParam, "Parameters: char aBuff[] --%s--, dword aFileHandle --%d--", aBuff, aFileHandle);
  
  //Verify if the file is open
  if (aFileHandle > 0)
  {
    //Write the buffer
    lReturn = filePutString (aBuff, strlen(aBuff), aFileHandle);
    
    //if the last action was succesfully and the string is not containing the \n(new line) add ","     
    if ((bc_eREADFILE_ERR == strstr (aBuff, "\n")) && (bc_eREADFILE_OK == lReturn))
    {
      lReturn = filePutString(",",elcount(","),aFileHandle);
    }
  }
  //Return NOK if the file is not open
  else
  {
    writeDbgLevel (DebugFuncParam, "The file you want to write is not opened.");
    return bc_eREADFILE_NOK;
  }
  
  writeDbgLevel (DebugFuncParam, "The return lFctn_READFILEWriteInFile: %d", lReturn);
  return lReturn;   
}

/*! \fn dword dwFctn_READFILEOpenFileWriteMode(char aFilePath[], enum bc_eREADFILE_WriteMode aWriteMode)
*  \brief This function opens a file for writing in it.
*  \param[in]  aFilePath	- File path.
*  \param[in]  aWriteMode	- The write mode.
*
*  \return  cc_eREADFILE_NOK(0)	- An error occured
*  \return  aFileHandle 	- The handler of the file
*
* Change History: 
* Date(DD.MM.YY)        Author          Change info 
  28.11.2018            CrJu            Created and implemented
  12.12.2018            CrJu            Update: added more writeDbgLevel, rename some local variables, update the doxygen part, added more comments.
*/

dword dwFctn_READFILEOpenFileWriteMode(char aFilePath[], enum bc_eREADFILE_WriteMode aWriteMode)
{
  char chFileName[100];
  char chPathName[260];
  byte bReturnExtractFileName, bReturnExtractFilePath, bDebugFlag;
  dword dwFileHandle;
  
  bDebugFlag = bcREADFILE_GlobalDebugFlag;

  writeDbgLevel (DebugFuncCalls , "Function dwFctn_READFILEOpenFileWriteMode called.");
  if ( (byte)DebugFuncParam & bDebugFlag )
    writeDbgLevel (DebugFuncParam, "Parameters: char aFilePath[] --%s--, enum bc_eREADFILE_WriteMode --%d--", aFilePath, aWriteMode);

  //Read the file name
  bReturnExtractFileName = bFctn_READFILEExtractFileName(aFilePath,chFileName);
  //Read the path name
  bReturnExtractFilePath = bFctn_READFILEExtractFilePath(aFilePath,chPathName);
    
  //If the path is invalid return an error
  if ((bc_eREADFILE_NOK == bReturnExtractFileName) || (bc_eREADFILE_NOK == bReturnExtractFilePath))
  {
    writeDbgLevel (DebugFuncParam, "The file path/name is not valid.");
    return bc_eREADFILE_NOK;
  }
    
  //Sets the write path to the directory
  setWritePath(chPathName);
  
  //Open the file
  dwFileHandle = openFileWrite(chFileName, aWriteMode);
  
  //Verify if the file was opened corectly
  if( 0 != dwFileHandle)
  {
    writeDbgLevel (DebugFuncParam, "The FileHandle for -%s- file is: %d", chFileName, dwFileHandle);
    return dwFileHandle;
  }
  else
  {
    writeDbgLevel (DebugFuncParam, "The return dwFctn_READFILEOpenFileWriteMode: %d", bc_eREADFILE_NOK);
    return bc_eREADFILE_NOK;
  }
}


/*! \fn dword dwFctn_READFILEOpenFileReadMode(char aFilePath[], enum bc_eREADFILE_ReadMode aReadMode)
*  \brief This function opens a file only for reading purpose, in ASCII or BINARY mode.
*  \param[in]  aFilePath  - The absolute file path (example: C:\\Users\\romulus.bita\\Desktop\\FileToBeOpened.txt).
*  \param[in]  aReadMode  - The read mode in which the file is opened (0 - ASCII, 1 - BINARY).
*
*  \return  0             - An error occured, file could not be opened.
*  \return  aFileHandle   - The handler of the file (file has been successfully opened).
*
* Change History: 
* Date(DD.MM.YY)        Author          Change info 
  07.03.2019            RoBi            Created and implemented
*/

dword dwFctn_READFILEOpenFileReadMode(char aFilePath[], enum bc_eREADFILE_ReadMode aReadMode)
{
  char chFileName[100];
  char chPathName[260];
  byte bReturnExtractFileName, bReturnExtractFilePath, bDebugFlag;
  dword dwFileHandle;

  bDebugFlag = bcREADFILE_GlobalDebugFlag;

  writeDbgLevel (DebugFuncCalls , "Function dwFctn_READFILEOpenFileReadMode() called.");
  if ( (byte)DebugFuncParam & bDebugFlag )
    writeDbgLevel (DebugFuncParam, "Parameters: char aFilePath[] --%s--, enum bc_eREADFILE_ReadMode --%d--", aFilePath, aReadMode);

  //Read the file name
  bReturnExtractFileName = bFctn_READFILEExtractFileName(aFilePath, chFileName);
  //Read the path name
  bReturnExtractFilePath = bFctn_READFILEExtractFilePath(aFilePath, chPathName);
    
  //If the path is invalid return an error
  if ((bc_eREADFILE_NOK == bReturnExtractFileName) || (bc_eREADFILE_NOK == bReturnExtractFilePath))
  {
    writeDbgLevel (DebugFuncParam, "The file path/name is not valid.");
    return bc_eREADFILE_NOK;
  }
  
  //Open the file
  dwFileHandle = openFileRead(aFilePath, aReadMode);

  //Verify if the file was opened corectly
  if( 0 != dwFileHandle)
  {
    writeDbgLevel (DebugFuncParam, "The FileHandle for -%s- file is: %d", chFileName, dwFileHandle);
    return dwFileHandle;
  }
  else
  {
    writeDbgLevel (DebugFuncParam, "The return dwFctn_READFILEOpenFileReadMode(): %d", bc_eREADFILE_NOK);
    return bc_eREADFILE_NOK;
  }
}



/*! @}*/
/*! @}*/
/*!
*   \file
*   \ingroup baseLib
*   \brief Library for reading files using CAPL primitve functions.
*/