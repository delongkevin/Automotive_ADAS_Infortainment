/*@!Encoding:1252*/
/*!
* @defgroup bRS232Receive bRS232Receive
* @defgroup RS232 RS232
* @ingroup baseLib
* @{
* @addtogroup bRS232Receive
* @{
*/ 


/*! \fn byte bFctn_RS232GetData(int iPort, char chAnswer[]) 
*  \brief Function gets from buffer data received on RS232
*  \param[in] iPort - port number.
*  \param[out] chAnswer - answer found in buffer of RS232 received data
* 
* Change History: 
* Date(DD.MM.YY)        Author          Change info                                                          
*   
*  15.03.18              SeNi        Used primitive function RS232OnReceive to handle received data on Serial Port
*  15.07.21              CrJu        Added a new sysvar for making a switch between Power Supply and Relay
*/


byte bFctn_RS232GetData(int iPort, char chAnswer[]) 
{
  byte bDebugFlag;
  long lWaitStatus;
  
  bDebugFlag = NotOk;
  
  writeDbgLevel (DebugFuncCalls, "Function bFctn_RS232GetData called");
  writeDbgLevel (DebugFuncParam, "Parameters: port -- %d --",iPort);
  
  lWaitStatus = TestWaitForSignalMatch (sysvar::RS232_SYSVariables::sv_RS232ReceiveStatus, Ok, 2000);//cv_wPOWPSWaitTimeForResponse)
  
  if ( Ok == lWaitStatus )
  {
    @sysvar::RS232_SYSVariables::sv_RS232ReceiveStatus = NotOk;
    
    if(NotOk == @sysvar::RS232_SYSVariables::sv_RS232RelayMode)//Decode received string for PowerSupply
    {
      if (NotOk == DecodeString(chAnswer, elCount(chAnswer), bv_bRS232DataAnswer, elCount(bv_bRS232DataAnswer), 65001))
      {
        if ( (byte)DebugFuncInternal & bDebugFlag)
          writeDbgLevel (DebugFuncInternal, "Data received converted to string variable bv_chRS232Answer.");  
        return Ok;
      }
      else
      {
        if ( (byte)DebugFuncInternal & bDebugFlag)
          writeDbgLevel (DebugFuncInternal, "Unknown data received."); 
        return NotOk;
      }
    }
    else //Decode received string for Relay
    {
      //Convert the byte array received to string(only the first 3 bytes are neccessary)
      if(Ok == bFctn_CONV_ConvertByteArrayToStringByDLC(bv_bRS232DataAnswer, chAnswer, 3))
      {
        @sysvar::RS232_SYSVariables::sv_RS232RelayMode = NotOk;
        if ( (byte)DebugFuncInternal & bDebugFlag)
          writeDbgLevel (DebugFuncInternal, "Data received converted to string variable bv_chRS232Answer.");  
        return Ok;
      }
      else
      {
        @sysvar::RS232_SYSVariables::sv_RS232RelayMode = NotOk;
        if ( (byte)DebugFuncInternal & bDebugFlag)
          writeDbgLevel (DebugFuncInternal, "Unknown data received."); 
        return NotOk;
      }
      
    }
  }
  else
  {
    if ( (byte)DebugFuncInternal & bDebugFlag)
      writeDbgLevel (DebugFuncInternal, "The receive has not arrived completely. Try to increase the time for waiting before sending another command from ini. file: -WaitForCommand-."); 
    return NotOk;
  }
}

/*! \fn RS232OnReceive(int iPort, byte bv_bRS232DataBuffer[], word wNumber)
*  \brief Function is a CAPL Primitive that handles Serial data received on an opened Serial Port
*  \param[in] iPort - port number.
*  \param[in] bv_bRS232DataBuffer - an array of bytes used to receive data on opened Serial Port.
*  \param[in] wNumber - number of bytes that are recieved each time function is called.
* 
* Change History: 
* Date(DD.MM.YY)        Author          Change info                                                          
*   
*  15.03.18              SeNi        Used primitive function RS232OnReceive to handle received data on Serial Port
*  23.07.20              CiCo        bv_iRS232Index reset to 0 when response is received
*  15.07.21              CrJu        Added a new sysvar for making a switch between Power Supply and Relay
*/

RS232OnReceive(int iPort, byte bv_bRS232DataBuffer[], word wNumber)
{
  int iIndex;
  byte bDebugFlag;
  
  bDebugFlag = NotOk;
  writeDbgLevel (DebugFuncCalls, "Function RS232OnReceive called");
  if ( (byte)DebugFuncParam & bDebugFlag)
    writeDbgLevel (DebugFuncParam, "Parameters: int iPort: -- %d --, byte bv_bRS232DataBuffer[], word wNumber -- %d --",iPort, wNumber);  

  if((iPort == bv_iSerialPortListen) && NotOk == @sysvar::RS232_SYSVariables::sv_RS232ReceiveStatus )
  {
    for (iIndex = 0; iIndex < wNumber; iIndex++)
    {
      bv_bRS232DataAnswer[bv_iRS232Index] =  bv_bRS232DataBuffer[iIndex];
      if ( (byte)DebugFuncInternal & bDebugFlag)
        writeDbgLevel (DebugFuncInternal, "Store buffer data received from port: -- %d --. bv_bRS232DataAnswer[%d]: -- %x --.", iPort, bv_iRS232Index, bv_bRS232DataBuffer[iIndex]);
      
      if(NotOk == @sysvar::RS232_SYSVariables::sv_RS232RelayMode)
      {
        //Receive data for Power Supply
        if(bv_bRS232DataAnswer[bv_iRS232Index] == 0x0D)
        {
          bv_iRS232Index = 0;// reset index when response is received
          if ( (byte)DebugFuncInternal & bDebugFlag)
            writeDbgLevel (DebugFuncInternal, "Carriage Return received. Data was received. Data is available in variable bv_bRS232DataAnswer.");
          @sysvar::RS232_SYSVariables::sv_RS232ReceiveStatus = Ok;
          break;
        }
      }
      else
      {
        //Receive data for Relay
        if(bv_iRS232Index == 2)
        {
          //First 3 bytes are enough for a valid response
          @sysvar::RS232_SYSVariables::sv_RS232ReceiveStatus = Ok;
          break;
        }
      }
      bv_iRS232Index++;
    }
  }
}


/*! \fn RS232OnError(dword iPort, dword dwErrorFlags) 
*  \brief Function is a CAPL Primitive that handles Serial data received on an opened Serial Port
*  \param[in] iPort - port number.
*  \param[in] dwErrorFlags - value returned by primitive function.
* 
* Change History: 
* Date(DD.MM.YY)        Author          Change info                                                          
*   
*  15.03.18              SeNi        Used primitive function RS232OnError to handle errors on Serial Port
*/

RS232OnError(int iPort, word wErrorFlags)
{
  write("Error on port -- %d --",iPort);
  if(wErrorFlags == bc_eRS232_ZERO)
    write("Send operation failed.");
  if(wErrorFlags == bc_eRS232_ONE)
    write("Receive operation failed.");
  if(wErrorFlags == bc_eRS232_TWO)
    write("Frame error. May be caused by  parity mismatch or any other frame mismatch (e.g. number of stop bits).");
  if(wErrorFlags == bc_eRS232_THREE)
    write("Frame parity error. Is caused by parity mismatch.");
  if(wErrorFlags == bc_eRS232_FOUR)
    write("Buffer overrun. It is not specified if the driver of the sender cannot send fast enough, if it is up to the receiver which got too much data in too short time or anything else.");
  if(wErrorFlags == bc_eRS232_FIVE)
    write("Buffer overrun at receiver.");
  if(wErrorFlags == bc_eRS232_SIX)
    write("Break state. Other end requested to pause.");
  if(wErrorFlags == bc_eRS232_SEVEN)
    write("Timeout. May be caused by wrongly set too short timeout. See RS232SetHandshake for setting the timeout.");
}

/*! @}*/
/*! @}*/
/*!
*   \file
*   \ingroup baseLib
*   \brief Library for handling RS232 communication using CAPL primitve functions.

*/
