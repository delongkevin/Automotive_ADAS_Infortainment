/*@!Encoding:1252*/
/*!
* @defgroup bvRS232 bvRS232
* @defgroup RS232 RS232
* @ingroup baseLib
* @{
* @addtogroup bvRS232
* @{
*/ 

variables 
{
byte      bv_bRS232DataSend[50];   //used to send data on serial 
char    bv_chRS232[250];
byte    bv_bRS232DataAnswer[50];   //used to store received answer on serial 
byte    bv_bRS232DataBuffer[50];   //used as buffer for incoming serial data
int              bv_iRS232Index;   //used to increment bv_bRS232DataAnswer with each new byte received on serial
byte     bv_bRS232ReceiveStatus;   //used to enable getting data from serial
int        bv_iSerialPortListen;   //used to store information on the according port
}

/*! @}*/
/*! @}*/
/*!
*   \file
*   \ingroup baseLib
*   \brief RS232 base library variables.

*/