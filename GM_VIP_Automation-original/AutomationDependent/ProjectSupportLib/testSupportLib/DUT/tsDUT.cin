/*@!Encoding:1252*/
includes
{
  #include "tscDUT.cin"
  #include "..\..\controlLib\DUT\cDUT.cin"
}

/*!
* @defgroup tsDUT tsDUT
* @defgroup DUT DUT
* @ingroup testSupportLib
* @{
* @addtogroup tsDUT
* @{
*/ 

/*! \fn void A_SSM_Diag_SetEcuDiagTarget()
*  \brief Function that will set diag target based on DUT_TestSupport::DUTSelect::Type sysvar
*
* \note See the definition of DUT_TestSupport::DUTSelect::Type sysvar
*
* Change History: 
* Date(DD.MM.YY)        Author          Change info                                                          
* 19.10.23              CiCo            Created and implemented
*/
void A_DUT_Diag_SetTarget()
{
  char chTempText[500];
  byte bDebugFlag;
  byte bResultAction;
  enum cc_eDUT eDiagTarget;
  // init local variables
  bResultAction = NotOk;
  bDebugFlag = tsc_bDUT_GlobalDebugFlag;

  writeDbgLevel(DebugFuncCalls, "Entered A_DUT_Diag_SetTarget().");
    
  if(  eDUT1 == @DUT_TestSupport::DUTSelect::Type){
    eDiagTarget = eDUT1;
    snprintf(chTempText,elcount(chTempText),"Set ECU diag target to DCU_EQ6H");
  }
  else if( eDUT2 == @DUT_TestSupport::DUTSelect::Type){
    eDiagTarget = eDUT2;
    snprintf(chTempText,elcount(chTempText),"Set ECU diag target to DCU_EQ6L");
  }
  else{
    eDiagTarget = eDUT3;
    snprintf(chTempText,elcount(chTempText),"Set ECU diag target to DCU_EQ6LH");  
  }
  
  bResultAction = bFctn_REPORTAction( chTempText ); // add the action text in the report file  
  if( Ok == bResultAction ){
    if (Ok == bFctn_DUT_Diag_SetTarget(eDiagTarget, chTempText))
      vFctn_REPORTActionEvaluation(chTempText, PASS); 
    else
      vFctn_REPORTActionEvaluation(chTempText, FAIL);
  }
}

/*! \fn void A_DUT_SwitchTarget()
*  \brief Function that will switch target based on DUT_TestSupport::DUTSelect::Type sysvar
*
* \note See the definition of DUT_TestSupport::DUTSelect::Type sysvar
* \note Project will define what are the target DUT
*
* Change History: 
* Date(DD.MM.YY)        Author          Change info                                                          
* 19.10.23              CiCo            Created and implemented
*/
void A_DUT_SwitchTarget(enum cc_eDUT aType)
{
  char chTempText[500];
  char chTarget[20];
  byte bDebugFlag;
  byte bResultAction;
  // init local variables
  bResultAction = NotOk;
  bDebugFlag = tsc_bDUT_GlobalDebugFlag;

  writeDbgLevel(DebugFuncCalls, "Entered A_DUT_SwitchTarget().");
    
  if(  eDUT1 == aType){
    @DUT_TestSupport::DUTSelect::Type = eDUT1;
    snprintf(chTarget,elcount(chTarget),"DCU_EQ6H");
  }
  else if( eDUT2 == aType){
    @DUT_TestSupport::DUTSelect::Type = eDUT2;
    snprintf(chTarget,elcount(chTarget),"DCU_EQ6L");
  }
  else{
    @DUT_TestSupport::DUTSelect::Type = eDUT3;
    snprintf(chTarget,elcount(chTarget),"DCU_EQ6LH");  
  }
  
  snprintf(chTempText,elcount(chTempText),"Switch target to %s", chTarget);
  bResultAction = bFctn_REPORTAction( chTempText ); // add the action text in the report file  
  if( Ok == bResultAction ){
    if (Ok){ // TBD when to fail
      snprintf(chTempText,elcount(chTempText),"Target switched target to %s", chTarget);
      vFctn_REPORTActionEvaluation(chTempText, PASS); 
    }
    else{
      snprintf(chTempText,elcount(chTempText),"FAIL: Unable to switch target to %s", chTarget);
      vFctn_REPORTActionEvaluation(chTempText, FAIL);
    }
  }
}

/*! @}*/
/*! @}*/
/*!
*   \file
*   \ingroup testSupportLib
*   \brief DUT functions with actions and expected
*/