/*@!Encoding:1252*/
/*!
* @defgroup ccDTC ccDTC
* @defgroup DTC DTC
* @ingroup controlLib
* @{
* @addtogroup ccDTC
* @{
*/ 
variables
{
  const byte cc_bDTC_GlobalDebugFlag = 0x01;
  // Constants used by check DTC by Status Mask
  const dword cc_dwMaxOfDTC = 100;
  const byte cc_bDtcStatusMask = 0x09;
}

/*! @}*/
/*! @}*/
/*!
*   \file
*   \ingroup controlLib
*   \brief DTC control library constants
*/