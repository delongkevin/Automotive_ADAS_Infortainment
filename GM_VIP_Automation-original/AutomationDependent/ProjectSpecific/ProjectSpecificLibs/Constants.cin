/*@!Encoding:1252*/
//  ====================================================
//   MAGNA - Constants for DCU_EQ6
//  ====================================================
//
//  File name: DCU_EQ6_Constants.cin
//
//  Created(DD.MM.YYYY): 29.01.2025
//
//  Description: Constants for DCU_EQ6 project
//          
//  References: This file should be included in test modules
//  --------------------------------------------------------------------

variables
{

  // This debug flag will be used to enable/disable the debug messages in all functions of the current module
  // 0x00 - No debug messages displayed (only function calls).
  // 0x01 - Only function call messages displayed (this will always displayed).
  // 0x02 - Function parameter.
  // 0x04 - Internal function actions.
  // 0xFF - All of the above (function calls, function parameters, internal function actions).  
  const byte pc_bGlobalDebugFlag = 0x00;
  // enum used by bFcnt_GEEA_SetSigUBMode
  enum eSigUB { eSigUBOFF = 0, eSigUBON = 3};
  // Sec Access Level
  enum eSecLvL { eSecLvL_1 = 0x1, eSecLvL_3 = 0x5, eSecLvL_17 = 0x21, eSecLvL_26 = 0x33, eSecLvL_61 = 0x79};
  // ECU select

}
 