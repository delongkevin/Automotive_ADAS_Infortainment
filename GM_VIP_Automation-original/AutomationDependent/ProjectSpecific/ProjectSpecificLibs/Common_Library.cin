/*@!Encoding:1252*/
//  ====================================================
//   MAGNA - DCU_EQ6 test function definition
//  ====================================================
//
//  File name: DCU_EQ6_Common_Library.cin
//
//  Created(DD.MM.YYYY): 27.01.2025
//
//  Description: Test function definition for DCU_EQ6 using generic function
//               framework.
//          
//  References: -
//  --------------------------------------------------------------------   
//  --------------------------------------------------------------------
//  GENERAL NOTES
//  --------------------------------------------------------------------  

  
includes
{
  #include "fctn_GenLib.cin"
}

variables
{

}